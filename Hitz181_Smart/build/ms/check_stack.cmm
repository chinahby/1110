global &stack_limit
global &stack_size
global &sname
global &order

Area.Create IO 80. 100.
Area.Select IO
Area IO

print "Checking exception stacks"
gosub exception_stack_check

print
print
print "Checking tasks' stacks"
gosub task_stack_check
print

; Now check current sp in svc mode
&r13_svc=R(R13_SVC)
&rex_curr=v.value(rex_curr_task)
gosub find_stack_details
if ((&r13_svc<&stack_limit)||(&r13_svc>(&stack_limit+&stack_size)))
  (
    BEEP 
    print "Current task's (&sname) SP is out of limit"
  )

; Ask if user wants to view other tasks execution points
  ;Save original register values
  &saved_CPSR=Register(CPSR)
  &saved_R13=Register(R13)
  &saved_R0=Register(R0)
  &saved_R1=Register(R1)
  &saved_R2=Register(R2)
  &saved_R3=Register(R3)
  &saved_R4=Register(R4)
  &saved_R5=Register(R5)
  &saved_R6=Register(R6)
  &saved_R7=Register(R7)
  &saved_R8=Register(R8)
  &saved_R9=Register(R9)
  &saved_R10=Register(R10)
  &saved_R11=Register(R11)
  &saved_R12=Register(R12)
  &saved_R14=Register(R14)
  &saved_PC=Register(PC)

  &order=&order-1
input_entry:

  print
  print
  print "Would you like to view these tasks's execution states?"
  print "0.No, thanks. Just exit!"
  print "(1-" FORMAT.DECIMAL(2., &order) "). Enter order no from above table (Don't forget . for decimal input)"
  print "100. Restore original register values"
  print "  Selection: "
  enter &sel
  if "&sel"=="0"
    goto end_of_exec
  if "&sel"=="100"
  (
    ;Restore original register values
    r.set CPSR &saved_CPSR
    r.set R13 &saved_R13
    r.set R0 &saved_R0
    r.set R1 &saved_R1
    r.set R2 &saved_R2
    r.set R3 &saved_R3
    r.set R4 &saved_R4
    r.set R5 &saved_R5
    r.set R6 &saved_R6
    r.set R7 &saved_R7
    r.set R8 &saved_R8
    r.set R9 &saved_R9
    r.set R10 &saved_R10
    r.set R11 &saved_R11
    r.set R12 &saved_R12
    r.set R14 &saved_R14
    r.set PC &saved_PC
    goto input_entry
  )
  if (&sel>=1)&&(&sel<=&order)
  (
     &task_order_no=1
     &rex_curr=v.value(rex_task_list->link->next_ptr)
     while (&task_order_no!=&sel)
     (
        &rex_curr=v.value(((rex_tcb_type *) &rex_curr)->link->next_ptr)
        &task_order_no=&task_order_no+1
     )
     ; We found the tcb. Now set the registers from this task's stack
     r.set CPSR DATA.LONG(RD:v.value(((rex_tcb_type *) &rex_curr)->sp))
     r.set R13 (v.value(((rex_tcb_type *) &rex_curr)->sp)+0x40)
     r.set R0 DATA.LONG(RD:v.value(((rex_tcb_type *) &rex_curr)->sp+0x4))
     r.set R1 DATA.LONG(RD:v.value(((rex_tcb_type *) &rex_curr)->sp+0x8))
     r.set R2 DATA.LONG(RD:v.value(((rex_tcb_type *) &rex_curr)->sp+0xC))
     r.set R3 DATA.LONG(RD:v.value(((rex_tcb_type *) &rex_curr)->sp+0x10))
     r.set R4 DATA.LONG(RD:v.value(((rex_tcb_type *) &rex_curr)->sp+0x14))
     r.set R5 DATA.LONG(RD:v.value(((rex_tcb_type *) &rex_curr)->sp+0x18))
     r.set R6 DATA.LONG(RD:v.value(((rex_tcb_type *) &rex_curr)->sp+0x1C))
     r.set R7 DATA.LONG(RD:v.value(((rex_tcb_type *) &rex_curr)->sp+0x20))
     r.set R8 DATA.LONG(RD:v.value(((rex_tcb_type *) &rex_curr)->sp+0x24))
     r.set R9 DATA.LONG(RD:v.value(((rex_tcb_type *) &rex_curr)->sp+0x28))
     r.set R10 DATA.LONG(RD:v.value(((rex_tcb_type *) &rex_curr)->sp+0x2C))
     r.set R11 DATA.LONG(RD:v.value(((rex_tcb_type *) &rex_curr)->sp+0x30))
     r.set R12 DATA.LONG(RD:v.value(((rex_tcb_type *) &rex_curr)->sp+0x34))
     r.set R14 DATA.LONG(RD:v.value(((rex_tcb_type *) &rex_curr)->sp+0x38))
     r.set PC DATA.LONG(RD:v.value(((rex_tcb_type *) &rex_curr)->sp+0x3C))
     goto input_entry
  )
  else
     goto input_entry

end_of_exec:
print "DONE!!!"
enddo

exception_stack_check:
  print "Exception Stack Usage"
  print "STACK_SIZE MAX_USED MAX_FREE STACK_NAME"
  gosub get_exc_stack_usage undef_stack
  gosub get_exc_stack_usage sys_stack
  gosub get_exc_stack_usage irq_stack
  gosub get_exc_stack_usage fiq_stack
  gosub get_exc_stack_usage abort_stack
return

get_exc_stack_usage:
  ENTRY &stack_name
  &stack_size=Y.SIZEOF("&stack_name")
  &stack_free=0
  while &stack_free<&stack_size
  (
     &stack_value=DATA.LONG(RD:&stack_name+&stack_free)
     if &stack_value!=0
       goto ext
     &stack_free=&stack_free+4
  )
ext:
  &stack_usage=&stack_size-&stack_free
  if &stack_free<(&stack_size/5)
  (
    BEEP 
    print
  )
  print FORMAT.DECIMAL(10., &stack_size) " " FORMAT.DECIMAL(8., &stack_usage) " " FORMAT.DECIMAL(8., &stack_free) "  &stack_name" 
  return

task_stack_check:
  &rex_curr=v.value(rex_task_list->link->next_ptr)

  print "Task Stack Usage"
  &order=1
  print "ORDER STACK_SIZE CURRENT_USAGE MAX_USED MAX_FREE TASK_NAME"
  while &rex_curr!=0
  (
    local &stack_free

    ;get stack_limit
    gosub find_stack_details
    ; Get the value at the bottom of the stack
    &stack_limit_val=data.long(RD:&stack_limit)
    if (&stack_limit_val!=0xabab)&&(&stack_limit_val!=0x0)
       &stack_free=0
    else
    (
       ; Some tasks have a different value at stack_limit+4. So start from +8
       &tmp=&stack_limit+8
       while &tmp<&stack_limit+&stack_size
       (
         &stack_content=data.long(RD:&tmp)
         if &stack_content!=&stack_limit_val
           goto out
         &tmp=&tmp+4  
       )
out:
       &stack_free=&tmp-&stack_limit
    )
    &stack_usage=&stack_size-&stack_free
    &stack_curr=v.value(((rex_tcb_type *) &rex_curr)->sp)-v.value(((rex_tcb_type *) &rex_curr)->stack_limit)
    &stack_curr=&stack_size-&stack_curr
    if &stack_free<(&stack_size/5)
    (
      BEEP 
      print
    )
    print FORMAT.DECIMAL(5., &order) " " FORMAT.DECIMAL(10., &stack_size) " " FORMAT.DECIMAL(13., &stack_curr) " " FORMAT.DECIMAL(8., &stack_usage) " " FORMAT.DECIMAL(8., &stack_free) "  &sname" 
    &rex_curr=v.value(((rex_tcb_type *) &rex_curr)->link->next_ptr)
    &order=&order+1
  )
  return

find_stack_details:
    ; form the task name
    &task_name=v.value(((rex_tcb_type *) &rex_curr)->task_name)
    &sname=data.string(RD:&task_name)
    &len=STRING.LEN("&sname")
    if (&len>12.)
       &sname=STRING.CUT("&sname", 12.-&len)
    ; get the stack limit
    &stack_limit=v.value(((rex_tcb_type *) &rex_curr)->stack_limit)
    &symbol_name=Y.VARNAME(RD:&stack_limit)
    &arr_pos=STRING.SCAN("&symbol_name", "[", 0)
    if &arr_pos>-1
    (
      &symbol_name=STRING.CUT("&symbol_name", &arr_pos-STRING.LEN("&symbol_name"))
      ; check for weird RealPlayer structures
      &arr_pos=STRING.SCAN("&symbol_name", ".", 0)
      if &arr_pos>-1
      (
        &symbol_name=STRING.CUT("&symbol_name", &arr_pos-STRING.LEN("&symbol_name"))
        ;RealPlayer stack is kept in structure that contains a pointer and a rex_tcb_type
        ; So, subtract them to find the actual size of the stack
        &stack_size=Y.SIZEOF("&symbol_name")-Y.SIZEOF("rex_kernel_tcb")-4
      )  
      else
        &stack_size=Y.SIZEOF("&symbol_name")
    )
    return




