y.create.l HWIO_RX_AGCc_RESET_ADDR  0x90000200
y.create.l HWIO_RX_AGCc_MODE_SEL_ADDR  0x90000204
y.create.l HWIO_RX_AGCc_LGLUT_LVAL_ADDR  0x90000208
y.create.l HWIO_RX_AGCc_LGLUT_HVAL_ADDR  0x9000020c
y.create.l HWIO_RX_AGCc_GAIN_CTL_ADDR  0x90000210
y.create.l HWIO_RX_AGCc_LNA_CTL_ADDR  0x90000214
y.create.l HWIO_RX_AGCc_LNA_DATA_ADDR  0x90000218
y.create.l HWIO_RX_AGCc_VALUE_WR_ADDR  0x9000021c
y.create.l HWIO_RX_AGCc_LNA_FILT_WR_ADDR  0x90000220
y.create.l HWIO_RX_AGCc_DC_GAIN_ADDR  0x90000224
y.create.l HWIO_RX_AGCc_VALUE_n_MIN_ADDR  0x90000228
y.create.l HWIO_RX_AGCc_VALUE_MAX_ADDR  0x90000238
y.create.l HWIO_RX_AGCc_IM_LEVELn_ADDR  0x9000023c
y.create.l HWIO_RX_AGCc_LNA_n_FALL_ADDR  0x9000024c
y.create.l HWIO_RX_AGCc_LNA_n_RISE_ADDR  0x9000025c
y.create.l HWIO_RX_AGCc_LNA_n_OFFSET_ADDR  0x9000026c
y.create.l HWIO_RX_AGCc_LNA_BP_TIMER_n_ADDR  0x9000027c
y.create.l HWIO_RX_AGCc_LNA_NBP_TIMER_n_ADDR  0x9000028c
y.create.l HWIO_RX_AGCc_LNA_RANGE_DELAY_ADDR  0x9000029c
y.create.l HWIO_RX_AGCc_SBI_ID_ADDR  0x900002a4
y.create.l HWIO_RX_AGCc_SBI_ADDR_ADDR  0x900002a8
y.create.l HWIO_RX_AGCc_VREF_DELAY_TIMER_ADDR  0x900002b4
y.create.l HWIO_RX_AGCc_VREF_VAL_ADDR  0x900002b8
y.create.l HWIO_RX_AGCc_TEST_CTL_ADDR  0x900002bc
y.create.l HWIO_RX_AGCc_1X_VALUE_RD_ADDR  0x900002c0
y.create.l HWIO_RX_AGCc_HDR_VALUE_RD_ADDR  0x900002c4
y.create.l HWIO_RX_AGCc_1X_VGA_GAIN_RD_ADDR  0x900002c8
y.create.l HWIO_RX_AGCc_HDR_VGA_GAIN_RD_ADDR  0x900002cc
y.create.l HWIO_RX_AGCc_LNA_FILT_RD_ADDR  0x900002d0
y.create.l HWIO_RX_AGCc_LNA_RANGE_RD_ADDR  0x900002d4
y.create.l HWIO_CDMA_RTC_SYNC_ADDR  0x90000400
y.create.l HWIO_RTC_CNT_1X_ADDR  0x90000404
y.create.l HWIO_RTC_SLEEP_ADDR  0x90000408
y.create.l HWIO_RTC_OFFSET_ADDR  0x9000040c
y.create.l HWIO_RTC_LOAD_ADDR  0x90000410
y.create.l HWIO_RTC_CTL_ADDR  0x90000414
y.create.l HWIO_RTC_GP_COMPARE1_ADDR  0x90000418
y.create.l HWIO_RTC_GP_COMPARE2_ADDR  0x9000041c
y.create.l HWIO_RTC_DIFF_1XHDR_ADDR  0x90000420
y.create.l HWIO_RTC_INT_ENABLE_ADDR  0x90000424
y.create.l HWIO_RTC_INT_CLEAR_ADDR  0x90000428
y.create.l HWIO_RTC_INT_STATUS_ADDR  0x9000042c
y.create.l HWIO_RTC_INT_SELECT_ADDR  0x90000430
y.create.l HWIO_RTC_TTRANS_CTL_1XHDR_ADDR  0x90000434
y.create.l HWIO_RTC_DUMP_STATUS_1XHDR_ADDR  0x90000438
y.create.l HWIO_RTC_TTRANS_TRIG_1X_ADDR  0x9000043c
y.create.l HWIO_RTC_TTRANS_TRIG_HDR_ADDR  0x90000440
y.create.l HWIO_RTC_DUMP_1X_ADDR  0x90000444
y.create.l HWIO_RTC_DUMP_HDR_ADDR  0x90000448
y.create.l HWIO_CDMA_SAMPSRV_n_CTL_ADDR  0x90000600
y.create.l HWIO_CDMA_SAMPSRV_n_MODE_ADDR  0x90000608
y.create.l HWIO_CDMA_SAMPSRV_TEST_RAM_WE_CTL_ADDR  0x90000610
y.create.l HWIO_CDMA_SAMPSRV_TEST_RAM_ADDR_ADDR  0x90000614
y.create.l HWIO_CDMA_SAMPSRV_TEST_RAM_DATA_ADDR  0x90000618
y.create.l HWIO_CDMA_SAMPSRV_n_LATEST_RTC_ADDR  0x9000061c
y.create.l HWIO_CDMA_PNSRV_ROM_BIST_MODE_ADDR  0x90000624
y.create.l HWIO_CDMA_PNSRV_ROM_BIST_CMD_ADDR  0x90000628
y.create.l HWIO_CDMA_PNSRV_ROM_BIST_STATUS_ADDR  0x9000062c
y.create.l HWIO_CDMA_PNSRV_TEST_MODE_ADDR  0x90000630
y.create.l HWIO_CDMA_PNSRV_TEST_MISR_RESET_ADDR  0x90000634
y.create.l HWIO_CDMA_PNSRV_TEST_EXPORT_MISR_ADDR  0x90000638
y.create.l HWIO_CDMA_PNSRV_TEST_MISR_CURR_VAL_ADDR  0x9000063c
y.create.l HWIO_CDMA_SAMPSRV_CLK_DISABLE_ADDR  0x90000640
y.create.l HWIO_CDMA_SAMPSRV_CLK_STATUS_ADDR  0x90000644
y.create.l HWIO_CDMA_SAMPSRV_CTL_SEL_ADDR  0x90000648
y.create.l HWIO_DEM1X_RESET_ADDR  0x90000700
y.create.l HWIO_DEM1X_SYNC_ADDR  0x90000704
y.create.l HWIO_DEM1X_LATCH_ADDR  0x90000708
y.create.l HWIO_DEM1X_TRACKING_ADDR  0x9000070c
y.create.l HWIO_DEM1X_FRAME_OFFSET_ADDR  0x90000710
y.create.l HWIO_DEM1X_FINGER_MERGE_ADDR  0x90000714
y.create.l HWIO_DEM1X_FINGERn_ADDR  0x90000718
y.create.l HWIO_DEM1X_COMBINER_TIME_LOAD_ADDR  0x90000738
y.create.l HWIO_DEM1X_ARM_COMBINER_SLAM_ADDR  0x9000073c
y.create.l HWIO_DEM1X_SLEW_COMBINER_TIME_ADDR  0x90000740
y.create.l HWIO_DEM1X_LC_STATE_LOAD_LO_ADDR  0x90000748
y.create.l HWIO_DEM1X_LC_STATE_LOAD_HI_ADDR  0x9000074c
y.create.l HWIO_DEM1X_ARM_LC_STATE_LOAD_ADDR  0x90000750
y.create.l HWIO_DEM1X_COMBINER_TIME_ADDR  0x90000754
y.create.l HWIO_DEM1X_FRAME_COUNT_ADDR  0x90000758
y.create.l HWIO_DEM1X_LC_STATE_LO_ADDR  0x9000075c
y.create.l HWIO_DEM1X_LC_STATE_HI_ADDR  0x90000760
y.create.l HWIO_DEM1X_TRAFFIC_REV_PWR_CTL_ADDR  0x90000764
y.create.l HWIO_DEM1X_COMMON_REV_PWR_CTL_ADDR  0x90000768
y.create.l HWIO_DEM1X_COMMON_REV_PWR_CTL2_ADDR  0x9000076c
y.create.l HWIO_DEM1X_FWD_PWR_CTL_IMMED_ADDR  0x90000770
y.create.l HWIO_DEM1X_FWD_PWR_CTL_FRAME_ADDR  0x90000774
y.create.l HWIO_DEM1X_FWD_PWR_CTL_TIMING_ADDR  0x90000778
y.create.l HWIO_DEM1X_BETA_TIMING_ADDR  0x9000077c
y.create.l HWIO_DEM1X_TIME_INT1_ENABLE_ADDR  0x90000784
y.create.l HWIO_DEM1X_TIME_INT1_STATUS_ADDR  0x90000788
y.create.l HWIO_DEM1X_TIME_INT1_CLEAR_ADDR  0x9000078c
y.create.l HWIO_DEM1X_TIME_INT2_ENABLE_ADDR  0x90000790
y.create.l HWIO_DEM1X_TIME_INT2_STATUS_ADDR  0x90000794
y.create.l HWIO_DEM1X_TIME_INT2_CLEAR_ADDR  0x90000798
y.create.l HWIO_DEM1X_CHn_LC_MASK_LO_IMMED_ADDR  0x9000079c
y.create.l HWIO_DEM1X_CHn_LC_MASK_HI_IMMED_ADDR  0x900007a0
y.create.l HWIO_DEM1X_CHn_LC_MASK_LO_SPN_ROLL_ADDR  0x900007e4
y.create.l HWIO_DEM1X_CHn_LC_MASK_HI_SPN_ROLL_ADDR  0x900007e8
y.create.l HWIO_DEM1X_COMBINER_CTL_ADDR  0x9000082c
y.create.l HWIO_DEM1X_FW_CH_ENABLE_IMMED_ADDR  0x90000830
y.create.l HWIO_DEM1X_FW_CH_ENABLE_FRAME_ADDR  0x90000834
y.create.l HWIO_DEM1X_CHANNEL0_IMMED_ADDR  0x90000838
y.create.l HWIO_DEM1X_CHANNEL0_FRAME_ADDR  0x9000083c
y.create.l HWIO_DEM1X_CHANNEL1_IMMED_ADDR  0x90000840
y.create.l HWIO_DEM1X_CHANNEL1_FRAME_ADDR  0x90000844
y.create.l HWIO_DEM1X_CHANNEL2_IMMED_ADDR  0x90000848
y.create.l HWIO_DEM1X_CHANNEL2_FRAME_ADDR  0x9000084c
y.create.l HWIO_DEM1X_CHANNEL3_IMMED_ADDR  0x90000850
y.create.l HWIO_DEM1X_CHANNEL3_FRAME_ADDR  0x90000854
y.create.l HWIO_DEM1X_CHANNEL4_IMMED_ADDR  0x90000858
y.create.l HWIO_DEM1X_CHANNEL4_FRAME_ADDR  0x9000085c
y.create.l HWIO_DEM1X_CHANNEL5_IMMED_ADDR  0x90000860
y.create.l HWIO_DEM1X_CHANNEL5_FRAME_ADDR  0x90000864
y.create.l HWIO_DEM1X_CHANNEL6_IMMED_ADDR  0x90000868
y.create.l HWIO_DEM1X_CHANNEL6_FRAME_ADDR  0x9000086c
y.create.l HWIO_DEM1X_CHANNEL8_IMMED_ADDR  0x90000870
y.create.l HWIO_DEM1X_CHANNEL8_FRAME_ADDR  0x90000874
y.create.l HWIO_DEM1X_ACKCH_FINGERn_IMMED_ADDR  0x90000878
y.create.l HWIO_DEM1X_ACKCH_FINGERn_FRAME_ADDR  0x90000890
y.create.l HWIO_DEM1X_RCCH_CTL_ADDR  0x900008a8
y.create.l HWIO_DEM1X_RCCH_CTL2_ADDR  0x900008ac
y.create.l HWIO_DEM1X_SYS_TIME_GP_COMPARE_ADDR  0x900008b0
y.create.l HWIO_DEM1X_OFFLINE_ADDR  0x900008b4
y.create.l HWIO_DEM1X_REF_COUNT_ADDR  0x900008b8
y.create.l HWIO_DEM1X_RTC_ADJUST_ADDR  0x900008bc
y.create.l HWIO_DEM1X_RTF_CTL_SEL_ADDR  0x900008c0
y.create.l HWIO_DEM1X_LPN_ADV_ADDR  0x900008c4
y.create.l HWIO_DEM1X_FINGER_MERGE_F8_ADDR  0x900008c8
y.create.l HWIO_DEM1X_CX8_TEST_MODE_ADDR  0x900008cc
y.create.l HWIO_DEM1X_CX8_TEST_MISR_RESET_ADDR  0x900008d0
y.create.l HWIO_DEM1X_CX8_TEST_EXPORT_MISR_ADDR  0x900008d4
y.create.l HWIO_DEM1X_CX8_TEST_CAPTURED_ADDR  0x900008d8
y.create.l HWIO_DEM1X_CX8_TEST_MISR_CURR_VAL_ADDR  0x900008dc
y.create.l HWIO_DEM1X_CX8_TEST_MISR_CAPT_VAL_ADDR  0x900008e0
y.create.l HWIO_DEM1X_MICRO_CX8_CLK_CTL_ADDR  0x900008e4
y.create.l HWIO_DEM1X_CX8_CLK_STATUS_ADDR  0x900008e8
y.create.l HWIO_DEM1X_RXCX8_SPARE_READ_REG0_ADDR  0x900008ec
y.create.l HWIO_DEM1X_RXCX8_SPARE_READ_REG1_ADDR  0x900008f0
y.create.l HWIO_DEM1X_RXCX8_SPARE_READ_REG2_ADDR  0x900008f4
y.create.l HWIO_DEM1X_RXCX8_SPARE_READ_REG3_ADDR  0x900008f8
y.create.l HWIO_DEM1X_RXCX8WR_SPARE_READ_REG0_ADDR  0x900008fc
y.create.l HWIO_DEM1X_Fn_PILOT_IMMED_ADDR  0x90000900
y.create.l HWIO_DEM1X_Fn_DIVERSITY_IMMED_ADDR  0x90000904
y.create.l HWIO_DEM1X_Fn_WALSH_ACCm_IMMED_ADDR  0x90000908
y.create.l HWIO_DEM1X_Fn_WALSH_ACCm_FRAME_ADDR  0x90000d08
y.create.l HWIO_DEM1X_Fn_HW_CH1_IMMED_ADDR  0x90000940
y.create.l HWIO_DEM1X_Fn_HW_CH1_FRAME_ADDR  0x90000d40
y.create.l HWIO_DEM1X_Fn_HW_CH2_IMMED_ADDR  0x90000944
y.create.l HWIO_DEM1X_Fn_HW_CH2_FRAME_ADDR  0x90000d44
y.create.l HWIO_DEM1X_Fn_HW_CH3_IMMED_ADDR  0x90000948
y.create.l HWIO_DEM1X_Fn_HW_CH3_FRAME_ADDR  0x90000d48
y.create.l HWIO_DEM1X_Fa_WALSH_ACCb_IMMED_ADDR  0x90000914
y.create.l HWIO_DEM1X_Fa_WALSH_ACCb_FRAME_ADDR  0x90000d14
y.create.l HWIO_DEM1X_Fn_HW_CH4_IMMED_ADDR  0x9000096c
y.create.l HWIO_DEM1X_Fn_HW_CH4_FRAME_ADDR  0x90000d6c
y.create.l HWIO_DEM1X_Fn_HW_CH5_IMMED_ADDR  0x90000970
y.create.l HWIO_DEM1X_Fn_HW_CH5_FRAME_ADDR  0x90000d70
y.create.l HWIO_DEM1X_FFE_TEST_ADDR  0x90000ca0
y.create.l HWIO_DEM1X_FFE_TEST_MODE_ADDR  0x90000ca4
y.create.l HWIO_DEM1X_FFE_TEST_MISR_RESET_ADDR  0x90000ca8
y.create.l HWIO_DEM1X_FFE_TEST_EXPORT_MISR_ADDR  0x90000cac
y.create.l HWIO_DEM1X_FFE_TEST_CAPTURED_ADDR  0x90000cb0
y.create.l HWIO_DEM1X_FFE_TEST_MISR_CURR_VAL_ADDR  0x90000cb4
y.create.l HWIO_DEM1X_FFE_TEST_MISR_CAPT_VAL_ADDR  0x90000cb8
y.create.l HWIO_DEM1X_TEST_MEM_SEL_ADDR  0x90000cbc
y.create.l HWIO_DEM1X_TEST_MEM_ADDR_ADDR  0x90000cc0
y.create.l HWIO_DEM1X_TEST_MEM_WRITE_ADDR  0x90000cc4
y.create.l HWIO_DEM1X_TEST_MEM_READ0_ADDR  0x90000cc8
y.create.l HWIO_DEM1X_HW_OFFLINE_CLK_CTL_ADDR  0x90000ccc
y.create.l HWIO_DEM1X_MICRO_OFFLINE_CLK_CTL_ADDR  0x90000cd0
y.create.l HWIO_DEM1X_OFFLINE_CLK_STATUS_ADDR  0x90000cd4
y.create.l HWIO_DEM1X_OFFLINE_SPARE_READ_REG0_ADDR  0x90000cd8
y.create.l HWIO_DEM1X_OFFLINE_SPARE_READ_REG1_ADDR  0x90000cdc
y.create.l HWIO_DEM1X_FFE_CONFIG_SPARE_READ_REG0_ADDR  0x90000ce0
y.create.l HWIO_DEM1X_FFE_RESULTS_SPARE_READ_REG0_ADDR  0x90000ce4
y.create.l HWIO_DEM1X_FFE_ENGINE_SPARE_READ_REG0_ADDR  0x90000ce8
y.create.l HWIO_DEM1X_FFE_ENGINE_SPARE_READ_REG1_ADDR  0x90000cec
y.create.l HWIO_TD_RESET_ADDR  0x90001100
y.create.l HWIO_TD_ENERGY_METRIC_ADDR  0x90001104
y.create.l HWIO_TD_STATUS_ADDR  0x90001108
y.create.l HWIO_TD_TEST_MEM_SEL_ADDR  0x9000110c
y.create.l HWIO_TD_TEST_MEM_ADDR_ADDR  0x90001110
y.create.l HWIO_TD_TEST_MEM_WRITE_ADDR  0x90001114
y.create.l HWIO_TD_TEST_MEM_READ0_ADDR  0x9000111c
y.create.l HWIO_TD_TEST_MEM_READ1_ADDR  0x90001120
y.create.l HWIO_TD_TEST_MEM_READ2_ADDR  0x90001124
y.create.l HWIO_TD_TEST_MEM_DIN_ADDR  0x90001128
y.create.l HWIO_HDR_DDI_CTL_ADDR  0x9000112c
y.create.l HWIO_HDR_DDI_HOST_ADDR  0x90001130
y.create.l HWIO_TD_HW_CLK_CTL_ADDR  0x90001134
y.create.l HWIO_TD_MICRO_CLK_CTL_ADDR  0x90001138
y.create.l HWIO_TD_CLK_STATUS_ADDR  0x9000113c
y.create.l HWIO_TD_MISC_CTL_ADDR  0x90001140
y.create.l HWIO_TD_ONE_FIFTH_TAIL_PATTERN_ADDR  0x90001144
y.create.l HWIO_TD_TAIL_CFG_ADDR  0x90001148
y.create.l HWIO_TD_MODE_CTL_ADDR  0x9000114c
y.create.l HWIO_VD_RESET_ADDR  0x90001200
y.create.l HWIO_VD_MODE_ADDR  0x90001204
y.create.l HWIO_VD_POLY2IJ_ADDR  0x90001208
y.create.l HWIO_VD_POLY3IJ_ADDR  0x9000120c
y.create.l HWIO_VD_POLY3K_ADDR  0x90001210
y.create.l HWIO_VD_POLY4IJ_ADDR  0x90001214
y.create.l HWIO_VD_POLY4KL_ADDR  0x90001218
y.create.l HWIO_VD_TESTCON_ADDR  0x9000121c
y.create.l HWIO_VD_TESTOUT_ADDR  0x90001220
y.create.l HWIO_VD_TEST_MEM_SEL_ADDR  0x90001224
y.create.l HWIO_VD_TEST_MEM_ADDR_ADDR  0x90001228
y.create.l HWIO_VD_TEST_MEM_WRITE_ADDR  0x9000122c
y.create.l HWIO_VD_TEST_MEM_READ0_ADDR  0x90001230
y.create.l HWIO_VD_TEST_MEM_READ1_ADDR  0x90001234
y.create.l HWIO_VD_TEST_MEM_DIN_ADDR  0x90001238
y.create.l HWIO_VD_HW_CLK_CTL_ADDR  0x9000123c
y.create.l HWIO_VD_MICRO_CLK_CTL_ADDR  0x90001240
y.create.l HWIO_VD_CLK_STATUS_ADDR  0x90001244
y.create.l HWIO_VD_SPARE_READ_REG0_ADDR  0x90001248
y.create.l HWIO_DECOB_RESET_ADDR  0x90001300
y.create.l HWIO_DECOB_BURST_IF_ACCESS_ADDR  0x90001304
y.create.l HWIO_DECOB_LONG_BUFFER_ADDR_ADDR  0x90001308
y.create.l HWIO_DECOB_LONG_BUFFER_DATA_ADDR  0x9000130c
y.create.l HWIO_DECOB_SHORT_BUFFER_ADDR_ADDR  0x90001310
y.create.l HWIO_DECOB_SHORT_BUFFER_DATA_ADDR  0x90001314
y.create.l HWIO_DECOB_LONG_BUFFER_HUNT_CHAR_ADDR  0x90001320
y.create.l HWIO_DECOB_LONG_BUFFER_DEBUG_WR_ADDR_ADDR  0x90001330
y.create.l HWIO_DECOB_LONG_BUFFER_DEBUG_RD_ADDR_ADDR  0x90001334
y.create.l HWIO_DECOB_PDCCH_0_DATA_RDm_ADDR  0x90001340
y.create.l HWIO_DECOB_PDCCH_1_DATA_RDm_ADDR  0x9000134c
y.create.l HWIO_DECOB_PDCCH_0_STATUS_RDm_ADDR  0x90001358
y.create.l HWIO_DECOB_PDCCH_1_STATUS_RDm_ADDR  0x90001364
y.create.l HWIO_DECOB_GCH_m_DATA_RD_ADDR  0x90001370
y.create.l HWIO_DECOB_GCH_m_STATUS_RD_ADDR  0x90001378
y.create.l HWIO_DECOB_TEST_CTL_ADDR  0x90001380
y.create.l HWIO_DECOB_HW_CLK_CTL_ADDR  0x90001384
y.create.l HWIO_DECOB_MICRO_CLK_CTL_ADDR  0x90001388
y.create.l HWIO_DECOB_CLK_STATUS_ADDR  0x9000138c
y.create.l HWIO_DECOB_CLK_SPARE_READ_REG0_ADDR  0x90001390
y.create.l HWIO_MOD_MODE_ADDR  0x90001400
y.create.l HWIO_MOD_RESET_ADDR  0x90001404
y.create.l HWIO_I_PN_STATE_w_ADDR  0x90001408
y.create.l HWIO_Q_PN_STATE_w_ADDR  0x90001410
y.create.l HWIO_U_PN_STATE_0_ADDR  0x90001418
y.create.l HWIO_U_PN_STATE_1_ADDR  0x9000141c
y.create.l HWIO_U_PN_STATE_2_ADDR  0x90001420
y.create.l HWIO_U_PN_STATE_3_ADDR  0x90001424
y.create.l HWIO_U_PN_STATE_4_ADDR  0x90001428
y.create.l HWIO_U_PN_STATE_5_ADDR  0x9000142c
y.create.l HWIO_U_PN_MASK_w_ADDR  0x90001430
y.create.l HWIO_FRAME_OFF_ADDR  0x90001448
y.create.l HWIO_MOD_STMR_MODIFIER_0_ADDR  0x9000144c
y.create.l HWIO_MOD_STMR_MODIFIER_1_ADDR  0x90001450
y.create.l HWIO_MOD_STMR_CMD_ADDR  0x90001454
y.create.l HWIO_TX_PCG_INT_ENABLE_ADDR  0x90001458
y.create.l HWIO_TX_PCG_INT_CLEAR_ADDR  0x9000145c
y.create.l HWIO_TX_PCG_INT_STATUS_ADDR  0x90001460
y.create.l HWIO_MOD_TX_TIME_LATCH_ADDR  0x900014e8
y.create.l HWIO_MOD_TX_TIME_RD_ADDR  0x900014ec
y.create.l HWIO_MOD_CH1_TIMING_CTL_ADDR  0x90001464
y.create.l HWIO_MOD_CH2_TIMING_CTL_ADDR  0x90001468
y.create.l HWIO_MOD_CH3_TIMING_CTL_ADDR  0x9000146c
y.create.l HWIO_MOD_WCOVER_SEL_ADDR  0x90001470
y.create.l HWIO_MOD_CH1_ENC_CTL_ADDR  0x90001474
y.create.l HWIO_MOD_CH1_CRC_POLY_ADDR  0x90001478
y.create.l HWIO_MOD_CH1_PUNCT_PATN_1_ADDR  0x9000147c
y.create.l HWIO_MOD_CH1_PUNCT_PATN_0_ADDR  0x90001480
y.create.l HWIO_MOD_CH2_ENC_CTL_0_ADDR  0x90001484
y.create.l HWIO_MOD_CH2_ENC_CTL_1_ADDR  0x90001488
y.create.l HWIO_MOD_CH2_CRC_POLY_ADDR  0x9000148c
y.create.l HWIO_MOD_CH2_PUNCT_PATN_1_ADDR  0x90001490
y.create.l HWIO_MOD_CH2_PUNCT_PATN_0_ADDR  0x90001494
y.create.l HWIO_MOD_CH3_ENC_CTL_0_ADDR  0x90001498
y.create.l HWIO_MOD_CH3_ENC_CTL_1_ADDR  0x9000149c
y.create.l HWIO_MOD_CH3_CRC_POLY_ADDR  0x900014a0
y.create.l HWIO_MOD_CH3_PUNCT_PATN_1_ADDR  0x900014a4
y.create.l HWIO_MOD_CH3_PUNCT_PATN_0_ADDR  0x900014a8
y.create.l HWIO_MOD_SCH_LTU_CTL_ADDR  0x900014ac
y.create.l HWIO_MOD_MISC_CTL_ADDR  0x900014b0
y.create.l HWIO_MOD_ROTATOR_MAP_ADDR  0x900014b4
y.create.l HWIO_MOD_WSYM_STATE_ADDR  0x900014b8
y.create.l HWIO_TX_VERY_EARLY_FRAME_CTL_ADDR  0x900014bc
y.create.l HWIO_TX_2_EARLY_PCG_CTL_ADDR  0x900014c0
y.create.l HWIO_MOD_PICH_PCBIT_DATA_ADDR  0x900014c4
y.create.l HWIO_MOD_PICH_PCBIT_MASK_ADDR  0x900014c8
y.create.l HWIO_MOD_STATUS_ADDR  0x900014cc
y.create.l HWIO_MASK_DATA_ADDR  0x900014d0
y.create.l HWIO_PA_PUNCT_FRAME_DIS_ADDR  0x900014d4
y.create.l HWIO_PA_WARMUP_ADDR  0x900014d8
y.create.l HWIO_TX_WARMUP_ADDR  0x900014dc
y.create.l HWIO_MOD_TEST_CTL_ADDR  0x900014f0
y.create.l HWIO_TX_I_CLK_ADDR  0x900014f4
y.create.l HWIO_MOD_CLK_CTL_ADDR  0x900014f8
y.create.l HWIO_TX_DATA_TEST_ADDR  0x900014fc
y.create.l HWIO_TX_Q_DATA_TEST_ADDR  0x90001500
y.create.l HWIO_MOD_TEST_POINT_SEL_ADDR  0x90001504
y.create.l HWIO_MOD_TEST_POINT_DIN_ADDR  0x90001508
y.create.l HWIO_MOD_TEST_MISR_RESET_ADDR  0x9000150c
y.create.l HWIO_MOD_TEST_MODE_ADDR  0x90001510
y.create.l HWIO_MOD_TEST_EXPORT_MISR_ADDR  0x90001514
y.create.l HWIO_MOD_TEST_MISR_EN_ADDR  0x90001518
y.create.l HWIO_MOD_TEST_MISR_CTL_ADDR  0x9000151c
y.create.l HWIO_MOD_TEST_MISR_DLY_ADDR  0x90001520
y.create.l HWIO_MOD_TEST_CURR_MISR_VAL_ADDR  0x90001524
y.create.l HWIO_MOD_PDCH_TIMING_CTL_ADDR  0x90001550
y.create.l HWIO_MOD_PDCH_CTL_ADDR  0x90001554
y.create.l HWIO_MOD_PDCCH_CTL_ADDR  0x90001570
y.create.l HWIO_MOD_SPICH_CTL_ADDR  0x90001574
y.create.l HWIO_MOD_VAR_GAIN_SHIFT_DLY_ADDR  0x90001578
y.create.l HWIO_REVMOD_PN_LONG_STATE_w_ADDR  0x90001580
y.create.l HWIO_REVMOD_PN_I_LONG_MASK_w_ADDR  0x9000158c
y.create.l HWIO_REVMOD_PN_Q_LONG_MASK_w_ADDR  0x90001598
y.create.l HWIO_REVMOD_PN_CTL_ADDR  0x900015a4
y.create.l HWIO_REVMOD_FRAME_OFFSET_ADDR  0x900015a8
y.create.l HWIO_REVMOD_TIME_STAMP_CTL_ADDR  0x900015ac
y.create.l HWIO_REVMOD_TIME_STAMP_ADDR  0x900015b0
y.create.l HWIO_REVMOD_TIME_STAMP2_ADDR  0x900015b4
y.create.l HWIO_REVMOD_FRM_CNT_OFFSET_ADDR  0x900015b8
y.create.l HWIO_REVMOD_FRM_CNT_OFFSET_CTL_ADDR  0x900015bc
y.create.l HWIO_REVMOD_TX_TIME_LATCH_ADDR  0x900015c0
y.create.l HWIO_REVMOD_TX_TIME_RD_ADDR  0x900015c4
y.create.l HWIO_REVMOD_FRAME_INT_OFFSET_ADDR  0x900015c8
y.create.l HWIO_REVMOD_ENC_RATE_ADDR  0x900015cc
y.create.l HWIO_REVMOD_EDI_CONTROL_ADDR  0x900015d0
y.create.l HWIO_REVMOD_TENC_CTL_ADDR  0x900015d4
y.create.l HWIO_REVMOD_TENC_STATUS_ADDR  0x900015d8
y.create.l HWIO_REVMOD_INBUF_STATUS_ADDR  0x900015dc
y.create.l HWIO_REVMOD_OUTBUF_STATUS_ADDR  0x900015e0
y.create.l HWIO_REVMOD_RRI_REQUEST_ADDR  0x900015e4
y.create.l HWIO_REVMOD_MOD_CTL_ADDR  0x900015e8
y.create.l HWIO_REVMOD_ENC_MODE_ADDR  0x900015ec
y.create.l HWIO_REVMOD_PA_CTL_ADDR  0x900015f0
y.create.l HWIO_REVMOD_PA_WARMUP_ADDR  0x900015f4
y.create.l HWIO_REVMOD_TX_WARMUP_ADDR  0x900015f8
y.create.l HWIO_TX_AGC_CTL_ADDR  0x90001620
y.create.l HWIO_TX_AGC_CTL2_ADDR  0x90001624
y.create.l HWIO_TX_AGC_RESET_ADDR  0x90001628
y.create.l HWIO_AGC_TEST_CTL_ADDR  0x9000162c
y.create.l HWIO_AGC_TX_MASK_DATA_SEL_ADDR  0x90001630
y.create.l HWIO_AGC_TX_RCCCH_FRAME_DELAY_ADDR  0x90001634
y.create.l HWIO_PA_R_MAP_ADDR  0x90001638
y.create.l HWIO_PA_R_TIMER_ADDR  0x9000163c
y.create.l HWIO_PA_R1_FALL_ADDR  0x90001640
y.create.l HWIO_PA_R1_RISE_ADDR  0x90001644
y.create.l HWIO_PA_R2_FALL_ADDR  0x90001648
y.create.l HWIO_PA_R2_RISE_ADDR  0x9000164c
y.create.l HWIO_PA_R3_FALL_ADDR  0x90001650
y.create.l HWIO_PA_R3_RISE_ADDR  0x90001654
y.create.l HWIO_PA_Sw_OFFSET_ADDR  0x90001658
y.create.l HWIO_PA_WARMUP_TIMER_ADDR  0x90001668
y.create.l HWIO_RAS_RAM_WR_ADDR_RESET_ADDR  0x9000166c
y.create.l HWIO_RAS_RAM_DATA_ADDR  0x90001670
y.create.l HWIO_SUBPCG_PA_WARMUP_DELAY_ADDR  0x90001674
y.create.l HWIO_TX_ALIGN_DELAY_ADDR  0x90001678
y.create.l HWIO_TX_ATTEN_LIMIT_WR_ADDR  0x9000167c
y.create.l HWIO_TX_GAIN_ADJ_WR_ADDR  0x90001680
y.create.l HWIO_TX_GAIN_LIMIT_WR_ADDR  0x90001684
y.create.l HWIO_TX_GAIN_CTL_LATCH_ADDR  0x90001688
y.create.l HWIO_TX_OPEN_LOOP_WR_ADDR  0x9000168c
y.create.l HWIO_TX_PDM_DELAY_VAL_ADDR  0x90001690
y.create.l HWIO_VERY_EARLY_FRAME_DELAY_REG_ADDR  0x90001698
y.create.l HWIO_TX_AGC_TEST_POINT_SEL_ADDR  0x9000169c
y.create.l HWIO_TX_AGC_TEST_POINT_DIN_ADDR  0x900016a0
y.create.l HWIO_TX_PA_RD_ADDR  0x900016a4
y.create.l HWIO_RATCHET_BIT_DIS_ADDR  0x900016a8
y.create.l HWIO_TX_AGC_ADJ_RD_ADDR  0x900016ac
y.create.l HWIO_TX_GAIN_ADJ_RD_ADDR  0x900016b0
y.create.l HWIO_TX_GAIN_CTL_RD_ADDR  0x900016b4
y.create.l HWIO_TX_OPEN_LOOP_RD_ADDR  0x900016b8
y.create.l HWIO_MOD_PA_ON_CTL_ADDR  0x900016c0
y.create.l HWIO_MOD_TX_AGC_ADJ_CTL_ADDR  0x900016c8
y.create.l HWIO_MOD_TX_AGC_ADJ_ADDR  0x900016cc
y.create.l HWIO_MOD_TX_AGC_ODRIVE_DLY_ADDR  0x900016d0
y.create.l HWIO_MOD_HW_CLK_CTL_ADDR  0x900016d4
y.create.l HWIO_MOD_MICRO_CLK_CTL_ADDR  0x900016d8
y.create.l HWIO_MOD_CLK_STATUS_ADDR  0x900016dc
y.create.l HWIO_MOD_TX_SLOT_INT_STATUS_ADDR  0x900016e0
y.create.l HWIO_MOD_TX_SLOT_INT_CLR_ADDR  0x900016e4
y.create.l HWIO_MOD_TX_SLOT_INT_EN_ADDR  0x900016e8
y.create.l HWIO_MOD_TX_FR_INT_STATUS_ADDR  0x900016ec
y.create.l HWIO_MOD_TX_FR_INT_CLR_ADDR  0x900016f0
y.create.l HWIO_MOD_TX_FR_INT_EN_ADDR  0x900016f4
y.create.l HWIO_MOD_TXCX8_SPARE_READ_REG_0_ADDR  0x90001700
y.create.l HWIO_MOD_TXCX8_SPARE_READ_REG_1_ADDR  0x90001704
y.create.l HWIO_MOD_TXCX8_SPARE_READ_REG_2_ADDR  0x90001708
y.create.l HWIO_MOD_TXCX8_SPARE_READ_REG_3_ADDR  0x9000170c
y.create.l HWIO_FL_SYM_BUFF_MODE_ADDR  0x90001800
y.create.l HWIO_FL_SYM_BUFF_CLK_CTL_ADDR  0x90001804
y.create.l HWIO_FL_SYM_BUFF_CLK_OVERRIDE_ADDR  0x90001808
y.create.l HWIO_FL_SYM_BUFF_CLK_STATUS_RD_ADDR  0x9000180c
y.create.l HWIO_FL_SYM_BUFF_MEM_CMD_ADDR  0x90001810
y.create.l HWIO_FL_SYM_BUFF_MEM_RD_ADDR  0x90001814
y.create.l HWIO_MOD_ERAM_DATA_ADDR  0x90002000
y.create.l HWIO_MOD_ERAM_DATA_CTL_ADDR  0x90002908
y.create.l HWIO_MOD_ERAM_WR_DONE_ADDR  0x9000290c
y.create.l HWIO_MOD_ERAM_RESERVED_BITS_ADDR  0x90002910
y.create.l HWIO_MOD_TEST_MEM_MODE_ADDR  0x90002914
y.create.l HWIO_MOD_TEST_MEM_SEL_ADDR  0x90002918
y.create.l HWIO_MOD_TEST_MEM_ADDR_ADDR  0x9000291c
y.create.l HWIO_MOD_TEST_MEM_DATA_ADDR  0x90002920
y.create.l HWIO_MOD_TXCX16_SPARE_READ_REG_0_ADDR  0x90002924
y.create.l HWIO_MOD_TXCX16_SPARE_READ_REG_1_ADDR  0x90002928
y.create.l HWIO_EMU_RX_FPGA_VERSION_RD_ADDR  0x90003000
y.create.l HWIO_EMU_TX_FPGA_VERSION_RD_ADDR  0x90003100
y.create.l HWIO_EMU_TX_SYSTEM_MODE_ADDR  0x90003104
y.create.l HWIO_EMU_TX_GPIO_WR_ADDR  0x90003108
y.create.l HWIO_EMU_TX_GPIO_STATUS_RD_ADDR  0x9000310c
y.create.l HWIO_EMU_TX_GPIO_OE_ADDR  0x90003110
y.create.l HWIO_EMU_PA_ON_CTL_ADDR  0x90003114
y.create.l HWIO_EMU_PA_ON_STATUS_RD_ADDR  0x90003118
y.create.l HWIO_EMU_TDEC_FPGA_VERSION_RD_ADDR  0x90003200
y.create.l HWIO_EMU_TDEC_DBG_BUS_RD_ADDR  0x90003204
y.create.l HWIO_EMU_TDEC_DSP_PC_RD_ADDR  0x90003208
y.create.l HWIO_EMU_TDEC_DSP_XMEMC_SIG_RD_ADDR  0x9000320c
y.create.l HWIO_EMU_ANT_RAM_ADDR_VAL_ADDR  0x90003300
y.create.l HWIO_EMU_ANT_RAM_DATA_ADDR  0x90003304
y.create.l HWIO_EMU_ANT_RAM_RTCMATCH_ADDR  0x90003308
y.create.l HWIO_EMU_ANT_RAM_CTL_ADDR  0x9000330c
y.create.l HWIO_EMU_ANT_RAM_DEBUG_CTL_ADDR  0x90003310
y.create.l HWIO_EMU_ANT_RAM_GPO_ADDR  0x90003314
y.create.l HWIO_EMU_ANT_RAM_DEBUG2_CTL_ADDR  0x90003318
y.create.l HWIO_EMU_RXFPGA_RESET_CMD_ADDR  0x9000331c
y.create.l HWIO_EMU_RXFPGA_MODE_SEL_ADDR  0x90003320
y.create.l HWIO_EMU_QDSP_CTL_ADDR_ADDR  0x90003324
y.create.l HWIO_EMU_QDSP_PC_DEBIG_ADDR  0x90003328
y.create.l HWIO_EMU_USB_CTL_ADDR  0x9000332c
y.create.l HWIO_EMU_USB_DET_ADDR  0x90003330
y.create.l HWIO_QLIC_MTI_CTL_ADDR  0x90003500
y.create.l HWIO_QLIC_FERAM0_WORD0_ADDR  0x90003504
y.create.l HWIO_QLIC_FERAM0_WORD1_ADDR  0x90003508
y.create.l HWIO_QLIC_FERAM1_WORD0_ADDR  0x9000350c
y.create.l HWIO_QLIC_FERAM1_WORD1_ADDR  0x90003510
y.create.l HWIO_QLIC_OMGRAM_WORD0_ADDR  0x90003514
y.create.l HWIO_QLIC_OMGRAM_WORD1_ADDR  0x90003518
y.create.l HWIO_QLIC_SECRAM_WORD0_ADDR  0x9000351c
y.create.l HWIO_QLIC_SECRAM_WORD1_ADDR  0x90003520
y.create.l HWIO_QLIC_COMBRAM0_WORD0_ADDR  0x90003524
y.create.l HWIO_QLIC_COMBRAM0_WORD1_ADDR  0x90003528
y.create.l HWIO_QLIC_COMBRAM0_WORD2_ADDR  0x9000352c
y.create.l HWIO_QLIC_COMBRAM1_WORD0_ADDR  0x90003530
y.create.l HWIO_QLIC_COMBRAM1_WORD1_ADDR  0x90003534
y.create.l HWIO_QLIC_COMBRAM1_WORD2_ADDR  0x90003538
y.create.l HWIO_QLIC_CGC_TASK_STATE_ARM_ADDR  0x9000353c
y.create.l HWIO_QLIC_TESTBUS_ARM_ADDR  0x9000354c
y.create.l HWIO_RXF_SRCc_RESET_ADDR  0x90003600
y.create.l HWIO_RXF_SRCc_CTL_ADDR  0x90003604
y.create.l HWIO_RXF_SRCc_LNA_S0_PHASE_OFFSET_ADDR  0x9000360c
y.create.l HWIO_RXF_SRCc_LNA_S1_PHASE_OFFSET_ADDR  0x90003610
y.create.l HWIO_RXF_SRCc_LNA_S2_PHASE_OFFSET_ADDR  0x90003614
y.create.l HWIO_RXF_SRCc_LNA_S3_PHASE_OFFSET_ADDR  0x90003618
y.create.l HWIO_RXF_SRCc_LNA_S4_PHASE_OFFSET_ADDR  0x9000361c
y.create.l HWIO_RXF_SRCc_BBF_NOTCH0_PARAMS_ADDR  0x90003624
y.create.l HWIO_RXF_SRCc_BBF_NOTCH1_PARAMS_ADDR  0x90003628
y.create.l HWIO_RXF_SRCc_BBF_NOTCH2_PARAMS_ADDR  0x9000362c
y.create.l HWIO_RXF_SRCc_MIS_COMP_A_COEFF_ADDR  0x90003630
y.create.l HWIO_RXF_SRCc_MIS_COMP_B_COEFF_ADDR  0x90003634
y.create.l HWIO_RXF_SRCc_RESAMP_PHASE_MAP0_ADDR  0x90003638
y.create.l HWIO_RXF_SRCc_RESAMP_PHASE_MAP1_ADDR  0x9000363c
y.create.l HWIO_RXF_SRCc_RESAMP_PHASE_MAP2_ADDR  0x90003640
y.create.l HWIO_RXF_SRCc_RESAMP_PHASE_MAP3_ADDR  0x90003644
y.create.l HWIO_RXF_SRCc_RESAMP_END_CNT_ADDR  0x90003648
y.create.l HWIO_RXF_SRCc_DVGA_PARAMS_ADDR  0x9000364c
y.create.l HWIO_RXF_SRCc_TEST_BUS_SEL_ADDR  0x90003650
y.create.l HWIO_RXF_SRCc_CXN_CLK_STATUS_ADDR  0x90003654
y.create.l HWIO_DINT_RESET_ADDR  0x90003800
y.create.l HWIO_DINT_CFG_ADDR  0x90003804
y.create.l HWIO_DINT_CHw_CFG_ADDR  0x90003808
y.create.l HWIO_TD_BLOCK_SIZE_ADDR  0x90003818
y.create.l HWIO_TD_INTLV_CFG_LO_ADDR  0x9000381c
y.create.l HWIO_TD_INTLV_CFG_HI_ADDR  0x90003820
y.create.l HWIO_TD_INTLV_SIZE_LO_ADDR  0x90003824
y.create.l HWIO_TD_INTLV_SIZE_HI_ADDR  0x90003828
y.create.l HWIO_TD_PUNCT_LO_ADDR  0x9000382c
y.create.l HWIO_TD_PUNCT_HI_ADDR  0x90003830
y.create.l HWIO_TD_PARAMS_LO_ADDR  0x90003834
y.create.l HWIO_TD_PARAMS_HI_ADDR  0x90003838
y.create.l HWIO_DINT_PKT_OFFSET_ADDR  0x9000383c
y.create.l HWIO_DINT_PKT_CFG_ADDR  0x90003840
y.create.l HWIO_DINT_TASK_OFFSET_ADDR  0x90003844
y.create.l HWIO_DINT_TASK_LIST_ADDR  0x90003848
y.create.l HWIO_TST_SYNC_DINT_ADDR  0x9000384c
y.create.l HWIO_TST_CH0_SYMS_ADDR  0x90003850
y.create.l HWIO_TST_CH1_SYMS_ADDR  0x90003854
y.create.l HWIO_TST_CH2_SYMS_ADDR  0x90003858
y.create.l HWIO_TST_SEQ_PROC_PHASE_ADDR  0x9000385c
y.create.l HWIO_TST_SEL_DINT_ADDR  0x90003860
y.create.l HWIO_DINT_OTD_CFG_ADDR  0x90003864
y.create.l HWIO_TD_MIN_LLR_THRESH_ADDR  0x90003868
y.create.l HWIO_TD_INTLV_LEN_X2_ADDR  0x9000386c
y.create.l HWIO_TD_INTLV_LEN_X4_ADDR  0x90003870
y.create.l HWIO_TD_INTLV_LEN_X8_ADDR  0x90003874
y.create.l HWIO_TD_NUM_SLWIN_X2_ADDR  0x90003878
y.create.l HWIO_TD_NUM_SLWIN_X4_ADDR  0x9000387c
y.create.l HWIO_TD_NUM_SLWIN_X8_ADDR  0x90003880
y.create.l HWIO_DINT_GCH_CFG0_ADDR  0x90003884
y.create.l HWIO_DINT_GCH_CFG1_ADDR  0x90003888
y.create.l HWIO_DINT_GCH_CFG2_ADDR  0x9000388c
y.create.l HWIO_DINT_GCH_CFG3_ADDR  0x90003890
y.create.l HWIO_DINT_PDCCH_CFG_ADDR  0x90003894
y.create.l HWIO_DINT_PDCCH_HYP0_CFG0_ADDR  0x90003898
y.create.l HWIO_DINT_PDCCH_HYP1_CFG0_ADDR  0x9000389c
y.create.l HWIO_DINT_PDCCH_HYP2_CFG0_ADDR  0x900038a0
y.create.l HWIO_DINT_PDCCH_HYP0_CFG1_ADDR  0x900038a4
y.create.l HWIO_DINT_PDCCH_HYP1_CFG1_ADDR  0x900038a8
y.create.l HWIO_DINT_PDCCH_HYP2_CFG1_ADDR  0x900038ac
y.create.l HWIO_DINT_TEST_MEM_SEL_ADDR  0x900038b0
y.create.l HWIO_DINT_TEST_MEM_ADDR_ADDR  0x900038b4
y.create.l HWIO_DINT_TEST_MEM_WRITE_ADDR  0x900038b8
y.create.l HWIO_DINT_TEST_MEM_READ0_ADDR  0x900038bc
y.create.l HWIO_TST_PDCCH_TASK_ADDR  0x900038c0
y.create.l HWIO_TST_SYS_TIME_ADDR  0x900038c4
y.create.l HWIO_DEINT_DBG_BUS_CTL_ADDR  0x900038c8
y.create.l HWIO_DEINT_CLK_SPARE_READ_REG0_ADDR  0x900038cc
y.create.l HWIO_DEINT_CLK_SPARE_READ_REG1_ADDR  0x900038d0
y.create.l HWIO_DEINT_HW_CLK_CTL_ADDR  0x900038d4
y.create.l HWIO_DEINT_MICRO_CLK_CTL_ADDR  0x900038d8
y.create.l HWIO_DEINT_CLK_STATUS_ADDR  0x900038dc
y.create.l HWIO_DEC_DONE_INT_STATUS_ADDR  0x900038e0
y.create.l HWIO_DEINT_TASK_STATUS_ADDR  0x90003800
y.create.l HWIO_DEINT_FRMHYP_STATUS_ADDR  0x90003804
y.create.l HWIO_DINT_VD_RD_ADDR_ADDR  0x9000382c
y.create.l HWIO_DINT_TD_WR_ADDR_ADDR  0x9000384c
y.create.l HWIO_MODEM_QMEMBIST_CLK_ENA_ADDR  0x90003900
y.create.l HWIO_MODEM_QMEMBIST_IO_CFG_ADDR  0x90003904
y.create.l HWIO_MODEM_QMEMBIST_RESET_ADDR  0x90003908
y.create.l HWIO_MODEM_QMEMBIST_FA_SEQUENCER_SEL_ADDR  0x9000390c
y.create.l HWIO_MODEM_QMEMBIST_EMBEDDED_ALG_CFG_ADDR  0x90003910
y.create.l HWIO_MODEM_QMEMBIST_USR_CMD_DESTINATION_ADDR  0x90003914
y.create.l HWIO_MODEM_QMEMBIST_USR_CMD_CFG_ADDR  0x90003918
y.create.l HWIO_MODEM_QMEMBIST_TEST_TRIGGER_ADDR  0x9000391c
y.create.l HWIO_MODEM_QMEMBIST_TEST_STATUS_ADDR  0x90003920
y.create.l HWIO_MODEM_QMEMBIST_TESTEDm_ADDR  0x90003924
y.create.l HWIO_MODEM_QMEMBIST_FAILEDm_ADDR  0x90003934
y.create.l HWIO_MODEM_QMEMBIST_RAM_FAIL_MAP_ADDR  0x90003944
y.create.l HWIO_MODEM_QMEMBIST_CLKOFFm_ADDR  0x90003948
y.create.l HWIO_MODEM_CLK_HALT_ADDR  0x90004000
y.create.l HWIO_MODEM_CLK_HALT_2_ADDR  0x90004004
y.create.l HWIO_MODEM_CLK_RESET_ADDR  0x90004008
y.create.l HWIO_MODEM_CLK_RESET_2_ADDR  0x9000400c
y.create.l HWIO_MODEM_CLK_INV_ADDR  0x90004010
y.create.l HWIO_MODEM_CLK_INV_2_ADDR  0x90004014
y.create.l HWIO_MODEM_RXF_SAMP_REF_CLK_CTL_ADDR  0x90004018
y.create.l HWIO_MODEM_IN_N_OUT_CLK_CTL_ADDR  0x9000401c
y.create.l HWIO_MODEM_MF_CHIPXN_CLK_CTL_ADDR  0x90004020
y.create.l HWIO_MODEM_CHIPXN_CLK_CTL_ADDR  0x90004024
y.create.l HWIO_MODEM_OFFLINE_MNCNTR_M_ADDR  0x90004028
y.create.l HWIO_MODEM_OFFLINE_MNCNTR_NOT_2D_ADDR  0x9000402c
y.create.l HWIO_MODEM_OFFLINE_MNCNTR_NOT_N_M_ADDR  0x90004030
y.create.l HWIO_MODEM_OFFLINE_CLK_CTL_ADDR  0x90004034
y.create.l HWIO_MODEM_GACC_MNCNTR_M_ADDR  0x90004038
y.create.l HWIO_MODEM_GACC_MNCNTR_NOT_2D_ADDR  0x9000403c
y.create.l HWIO_MODEM_GACC_MNCNTR_NOT_N_M_ADDR  0x90004040
y.create.l HWIO_MODEM_GACC_CLK_CTL_ADDR  0x90004044
y.create.l HWIO_MODEM_GPS_CLK_CTL_ADDR  0x90004048
y.create.l HWIO_MODEM_GPS_MNCNTR_M_ADDR  0x9000404c
y.create.l HWIO_MODEM_GPS_MNCNTR_NOT_2D_ADDR  0x90004050
y.create.l HWIO_MODEM_GPS_MNCNTR_NOT_N_M_ADDR  0x90004054
y.create.l HWIO_MODEM_F9_CLK_CTL_ADDR  0x90004058
y.create.l HWIO_MODEM_EDGE_CLK_CTL_ADDR  0x9000405c
y.create.l HWIO_MODEM_EDGE_MNCNTR_M_ADDR  0x90004060
y.create.l HWIO_MODEM_EDGE_MNCNTR_NOT_2D_ADDR  0x90004064
y.create.l HWIO_MODEM_EDGE_MNCNTR_NOT_N_M_ADDR  0x90004068
y.create.l HWIO_MODEM_WCDMA_CHIPXN_MNCTNR_UPDATE_ADDR  0x9000406c
y.create.l HWIO_MODEM_WEB_CLK_CTL_ADDR  0x9000408c
y.create.l HWIO_MODEM_CHIPXN_CLK_MISC_CTL_ADDR  0x90004090
y.create.l HWIO_MODEM_CLK_MISC_CTL_ADDR  0x90004094
y.create.l HWIO_MODEM_CLK_MISC_CTL_2_ADDR  0x90004098
y.create.l HWIO_MODEM_CLK_MDSP_FS_CTL_ADDR  0x9000409c
y.create.l HWIO_MODEM_CLK_STATUS_RD_ADDR  0x900040a0
y.create.l HWIO_MODEM_CLK_STATUS_RD_2_ADDR  0x900040a4
y.create.l HWIO_MODEM_CLK_TEST_ADDR  0x900040a8
y.create.l HWIO_MODEM_CLK_TEST_2_ADDR  0x900040ac
y.create.l HWIO_MODEM_CDMA_CHIPXN_MNCNTR_M_ADDR  0x900040b0
y.create.l HWIO_MODEM_CDMA_CHIPXN_MNCNTR_NOT_2D_ADDR  0x900040b4
y.create.l HWIO_MODEM_CDMA_CHIPXN_MNCNTR_NOT_N_M_ADDR  0x900040b8
y.create.l HWIO_MODEM_CDMA_CHIPXN_MNCTNR_UPDATE_ADDR  0x900040bc
y.create.l HWIO_MODEM_WCDMA_CHIPXN_MNCNTR_M_ADDR  0x900040c0
y.create.l HWIO_MODEM_WCDMA_CHIPXN_MNCNTR_NOT_2D_ADDR  0x900040c4
y.create.l HWIO_MODEM_WCDMA_CHIPXN_MNCNTR_NOT_N_M_ADDR  0x900040c8
y.create.l HWIO_MODEM_GPS_MNCNTR_UPDATE_ADDR  0x900040cc
y.create.l HWIO_MDSP_MNCNTR_MD_ADDR  0x900040d0
y.create.l HWIO_MDSP_MNCNTR_NS_ADDR  0x900040d4
y.create.l HWIO_MDSP_ACTIVE_MD_RD_ADDR  0x900040d8
y.create.l HWIO_MDSP_ACTIVE_NS_RD_ADDR  0x900040dc
y.create.l HWIO_MDSP_CLK_SWITCH_ADDR  0x900040e0
y.create.l HWIO_MODEM_CLK_DYN_SW_BYPASS_ADDR  0x900040e4
y.create.l HWIO_MODEM_CLK_DYN_SW_SPARE_READ_REG0_ADDR  0x900040e8
y.create.l HWIO_MODEM_CDXO_CTL_ADDR  0x900040ec
y.create.l HWIO_MODEM_CDXO_Y_CUT_CNTR_CTL_ADDR  0x900040f0
y.create.l HWIO_MODEM_CDXO_AT_CUT_CNTR_ADDR  0x900040f4
y.create.l HWIO_MODEM_CLK_SSBI_CLK_CTL_ADDR  0x900040f8
y.create.l HWIO_MODEM_EDGE_SWC_CNT_ADDR  0x900040fc
y.create.l HWIO_SLEEPn_RTC_ARM_ADDR  0x90004200
y.create.l HWIO_SLEEPn_MICRO_START_ADDR  0x90004204
y.create.l HWIO_SLEEPn_FINE_TIME_ADDR  0x90004208
y.create.l HWIO_SLEEPn_COARSE_TIME_ADDR  0x9000420c
y.create.l HWIO_SLEEPn_COARSE_TIME_LATCH_ADDR  0x90004210
y.create.l HWIO_SLEEPn_WAKEUP_TIME_ADDR  0x90004214
y.create.l HWIO_SLEEPn_WAKEUP_TIME_LATCH_ADDR  0x90004218
y.create.l HWIO_SLEEPn_FINE_COUNT_VAL_ADDR  0x9000421c
y.create.l HWIO_SLEEPn_COARSE_COUNT_VAL_ADDR  0x90004220
y.create.l HWIO_SLEEPn_STATUS_ADDR  0x90004224
y.create.l HWIO_SLEEPn_MODEM_STATUS_ENABLE_ADDR  0x9000422c
y.create.l HWIO_SLEEPn_INT_EN_ADDR  0x90004230
y.create.l HWIO_FEE_SLEEP_XTAL_COUNT_ADDR  0x900042bc
y.create.l HWIO_FEE_SLEEP_XTAL_FREQ_ERR_ADDR  0x900042c0
y.create.l HWIO_MODEM_SBIc_CLK_EN_ADDR  0x90004500
y.create.l HWIO_MODEM_SBIc_CGC_HW_EN_ADDR  0x90004504
y.create.l HWIO_MODEM_SBIc_WR_ADDR  0x90004514
y.create.l HWIO_MODEM_SBI_PIN_CFG_ADDR  0x90004600
y.create.l HWIO_MODEM_SBI_INOUT_CONFIG_ADDR  0x90004604
y.create.l HWIO_MODEM_SBI_RXF_AGC_CONFIG_ADDR  0x90004608
y.create.l HWIO_MODEM_SBI_BUGFIX_DISABLE_ADDR  0x90004618
y.create.l HWIO_MODEM_SBI_EXT_SSBI_CLK_FORCE_ON_ADDR  0x9000461c
y.create.l HWIO_MODEM_SBI_EXT_SSBI_CLK_DLY_ADDR  0x90004620
y.create.l HWIO_MODEM_HW_REV_RD_ADDR  0x90004800
y.create.l HWIO_BT_SLP_CTL_CMD_ADDR  0x90004804
y.create.l HWIO_MODEM_MISC_CFG0_ADDR  0x90004808
y.create.l HWIO_MODEM_MISC_CFG1_ADDR  0x9000480c
y.create.l HWIO_MODEM_MISC_CFG2_ADDR  0x90004810
y.create.l HWIO_MODEM_TX_DAC_SLEEP_ADDR  0x90004814
y.create.l HWIO_MODEM_DBG_BUS_OUT_GATING_ADDR  0x90004818
y.create.l HWIO_SAMPLING_RESET_ADDR  0x9000481c
y.create.l HWIO_MODEM_WEB_SPARE_READ_REG0_ADDR  0x90004820
y.create.l HWIO_MODEM_GENERIC_CTL_REG_ADDR  0x90004824
y.create.l HWIO_MODEM_BRIDGE_TIMEOUT_CFG_ADDR  0x90004828
y.create.l HWIO_MODEM_PA_ON_STATUS_ADDR  0x9000482c
y.create.l HWIO_MODEM_PA_ON_CTL_ADDR  0x90004830
y.create.l HWIO_MODEM_PA_ON_PROTECTION_ADDR  0x90004834
y.create.l HWIO_MDM_SEC_DOMAIN_CFG_ADDR  0x90004838
y.create.l HWIO_MODEM_WEB_DBG_BUS_SEL_ADDR  0x9000483c
y.create.l HWIO_MODEM_OUTPORT_OVERRIDE0_ADDR  0x90004840
y.create.l HWIO_MODEM_OUTPORT_OVERRIDE1_ADDR  0x90004844
y.create.l HWIO_MODEM_OUTPORT_OVERRIDE2_ADDR  0x90004848
y.create.l HWIO_MODEM_OUTPORT_OVERRIDE3_ADDR  0x9000484c
y.create.l HWIO_MODEM_OUTPORT_OVERRIDE4_ADDR  0x90004850
y.create.l HWIO_MODEM_OUTPORT_OVERRIDE5_ADDR  0x90004854
y.create.l HWIO_MODEM_OUTPORT_OVERRIDE_EN_ADDR  0x90004858
y.create.l HWIO_MODEM_INPORT_RD_DATA0_ADDR  0x9000485c
y.create.l HWIO_MODEM_INPORT_RD_DATA1_ADDR  0x90004860
y.create.l HWIO_MODEM_INPORT_RD_DATA2_ADDR  0x90004864
y.create.l HWIO_AGC_CARRIER_FREQ_ERR_ADDR  0x90004868
y.create.l HWIO_AGC_FREQ_COMB_CTL_ADDR  0x9000486c
y.create.l HWIO_RXF_SRCc_BBF_COEF0_ADDR  0x90004b00
y.create.l HWIO_RXF_SRCc_BBF_COEF1_ADDR  0x90004b04
y.create.l HWIO_RXF_SRCc_BBF_COEF_NOTCH0_ADDR  0x90004b08
y.create.l HWIO_RXF_SRCc_BBF_COEF_NOTCH1_ADDR  0x90004b0c
y.create.l HWIO_RXF_SRCc_BBF_COEF_NOTCH2_ADDR  0x90004b10
y.create.l HWIO_RXF_SRCc_OFFSET_CTL_ADDR  0x90004b14
y.create.l HWIO_RXF_SRCc_DACC_CTL_ADDR  0x90004b18
y.create.l HWIO_RXF_SRCc_FG_IOFFSET_ADDR  0x90004b1c
y.create.l HWIO_RXF_SRCc_FG_QOFFSET_ADDR  0x90004b20
y.create.l HWIO_RXF_SRCc_DC_IOFFSET_ADJ_ADDR  0x90004b24
y.create.l HWIO_RXF_SRCc_DC_QOFFSET_ADJ_ADDR  0x90004b28
y.create.l HWIO_RXF_SRCc_DACC_ACQ_TIMER_ADDR  0x90004b2c
y.create.l HWIO_RXF_SRCc_DACC_TRC_TIMER_ADDR  0x90004b30
y.create.l HWIO_RXF_SRCc_DACC_CLR_TIMER_ADDR  0x90004b34
y.create.l HWIO_RXF_SRCc_DACC_EST_THRESH_ADDR  0x90004b38
y.create.l HWIO_RXF_SRCc_DACC_EST_IOFFSET_ADDR  0x90004b3c
y.create.l HWIO_RXF_SRCc_DACC_EST_QOFFSET_ADDR  0x90004b40
y.create.l HWIO_RXF_SRCc_DACC_IACCUM0_ADDR  0x90004b44
y.create.l HWIO_RXF_SRCc_DACC_IACCUM1_ADDR  0x90004b48
y.create.l HWIO_RXF_SRCc_DACC_IACCUM2_ADDR  0x90004b4c
y.create.l HWIO_RXF_SRCc_DACC_IACCUM3_ADDR  0x90004b50
y.create.l HWIO_RXF_SRCc_DACC_IACCUM4_ADDR  0x90004b54
y.create.l HWIO_RXF_SRCc_DACC_QACCUM0_ADDR  0x90004b58
y.create.l HWIO_RXF_SRCc_DACC_QACCUM1_ADDR  0x90004b5c
y.create.l HWIO_RXF_SRCc_DACC_QACCUM2_ADDR  0x90004b60
y.create.l HWIO_RXF_SRCc_DACC_QACCUM3_ADDR  0x90004b64
y.create.l HWIO_RXF_SRCc_DACC_QACCUM4_ADDR  0x90004b68
y.create.l HWIO_RXF_SRCc_MICRO_DACC_UPDATE_ADDR  0x90004b6c
y.create.l HWIO_RXF_SRCc_DACC_GAIN_MULT_ADDR  0x90004b74
y.create.l HWIO_RXF_SRCc_NOTCH_CFG_ADDR  0x90004b78
y.create.l HWIO_RXF_SRCc_MICRO_SYNC_CMD_ADDR  0x90004b7c
y.create.l HWIO_RXF_SRCc_ARM_IRQ_STATUS_ADDR  0x90004b80
y.create.l HWIO_MDM_HI0_CHn_CMD_PTR_SDs_ADDR  0x90400000
y.create.l HWIO_MDM_HI0_CHn_RSLT_SDs_ADDR  0x90400040
y.create.l HWIO_MDM_HI0_CHn_FLUSH_STATE0_SDs_ADDR  0x90400080
y.create.l HWIO_MDM_HI0_CHn_FLUSH_STATE1_SDs_ADDR  0x904000c0
y.create.l HWIO_MDM_HI0_CHn_FLUSH_STATE2_SDs_ADDR  0x90400100
y.create.l HWIO_MDM_HI0_CHn_FLUSH_STATE3_SDs_ADDR  0x90400140
y.create.l HWIO_MDM_HI0_CHn_FLUSH_STATE4_SDs_ADDR  0x90400180
y.create.l HWIO_MDM_HI0_CHn_FLUSH_STATE5_SDs_ADDR  0x904001c0
y.create.l HWIO_MDM_HI0_SEC_DOMAIN_IRQ_STATUS_SDs_ADDR  0x90400380
y.create.l HWIO_MDM_HI0_CHn_RSLT_CONF_SDs_ADDR  0x90400300
y.create.l HWIO_MDM_HI0_CHn_STATUS_SDs_ADDR  0x90400200
y.create.l HWIO_MDM_HI0_CHn_CONF_ADDR  0x90400240
y.create.l HWIO_MDM_HI0_CHn_DBG_0_ADDR  0x90400280
y.create.l HWIO_MDM_HI0_CHn_DBG_1_ADDR  0x904002c0
y.create.l HWIO_MDM_HI0_CIn_CONF_ADDR  0x90400390
y.create.l HWIO_MDM_HI0_CIn_DBG_ERR_ADDR  0x904003b0
y.create.l HWIO_MDM_HI0_CRCI_DBG_ADDR  0x904003d0
y.create.l HWIO_MDM_HI0_CRCI_STATUS_ADDR  0x904003d4
y.create.l HWIO_MDM_HI0_GP_CTL_ADDR  0x904003d8
y.create.l HWIO_MDM_HI0_GP_STATUS_ADDR  0x904003dc
y.create.l HWIO_MDM_HI0_GLBL_DBG_CMD_ENG_ADDR  0x904003e0
y.create.l HWIO_MDM_HI0_GLBL_DBG_REQ_ENG_ADDR  0x904003e4
y.create.l HWIO_MDM_HI0_GLBL_DBG_XFR_ENG_ADDR  0x904003e8
y.create.l HWIO_MDM_HI0_GLBL_DBG_CHAN_BLK_ADDR  0x904003ec
y.create.l HWIO_MDM_HI0_GLBL_DBG_CHAN_BLK_CLR_ADDR  0x904003f0
y.create.l HWIO_MDM_HI0_GLBL_DBG_TEST_SEL_ADDR  0x904003f4
y.create.l HWIO_GPS_SRCH_DM_BYPASS_ADDR  0x90500000
y.create.l HWIO_GPS_SRCH_RESET_ADDR  0x90500004
y.create.l HWIO_GPS_SRCH_CTL_ADDR  0x90500008
y.create.l HWIO_GPS_SRCH_TESTBUS_OUT_ADDR  0x9050000c
y.create.l HWIO_GPS_SRCH_SS_TESTBUS_OUT_ADDR  0x90500010
y.create.l HWIO_ALT_GPS_SRCH_CMD_ADDR  0x90580000
y.create.l HWIO_ALT_GPS_SRCH_OUT_ADDR  0x905c0000
y.create.l HWIO_GPS_SRCH_CMD_START_ADDR_ADDR  0x90580000
y.create.l HWIO_GPS_SRCH_CMD_END_ADDR_ADDR  0x905bfffc
y.create.l HWIO_GPS_SRCH_OUT_START_ADDR_ADDR  0x905c0000
y.create.l HWIO_GPS_SRCH_OUT_END_ADDR_ADDR  0x905ffffc
y.create.l HWIO_GPS_SRCH_CMD_ST0_ADDR  0x90580004
y.create.l HWIO_GPS_SRCH_CMD_DIAG0_ADDR  0x90580008
y.create.l HWIO_GPS_SRCH_CMD_WD0_ADDR  0x9058000c
y.create.l HWIO_GPS_SRCH_CMD_WD1_ADDR  0x90580010
y.create.l HWIO_GPS_SRCH_CMD_WD2_ADDR  0x90580014
y.create.l HWIO_GPS_SRCH_CMD_CDMA_WD3_ADDR  0x90580018
y.create.l HWIO_GPS_SRCH_CMD_GPS_WD3_ADDR  0x9058001c
y.create.l HWIO_GPS_SRCH_CMD_HDR_WD3_ADDR  0x90580020
y.create.l HWIO_GACC_DM_BYPASS_ADDR  0x90600000
y.create.l HWIO_GACC_CLK_CTL_ADDR  0x90600004
y.create.l HWIO_GACC_TEST_BUS_OUT_ADDR  0x90600008
y.create.l HWIO_GACC_RTC_WAIT_ALT_ADDR  0x90680000
y.create.l HWIO_GACC_START_ADDR_ALT_ADDR  0x90680004
y.create.l HWIO_GACC_COUNT_ALT_ADDR  0x90680008
y.create.l HWIO_GACC_INCR_ALT_ADDR  0x9068000c
y.create.l HWIO_GACC_FREQ_ALT_ADDR  0x90680010
y.create.l HWIO_GACC_CONFIG_ALT_ADDR  0x90680014
y.create.l HWIO_GACC_PEAK_ALT_ADDR  0x90680018
y.create.l HWIO_GACC_DONE_ALT_ADDR  0x9068001c
y.create.l HWIO_GACC_RTC_ALT_ADDR  0x90680020
y.create.l HWIO_GACC_SAMPLE_MEM_START_ADDR_ALT_ADDR  0x90681000
y.create.l HWIO_GACC_SAMPLE_MEM_END_ADDR_ALT_ADDR  0x906819fc
y.create.l HWIO_GACC_ENERGY_MEM_START_ADDR_ALT_ADDR  0x90682000
y.create.l HWIO_GACC_ENERGY_MEM_END_ADDR_ALT_ADDR  0x906829fc
y.create.l HWIO_GACC_RTC_WAIT_ADDR  0x90680000
y.create.l HWIO_GACC_START_ADDR_ADDR  0x90680004
y.create.l HWIO_GACC_COUNT_ADDR  0x90680008
y.create.l HWIO_GACC_INCR_ADDR  0x9068000c
y.create.l HWIO_GACC_FREQ_ADDR  0x90680010
y.create.l HWIO_GACC_CONFIG_ADDR  0x90680014
y.create.l HWIO_GACC_PEAK_ADDR  0x90680018
y.create.l HWIO_GACC_DONE_ADDR  0x9068001c
y.create.l HWIO_GACC_RTC_ADDR  0x90680020
y.create.l HWIO_GACC_SAMPLE_MEM_START_ADDR_ADDR  0x90681000
y.create.l HWIO_GACC_SAMPLE_MEM_END_ADDR_ADDR  0x906819fc
y.create.l HWIO_GACC_ENERGY_MEM_START_ADDR_ADDR  0x90682000
y.create.l HWIO_GACC_ENERGY_MEM_END_ADDR_ADDR  0x906829fc
y.create.l HWIO_MDSP_RAMA_BASE_ADDR  0x91000000
y.create.l HWIO_MDSP_RAMB_BASE_ADDR  0x91200000
y.create.l HWIO_MDSP_RAMC_BASE_ADDR  0x91400000
y.create.l HWIO_MDSP_RAMI_BASE_ADDR  0x91800000
y.create.l HWIO_MDSP_CTRL_ADDR  0x91c00000
y.create.l HWIO_MDSP_UP_IRQ_ADDR  0x91c00004
y.create.l HWIO_MDSP_UP_IRQ_VECTOR_ADDR  0x91c00008
y.create.l HWIO_MDSP_CLK_GATE_CTRL_ADDR  0x91c00010
y.create.l HWIO_MDSP_CLK_STATUS_ADDR  0x91c00014
y.create.l HWIO_MDSP_DBG_CTRL_ADDR  0x91c0001c
y.create.l HWIO_MDSP_PC_DBG_ADDR  0x91c00020
y.create.l HWIO_MDSP_INT_MASK_DBG_ADDR  0x91c00024
y.create.l HWIO_MDSP_INT_MASK2_DBG_ADDR  0x91c00028
y.create.l HWIO_MDSP_MEM_ACC_CTRL_ADDR  0x91c0002c
y.create.l HWIO_ADSP_RAMA_BASE_ADDR  0x70000000
y.create.l HWIO_ADSP_RAMB_BASE_ADDR  0x70200000
y.create.l HWIO_ADSP_RAMC_BASE_ADDR  0x70400000
y.create.l HWIO_ADSP_RAMI_BASE_ADDR  0x70800000
y.create.l HWIO_ADSP_CTL_ADDR  0x70c00000
y.create.l HWIO_MICRO_TO_ADSP_IRQ_ADDR  0x70c00004
y.create.l HWIO_MICRO_TO_ADSP_IRQ_VECTOR_ADDR  0x70c00008
y.create.l HWIO_ADSP_CLK_GATE_CTL_ADDR  0x70c00010
y.create.l HWIO_ADSP_CLK_STATUS_ADDR  0x70c00014
y.create.l HWIO_ADSP_DBG_CTRL_ADDR  0x70c0001c
y.create.l HWIO_ADSP_PC_DBG_ADDR  0x70c00020
y.create.l HWIO_ADSP_INT_MASK_DBG_ADDR  0x70c00024
y.create.l HWIO_ADSP_INT_MASK2_DBG_ADDR  0x70c00028
y.create.l HWIO_ADSP_MEM_ACC_CTRL_ADDR  0x70c0002c
y.create.l HWIO_GSBI0_GSBI_CTRL_REG_ADDR  0x98000000
y.create.l HWIO_GSBI0_GSBI_DBG0_REG_ADDR  0x98000004
y.create.l HWIO_GSBI0_GSBI_DBG1_REG_ADDR  0x98000008
y.create.l HWIO_GSBI0_GSBI_DBG2_REG_ADDR  0x9800000c
y.create.l HWIO_GSBI0_GSBI_DBG3_REG_ADDR  0x98000010
y.create.l HWIO_GSBI0_UART_DM_MR1_ADDR  0x9a000000
y.create.l HWIO_GSBI0_UART_DM_MR2_ADDR  0x9a000004
y.create.l HWIO_GSBI0_UART_DM_CSR_ADDR  0x9a000008
y.create.l HWIO_GSBI0_UART_DM_TF_ADDR  0x9a000070
y.create.l HWIO_GSBI0_UART_DM_TF_2_ADDR  0x9a000074
y.create.l HWIO_GSBI0_UART_DM_TF_3_ADDR  0x9a000078
y.create.l HWIO_GSBI0_UART_DM_TF_4_ADDR  0x9a00007c
y.create.l HWIO_GSBI0_UART_DM_CR_ADDR  0x9a000010
y.create.l HWIO_GSBI0_UART_DM_IMR_ADDR  0x9a000014
y.create.l HWIO_GSBI0_UART_DM_IPR_ADDR  0x9a000018
y.create.l HWIO_GSBI0_UART_DM_TFWR_ADDR  0x9a00001c
y.create.l HWIO_GSBI0_UART_DM_RFWR_ADDR  0x9a000020
y.create.l HWIO_GSBI0_UART_DM_HCR_ADDR  0x9a000024
y.create.l HWIO_GSBI0_UART_DM_DMRX_ADDR  0x9a000034
y.create.l HWIO_GSBI0_UART_DM_IRDA_ADDR  0x9a000038
y.create.l HWIO_GSBI0_UART_DM_DMEN_ADDR  0x9a00003c
y.create.l HWIO_GSBI0_UART_DM_NO_CHARS_FOR_TX_ADDR  0x9a000040
y.create.l HWIO_GSBI0_UART_DM_BADR_ADDR  0x9a000044
y.create.l HWIO_GSBI0_UART_DM_TESTSL_ADDR  0x9a000048
y.create.l HWIO_GSBI0_UART_DM_MISR_MODE_ADDR  0x9a000060
y.create.l HWIO_GSBI0_UART_DM_MISR_RESET_ADDR  0x9a000064
y.create.l HWIO_GSBI0_UART_DM_MISR_EXPORT_ADDR  0x9a000068
y.create.l HWIO_GSBI0_UART_DM_MISR_VAL_ADDR  0x9a00006c
y.create.l HWIO_GSBI0_UART_DM_SIM_CFG_ADDR  0x9a000080
y.create.l HWIO_GSBI0_UART_DM_TEST_WR_ADDR_ADDR  0x9a000084
y.create.l HWIO_GSBI0_UART_DM_TEST_WR_DATA_ADDR  0x9a000088
y.create.l HWIO_GSBI0_UART_DM_TEST_RD_ADDR_ADDR  0x9a00008c
y.create.l HWIO_GSBI0_UART_DM_SR_ADDR  0x9a000008
y.create.l HWIO_GSBI0_UART_DM_RF_ADDR  0x9a000070
y.create.l HWIO_GSBI0_UART_DM_RF_2_ADDR  0x9a000074
y.create.l HWIO_GSBI0_UART_DM_RF_3_ADDR  0x9a000078
y.create.l HWIO_GSBI0_UART_DM_RF_4_ADDR  0x9a00007c
y.create.l HWIO_GSBI0_UART_DM_MISR_ADDR  0x9a000010
y.create.l HWIO_GSBI0_UART_DM_ISR_ADDR  0x9a000014
y.create.l HWIO_GSBI0_UART_DM_RX_TOTAL_SNAP_ADDR  0x9a000038
y.create.l HWIO_GSBI0_UART_DM_TXFS_ADDR  0x9a00004c
y.create.l HWIO_GSBI0_UART_DM_RXFS_ADDR  0x9a000050
y.create.l HWIO_GSBI0_UART_DM_TEST_RD_DATA_ADDR  0x9a000090
y.create.l HWIO_GSBI0_I2C_WRITE_DATA_ADDR  0x9c000000
y.create.l HWIO_GSBI0_I2C_CLK_CTL_ADDR  0x9c000004
y.create.l HWIO_GSBI0_I2C_STATUS_ADDR  0x9c000008
y.create.l HWIO_GSBI0_I2C_READ_DATA_ADDR  0x9c00000c
y.create.l HWIO_GSBI0_I2C_INTERFACE_SELECT_ADDR  0x9c000010
y.create.l HWIO_GSBI0_SPI_CONFIG_ADDR  0x9e000000
y.create.l HWIO_GSBI0_SPI_IO_CONTROL_ADDR  0x9e000004
y.create.l HWIO_GSBI0_SPI_IO_MODES_ADDR  0x9e000008
y.create.l HWIO_GSBI0_SPI_SW_RESET_ADDR  0x9e00000c
y.create.l HWIO_GSBI0_SPI_TIME_OUT_ADDR  0x9e000010
y.create.l HWIO_GSBI0_SPI_TIME_OUT_CURRENT_ADDR  0x9e000014
y.create.l HWIO_GSBI0_SPI_MX_OUTPUT_COUNT_ADDR  0x9e000018
y.create.l HWIO_GSBI0_SPI_MX_OUTPUT_CNT_CURRENT_ADDR  0x9e00001c
y.create.l HWIO_GSBI0_SPI_MX_INPUT_COUNT_ADDR  0x9e000020
y.create.l HWIO_GSBI0_SPI_MX_INPUT_CNT_CURRENT_ADDR  0x9e000024
y.create.l HWIO_GSBI0_SPI_MX_READ_COUNT_ADDR  0x9e000028
y.create.l HWIO_GSBI0_SPI_MX_READ_CNT_CURRENT_ADDR  0x9e00002c
y.create.l HWIO_GSBI0_SPI_OPERATIONAL_ADDR  0x9e000030
y.create.l HWIO_GSBI0_SPI_ERROR_FLAGS_ADDR  0x9e000034
y.create.l HWIO_GSBI0_SPI_ERROR_FLAGS_EN_ADDR  0x9e000038
y.create.l HWIO_GSBI0_SPI_DEASSERT_WAIT_ADDR  0x9e00003c
y.create.l HWIO_GSBI0_SPI_OUTPUT_DEBUG_ADDR  0x9e000040
y.create.l HWIO_GSBI0_SPI_INPUT_DEBUG_ADDR  0x9e000044
y.create.l HWIO_GSBI0_SPI_FIFO_WORD_CNT_ADDR  0x9e000048
y.create.l HWIO_GSBI0_SPI_TEST_CTRL_ADDR  0x9e00004c
y.create.l HWIO_GSBI0_SPI_OUTPUT_FIFO_ADDR  0x9e000100
y.create.l HWIO_GSBI0_SPI_INPUT_FIFO_ADDR  0x9e000200
y.create.l HWIO_GSBI1_GSBI_CTRL_REG_ADDR  0xa0000000
y.create.l HWIO_GSBI1_GSBI_DBG0_REG_ADDR  0xa0000004
y.create.l HWIO_GSBI1_GSBI_DBG1_REG_ADDR  0xa0000008
y.create.l HWIO_GSBI1_GSBI_DBG2_REG_ADDR  0xa000000c
y.create.l HWIO_GSBI1_GSBI_DBG3_REG_ADDR  0xa0000010
y.create.l HWIO_GSBI1_UART_DM_MR1_ADDR  0xa2000000
y.create.l HWIO_GSBI1_UART_DM_MR2_ADDR  0xa2000004
y.create.l HWIO_GSBI1_UART_DM_CSR_ADDR  0xa2000008
y.create.l HWIO_GSBI1_UART_DM_TF_ADDR  0xa2000070
y.create.l HWIO_GSBI1_UART_DM_TF_2_ADDR  0xa2000074
y.create.l HWIO_GSBI1_UART_DM_TF_3_ADDR  0xa2000078
y.create.l HWIO_GSBI1_UART_DM_TF_4_ADDR  0xa200007c
y.create.l HWIO_GSBI1_UART_DM_CR_ADDR  0xa2000010
y.create.l HWIO_GSBI1_UART_DM_IMR_ADDR  0xa2000014
y.create.l HWIO_GSBI1_UART_DM_IPR_ADDR  0xa2000018
y.create.l HWIO_GSBI1_UART_DM_TFWR_ADDR  0xa200001c
y.create.l HWIO_GSBI1_UART_DM_RFWR_ADDR  0xa2000020
y.create.l HWIO_GSBI1_UART_DM_HCR_ADDR  0xa2000024
y.create.l HWIO_GSBI1_UART_DM_DMRX_ADDR  0xa2000034
y.create.l HWIO_GSBI1_UART_DM_IRDA_ADDR  0xa2000038
y.create.l HWIO_GSBI1_UART_DM_DMEN_ADDR  0xa200003c
y.create.l HWIO_GSBI1_UART_DM_NO_CHARS_FOR_TX_ADDR  0xa2000040
y.create.l HWIO_GSBI1_UART_DM_BADR_ADDR  0xa2000044
y.create.l HWIO_GSBI1_UART_DM_TESTSL_ADDR  0xa2000048
y.create.l HWIO_GSBI1_UART_DM_MISR_MODE_ADDR  0xa2000060
y.create.l HWIO_GSBI1_UART_DM_MISR_RESET_ADDR  0xa2000064
y.create.l HWIO_GSBI1_UART_DM_MISR_EXPORT_ADDR  0xa2000068
y.create.l HWIO_GSBI1_UART_DM_MISR_VAL_ADDR  0xa200006c
y.create.l HWIO_GSBI1_UART_DM_SIM_CFG_ADDR  0xa2000080
y.create.l HWIO_GSBI1_UART_DM_TEST_WR_ADDR_ADDR  0xa2000084
y.create.l HWIO_GSBI1_UART_DM_TEST_WR_DATA_ADDR  0xa2000088
y.create.l HWIO_GSBI1_UART_DM_TEST_RD_ADDR_ADDR  0xa200008c
y.create.l HWIO_GSBI1_UART_DM_SR_ADDR  0xa2000008
y.create.l HWIO_GSBI1_UART_DM_RF_ADDR  0xa2000070
y.create.l HWIO_GSBI1_UART_DM_RF_2_ADDR  0xa2000074
y.create.l HWIO_GSBI1_UART_DM_RF_3_ADDR  0xa2000078
y.create.l HWIO_GSBI1_UART_DM_RF_4_ADDR  0xa200007c
y.create.l HWIO_GSBI1_UART_DM_MISR_ADDR  0xa2000010
y.create.l HWIO_GSBI1_UART_DM_ISR_ADDR  0xa2000014
y.create.l HWIO_GSBI1_UART_DM_RX_TOTAL_SNAP_ADDR  0xa2000038
y.create.l HWIO_GSBI1_UART_DM_TXFS_ADDR  0xa200004c
y.create.l HWIO_GSBI1_UART_DM_RXFS_ADDR  0xa2000050
y.create.l HWIO_GSBI1_UART_DM_TEST_RD_DATA_ADDR  0xa2000090
y.create.l HWIO_GSBI1_I2C_WRITE_DATA_ADDR  0xa4000000
y.create.l HWIO_GSBI1_I2C_CLK_CTL_ADDR  0xa4000004
y.create.l HWIO_GSBI1_I2C_STATUS_ADDR  0xa4000008
y.create.l HWIO_GSBI1_I2C_READ_DATA_ADDR  0xa400000c
y.create.l HWIO_GSBI1_I2C_INTERFACE_SELECT_ADDR  0xa4000010
y.create.l HWIO_GSBI1_SPI_CONFIG_ADDR  0xa6000000
y.create.l HWIO_GSBI1_SPI_IO_CONTROL_ADDR  0xa6000004
y.create.l HWIO_GSBI1_SPI_IO_MODES_ADDR  0xa6000008
y.create.l HWIO_GSBI1_SPI_SW_RESET_ADDR  0xa600000c
y.create.l HWIO_GSBI1_SPI_TIME_OUT_ADDR  0xa6000010
y.create.l HWIO_GSBI1_SPI_TIME_OUT_CURRENT_ADDR  0xa6000014
y.create.l HWIO_GSBI1_SPI_MX_OUTPUT_COUNT_ADDR  0xa6000018
y.create.l HWIO_GSBI1_SPI_MX_OUTPUT_CNT_CURRENT_ADDR  0xa600001c
y.create.l HWIO_GSBI1_SPI_MX_INPUT_COUNT_ADDR  0xa6000020
y.create.l HWIO_GSBI1_SPI_MX_INPUT_CNT_CURRENT_ADDR  0xa6000024
y.create.l HWIO_GSBI1_SPI_MX_READ_COUNT_ADDR  0xa6000028
y.create.l HWIO_GSBI1_SPI_MX_READ_CNT_CURRENT_ADDR  0xa600002c
y.create.l HWIO_GSBI1_SPI_OPERATIONAL_ADDR  0xa6000030
y.create.l HWIO_GSBI1_SPI_ERROR_FLAGS_ADDR  0xa6000034
y.create.l HWIO_GSBI1_SPI_ERROR_FLAGS_EN_ADDR  0xa6000038
y.create.l HWIO_GSBI1_SPI_DEASSERT_WAIT_ADDR  0xa600003c
y.create.l HWIO_GSBI1_SPI_OUTPUT_DEBUG_ADDR  0xa6000040
y.create.l HWIO_GSBI1_SPI_INPUT_DEBUG_ADDR  0xa6000044
y.create.l HWIO_GSBI1_SPI_FIFO_WORD_CNT_ADDR  0xa6000048
y.create.l HWIO_GSBI1_SPI_TEST_CTRL_ADDR  0xa600004c
y.create.l HWIO_GSBI1_SPI_OUTPUT_FIFO_ADDR  0xa6000100
y.create.l HWIO_GSBI1_SPI_INPUT_FIFO_ADDR  0xa6000200
y.create.l HWIO_GSBI2_GSBI_CTRL_REG_ADDR  0xa8000000
y.create.l HWIO_GSBI2_GSBI_DBG0_REG_ADDR  0xa8000004
y.create.l HWIO_GSBI2_GSBI_DBG1_REG_ADDR  0xa8000008
y.create.l HWIO_GSBI2_GSBI_DBG2_REG_ADDR  0xa800000c
y.create.l HWIO_GSBI2_GSBI_DBG3_REG_ADDR  0xa8000010
y.create.l HWIO_GSBI2_UART_DM_MR1_ADDR  0xaa000000
y.create.l HWIO_GSBI2_UART_DM_MR2_ADDR  0xaa000004
y.create.l HWIO_GSBI2_UART_DM_CSR_ADDR  0xaa000008
y.create.l HWIO_GSBI2_UART_DM_TF_ADDR  0xaa000070
y.create.l HWIO_GSBI2_UART_DM_TF_2_ADDR  0xaa000074
y.create.l HWIO_GSBI2_UART_DM_TF_3_ADDR  0xaa000078
y.create.l HWIO_GSBI2_UART_DM_TF_4_ADDR  0xaa00007c
y.create.l HWIO_GSBI2_UART_DM_CR_ADDR  0xaa000010
y.create.l HWIO_GSBI2_UART_DM_IMR_ADDR  0xaa000014
y.create.l HWIO_GSBI2_UART_DM_IPR_ADDR  0xaa000018
y.create.l HWIO_GSBI2_UART_DM_TFWR_ADDR  0xaa00001c
y.create.l HWIO_GSBI2_UART_DM_RFWR_ADDR  0xaa000020
y.create.l HWIO_GSBI2_UART_DM_HCR_ADDR  0xaa000024
y.create.l HWIO_GSBI2_UART_DM_DMRX_ADDR  0xaa000034
y.create.l HWIO_GSBI2_UART_DM_IRDA_ADDR  0xaa000038
y.create.l HWIO_GSBI2_UART_DM_DMEN_ADDR  0xaa00003c
y.create.l HWIO_GSBI2_UART_DM_NO_CHARS_FOR_TX_ADDR  0xaa000040
y.create.l HWIO_GSBI2_UART_DM_BADR_ADDR  0xaa000044
y.create.l HWIO_GSBI2_UART_DM_TESTSL_ADDR  0xaa000048
y.create.l HWIO_GSBI2_UART_DM_MISR_MODE_ADDR  0xaa000060
y.create.l HWIO_GSBI2_UART_DM_MISR_RESET_ADDR  0xaa000064
y.create.l HWIO_GSBI2_UART_DM_MISR_EXPORT_ADDR  0xaa000068
y.create.l HWIO_GSBI2_UART_DM_MISR_VAL_ADDR  0xaa00006c
y.create.l HWIO_GSBI2_UART_DM_SIM_CFG_ADDR  0xaa000080
y.create.l HWIO_GSBI2_UART_DM_TEST_WR_ADDR_ADDR  0xaa000084
y.create.l HWIO_GSBI2_UART_DM_TEST_WR_DATA_ADDR  0xaa000088
y.create.l HWIO_GSBI2_UART_DM_TEST_RD_ADDR_ADDR  0xaa00008c
y.create.l HWIO_GSBI2_UART_DM_SR_ADDR  0xaa000008
y.create.l HWIO_GSBI2_UART_DM_RF_ADDR  0xaa000070
y.create.l HWIO_GSBI2_UART_DM_RF_2_ADDR  0xaa000074
y.create.l HWIO_GSBI2_UART_DM_RF_3_ADDR  0xaa000078
y.create.l HWIO_GSBI2_UART_DM_RF_4_ADDR  0xaa00007c
y.create.l HWIO_GSBI2_UART_DM_MISR_ADDR  0xaa000010
y.create.l HWIO_GSBI2_UART_DM_ISR_ADDR  0xaa000014
y.create.l HWIO_GSBI2_UART_DM_RX_TOTAL_SNAP_ADDR  0xaa000038
y.create.l HWIO_GSBI2_UART_DM_TXFS_ADDR  0xaa00004c
y.create.l HWIO_GSBI2_UART_DM_RXFS_ADDR  0xaa000050
y.create.l HWIO_GSBI2_UART_DM_TEST_RD_DATA_ADDR  0xaa000090
y.create.l HWIO_GSBI2_I2C_WRITE_DATA_ADDR  0xac000000
y.create.l HWIO_GSBI2_I2C_CLK_CTL_ADDR  0xac000004
y.create.l HWIO_GSBI2_I2C_STATUS_ADDR  0xac000008
y.create.l HWIO_GSBI2_I2C_READ_DATA_ADDR  0xac00000c
y.create.l HWIO_GSBI2_I2C_INTERFACE_SELECT_ADDR  0xac000010
y.create.l HWIO_GSBI2_SPI_CONFIG_ADDR  0xae000000
y.create.l HWIO_GSBI2_SPI_IO_CONTROL_ADDR  0xae000004
y.create.l HWIO_GSBI2_SPI_IO_MODES_ADDR  0xae000008
y.create.l HWIO_GSBI2_SPI_SW_RESET_ADDR  0xae00000c
y.create.l HWIO_GSBI2_SPI_TIME_OUT_ADDR  0xae000010
y.create.l HWIO_GSBI2_SPI_TIME_OUT_CURRENT_ADDR  0xae000014
y.create.l HWIO_GSBI2_SPI_MX_OUTPUT_COUNT_ADDR  0xae000018
y.create.l HWIO_GSBI2_SPI_MX_OUTPUT_CNT_CURRENT_ADDR  0xae00001c
y.create.l HWIO_GSBI2_SPI_MX_INPUT_COUNT_ADDR  0xae000020
y.create.l HWIO_GSBI2_SPI_MX_INPUT_CNT_CURRENT_ADDR  0xae000024
y.create.l HWIO_GSBI2_SPI_MX_READ_COUNT_ADDR  0xae000028
y.create.l HWIO_GSBI2_SPI_MX_READ_CNT_CURRENT_ADDR  0xae00002c
y.create.l HWIO_GSBI2_SPI_OPERATIONAL_ADDR  0xae000030
y.create.l HWIO_GSBI2_SPI_ERROR_FLAGS_ADDR  0xae000034
y.create.l HWIO_GSBI2_SPI_ERROR_FLAGS_EN_ADDR  0xae000038
y.create.l HWIO_GSBI2_SPI_DEASSERT_WAIT_ADDR  0xae00003c
y.create.l HWIO_GSBI2_SPI_OUTPUT_DEBUG_ADDR  0xae000040
y.create.l HWIO_GSBI2_SPI_INPUT_DEBUG_ADDR  0xae000044
y.create.l HWIO_GSBI2_SPI_FIFO_WORD_CNT_ADDR  0xae000048
y.create.l HWIO_GSBI2_SPI_TEST_CTRL_ADDR  0xae00004c
y.create.l HWIO_GSBI2_SPI_OUTPUT_FIFO_ADDR  0xae000100
y.create.l HWIO_GSBI2_SPI_INPUT_FIFO_ADDR  0xae000200
y.create.l HWIO_UART_DM_MR1_ADDR  0xf0000000
y.create.l HWIO_UART_DM_MR2_ADDR  0xf0000004
y.create.l HWIO_UART_DM_CSR_ADDR  0xf0000008
y.create.l HWIO_UART_DM_TF_ADDR  0xf0000070
y.create.l HWIO_UART_DM_TF_2_ADDR  0xf0000074
y.create.l HWIO_UART_DM_TF_3_ADDR  0xf0000078
y.create.l HWIO_UART_DM_TF_4_ADDR  0xf000007c
y.create.l HWIO_UART_DM_CR_ADDR  0xf0000010
y.create.l HWIO_UART_DM_IMR_ADDR  0xf0000014
y.create.l HWIO_UART_DM_IPR_ADDR  0xf0000018
y.create.l HWIO_UART_DM_TFWR_ADDR  0xf000001c
y.create.l HWIO_UART_DM_RFWR_ADDR  0xf0000020
y.create.l HWIO_UART_DM_HCR_ADDR  0xf0000024
y.create.l HWIO_UART_DM_DMRX_ADDR  0xf0000034
y.create.l HWIO_UART_DM_IRDA_ADDR  0xf0000038
y.create.l HWIO_UART_DM_DMEN_ADDR  0xf000003c
y.create.l HWIO_UART_DM_NO_CHARS_FOR_TX_ADDR  0xf0000040
y.create.l HWIO_UART_DM_BADR_ADDR  0xf0000044
y.create.l HWIO_UART_DM_TESTSL_ADDR  0xf0000048
y.create.l HWIO_UART_DM_MISR_MODE_ADDR  0xf0000060
y.create.l HWIO_UART_DM_MISR_RESET_ADDR  0xf0000064
y.create.l HWIO_UART_DM_MISR_EXPORT_ADDR  0xf0000068
y.create.l HWIO_UART_DM_MISR_VAL_ADDR  0xf000006c
y.create.l HWIO_UART_DM_SIM_CFG_ADDR  0xf0000080
y.create.l HWIO_UART_DM_TEST_WR_ADDR_ADDR  0xf0000084
y.create.l HWIO_UART_DM_TEST_WR_DATA_ADDR  0xf0000088
y.create.l HWIO_UART_DM_TEST_RD_ADDR_ADDR  0xf000008c
y.create.l HWIO_UART_DM_SR_ADDR  0xf0000008
y.create.l HWIO_UART_DM_RF_ADDR  0xf0000070
y.create.l HWIO_UART_DM_RF_2_ADDR  0xf0000074
y.create.l HWIO_UART_DM_RF_3_ADDR  0xf0000078
y.create.l HWIO_UART_DM_RF_4_ADDR  0xf000007c
y.create.l HWIO_UART_DM_MISR_ADDR  0xf0000010
y.create.l HWIO_UART_DM_ISR_ADDR  0xf0000014
y.create.l HWIO_UART_DM_RX_TOTAL_SNAP_ADDR  0xf0000038
y.create.l HWIO_UART_DM_TXFS_ADDR  0xf000004c
y.create.l HWIO_UART_DM_RXFS_ADDR  0xf0000050
y.create.l HWIO_UART_DM_TEST_RD_DATA_ADDR  0xf0000090
y.create.l HWIO_NAND_FLASH_CMD_ADDR  0x80008000
y.create.l HWIO_NAND_ADDR0_ADDR  0x80008004
y.create.l HWIO_NAND_ADDR1_ADDR  0x80008008
y.create.l HWIO_NAND_FLASH_CHIP_SELECT_ADDR  0x8000800c
y.create.l HWIO_NANDC_EXEC_CMD_ADDR  0x80008010
y.create.l HWIO_NAND_FLASH_STATUS_ADDR  0x80008014
y.create.l HWIO_NANDC_BUFFER_STATUS_ADDR  0x80008018
y.create.l HWIO_NAND_DEVn_CFG0_ADDR  0x80008020
y.create.l HWIO_NAND_DEVn_CFG1_ADDR  0x80008024
y.create.l HWIO_NAND_FLASH_READ_ID_ADDR  0x80008040
y.create.l HWIO_NAND_FLASH_READ_STATUS_ADDR  0x80008044
y.create.l HWIO_NAND_CONTROLLER_CFG_ADDR  0x80008048
y.create.l HWIO_NAND_FLASH_CONFIG_DATA_ADDR  0x80008050
y.create.l HWIO_NAND_FLASH_CONFIG_ADDR  0x80008054
y.create.l HWIO_NAND_FLASH_CONFIG_MODE_ADDR  0x80008058
y.create.l HWIO_NAND_FLASH_CONFIG_STATUS_ADDR  0x80008060
y.create.l HWIO_FLASH_MACRO1_REG_ADDR  0x80008064
y.create.l HWIO_FLASH_XFR_STEP1_ADDR  0x80008070
y.create.l HWIO_FLASH_XFR_STEP2_ADDR  0x80008074
y.create.l HWIO_FLASH_XFR_STEP3_ADDR  0x80008078
y.create.l HWIO_FLASH_XFR_STEP4_ADDR  0x8000807c
y.create.l HWIO_FLASH_XFR_STEP5_ADDR  0x80008080
y.create.l HWIO_FLASH_XFR_STEP6_ADDR  0x80008084
y.create.l HWIO_FLASH_XFR_STEP7_ADDR  0x80008088
y.create.l HWIO_NAND_CTLR_DEBUG_BUS_CFG_ADDR  0x8000808c
y.create.l HWIO_FLASH_DEV_CMD0_ADDR  0x800080a0
y.create.l HWIO_FLASH_DEV_CMD1_ADDR  0x800080a4
y.create.l HWIO_FLASH_DEV_CMD2_ADDR  0x800080a8
y.create.l HWIO_FLASH_DEV_CMD_VLD_ADDR  0x800080ac
y.create.l HWIO_EBI2_MISR_SIG_REG_ADDR  0x800080b0
y.create.l HWIO_NAND_ADDR2_ADDR  0x800080c0
y.create.l HWIO_NAND_ADDR3_ADDR  0x800080c4
y.create.l HWIO_NAND_ADDR4_ADDR  0x800080c8
y.create.l HWIO_NAND_ADDR5_ADDR  0x800080cc
y.create.l HWIO_FLASH_DEV_CMD3_ADDR  0x800080d0
y.create.l HWIO_FLASH_DEV_CMD4_ADDR  0x800080d4
y.create.l HWIO_FLASH_DEV_CMD5_ADDR  0x800080d8
y.create.l HWIO_FLASH_DEV_CMD6_ADDR  0x800080dc
y.create.l HWIO_FLASH_BURST_CFG_ADDR  0x800080e0
y.create.l HWIO_EBI2_ECC_BUF_CFG_ADDR  0x800080f0
y.create.l HWIO_NAND_FLASH_BIT_STREAM_ADDR  0x800080f4
y.create.l HWIO_FLASH_BUFFn_ACC_ADDR  0x80008100
y.create.l HWIO_ARM_MOD_REG_ADDR  0x80000000
y.create.l HWIO_ARM_CFG_REG_ADDR  0x80000004
y.create.l HWIO_ARM_CLK_EN_REG_ADDR  0x80000008
y.create.l HWIO_ARM_CLK_INV_REG_ADDR  0x800000f0
y.create.l HWIO_ADSP_MND0_REG_ADDR  0x80000010
y.create.l HWIO_ADSP_MND1_REG_ADDR  0x80000014
y.create.l HWIO_ADSP_CFG_REG_ADDR  0x80000018
y.create.l HWIO_ADSP_CLK_CTL_REG_ADDR  0x80000054
y.create.l HWIO_ADSP_MODE_REG_ADDR  0x800000fc
y.create.l HWIO_ADSP_FS_CTL_REG_ADDR  0x80000100
y.create.l HWIO_ECODEC_MN_REG_ADDR  0x8000001c
y.create.l HWIO_ECODEC_CD_REG_ADDR  0x80000020
y.create.l HWIO_GSBI0_MN_REG_ADDR  0x8000002c
y.create.l HWIO_GSBI0_CD_REG_ADDR  0x80000030
y.create.l HWIO_GSBI1_MN_REG_ADDR  0x80000034
y.create.l HWIO_GSBI1_CD_REG_ADDR  0x80000038
y.create.l HWIO_GSBI2_MN_REG_ADDR  0x800000d4
y.create.l HWIO_GSBI2_CD_REG_ADDR  0x800000d8
y.create.l HWIO_I2S_MN_REG_ADDR  0x8000003c
y.create.l HWIO_I2S_CD_REG_ADDR  0x80000040
y.create.l HWIO_ICODEC_RX_MN_REG_ADDR  0x80000044
y.create.l HWIO_ICODEC_RX_CD_REG_ADDR  0x80000048
y.create.l HWIO_ICODEC_TX_MN_REG_ADDR  0x8000004c
y.create.l HWIO_ICODEC_TX_CD_REG_ADDR  0x80000050
y.create.l HWIO_SDCC_MN_REG_ADDR  0x800000e0
y.create.l HWIO_SDCC_CD_REG_ADDR  0x800000e4
y.create.l HWIO_MISC_CFG_REG_ADDR  0x80000090
y.create.l HWIO_UART_DM_MN_REG_ADDR  0x800000f4
y.create.l HWIO_UART_DM_CD_REG_ADDR  0x800000f8
y.create.l HWIO_USB_MN_REG_ADDR  0x80000094
y.create.l HWIO_USB_CD_REG_ADDR  0x800000c0
y.create.l HWIO_CAMCLK_MN_REG_ADDR  0x80000104
y.create.l HWIO_CAMCLK_CD_REG_ADDR  0x80000108
y.create.l HWIO_VIDEO_VFE_MN_REG_ADDR  0x800000e8
y.create.l HWIO_VIDEO_VFE_CD_REG_ADDR  0x800000ec
y.create.l HWIO_CLK_OFF_A_ADDR  0x800000c4
y.create.l HWIO_CLK_OFF_B_ADDR  0x800000c8
y.create.l HWIO_DBG_CFG_REG_ADDR  0x800000d0
y.create.l HWIO_SW_RESET_ALL_REG_ADDR  0x80000200
y.create.l HWIO_RESET_STATUS_REG_ADDR  0x80000204
y.create.l HWIO_SW_RESET_REG_ADDR  0x80000208
y.create.l HWIO_PLL_TESTPAD_CFG_REG_ADDR  0x800000cc
y.create.l HWIO_PLL_MODE_REG_ADDR  0x80000300
y.create.l HWIO_PLL_L_VAL_REG_ADDR  0x80000308
y.create.l HWIO_PLL_M_VAL_REG_ADDR  0x8000030c
y.create.l HWIO_PLL_N_VAL_REG_ADDR  0x80000310
y.create.l HWIO_PLL_CONFIG_REG_ADDR  0x80000314
y.create.l HWIO_PLL_TEST_CTL_REG_ADDR  0x80000318
y.create.l HWIO_PLL_STATUS_REG_ADDR  0x8000031c
y.create.l HWIO_BOOT_ROM_CLOCK_ENABLE_ADDR  0x80002000
y.create.l HWIO_PAUSE_TIMER_ADDR  0x80002020
y.create.l HWIO_PAUSE_TIMER_CTL_ADDR  0x80002028
y.create.l HWIO_BPM_TRIGGER_ADDR  0x80002030
y.create.l HWIO_BPM_HSEL_SEL_ADDR  0x80002034
y.create.l HWIO_EBI1_CS0_CS1_SWAP_ADDR  0x80002040
y.create.l HWIO_MSM_BRIDGE_CFG_ADDR  0x8000204c
y.create.l HWIO_AHB_TEST_BUS_CTL_ADDR  0x80002068
y.create.l HWIO_AHB_TEST_BUS_ADDR  0x8000206c
y.create.l HWIO_BOOT_FROM_ROM_STATUS_ADDR  0x80002074
y.create.l HWIO_AHB_APP_BUS_PRIORITY_ADDR  0x80002090
y.create.l HWIO_AHB_BUS_REQUEST_ADDR  0x80002098
y.create.l HWIO_AHB_BUS_MASTERS_ADDR  0x8000209c
y.create.l HWIO_AHB_SYS_BUS_PRIORITY_ADDR  0x800020e4
y.create.l HWIO_AHB_SYS_DUMMY0_ADDR  0x800020e8
y.create.l HWIO_AHB_SYS_DUMMY1_ADDR  0x800020ec
y.create.l HWIO_AHB_SYS_DUMMY2_ADDR  0x800020f0
y.create.l HWIO_SYS_FINE_TABLEn_ADDR  0x800020f4
y.create.l HWIO_SYS_COARSE_TABLEn_ADDR  0x80002114
y.create.l HWIO_APP_FINE_TABLEn_ADDR  0x80002174
y.create.l HWIO_APP_COARSE_TABLEn_ADDR  0x80002194
y.create.l HWIO_GT_SLOT_SIZE_ADDR  0x800021b8
y.create.l HWIO_RXA2D_GPR_A1_ADDR  0x80012000
y.create.l HWIO_RXA2D_DDO_ADDR  0x80012004
y.create.l HWIO_RXA2D_EN_ADDR  0x80012008
y.create.l HWIO_RXA2D_CONF_ADDR  0x8001200c
y.create.l HWIO_RXA2D_CLK_ADDR  0x80012010
y.create.l HWIO_RXA2D_CLK_HDRV_ADDR  0x80012014
y.create.l HWIO_RXA2D_CM1_ADDR  0x80012018
y.create.l HWIO_RXA2D_BOOST_ADDR  0x8001201c
y.create.l HWIO_RXA2D_I1_ADDR  0x80012020
y.create.l HWIO_RXA2D_I2_ADDR  0x80012024
y.create.l HWIO_RXA2D_I3_ADDR  0x80012028
y.create.l HWIO_RXA2D_TMUX_ADDR  0x8001202c
y.create.l HWIO_RXA2D_CMP_ADDR  0x80012030
y.create.l HWIO_RXA2D_AAF_ADDR  0x80012034
y.create.l HWIO_IRQ_CLEAR_0_ADDR  0x80006000
y.create.l HWIO_IRQ_CLEAR_1_ADDR  0x80006004
y.create.l HWIO_FIQ_CLEAR_0_ADDR  0x80006008
y.create.l HWIO_FIQ_CLEAR_1_ADDR  0x8000600c
y.create.l HWIO_INT_SET_0_ADDR  0x80006028
y.create.l HWIO_INT_SET_1_ADDR  0x8000602c
y.create.l HWIO_INT_POL_SET_ADDR  0x80006040
y.create.l HWIO_IRQ_EN_0_ADDR  0x80006030
y.create.l HWIO_IRQ_EN_1_ADDR  0x80006034
y.create.l HWIO_FIQ_EN_0_ADDR  0x80006038
y.create.l HWIO_FIQ_EN_1_ADDR  0x8000603c
y.create.l HWIO_INT_DET_REG_0_ADDR  0x80006058
y.create.l HWIO_INT_DET_REG_1_ADDR  0x8000605c
y.create.l HWIO_IRQ_STATUS_0_ADDR  0x80006074
y.create.l HWIO_IRQ_STATUS_1_ADDR  0x80006078
y.create.l HWIO_FIQ_STATUS_0_ADDR  0x8000607c
y.create.l HWIO_FIQ_STATUS_1_ADDR  0x80006080
y.create.l HWIO_IRQ_VEC_INDEX_RD_ADDR  0x8000609c
y.create.l HWIO_IRQ_VEC_INDEX_PEND_RD_ADDR  0x800060a0
y.create.l HWIO_IRQ_IN_SERVICE_RD_ADDR  0x800060a4
y.create.l HWIO_IRQ_IN_STACK_RD_ADDR  0x800060a8
y.create.l HWIO_INT_CTL_CFG_ADDR  0x800060ac
y.create.l HWIO_INT_n_PRIORITY_ADDR  0x800060b0
y.create.l HWIO_MSM_GPIO1_INT_CLEAR_0_ADDR  0x800061a4
y.create.l HWIO_MSM_GPIO1_INT_EN_0_ADDR  0x800061a0
y.create.l HWIO_MSM_GPIO1_INT_POLARITY_0_ADDR  0x800061b4
y.create.l HWIO_MSM_GPIO1_DETECT_CTL_0_ADDR  0x800061c8
y.create.l HWIO_MSM_GPIO1_INT_STATUS_0_ADDR  0x800061dc
y.create.l HWIO_MSM_GPIO1_INT_CLEAR_1_ADDR  0x800061f0
y.create.l HWIO_MSM_GPIO1_INT_EN_1_ADDR  0x800061f4
y.create.l HWIO_MSM_GPIO1_INT_POLARITY_1_ADDR  0x800061f8
y.create.l HWIO_MSM_GPIO1_DETECT_CTL_1_ADDR  0x800061fc
y.create.l HWIO_MSM_GPIO1_INT_STATUS_1_ADDR  0x80006200
y.create.l HWIO_GPIO_OUT_0_ADDR  0x8000a000
y.create.l HWIO_GPIO_OUT_1_ADDR  0x8000a004
y.create.l HWIO_GPIO_OE_0_ADDR  0x8000a008
y.create.l HWIO_GPIO_OE_1_ADDR  0x8000a00c
y.create.l HWIO_GPIO_PAGE_ADDR  0x8000a010
y.create.l HWIO_GPIO_CFG_ADDR  0x8000a014
y.create.l HWIO_GPIO_IN_0_ADDR  0x8000a018
y.create.l HWIO_GPIO_IN_1_ADDR  0x8000a01c
y.create.l HWIO_CHIP_MODE_ADDR  0x8000c000
y.create.l HWIO_WEB_MISC_WR_ADDR  0x8000c004
y.create.l HWIO_EBI1_PAD_PULL_0_ADDR  0x8000c120
y.create.l HWIO_EBI1_PAD_PULL_1_ADDR  0x8000c124
y.create.l HWIO_EBI2_PAD_PULL_0_ADDR  0x8000c128
y.create.l HWIO_EBI2_PAD_PULL_1_ADDR  0x8000c12c
y.create.l HWIO_D2D_PAD_PULL_0_ADDR  0x8000c008
y.create.l HWIO_D2D_PAD_PULL_1_ADDR  0x8000c00c
y.create.l HWIO_D2D_PAD_HDRIVE_MSEL_0_ADDR  0x8000c010
y.create.l HWIO_D2D_PAD_HDRIVE_MSEL_1_ADDR  0x8000c014
y.create.l HWIO_PAD_HDRIVE_MSEL_ADDR  0x8000c018
y.create.l HWIO_EBI1_PAD_HDRIVE_MSEL_0_ADDR  0x8000c01c
y.create.l HWIO_EBI1_PAD_HDRIVE_MSEL_1_ADDR  0x8000c020
y.create.l HWIO_EBI2_PAD_HDRIVE_MSEL_0_ADDR  0x8000c024
y.create.l HWIO_GPIO_PAD_HDRIVE_MSEL_0_ADDR  0x8000c030
y.create.l HWIO_GPIO_PAD_HDRIVE_MSEL_1_ADDR  0x8000c034
y.create.l HWIO_GPIO_PAD_HDRIVE_MSEL_2_ADDR  0x8000c038
y.create.l HWIO_GPIO_PAD_HDRIVE_MSEL_3_ADDR  0x8000c03c
y.create.l HWIO_GPIO_PAD_HDRIVE_MSEL_4_ADDR  0x8000c040
y.create.l HWIO_GPIO_PAD_HDRIVE_MSEL_5_ADDR  0x8000c044
y.create.l HWIO_GPIO_PAD_HDRIVE_MSEL_6_ADDR  0x8000c048
y.create.l HWIO_GPIO_PAD_HDRIVE_MSEL_7_ADDR  0x8000c04c
y.create.l HWIO_PMIC_CONTROL_ADDR  0x8000c100
y.create.l HWIO_ANALOG_TEST_SEL_ADDR  0x8000c058
y.create.l HWIO_ADIE_TEST_CONTROL_ADDR  0x8000c05c
y.create.l HWIO_TXDAC_TEST_CONTROL_ADDR  0x8000c060
y.create.l HWIO_HW_REVISION_NUMBER_ADDR  0x8000c064
y.create.l HWIO_CHIP_FEATURE_ID_ADDR  0x8000c068
y.create.l HWIO_USB_GPIO_TEST_ADDR  0x8000c130
y.create.l HWIO_SSBI_GPIO_TEST_ADDR  0x8000c134
y.create.l HWIO_USB_PIN_CONFIG_ADDR  0x8000c07c
y.create.l HWIO_USB_PIN_SEL_ADDR  0x8000c080
y.create.l HWIO_TEST_BUS_EN_ADDR  0x8000c084
y.create.l HWIO_PMBLK_CONFIG_ADDR  0x8000c088
y.create.l HWIO_PMBLK_CNT0_ADDR  0x8000c08c
y.create.l HWIO_PMBLK_CNT1_ADDR  0x8000c090
y.create.l HWIO_PMBLK_CNT2_ADDR  0x8000c094
y.create.l HWIO_PMBLK_CNT3_ADDR  0x8000c098
y.create.l HWIO_PMBLK_CNT4_ADDR  0x8000c09c
y.create.l HWIO_TIME_TICK_CTL_ADDR  0x8000e0a4
y.create.l HWIO_TIME_TICK_INT_MSB_ADDR  0x8000e0a8
y.create.l HWIO_TCXO_PDM_CTL_ADDR  0x80030040
y.create.l HWIO_PDM0_CTL_ADDR  0x80030044
y.create.l HWIO_PDM1_CTL_ADDR  0x80030048
y.create.l HWIO_GP_MN_CLK_MDIV_ADDR  0x8003004c
y.create.l HWIO_GP_MN_CLK_NDIV_ADDR  0x80030050
y.create.l HWIO_GP_MN_CLK_DUTY_ADDR  0x80030054
y.create.l HWIO_WEB_TCXO4_TEST_ADDR  0x80030058
y.create.l HWIO_I2C_WRITE_DATA_ADDR  0x80030000
y.create.l HWIO_I2C_CLK_CTL_ADDR  0x80030004
y.create.l HWIO_I2C_STATUS_ADDR  0x80030008
y.create.l HWIO_I2C_READ_DATA_ADDR  0x8003000c
y.create.l HWIO_I2C_INTERFACE_SELECT_ADDR  0x80030010
y.create.l HWIO_MCI_POWER_ADDR  0x80010000
y.create.l HWIO_MCI_CLK_ADDR  0x80010004
y.create.l HWIO_MCI_ARGUMENT_ADDR  0x80010008
y.create.l HWIO_MCI_CMD_ADDR  0x8001000c
y.create.l HWIO_MCI_RESP_CMD_ADDR  0x80010010
y.create.l HWIO_MCI_RESPn_ADDR  0x80010014
y.create.l HWIO_MCI_DATA_TIMER_ADDR  0x80010024
y.create.l HWIO_MCI_DATA_LENGTH_ADDR  0x80010028
y.create.l HWIO_MCI_DATA_CTL_ADDR  0x8001002c
y.create.l HWIO_MCI_DATA_COUNT_ADDR  0x80010030
y.create.l HWIO_MCI_STATUS_ADDR  0x80010034
y.create.l HWIO_MCI_CLEAR_ADDR  0x80010038
y.create.l HWIO_MCI_INT_MASKn_ADDR  0x8001003c
y.create.l HWIO_MCI_FIFO_COUNT_ADDR  0x80010044
y.create.l HWIO_MCI_FIFO_ADDR  0x80010080
y.create.l HWIO_MCI_ABORT_ADDR  0x800100c0
y.create.l HWIO_MCI_START_ADDR_ADDR  0x800100c4
y.create.l HWIO_MCI_DMA_CONFIG_ADDR  0x800100c8
y.create.l HWIO_MCI_TESTBUS_CONFIG_ADDR  0x800100cc
y.create.l HWIO_MCI_TEST_CTL_ADDR  0x800100d0
y.create.l HWIO_MCI_TEST_INPUT_ADDR  0x800100d4
y.create.l HWIO_MCI_TEST_OUT_ADDR  0x800100d8
y.create.l HWIO_MCI_PERPH_ID0_ADDR  0x800100e0
y.create.l HWIO_MCI_PERPH_ID1_ADDR  0x800100e4
y.create.l HWIO_MCI_PERPH_ID2_ADDR  0x800100e8
y.create.l HWIO_MCI_PERPH_ID3_ADDR  0x800100ec
y.create.l HWIO_MCI_PCELL_ID0_ADDR  0x800100f0
y.create.l HWIO_MCI_PCELL_ID1_ADDR  0x800100f4
y.create.l HWIO_MCI_PCELL_ID2_ADDR  0x800100f8
y.create.l HWIO_MCI_PCELL_ID3_ADDR  0x800100fc
y.create.l HWIO_USB_OTG_HS_ID_ADDR  0x80016000
y.create.l HWIO_USB_OTG_HS_HWGENERAL_ADDR  0x80016004
y.create.l HWIO_USB_OTG_HS_HWHOST_ADDR  0x80016008
y.create.l HWIO_USB_OTG_HS_HWDEVICE_ADDR  0x8001600c
y.create.l HWIO_USB_OTG_HS_HWTXBUF_ADDR  0x80016010
y.create.l HWIO_USB_OTG_HS_HWRXBUF_ADDR  0x80016014
y.create.l HWIO_USB_OTG_HS_GPTIMER0LD_ADDR  0x80016080
y.create.l HWIO_USB_OTG_HS_GPTIMER0CTRL_ADDR  0x80016084
y.create.l HWIO_USB_OTG_HS_GPTIMER1LD_ADDR  0x80016088
y.create.l HWIO_USB_OTG_HS_GPTIMER1CTRL_ADDR  0x8001608c
y.create.l HWIO_USB_OTG_HS_AHB_BURST_ADDR  0x80016090
y.create.l HWIO_USB_OTG_HS_XTOR_STS_ADDR  0x80016094
y.create.l HWIO_USB_OTG_HS_AHB_MODE_ADDR  0x80016098
y.create.l HWIO_USB_OTG_HS_GEN_CONFIG_ADDR  0x8001609c
y.create.l HWIO_USB_OTG_HS_CAPLENGTH_ADDR  0x80016100
y.create.l HWIO_USB_OTG_HS_HCIVERSION_ADDR  0x80016102
y.create.l HWIO_USB_OTG_HS_HCSPARAMS_ADDR  0x80016104
y.create.l HWIO_USB_OTG_HS_HCCPARAMS_ADDR  0x80016108
y.create.l HWIO_USB_OTG_HS_DCIVERSION_ADDR  0x80016120
y.create.l HWIO_USB_OTG_HS_DCCPARAMS_ADDR  0x80016124
y.create.l HWIO_USB_OTG_HS_USBCMD_ADDR  0x80016140
y.create.l HWIO_USB_OTG_HS_USBSTS_ADDR  0x80016144
y.create.l HWIO_USB_OTG_HS_USBINTR_ADDR  0x80016148
y.create.l HWIO_USB_OTG_HS_FRINDEX_ADDR  0x8001614c
y.create.l HWIO_USB_OTG_HS_PERIODICLISTBASE_ADDR  0x80016154
y.create.l HWIO_USB_OTG_HS_DEVICEADDR_ADDR  0x80016154
y.create.l HWIO_USB_OTG_HS_ASYNCLISTADDR_ADDR  0x80016158
y.create.l HWIO_USB_OTG_HS_ENDPOINTLISTADDR_ADDR  0x80016158
y.create.l HWIO_USB_OTG_HS_TTCTRL_ADDR  0x8001615c
y.create.l HWIO_USB_OTG_HS_BURSTSIZE_ADDR  0x80016160
y.create.l HWIO_USB_OTG_HS_TXFILLTUNING_ADDR  0x80016164
y.create.l HWIO_USB_OTG_HS_ULPI_VIEWPORT_ADDR  0x80016170
y.create.l HWIO_USB_OTG_HS_ENDPTNAK_ADDR  0x80016178
y.create.l HWIO_USB_OTG_HS_ENDPTNAKEN_ADDR  0x8001617c
y.create.l HWIO_USB_OTG_HS_PORTSC_ADDR  0x80016184
y.create.l HWIO_USB_OTG_HS_OTGSC_ADDR  0x800161a4
y.create.l HWIO_USB_OTG_HS_USBMODE_ADDR  0x800161a8
y.create.l HWIO_USB_OTG_HS_ENPDTSETUPSTAT_ADDR  0x800161ac
y.create.l HWIO_USB_OTG_HS_ENDPTPRIME_ADDR  0x800161b0
y.create.l HWIO_USB_OTG_HS_ENDPTFLUSH_ADDR  0x800161b4
y.create.l HWIO_USB_OTG_HS_ENDPTSTAT_ADDR  0x800161b8
y.create.l HWIO_USB_OTG_HS_ENDPTCOMPLETE_ADDR  0x800161bc
y.create.l HWIO_USB_OTG_HS_ENDPTCTRL0_ADDR  0x800161c0
y.create.l HWIO_USB_OTG_HS_ENDPTCTRLn_ADDR  0x800161c0
y.create.l HWIO_SSBI_WRAPPER_SSBI_CTL_ADDR  0x80018000
y.create.l HWIO_SSBI_WRAPPER_SSBI_RESET_ADDR  0x80018004
y.create.l HWIO_SSBI_WRAPPER_SSBI_CMD_ADDR  0x80018008
y.create.l HWIO_SSBI_WRAPPER_SSBI_BYPASS_ADDR  0x8001800c
y.create.l HWIO_SSBI_WRAPPER_SSBI_RD_ADDR  0x80018010
y.create.l HWIO_SSBI_WRAPPER_SSBI_STATUS_ADDR  0x80018014
y.create.l HWIO_SSBI_WRAPPER_SSBI_PRIORITIES_ADDR  0x80018018
y.create.l HWIO_MDP_TEST_MODE_ADDR  0x8001e000
y.create.l HWIO_MDP_COMMAND_ADDR  0x8001e004
y.create.l HWIO_MDP_SCRIPT_ADDR_ADDR  0x8001e008
y.create.l HWIO_MDP_CGC_CONFIG_ADDR  0x8001e00c
y.create.l HWIO_MDP_SYNC_CONFIG_ADDR  0x8001e010
y.create.l HWIO_MDP_SYNC_STATUS_ADDR  0x8001e014
y.create.l HWIO_MDP_SST_REFRESH_COUNT_ADDR  0x8001e018
y.create.l HWIO_MDP_SCRIPT_STATUS_ADDR  0x8001e01c
y.create.l HWIO_MDP_INTR_ENABLE_ADDR  0x8001e020
y.create.l HWIO_MDP_INTR_STATUS_ADDR  0x8001e024
y.create.l HWIO_MDP_INTR_CLEAR_ADDR  0x8001e028
y.create.l HWIO_MDP_TEST_MISR_RESET_ADDR  0x8001e02c
y.create.l HWIO_MDP_TEST_EXPORT_MISR_ADDR  0x8001e030
y.create.l HWIO_MDP_TEST_MISR_CURR_VAL_ADDR  0x8001e034
y.create.l HWIO_MDP_INIT_SST_RD_PTR_ADDR  0x8001e038
y.create.l HWIO_MDP_ADDRESS_14_ADDR  0x8001e038
y.create.l HWIO_MDP_MAX_SST_RD_PTR_ADDR  0x8001e03c
y.create.l HWIO_MDP_ADDRESS_15_ADDR  0x8001e03c
y.create.l HWIO_MDP_DEBUG_BUS_VALUE_ADDR  0x8001e040
y.create.l HWIO_QMEMBIST_CLK_ENA_ADDR  0x80020000
y.create.l HWIO_QMEMBIST_IO_CFG_ADDR  0x80020004
y.create.l HWIO_QMEMBIST_RESET_ADDR  0x80020008
y.create.l HWIO_QMEMBIST_FA_SEQUENCER_SEL_ADDR  0x8002000c
y.create.l HWIO_QMEMBIST_EMBEDDED_ALG_CFG_ADDR  0x80020010
y.create.l HWIO_QMEMBIST_USR_CMD_DESTINATION_ADDR  0x80020014
y.create.l HWIO_QMEMBIST_USR_CMD_CFG_ADDR  0x80020018
y.create.l HWIO_QMEMBIST_TEST_TRIGGER_ADDR  0x8002001c
y.create.l HWIO_QMEMBIST_TEST_STATUS_ADDR  0x80020020
y.create.l HWIO_QMEMBIST_TESTEDm_ADDR  0x80020024
y.create.l HWIO_QMEMBIST_FAILEDm_ADDR  0x80020034
y.create.l HWIO_QMEMBIST_RAM_FAIL_MAP_ADDR  0x80020044
y.create.l HWIO_QMEMBIST_CLKOFFm_ADDR  0x80020048
y.create.l HWIO_CHIP_ARM9_TEST_MEM_ADDR_ADDR  0x80024000
y.create.l HWIO_CHIP_ARM9_TEST_MEM_WRITE_ADDR  0x80024004
y.create.l HWIO_CHIP_ARM9_TEST_MEM_SEL_ADDR  0x80024008
y.create.l HWIO_CHIP_ARM9_TEST_MEM_READ0_ADDR  0x8002400c
y.create.l HWIO_CHIP_ARM9_TEST_MEM_WRITE_NON_INCR_ADDR  0x80024010
y.create.l HWIO_CHIP_ARM9_TEST_MEM_READ0_NON_INCR_ADDR  0x80024014
y.create.l HWIO_ARM9_11_MEM_ACC_CTRL_ADDR  0x80024018
y.create.l HWIO_SYS_MPU_ENABLE_ADDR  0x8002c000
y.create.l HWIO_SYS_MPU_ERR_STATS_ADDR  0x8002c004
y.create.l HWIO_SYS_MPU_DEF_PART_PERM0_ADDR  0x8002c008
y.create.l HWIO_SYS_MPU_PART_START_ADDRa_ADDR  0x8002c020
y.create.l HWIO_SYS_MPU_PART_END_ADDRa_ADDR  0x8002c024
y.create.l HWIO_SYS_MPU_PART_PERM0a_ADDR  0x8002c028
y.create.l HWIO_APP_MPU_ENABLE_ADDR  0x8002e000
y.create.l HWIO_APP_MPU_ERR_STATS_ADDR  0x8002e004
y.create.l HWIO_APP_MPU_DEF_PART_PERM0_ADDR  0x8002e008
y.create.l HWIO_APP_MPU_PART_START_ADDRa_ADDR  0x8002e020
y.create.l HWIO_APP_MPU_PART_END_ADDRa_ADDR  0x8002e024
y.create.l HWIO_APP_MPU_PART_PERM0a_ADDR  0x8002e028
y.create.l HWIO_SLEEP_XTAL_TIMER_0_COUNT_ADDR  0x80034000
y.create.l HWIO_SLEEP_XTAL_TIMER_1_COUNT_ADDR  0x80034004
y.create.l HWIO_SLEEP_XTAL_TIMETICK_COUNT_ADDR  0x80034008
y.create.l HWIO_WDOG_RESET_ADDR  0x8003400c
y.create.l HWIO_AUTOKICK_START_ADDR  0x80034010
y.create.l HWIO_WDOG_UNMASKED_INT_EN_ADDR  0x80034014
y.create.l HWIO_WDOG_STATUS_ADDR  0x80034018
y.create.l HWIO_SLEEP_XTAL_TIMER_0_ENABLE_ADDR  0x800340b0
y.create.l HWIO_SLEEP_XTAL_TIMER_1_ENABLE_ADDR  0x800340b4
y.create.l HWIO_SLEEP_XTAL_TIMER_0_MATCH_VAL_ADDR  0x800340b8
y.create.l HWIO_SLEEP_XTAL_TIMER_1_MATCH_VAL_ADDR  0x800340bc
y.create.l HWIO_SLEEP_XTAL_TIMETICK_MATCH_VAL_STATUS_ADDR  0x800340c0
y.create.l HWIO_SLEEP_XTAL_TIMETICK_MATCH_VAL_ADDR  0x800340c4
y.create.l HWIO_WDOG_EXPIRED_WIDTH_ADDR  0x800340c8
y.create.l HWIO_WDOG_TEST_LOAD_STATUS_ADDR  0x800340cc
y.create.l HWIO_WDOG_TEST_LOAD_ADDR  0x800340d0
y.create.l HWIO_WDOG_TEST_ADDR  0x800340d4
y.create.l HWIO_EF_CHAIN_SEL_ADDR  0x80036000
y.create.l HWIO_EF_BLOW_TIMER_ADDR  0x80036004
y.create.l HWIO_EF_BLOW_VALUE_ADDR  0x80036008
y.create.l HWIO_EF_SHIFT_VALUE_ADDR  0x8003600c
y.create.l HWIO_EF_STATUS_ADDR  0x80036010
y.create.l HWIO_EF_PWR_CTL_ADDR  0x80036014
y.create.l HWIO_EF_CONFIG_LSB_ADDR  0x80036018
y.create.l HWIO_EF_CONFIG_MSB_ADDR  0x8003601c
y.create.l HWIO_ENABLE_ARM9_JTAG_ADDR  0x80036020
y.create.l HWIO_RF_CAL_PART1_ADDR  0x91c00024
y.create.l HWIO_RF_CAL_PART2_ADDR  0x91c00028
y.create.l HWIO_RF_CAL_PART3_ADDR  0x91c00020
y.create.l HWIO_GPIO2_OE_0_ADDR  0x84022000
y.create.l HWIO_GPIO2_OE_1_ADDR  0x84022004
y.create.l HWIO_GPIO2_OUT_0_ADDR  0x84022008
y.create.l HWIO_GPIO2_OUT_1_ADDR  0x8402200c
y.create.l HWIO_GPIO2_PAGE_ADDR  0x84022010
y.create.l HWIO_GPIO2_CFG_ADDR  0x84022014
y.create.l HWIO_GPIO2_IN_0_ADDR  0x84022018
y.create.l HWIO_GPIO2_IN_1_ADDR  0x8402201c
y.create.l HWIO_MSM_INT_CLEAR_ADDR  0x84006174
y.create.l HWIO_MSM_INT_EN_ADDR  0x84006178
y.create.l HWIO_MSM_INT_POLARITY_ADDR  0x8400617c
y.create.l HWIO_MSM_DETECT_CTL_ADDR  0x84006180
y.create.l HWIO_MSM_INT_STATUS_ADDR  0x84006184
y.create.l HWIO_MSM_KEYSENSE_GROUP_STATUS_ADDR  0x84006188
y.create.l HWIO_MSM_GPIO2_INT_CLEAR_ADDR  0x84006194
y.create.l HWIO_MSM_GPIO2_INT_EN_ADDR  0x840061a8
y.create.l HWIO_MSM_GPIO2_INT_POLARITY_ADDR  0x840061bc
y.create.l HWIO_MSM_GPIO2_DETECT_CTL_ADDR  0x840061d0
y.create.l HWIO_MSM_GPIO2_INT_STATUS_ADDR  0x840061e4
y.create.l HWIO_UXMC_PSRAM_CRE_CFG_ADDR  0x80004000
y.create.l HWIO_UXMC_CALIB_CFG_ADDR  0x80004004
y.create.l HWIO_UXMC_CALIB_STATUS_ADDR  0x80004008
y.create.l HWIO_UXMC_CORE_ID_ADDR  0x8000400c
y.create.l HWIO_EBI1_CFG_ADDR  0x80026000
y.create.l HWIO_EBI1_CSn_CFG0_ADDR  0x8002600c
y.create.l HWIO_EBI1_CSn_CFG1_ADDR  0x80026010
y.create.l HWIO_EBI1_AHB_RD_PRIORITY_ADDR  0x80026030
y.create.l HWIO_EBI1_AHB_WR_PRIORITY_ADDR  0x80026034
y.create.l HWIO_EBI1_BUFC_CFG_ADDR  0x8002603c
y.create.l HWIO_EBI1_BUFC_STATUS_ADDR  0x80026040
y.create.l HWIO_EBI1_BUFC_PROF_COUNT_CFG_ADDR  0x80026044
y.create.l HWIO_EBI1_PSRAM_REFRESH_CFG_ADDR  0x8002604c
y.create.l HWIO_EBI1_BUFC_PROF_COUNT0_ADDR  0x80026054
y.create.l HWIO_EBI1_BUFC_PROF_COUNT1_ADDR  0x80026058
y.create.l HWIO_EBI1_BUFC_PROF_COUNT2_ADDR  0x8002605c
y.create.l HWIO_EBI1_DEBUG_BUS_CFG0_ADDR  0x80026060
y.create.l HWIO_EBI1_DEBUG_BUS_CFG1_ADDR  0x80026064
y.create.l HWIO_EBI1_DEBUG_WORDn_BUFC_ADDR  0x80026070
y.create.l HWIO_EBI1_DEBUG_WORD_ENn_BUFC_ADDR  0x80026090
y.create.l HWIO_EBI1_DEBUG_BUFC_CFG_ADDR  0x800260b0
y.create.l HWIO_EBI1_DEBUG_BUFC_TAG_RD0_ADDR  0x800260bc
y.create.l HWIO_EBI1_DEBUG_BUFC_TAG_RD1_ADDR  0x800260c0
y.create.l HWIO_EBI1_BUFC_PROFILING_CFG_ADDR  0x800260c4
y.create.l HWIO_EBI1_CSn_CFG2_ADDR  0x800260d0
y.create.l HWIO_EBI1_LCD_CFG_ADDR  0x800260e0
y.create.l HWIO_EBI1_2X_XLTR_CFG_ADDR  0x800260f0
y.create.l HWIO_EBI2_CFG_ADDR  0x80028000
y.create.l HWIO_LCD_CFG0_ADDR  0x80028004
y.create.l HWIO_LCD_CFG1_ADDR  0x80028008
y.create.l HWIO_EBI2_CSn_CFG0_ADDR  0x8002800c
y.create.l HWIO_EBI2_CSn_CFG1_ADDR  0x80028010
y.create.l HWIO_EBI2_CSn_CFG2_ADDR  0x80028014
y.create.l HWIO_ETM_GPIO2_CFG0_ADDR  0x8002804c
y.create.l HWIO_ETM_GPIO2_CFG1_ADDR  0x80028050
y.create.l HWIO_EBI2_DEBUG_BUS_CFG_ADDR  0x80028054
y.create.l HWIO_EBI2_PROFILING_CFG_ADDR  0x80028058
y.create.l HWIO_EBI2_SWBM_AHB_PRIORITY_ADDR  0x80028080
y.create.l HWIO_EBI2_SWBM_STATUS_ADDR  0x80028088
y.create.l HWIO_EBI2_SWBM_DEBUG_BUS_CFG_ADDR  0x8002808c
y.create.l HWIO_EBI2_CBC_AHB_RD_PRIORITY_ADDR  0x800280b0
y.create.l HWIO_EBI2_CBC_AHB_WR_PRIORITY_ADDR  0x800280b4
y.create.l HWIO_EBI2_CBC_BUFC_CFG_ADDR  0x800280b8
y.create.l HWIO_EBI2_CBC_BUFC_STATUS_ADDR  0x800280bc
y.create.l HWIO_EBI2_CBC_PRF_CNT_CFG_ADDR  0x800280c0
y.create.l HWIO_EBI2_CBC_PRF_CNT0_ADDR  0x800280c4
y.create.l HWIO_EBI2_CBC_PRF_CNT1_ADDR  0x800280c8
y.create.l HWIO_EBI2_CBC_PRF_CNT2_ADDR  0x800280cc
y.create.l HWIO_EBI2_CBC_DEBUG_BUS_CFG0_ADDR  0x800280d0
y.create.l HWIO_EBI2_CBC_DEBUG_WORDn_ADDR  0x800280e0
y.create.l HWIO_EBI2_CBC_DEBUG_WORD_ENn_ADDR  0x80028100
y.create.l HWIO_EBI2_CBC_DEBUG_CFG_ADDR  0x80028120
y.create.l HWIO_EBI2_CBC_DEBUG_TAG_RD0_ADDR  0x80028124
y.create.l HWIO_EBI2_CBC_DEBUG_TAG_RD1_ADDR  0x80028128
y.create.l HWIO_EBI2_CBC_PRF_CFG_ADDR  0x8002812c
y.create.l HWIO_UXMC_DEBUG_BUS_CTRL_ADDR  0x8002a000
y.create.l HWIO_SDRAM_OPT_CFG_ADDR  0x80014000
y.create.l HWIO_SDRAM_RFRSH_CFG_ADDR  0x80014010
y.create.l HWIO_SDRAM_DEV_PARAM_CFG1_ADDR  0x80014014
y.create.l HWIO_SDRAM_DEV_PARAM_CFG2_ADDR  0x80014018
y.create.l HWIO_SDRAM_DEV_PARAM_CFG3_ADDR  0x8001401c
y.create.l HWIO_SDRAM_CTRL_CFG_ADDR  0x80014020
y.create.l HWIO_SDRAM_DEV_INIT_CFG_ADDR  0x80014024
y.create.l HWIO_SDRAM_COL_ROW_SIZE_CFG_ADDR  0x80014028
y.create.l HWIO_SDRAM_HW_DEV_INIT_CFG_ADDR  0x8001402c
y.create.l HWIO_SDRAM_CDCM_CFG_ADDR  0x80014030
y.create.l HWIO_SDRAM_CDCM_INTERNAL1_ADDR  0x80014034
y.create.l HWIO_SDRAM_CDCn_CFG_ADDR  0x80014038
y.create.l HWIO_SDRAM_CDCM_STATUS_ADDR  0x80014044
y.create.l HWIO_SDRAM_CLOCK_VOLTAGE_SWITCH_CFG_ADDR  0x80014048
y.create.l HWIO_SDRAM_CLK_PWR_DOWN_CFG_ADDR  0x8001404c
y.create.l HWIO_SDRAM_PERF_MON_CFG_ADDR  0x80014050
y.create.l HWIO_SDRAM_PERF_CNTRn_CFG_ADDR  0x80014054
y.create.l HWIO_SDRAM_PERF_CNTRn_OUT_ADDR  0x80014060
y.create.l HWIO_SDRAM_PERF_CNTR_STATUS_ADDR  0x8001406c
y.create.l HWIO_SDRAM_TEST_BUS_CFG_ADDR  0x80014070
y.create.l HWIO_SDRAM_MISR_CTRL_ADDR  0x80014074
y.create.l HWIO_SDRAM_MISR_OUT0_ADDR  0x80014078
y.create.l HWIO_SDRAM_MISR_OUT1_ADDR  0x8001407c
y.create.l HWIO_SDRAM_FPGA_CONTROLLER_CFG1_ADDR  0x80014080
y.create.l HWIO_SDRAM_FPGA_CONTROLLER_CFG2_ADDR  0x80014084
y.create.l HWIO_SDRAM_FPGA_CONTROLLER_CFG3_ADDR  0x80014088
y.create.l HWIO_SDRAM_FPGA_CONTROLLER_CFG4_ADDR  0x8001408c
y.create.l HWIO_SDRAM_FPGA_CONTROLLER_CFG5_ADDR  0x80014090
y.create.l HWIO_AUX_CODEC_CTL_ADDR  0x8001a000
y.create.l HWIO_PCM_PATH_CTL_ADDR  0x8001a004
y.create.l HWIO_AUX_CODEC_CTL_OUT_ADDR  0x8001a008
y.create.l HWIO_WB_CODEC_TEST_CTL_ADDR  0x8001a00c
y.create.l HWIO_WB_CODEC_FIFO_WR_REG_ADDR  0x8001a010
y.create.l HWIO_WB_CODEC_FIFO_RD_REG_ADDR  0x8001a014
y.create.l HWIO_WB_MISSED_ACKS_CNT_ADDR  0x8001a018
y.create.l HWIO_WB_CODEC_CMD_REG_ADDR  0x8001a01c
y.create.l HWIO_WB_CODEC_SEL_ADSP_ADDR  0x8001a020
y.create.l HWIO_BPM_CFG_ADDR  0x8001c000
y.create.l HWIO_BPM_CMD_ADDR  0x8001c004
y.create.l HWIO_BPM_MSTR_CFG_ADDR  0x8001c008
y.create.l HWIO_BPM_TIMER_ADDR  0x8001c00c
y.create.l HWIO_BPM_CYC_CFG_ADDR  0x8001c010
y.create.l HWIO_BPM_CYC_OUT_ADDR  0x8001c014
y.create.l HWIO_BPM_Cn_CFG0_ADDR  0x8001c020
y.create.l HWIO_BPM_Cn_CFG1_ADDR  0x8001c024
y.create.l HWIO_BPM_Cn_CFG2_ADDR  0x8001c028
y.create.l HWIO_BPM_Cn_CFG3_ADDR  0x8001c02c
y.create.l HWIO_BPM_Cn_CFG4_ADDR  0x8001c030
y.create.l HWIO_BPM_Cn_CFG5_ADDR  0x8001c034
y.create.l HWIO_BPM_Cn_CFG6_ADDR  0x8001c038
y.create.l HWIO_BPM_Cn_OUT_ADDR  0x8001c03c
y.create.l HWIO_BPM_DBG_CFG_ADDR  0x8001c220
y.create.l HWIO_IBIn_CFG_ADDR  0x80038000
y.create.l HWIO_IBIn_AHB_PRIORITY_ADDR  0x80038010
y.create.l HWIO_IMEMn_CFG_ADDR  0x80038020
y.create.l HWIO_IMEM0_BASE_ADDR_ADDR  0x80038030
y.create.l HWIO_IMEM1_BASE_ADDR_ADDR  0x80038034
y.create.l HWIO_IMEM2_BASE_ADDR_ADDR  0x80038038
y.create.l HWIO_IMEM3_BASE_ADDR_ADDR  0x8003803c
y.create.l HWIO_IMEM_BASE_ADDR_EN_ADDR  0x80038040
y.create.l HWIO_IBIn_DEBUG_BUS_CFG_ADDR  0x80038050
y.create.l HWIO_IBIn_PROFILING_CFG_ADDR  0x80038060
y.create.done
