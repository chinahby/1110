;****************************************************************************
;**           SetupMems.CMM                                                **
;**           This script sets up MSM6550 registers and memories for       **
;**           software load and debug                                      **
;**                                                                        **
;**           Changes:                                                     **
;**           05-20-04   Ported for MSM6550                                **
;**           02-19-03   First version                                     **
;****************************************************************************
;



;--------------------------------------------------------------------------
; ARM clock controller registers
;--------------------------------------------------------------------------
; MICROPROCESSOR CLOCK CONFIGURATION
; After RESET, uP clock should default to TCXO/1. 
; Clocks are not initialized here since the default values should work
; properly. MSM6500 defaults to all clocks off, so turn them on. 
;d.out &MSM_CLK_HALT %LONG 0x00000000
d.out &MSM_CLK_HALTA %LONG 0x00000000
d.out &MSM_CLK_HALTB %LONG 0x00000000

;
; now, for EBI1, setup either the MPMC or the XMEMC memories
;
IF &SETUP_MPMC_SDRAM==1
  (  
  print "   SetupMems: setting up ARM PL712 memory controller and memories"
  do SetupMPMC
;set a bit in this register to go into self-refresh mode
; &MPMCDynamicControl=&MPMC_BASE_ADDR+0x0020
;when entering self-refresh mode, check this register...
;  &MPMCStatus=&MPMC_BASE_ADDR+0x0004
  )
ELSE IF &SETUP_XMEMC==1  
  (
  print "   SetupMems: setting up XMEMC controller and memories"
  do SetupXMEMC
  )  
ELSE // neither memory controller was selected
  (
  PRINT "SetupMems: ERROR: no memory controller was selected"
  )  
;

;
;
; Now setup EBI2 -- the same for all configurations.
;
;
do SetupEBI2.cmm



ENDDO

