;============================================================================
; qsc11x0_setupebi1.cmm
;
;     Setup the GPIOs, Memory Wait States for EBI1
;
;     Changes:
;     02-12-08  First version
;============================================================================

;
; Follow are GPIOs that are primary used by EBI1, except GPIO-41.
; In fact,we don't need to program these primary GPIOs, but for safety
; purpose, we shall reprogramming them!!!
;
; GPIO-33	EBI1_A/D(24), alternative are EBI1_CRE AND BT_EN
; GPIO-62	EBI1_A/D(23)
; GPIO-61	EBI1_A/D(22)
; GPIO-60	EBI1_A/D(21)
; GPIO-59	EBI1_A/D(20)
; GPIO-58	EBI1_A/D(19)
; GPIO-57	EBI1_A/D(18)
; GPIO-56	EBI1_A/D(17)
; GPIO-55	EBI1_A/D(16)
; GPIO-34	EBI1_CS(2)_N
; GPIO-41	EBI1_CS(3)_N (not use)

 IF !Y.EXIST(HWIO_GPIO_PAGE_ADDR)
 (
  PRINT "LOADING HWIO.CMM"
  DO &BUILDMSdir/../../systemdrivers/core/hw/src/hwio.cmm
 )

 ;;DATA.SET	HWIO_GPIO2_PAGE_ADDR %long 33. ; GPIO-33 - EBI1_A/D(24)
 ;;DATA.SET	HWIO_GPIO2_CFG_ADDR  %long 0x4

 DATA.SET	HWIO_GPIO_PAGE_ADDR %long 62.  ; GPIO-62 - EBI1_A/D(23)
 DATA.SET	HWIO_GPIO_CFG_ADDR  %long 0x4

 DATA.SET	HWIO_GPIO_PAGE_ADDR %long 61.  ; GPIO-61 - EBI1_A/D(22)
 DATA.SET	HWIO_GPIO_CFG_ADDR  %long 0x4

 DATA.SET	HWIO_GPIO_PAGE_ADDR %long 60.   ; GPIO-60 - EBI1_A/D(21)
 DATA.SET	HWIO_GPIO_CFG_ADDR  %long 0x4

 DATA.SET	HWIO_GPIO_PAGE_ADDR %long 59.   ; GPIO-59 - EBI1_A/D(20)
 DATA.SET	HWIO_GPIO_CFG_ADDR  %long 0x4

 DATA.SET	HWIO_GPIO_PAGE_ADDR %long 58.   ; GPIO-58 - EBI1_A/D(19)
 DATA.SET	HWIO_GPIO_CFG_ADDR  %long 0x4

 DATA.SET	HWIO_GPIO_PAGE_ADDR %long 57.    ; GPIO-57 - EBI1_A/D(18)
 DATA.SET	HWIO_GPIO_CFG_ADDR  %long 0x4

 DATA.SET	HWIO_GPIO_PAGE_ADDR %long 56.    ; GPIO-56 - EBI1_A/D(17)
 DATA.SET	HWIO_GPIO_CFG_ADDR  %long 0x4

 DATA.SET	HWIO_GPIO_PAGE_ADDR %long 55.    ; GPIO-55 - EBI1_A/D(16)
 DATA.SET	HWIO_GPIO_CFG_ADDR  %long 0x4

 DATA.SET	HWIO_GPIO_PAGE_ADDR %long 34.    ; GPIO-34 - EBI1_CS(2)_N (shadow, move it to jload script)
 DATA.SET	HWIO_GPIO_CFG_ADDR  %long 0x4

 ;-----------------------------------------------------------------
 ;  Memory interface and controller registers
 ;-----------------------------------------------------------------
 ;+++++++ EBI1 registers +++++++

 ;
 ; Configure EBI1 AND UXMC to support Async mode for downloading image to
 ; NOR or PSRAM via JTAG
 ;

 ; Configure EBI1_CFG register
 DATA.SET HWIO_EBI1_CFG_ADDR %long 0x00000080

 ; EBI1_CS0 = NOR or PSRAM
 DATA.SET HWIO_EBI1_CSn_CFG0_ADDR+(0*8) %long 0x0002AA22   ; Memory wait states based on EBI1 = 48 MHz
 DATA.SET HWIO_EBI1_CSn_CFG1_ADDR+(0*8) %long 0x02030000

 ; EBI1_CS1 = PSRAM
 DATA.SET HWIO_EBI1_CSn_CFG0_ADDR+(1*8) %long 0x0002AA22
 DATA.SET HWIO_EBI1_CSn_CFG1_ADDR+(1*8) %long 0x02030000

 ; Configure EBI1 BUFFER
 DATA.SET HWIO_EBI1_BUFC_CFG_ADDR %long 0xFF25000F


;-------------------set BCR register to default  -------------------------

local &dataram_bcr
                            
&dataram_bcr=0x9b1f   ;wrap8 mode, same as shadow psram

d.in 0x09FFFFFE /word
d.in 0x09FFFFFE /word
DATA.SET 0x09FFFFFE %word 0x1
DATA.SET 0x09FFFFFE %word &dataram_bcr   ;config CS1

d.in 0x09FFFFFE /word
d.in 0x09FFFFFE /word
DATA.SET 0x09FFFFFE %word 0x1
&temp=data.word(RD:0x09FFFFFE)      ;read BCR value
print &temp

;-------------------------------------------------------------------------
