  map.nobonchip
  b.reset
  b.s err_fatal_put_log /soft /program 
  b.s hw_power_off /soft /program 
  b.s boot_default_exception_handler
  b.s DBGBreak 

  ; Exception Vectors
  b.s 0x00 /soft /program 
  b.s 0x04 /soft /program
  b.s 0x08 /soft /program
  b.s 0x0c /soft /program
  b.s 0x10 /soft /program
  b.s 0x14 /soft /program
  
  ; Write breakpoints across program memory

  b.s (0--0x3fffff) /onchip /write
