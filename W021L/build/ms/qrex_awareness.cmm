menu.reset
task.config qrex
menu.reprogram qrex
