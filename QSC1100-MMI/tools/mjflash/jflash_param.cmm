;;;;;;;;;;;;;;;;;;;;;;;;;;;;;;;;;;;;;  
;;  GENERATED FILE - DO NOT EDIT       
;;                                     
;; generated:  Tue May 25 14:10:17     2010                  
;;;;;;;;;;;;;;;;;;;;;;;;;;;;;;;;;;;;;  
 global &JflashCodeAddr                
 &JflashCodeAddr=0x08000000   
 global &JflashParamAddr               
 &JflashParamAddr=0x08080000 
 global &JflashRomBegin                
 &JflashRomBegin=0x00000000   
 global &JflashRomEnd                  
 &JflashRomEnd=0x07ffffff       
 global &ExternalRamType               
 &ExternalRamType="PSRAM"      
 global &UseTerm                       
 &UseTerm="NO"           
                                       
