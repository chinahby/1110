;;;;;;;;;;;;;;;;;;;;;;;;;;;;;;;;;;;;;;;;;;;;;;; 
;;  GENERATED FILE - DO NOT EDIT      
;;                                    
;; generated:  Tue May 25 14:10:19     2010                 
;;;;;;;;;;;;;;;;;;;;;;;;;;;;;;;;;;;;;;;;;;;;;;; 
  
  
local &ExtError

;==========================================
; Get the arguments passed in.
;==========================================
ENTRY &ExtError



print "  "
print "  "
print "Extended error is &ExtError"



if &ExtError==0x00
(
  print "Error name is ERR_OK"
  print "      Success. Send an acknowledgement.            "
  enddo
)

if &ExtError==0x01
(
  print "Error name is ERR_BAD_CMD"
  print "      Failure: Not a valid command from JTAG ICD   "
  enddo
)

if &ExtError==0x02
(
  print "Error name is ERR_DEV_MISSING"
  print "      Failure: No NAND device found.               "
  enddo
)

if &ExtError==0x03
(
  print "Error name is ERR_BAD_DEVICE"
  print "      Failure: Bad Device Descriptor found         "
  enddo
)

if &ExtError==0x04
(
  print "Error name is ERR_OUT_OF_NAND"
  print "      Failure: Ran past end of NAND flash          "
  enddo
)

if &ExtError==0x05
(
  print "Error name is ERR_SPANS_TOO_BIG"
  print "      Failure: Number of spans > span buffer size  "
  enddo
)

if &ExtError==0x06
(
  print "Error name is ERR_PAGE_TOO_BIG"
  print "      Failure: Size of page > page buffer          "
  enddo
)

if &ExtError==0x07
(
  print "Error name is ERR_PAST_SPANS_END"
  print "      Failure: More spans than will fit in block   "
  enddo
)

if &ExtError==0x08
(
  print "Error name is ERR_PAST_NAND_END"
  print "      Failure: Image+ bad blocks > flash avail     "
  enddo
)

if &ExtError==0x09
(
  print "Error name is ERR_ERASE_FAIL"
  print "      Failure: Erase of good block failed          "
  enddo
)

if &ExtError==0x0A
(
  print "Error name is ERR_WRITE_FAIL"
  print "      Failure: Write of good page failed           "
  enddo
)

if &ExtError==0x0B
(
  print "Error name is ERR_READ_FAIL"
  print "      Failure: Read page failed                    "
  enddo
)

if &ExtError==0x0C
(
  print "Error name is ERR_VERIFY_FAIL"
  print "      Failure: Verify after readback failed        "
  enddo
)

if &ExtError==0x0D
(
  print "Error name is ERR_COMPARE_FAIL"
  print "      Failure: Compare failed in self test verify  "
  enddo
)

if &ExtError==0x0E
(
  print "Error name is ERR_CRC_FAIL"
  print "      Failure: CRC failed during flash verify      "
  enddo
)

if &ExtError==0x0F
(
  print "Error name is ERR_BIBCRC_FAIL"
  print "      Failure: CRC passed to selftest did not match"
  enddo
)

if &ExtError==0x10
(
  print "Error name is ERR_MAGIC1_FAIL"
  print "      Failure: Magic1 not correct in boot_info     "
  enddo
)

if &ExtError==0x11
(
  print "Error name is ERR_MAGIC2_FAIL"
  print "      Failure: Magic2 not correct in boot_info     "
  enddo
)

if &ExtError==0x12
(
  print "Error name is ERR_BIBVER_FAIL"
  print "      Failure: VIB version not correct in boot_info"
  enddo
)

if &ExtError==0x13
(
  print "Error name is ERR_OVER_CONSUME"
  print "      Failure: Consumed too much of input buffer   "
  enddo
)

if &ExtError==0x14
(
  print "Error name is ERR_PAGE_UNIT_CALC"
  print "      Failure: Off by one error in whole page calc "
  enddo
)

if &ExtError==0x15
(
  print "Error name is ERR_BIB_TOO_BIG"
  print "      Failure: BIB + spans too long for one block  "
  enddo
)

if &ExtError==0x16
(
  print "Error name is ERR_BIB_BAD"
  print "      Failure: BIB block was bad                   "
  enddo
)

if &ExtError==0x17
(
  print "Error name is ERR_SPAN_DIVIDE"
  print "      Failure: Partial span remainder              "
  enddo
)

if &ExtError==0x18
(
  print "Error name is ERR_SPAN_NOTALIGN"
  print "      Failure: Span not aligned on a page boundary "
  enddo
)

if &ExtError==0x19
(
  print "Error name is ERR_ADDR_REVERSE"
  print "      Failure: Current code address < previous     "
  enddo
)

if &ExtError==0x1A
(
  print "Error name is ERR_PPI_TOO_BIG"
  print "      Failure: Partial page index > page_size      "
  enddo
)

if &ExtError==0x1B
(
  print "Error name is ERR_ECC_READ"
  print "      Failure: Uncorrectable ECC error             "
  enddo
)

if &ExtError==0x1C
(
  print "Error name is ERR_ECC"
  print "      Success: Correctable ECC error               "
  enddo
)

if &ExtError==0x1D
(
  print "Error name is ERR_ECC_SELF"
  print "      Failure: Error in the ECC itself             "
  enddo
)

if &ExtError==0x1E
(
  print "Error name is ERR_BAD_BLOCK"
  print "      Failure: Block identified as bad             "
  enddo
)

if &ExtError==0x1F
(
  print "Error name is ERR_BAD_BOOT"
  print "      Failure: Boot Block identified as bad        "
  enddo
)

if &ExtError==0x20
(
  print "Error name is ERR_GOOD_BOOT"
  print "      Success: Boot Block identified as good       "
  enddo
)

if &ExtError==0x21
(
  print "Error name is ERR_PAST_BLOCK_END"
  print "      Failure: Single block image too big for block"
  enddo
)

if &ExtError==0x22
(
  print "Error name is ERR_NO_MIBIB_BLOCK"
  print "      Failure: MIBIB block not found               "
  enddo
)

if &ExtError==0x23
(
  print "Error name is ERR_PARTI_NOMATCH"
  print "      Failure: Partition tbl mismatch, no override "
  enddo
)

if &ExtError==0x24
(
  print "Error name is ERR_PARTI_NOT_RCVD"
  print "      Failure: No partition table received         "
  enddo
)

if &ExtError==0x25
(
  print "Error name is ERR_PARTI_NO_QCSBL"
  print "      Failure: No QCSBL partition in table         "
  enddo
)

if &ExtError==0x26
(
  print "Error name is ERR_PARTI_NO_OEMSBL"
  print "      Failure: No OEMSBL partition in table        "
  enddo
)

if &ExtError==0x27
(
  print "Error name is ERR_PARTI_NO_AMSS"
  print "      Failure: No AMSS partition in table          "
  enddo
)

if &ExtError==0x28
(
  print "Error name is ERR_PARTI_INVALID"
  print "      Failure: Table format not recognized         "
  enddo
)

if &ExtError==0x29
(
  print "Error name is ERR_SECURE_PBL"
  print "      Failure: PBL disallowed in Secure Boot mode  "
  enddo
)

if &ExtError==0x2A
(
  print "Error name is ERR_SECURE_BAD_MODE"
  print "      Failure: Unknown Security Mode               "
  enddo
)

if &ExtError==0x2B
(
  print "Error name is ERR_SECURE_MODE_CHG"
  print "      Failure: Cannot change in single invocation  "
  enddo
)

if &ExtError==0x2C
(
  print "Error name is ERR_SEC_BAD_ORDER"
  print "      Failure: Security mode must be first         "
  enddo
)

if &ExtError==0x2D
(
  print "Error name is ERR_ALLOC_EXCEEDED"
  print "      Failure: Image size exceeds allocation for it"
  enddo
)

if &ExtError==0x2E
(
  print "Error name is ERR_PARTI_NO_EFS2"
  print "      Failure: No EFS2 partition in table          "
  enddo
)

if &ExtError==0x2F
(
  print "Error name is ERR_PARTI_NO_FOTA"
  print "      Failure: No FOTA partition in table          "
  enddo
)

if &ExtError==0x30
(
  print "Error name is ERR_MIBIB_DAMAGED"
  print "      Failure: Damaged MIBIB found                 "
  enddo
)

if &ExtError==0x31
(
  print "Error name is ERR_NOT_ERASED"
  print "      Failure: Cannot write page not erased        "
  enddo
)

if &ExtError==0x32
(
  print "Error name is ERR_NO_BBT_BLOCK"
  print "      Failure: Cannot find bad block table         "
  enddo
)

if &ExtError==0x33
(
  print "Error name is ERR_BBT_MAGIC1_FAIL"
  print "      Failure: incorrect Magic1 in bad block table "
  enddo
)

if &ExtError==0x34
(
  print "Error name is ERR_BBT_MAGIC2_FAIL"
  print "      Failure: incorrect Magic2 in bad block table "
  enddo
)

if &ExtError==0x35
(
  print "Error name is ERR_USR_PARTI_NOMATCH"
  print "      Failure: Usr Prtn. tbl miamatch, no override "
  enddo
)

if &ExtError==0x36
(
  print "Error name is ERR_PARTI_CNV_FAIL"
  print "      Failure: Partition table conversion failed   "
  enddo
)

if &ExtError==0x37
(
  print "Error name is ERR_BIB_VALID_FAIL"
  print "      Failure: MIBIB block validation failed       "
  enddo
)

if &ExtError==0x38
(
  print "Error name is ERR_PARTI_NO_BVT"
  print "      Failure: No Boot Vec. Tbl. partiton in table "
  enddo
)

if &ExtError==0x39
(
  print "Error name is ERR_NO_FLASH_PARTI"
  print "      Failure: Partition table not found on flash  "
  enddo
)

if &ExtError==0x3A
(
  print "Error name is ERR_PARTI_NO_FOTAUI"
  print "      Failure: No FOTA UI Bitmap partition in table"
  enddo
)

if &ExtError==0x3B
(
  print "Error name is ERR_PARTI_NO_FOTAPKG"
  print "      Failure: No FOTA package partition in table  "
  enddo
)

if &ExtError==0x3C
(
  print "Error name is ERR_PARTI_TOO_BIG"
  print "      Failure: Partition Structure too large "
  enddo
)



enddo

