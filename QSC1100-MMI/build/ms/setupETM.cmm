;============================================================================
;
; ETM9 8-BIT DEMUX MODE SETUP SCRIPT
;
; DESCRIPTION
;
;   This file enables the clock to the ETM9 hardware core and configures the
;   ETM9 core for 8-bit demuxed mode.
;
; Copyright (c) 2004 by QUALCOMM, Incorporated.  All Rights reserved
;============================================================================

;----------------------------------------------------------------------------
; Enable clock to ETM core.
;----------------------------------------------------------------------------

; Read the current value of the MSM_CLK_HALTA register.

local &HWIO_MSM_CLK_HALTA_ADDR_etm
local &HWIO_ETM_GPIO2_CFG0_ADDR_etm
local &HWIO_DELAY_CNTL_ADDR_etm
local &HWIO_GPIO_PAD_HDRIVE_MSEL_0_ADDR_etm
local &HWIO_GPIO_PAD_HDRIVE_MSEL_1_ADDR_etm
local &HWIO_GPIO_PAD_HDRIVE_MSEL_2_ADDR_etm
local &HWIO_GPIO_PAD_HDRIVE_MSEL_3_ADDR_etm
local &HWIO_GPIO_PAD_HDRIVE_MSEL_4_ADDR_etm
local &HWIO_GPIO_PAD_HDRIVE_MSEL_5_ADDR_etm
local &HWIO_GPIO_PAD_HDRIVE_MSEL_6_ADDR_etm
local &HWIO_GPIO_PAD_HDRIVE_MSEL_7_ADDR_etm


cd ..\..\drivers\hw

;****************************************************************************
; Detect if MMU is enabled/disabled
;****************************************************************************
; Read CR register has MMU enable/disable bit
&reg=data.long(C15:0x1)
; Print out CR value
print "CR is &reg"

&reg=&reg&0x1

if &reg==0
(
  &HWIO_MSM_CLK_HALTA_ADDR_etm=0x80000000
  &HWIO_ETM_GPIO2_CFG0_ADDR_etm=0x8002804c
  &HWIO_DELAY_CNTL_ADDR_etm=0x80002080
  &HWIO_GPIO_PAD_HDRIVE_MSEL_0_ADDR_etm=0x8000c030
  &HWIO_GPIO_PAD_HDRIVE_MSEL_1_ADDR_etm=0x8000c034
  &HWIO_GPIO_PAD_HDRIVE_MSEL_2_ADDR_etm=0x8000c038
  &HWIO_GPIO_PAD_HDRIVE_MSEL_3_ADDR_etm=0x8000c03c
  &HWIO_GPIO_PAD_HDRIVE_MSEL_4_ADDR_etm=0x8000c040
  &HWIO_GPIO_PAD_HDRIVE_MSEL_5_ADDR_etm=0x8000c044
  &HWIO_GPIO_PAD_HDRIVE_MSEL_6_ADDR_etm=0x8000c048
  &HWIO_GPIO_PAD_HDRIVE_MSEL_7_ADDR_etm=0x8000c050

  print "MMU disabled"
)
else
(
  &HWIO_MSM_CLK_HALTA_ADDR_etm=0xfbf00000
  &HWIO_ETM_GPIO2_CFG0_ADDR_etm=0xfc12804c
  &HWIO_DELAY_CNTL_ADDR_etm=0xfbf02080
  &HWIO_GPIO_PAD_HDRIVE_MSEL_0_ADDR_etm=0xfbf0c030
  &HWIO_GPIO_PAD_HDRIVE_MSEL_1_ADDR_etm=0xfbf0c034
  &HWIO_GPIO_PAD_HDRIVE_MSEL_2_ADDR_etm=0xfbf0c038
  &HWIO_GPIO_PAD_HDRIVE_MSEL_3_ADDR_etm=0xfbf0c03c
  &HWIO_GPIO_PAD_HDRIVE_MSEL_4_ADDR_etm=0xfbf0c040
  &HWIO_GPIO_PAD_HDRIVE_MSEL_5_ADDR_etm=0xfbf0c044
  &HWIO_GPIO_PAD_HDRIVE_MSEL_6_ADDR_etm=0xfbf0c048
  &HWIO_GPIO_PAD_HDRIVE_MSEL_7_ADDR_etm=0xfbf0c050

  print "MMU enabled"
)

cd ..\..\build\ms

local &MSM_CLK_HALTA_Val
&MSM_CLK_HALTA_Val=data.word(RD:&HWIO_MSM_CLK_HALTA_ADDR_etm)

; Now clear bit 17 so that the ETM clock is enabled.

&MSM_CLK_HALT_Val=&MSM_CLK_HALTA_Val&0xFFFDFFFF
d.out &HWIO_MSM_CLK_HALTA_ADDR_etm %LONG &MSM_CLK_HALTA_Val

d.s &HWIO_ETM_GPIO2_CFG0_ADDR_etm %LONG 0xFF
d.s &HWIO_DELAY_CNTL_ADDR_etm %LONG 0x20

; Set all GPIOs Drive_Strength to high drive by writing the following value
&DRIVESTRENGTH=0xFFFFFFFF ; Drive Strength of 10 mA

d.S &HWIO_GPIO_PAD_HDRIVE_MSEL_0_ADDR_etm %LONG &DRIVESTRENGTH
d.s &HWIO_GPIO_PAD_HDRIVE_MSEL_1_ADDR_etm %LONG &DRIVESTRENGTH
d.s &HWIO_GPIO_PAD_HDRIVE_MSEL_2_ADDR_etm %LONG &DRIVESTRENGTH
d.s &HWIO_GPIO_PAD_HDRIVE_MSEL_3_ADDR_etm %LONG &DRIVESTRENGTH
d.s &HWIO_GPIO_PAD_HDRIVE_MSEL_4_ADDR_etm %LONG &DRIVESTRENGTH
d.s &HWIO_GPIO_PAD_HDRIVE_MSEL_5_ADDR_etm %LONG &DRIVESTRENGTH
d.s &HWIO_GPIO_PAD_HDRIVE_MSEL_6_ADDR_etm %LONG &DRIVESTRENGTH
d.s &HWIO_GPIO_PAD_HDRIVE_MSEL_7_ADDR_etm %LONG &DRIVESTRENGTH

;----------------------------------------------------------------------------
; Set Trace32 ETM demux mode endianness convention.
;
; NOTE: This needs to be done *before* configuring the ETM core, or the
;       Trace32 software will not correctly decompress a trace. [07 May 2003]
;----------------------------------------------------------------------------

system.option.etmswap ON

;----------------------------------------------------------------------------
; Configure ETM core.
;----------------------------------------------------------------------------

ETM.RESET
ETM.PortSize   8             
ETM.PortMode   Demuxed
ETM.Fifolevel  16.
ETM.Stall      OFF
ETM.DataTrace BOTH
ETM.ON                      

;----------------------------------------------------------------------------
; Open Trace ETM windows
;----------------------------------------------------------------------------

TRACE
TRACE.LIST

;----------------------------------------------------------------------------
; Terminate script.
;----------------------------------------------------------------------------

print "Status: ETM is setup"
enddo




