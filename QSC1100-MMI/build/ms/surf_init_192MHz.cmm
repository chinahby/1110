;**************************************************************************
;**         Rizzo_memories_init.cmm                                      **
;**         MSM: SC2X post silicon only(Rizzo memory core)               **           
;**         Call this script segment from any script to do an initial    **
;**         configuration of MSM in preparation for a software load.     **
;**                                                                      **
;** Author: Chuang Liang                                                 **
;**                                                                      ** 
;**Changes: 06-13-06     First version                                   **
;**         08-01-06     set DDR timing parameter base on mem_clk      **
;**                      at 96Mhz                                        **
;**         08-23-06     use JEDEC standard as reference to config       **
;**                      DDR timing parameters at 20Mhz for rumi P2r0    **
;**         08-28-06     updated tRFC value from '4' to '5', setting     **
;**                      tRFC=4 not working in AMSS build                **
;**         10-13-06     changed data PSRAM to wrap8 mode, reduced LC    **
;**                      from 3 to 2. updated EBI1_CFG, and low_mark in  **
;**                      EBI1_BUFC_CFG_0, enabled EBI1&EBI2 CSs          **
;**         10-23-06     set CDC for post silicon                        **
;**         11-13-06     set tRFC to 5 from 4 to avoid memset function   **
;**                      at 20Mhz                                        **
;**         11-14-06     changed psram latency code from '2' to '3' for  **
;**                      the hclk running at 96Mhz                       **
;**         01-11-07     added 32b psram support                         **
;**         03-22-07     init DDR controller at 96Mhz                    **
;**************************************************************************

;This .cmm file will auto-detect which memory card is on EBI1 connector,
;then configure the memories on EBI1 bus.
;
;This initialization file supports the following EBI1 memory
;configuration:
;EBI1_CS0 - Micron 128Mb x16 PSRAM(MT45W8MW16BGX), WRAP8 bust mode with
;     Neuron card(20-V9374-H1 or 20-V9374-H2)
;EBI1_CS1 - Micron 128Mb x16 PSRAM(MT45W8MW16BGX), WRAP8 burst mode with
;     Neuron card(20-V9374-H1 or 20-V9374-H2)
;EBI1_CS1 - Micron 256Mb x32 PSRAM(2x16), WRAP8 burst mode with
;     Neuron card(20-V9374-H2)
;                          or
;EBI1_CS0 - Infineon 512Mb x16 DDR(HYE18MS12), burst_len=4 with DDR
;memory card(20-V9361-4)

Entry &arg1 &arg2

sys.d
sys.u

do ..\..\build\ms\Rizzo_reg.cmm
do ..\..\core\systemdrivers\hw\src\hwio.cmm
do ..\..\build\ms\surf_init_clock_192MHz.cmm

DATA.SET &EBI1_CFG %long 0x00080           ;pwrsave_mode=1

;--------------------------------------------------------------------------
;Set ARM registers
;--------------------------------------------------------------------------
DATA.SET HWIO_GPIO2_PAGE_ADDR %long 0xB       ;gpio2_page -> gpio11
DATA.SET HWIO_GPIO2_CFG_ADDR %long 0x4        ;gpio2_cfg  -> EBI2_CS2
DATA.SET HWIO_GPIO_PAGE_ADDR %long 0xC        ;gpio_page  -> gpio12
DATA.SET HWIO_GPIO_CFG_ADDR %long 0x4         ;gpio_cfg   -> EBI2_CS3
DATA.SET HWIO_GPIO_PAGE_ADDR %long 0x33       ;gpio_page  -> gpio51
DATA.SET HWIO_GPIO_CFG_ADDR %long 0x4         ;gpio_cfg   -> EBI1_CS2
DATA.SET HWIO_GPIO_PAGE_ADDR %long 0x34       ;gpio_page  -> gpio52
DATA.SET HWIO_GPIO_CFG_ADDR %long 0x4         ;gpio_cfg   -> EBI1_CS3

DATA.SET HWIO_EBI2_PAD_HDRIVE_MSEL_0_ADDR %long 0x44444444
DATA.SET HWIO_EBI2_PAD_HDRIVE_MSEL_1_ADDR %long 0x00044444
DATA.SET HWIO_EBI1_PAD_HDRIVE_MSEL_0_ADDR %long 0x44444444
DATA.SET HWIO_EBI1_PAD_HDRIVE_MSEL_1_ADDR %long 0x04444444
DATA.SET HWIO_EBI1_PAD_HDRIVE_MSEL_2_ADDR %long 0x00004444
DATA.SET HWIO_GPIO_PAD_HDRIVE_MSEL_1_ADDR %long 0x04444000 ;hdrive for gpio11,12
DATA.SET HWIO_GPIO_PAD_HDRIVE_MSEL_6_ADDR %long 0x22044000 ;hdrive for gpio51,52
DATA.SET HWIO_WEB_MISC_WR_ADDR %long 0x42                 ;b[2]mem_clk_diff_en=0
DATA.SET HWIO_EBI1_PAD_PULL_0_ADDR %long 0x000C0
DATA.SET HWIO_EBI1_PAD_PULL_1_ADDR %long 0x000CF
DATA.SET HWIO_EBI2_PAD_PULL_0_ADDR %long 0x01020
DATA.SET HWIO_EBI2_PAD_PULL_1_ADDR %long 0x01023
;-------------------------------------------------------------------------

;--------------------------------------------------------------------------
; EBI registers - set to default value
;--------------------------------------------------------------------------
DATA.SET &EBI1_CS0_CFG0 %long 0x0033FC00    ;
DATA.SET &EBI1_CS0_CFG1 %long 0x30020       ;default setting

DATA.SET &EBI1_CS1_CFG0 %long 0x0033FC00    ;
DATA.SET &EBI1_CS1_CFG1 %long 0x30020       ;default setting

DATA.SET &EBI2_CS0_CFG0 %long 0x031F1C00    ;
DATA.SET &EBI2_CS0_CFG1 %long 0x30020       ;default setting
;--------------------------------------------------------------------------

;-------------------- set BCR mode  ---------------------------------------
;If configure 16-bit burst PSRAM with CRE pin, it needs shift one bit
;to left to match AHB address map(BCR A0 = AHB address A1).
;If configure 32-bit burst PSRAM with CRE pin, it needs shift two bits
;to left to match AHB address map(BCR A0 = AHB address A2).
;Psram BCR conf_REG   CS0x16     CS1x16   CS2x32
; a20      reserved      0         0         0
; a19       reg_sel      1         1         1   ;select bcr mode
; a18:16   reserved      0         0         0
; a15     oper_mode      0         0         0   ;set sync mode
; a14      reserved      0         0         1   ;0-variable,1-fixed
; a13:11    latency      3         3         6   ;2-64Mhz, 3-104Mhz
; a10      wait_pol      0         0         0   ;active low
; a9       reserved      0         0         0
; a8       wait_cfg      1         1         1   ;one data cycle delay
; a7       reserved      0         0         1   ;'1'-disable async access
; a6       reserved      0         0         0   ;rising edge
; a5:4    output_z0      0         0         0   ;full drive
; a3     burst_wrap      0         0         0   ;0-wraps, 1-no wraps
; a2:0 burst_length      3         3         2   ;7-continuous,3-16 words
;--------------------------------------------------------------------------
;BCR_val w. SW seq: | 0x81903  | 0x81903 |  0x87182

local &shadow_bcr &dataram_bcr

IF "&arg1"=="32bits"
(
  &shadow_bcr=0x71827182;  0x71837182(wrap8),0x718F718F(INCR)
  &dataram_bcr=0x71827182; 0x71837182(wrap8),0x718F718F(INCR)
  IF "&arg2"=="incr"
  (
    &shadow_bcr=0x718F718F
    &dataram_bcr=0x718F718F
  )
)
ELSE  ;;;16bits mode
(
  &shadow_bcr=0x81903     ;0x81903(wrap8),0x8110F(INCR)
  &dataram_bcr=0x81903    ;0x81903(wrap8),0x8110F(INCR)
  IF "&arg1"=="incr"||"&arg2"=="incr"
  (
    &shadow_bcr=0x8110F
    &dataram_bcr=0x8110F
  )
)

local &temp

;-- reset PSRAM CRE pin for synchronous Micron PSRAM
;;;DATA.SET &UXMC_PSRAM_CRE_CFG  %byte 0x1

;----------------  use software seq to config BCR -------------------------
IF "&arg1"=="32bits"
(
  ;The below sequence is for a true/real 32-bit device
  ;DATA.SET &EBI1_CS0_CFG1 %long 0x30300A0
  ;d.in 0x0FFFFFFC /long
  ;d.in 0x0FFFFFFC /long
  ;DATA.SET 0x0FFFFFFC %long 0x1
  ;DATA.SET 0x0FFFFFFC %long &shadow_bcr   ;config CS0
  ;READ BACK
  ;d.in 0x0FFFFFFC /long
  ;d.in 0x0FFFFFFC /long
  ;DATA.SET 0x0FFFFFFC %long 0x1
  ;&temp=data.long(RD:0x0FFFFFFC)      ;read BCR value
          ;+++++++++++++ CS0 +++++++++++++++
  ;Sequence for 2 16-bit devices combined to create a 32-bit device
  DATA.SET &EBI1_CS0_CFG1 %long 0x30300A0
  d.in 0x0FFFFFFC /long
  d.in 0x0FFFFFFC /long
  DATA.SET 0x0FFFFFFC %long 0x10001
  DATA.SET 0x0FFFFFFC %long &shadow_bcr   ;config CS0
  ;READ BACK
  d.in 0x0FFFFFFC /long
  d.in 0x0FFFFFFC /long
  DATA.SET 0x0FFFFFFC %long 0x10001
  &temp=data.long(RD:0x0FFFFFFC)      ;read BCR value
  print &temp

          ;+++++++++++++ CS1 +++++++++++++++
  ;The below sequence is for a true/real 32-bit device
  ;DATA.SET &EBI1_CS1_CFG1 %long 0x30300A0
  ;d.in 0x1FFFFFFC /long
  ;d.in 0x1FFFFFFC /long
  ;DATA.SET 0x1FFFFFFC %long 0x1
  ;DATA.SET 0x1FFFFFFC %long &dataram_bcr   ;config CS0
  ;READ BACK
  ;d.in 0x1FFFFFFC /long
  ;d.in 0x1FFFFFFC /long
  ;DATA.SET 0x1FFFFFFC %long 0x1
  ;&temp=data.long(RD:0x1FFFFFFC)      ;read BCR value

  ;Sequence for 2 16-bit devices combined to create a 32-bit device
  DATA.SET &EBI1_CS1_CFG1 %long 0x30300A0
  d.in 0x1FFFFFFC /long
  d.in 0x1FFFFFFC /long
  DATA.SET 0x1FFFFFFC %long 0x10001
  DATA.SET 0x1FFFFFFC %long &dataram_bcr   ;config CS0
  ;READ BACK
  d.in 0x1FFFFFFC /long
  d.in 0x1FFFFFFC /long
  DATA.SET 0x1FFFFFFC %long 0x10001
  &temp=data.long(RD:0x1FFFFFFC)      ;read BCR value
  print &temp
)
ELSE
(
  d.in 0x0FFFFFFE /word
  d.in 0x0FFFFFFE /word
  DATA.SET 0x0FFFFFFE %word 0x1
  DATA.SET 0x0FFFFFFE %word &shadow_bcr   ;config CS0

  d.in 0x0FFFFFFE /word
  d.in 0x0FFFFFFE /word
  DATA.SET 0x0FFFFFFE %word 0x1
  &temp=data.word(RD:0x0FFFFFFE)      ;read BCR value
  print &temp

  d.in 0x1FFFFFFE /word
  d.in 0x1FFFFFFE /word
  DATA.SET 0x1FFFFFFE %word 0x1
  DATA.SET 0x1FFFFFFE %word &dataram_bcr   ;config CS1

  d.in 0x1FFFFFFE /word
  d.in 0x1FFFFFFE /word
  DATA.SET 0x1FFFFFFE %word 0x1
  &temp=data.word(RD:0x1FFFFFFE)      ;read BCR value
  print &temp
)

;;;DATA.SET (0x00000000|&shadow_bcr<<1) %word 0x0
;;;DATA.SET (0x10000000|&dataram_bcr<<1) %word 0x0
;-------------------- done BCR mode  --------------------------------------

;-- reset PSRAM CRE pin for synchronous Micron PSRAM
;;;DATA.SET &UXMC_PSRAM_CRE_CFG  %byte 0x0

;--------------------------------------------------------------------------
; EBI registers - set to burst mode
;--------------------------------------------------------------------------
; EBI1_CSx_CFG0          CS0x16    CS1x16   CS1x32
; [23:20] recovery         0         0        0
; [19:16]hold_wait         0         0        0
; [15:12] delta_wr         2         2        5
; [11:8]  delta_rd         2         2        7
; [7:4]    wait_wr         0         0        0
; [3:0]    wait_rd         0         0        0
;--------------------------------------------------------------------------
;                    | 0x002200  | 0x002200 | 0x005700
;--------------------------------------------------------------------------
; EBI1_CSx_CFG1          CS0x16    CS1x16   CS1x32
; [22:20]page_size         3         3        2
; [19]IGN_WAIT_FOR_WR      0         0        1
; [18]IGN_WAIT_FOR_RD      0         0        1
; [17:16]ADV_OE_RECOVERY   1         1        1
; [15:12]precharge         0         0        0
; [11:8]wr_prechg          0         0        0
; [7]  x32_device_ena      0         0        1
; [6]  WE_TIMING           0         0        0
; [5]  ADDR_HOLD_ENA       1         1        1
; [4]  wrap8_mode          1         1        1
; [3]  burst_wr_ena        1         1        1
; [2]  burst_rd_ena        1         1        1
; [1]  page_wr_ena         0         0        0
; [0]  page_rd_ena         0         0        0
;--------------------------------------------------------------------------
;                    | 0x31003C  | 0x31003C | 0x2D00BC

IF "&arg1"=="32bits"
(
  DATA.SET &EBI1_CS0_CFG0 %long 0x005700
  DATA.SET &EBI1_CS0_CFG1 %long 0x2D00BC ;0x2D00BC(Wrap8),0x5D002C(INCR)
  DATA.SET &EBI1_CS1_CFG0 %long 0x005700
  DATA.SET &EBI1_CS1_CFG1 %long 0x2D00BC ;0x2D00BC(Wrap8),0x5D002C(INCR)
  IF "&arg2"=="incr"
  (
    DATA.SET &EBI1_CS0_CFG1 %long 0x5D002C
    DATA.SET &EBI1_CS1_CFG1 %long 0x5D002C
  )
)
ELSE
(
  DATA.SET &EBI1_CS0_CFG0 %long 0x002200
  DATA.SET &EBI1_CS0_CFG1 %long 0x31003C  ;0x31003C(Wrap8),0x61002C(INCR)
  DATA.SET &EBI1_CS1_CFG0 %long 0x002200
  DATA.SET &EBI1_CS1_CFG1 %long 0x31003C  ;0x31003C(Wrap8),0x61002C(INCR)
  IF "&arg1"=="incr"||"&arg2"=="incr"
  (
    DATA.SET &EBI1_CS0_CFG1 %long 0x61002C
    DATA.SET &EBI1_CS1_CFG1 %long 0x61002C
  )
)

DATA.SET &EBI1_CFG %long 0x06380           ;pwrsave_mode=1,fixed_len=incr4

;-- enable multi-buffers mode --
DATA.SET &EBI1_BUFC_CFG_0 %long 0x01400500

;;;DATA.IN 0x00000000 /LONG     ;dummy read
;;;DATA.IN 0x10000000 /LONG     ;dummy read

DATA.SET 0x1000401C %long 0x12345678
&temp=data.long(RD:0x1000401C)
print &temp
IF &temp==0x12345678
(
  DATA.SET 0x00040004 %long 0xdeadbeef
  &temp=data.long(RD:0x00040004)
  IF &temp==0xdeadbeef
  (
    area.reset
    Print "You are using NEURON PSRAM card !!!"
    Print "Now shadow and data PSRAM are running at 96Mhz in burst mode"
    wait 1200.ms
    ENDDO
  )
  ELSE
  (
    area.reset
    Print "Error !!!!"
    Print "Make sure you are using this card MCN #: Neuron 20-V9374-H1"
    Print "and the jumper=1-2 on your NEURON memory card"
    END
  )
)
ELSE
(
  area.reset
  Print "Failing to initialize the Neuron PSRAM card at 96Mhz"
  Print "Now trying to initialize the DDR memory card at 96Mhz"
  wait 800.ms
  sys.d
  sys.u

  ;----------------------- DDR x 16 initialization ------------------------
  ;;;DATA.SET 0x90003310 %LONG 0x1 ;RUMI only. 0x1 for ddr, 0x0 for psram

do ..\..\build\ms\surf_init_clock_192MHz.cmm

;--------------------------------------------------------------------------
;Set ARM registers
;--------------------------------------------------------------------------
DATA.SET HWIO_GPIO2_PAGE_ADDR %long 0xB       ;gpio2_page -> gpio11
DATA.SET HWIO_GPIO2_CFG_ADDR %long 0x4        ;gpio2_cfg  -> EBI2_CS2
DATA.SET HWIO_GPIO_PAGE_ADDR %long 0xC        ;gpio_page  -> gpio12
DATA.SET HWIO_GPIO_CFG_ADDR %long 0x4         ;gpio_cfg   -> EBI2_CS3
DATA.SET HWIO_GPIO_PAGE_ADDR %long 0x33       ;gpio_page  -> gpio51
DATA.SET HWIO_GPIO_CFG_ADDR %long 0x4         ;gpio_cfg   -> EBI1_CS2
DATA.SET HWIO_GPIO_PAGE_ADDR %long 0x34       ;gpio_page  -> gpio52
DATA.SET HWIO_GPIO_CFG_ADDR %long 0x4         ;gpio_cfg   -> EBI1_CS3

DATA.SET HWIO_EBI2_PAD_HDRIVE_MSEL_0_ADDR %long 0x44444444
DATA.SET HWIO_EBI2_PAD_HDRIVE_MSEL_1_ADDR %long 0x00044444
DATA.SET HWIO_EBI1_PAD_HDRIVE_MSEL_0_ADDR %long 0x44444444
DATA.SET HWIO_EBI1_PAD_HDRIVE_MSEL_1_ADDR %long 0x04444444;0x04444444
DATA.SET HWIO_EBI1_PAD_HDRIVE_MSEL_2_ADDR %long 0x00004444
DATA.SET HWIO_GPIO_PAD_HDRIVE_MSEL_1_ADDR %long 0x04444000 ;hdrive for gpio11,12
DATA.SET HWIO_GPIO_PAD_HDRIVE_MSEL_6_ADDR %long 0x22044000 ;hdrive for gpio51,52
DATA.SET HWIO_EBI2_PAD_PULL_0_ADDR %long 0x01020
DATA.SET HWIO_EBI2_PAD_PULL_1_ADDR %long 0x01023
;-------------------------------------------------------------------------

  ;selecting buffer mode
  DATA.SET &EBI1_BUFC_CFG_0 %long 0xFF404740
  wait 100.ms

  ;check the buffer is empty or not
  &temp=data.long(RD:&EBI1_BUFC_STATUS_1)
  &temp=&temp&0x100
  IF &temp==0x100
  (
    Print "all buffers are empty."
  )
  ELSE
  (
    Print "all buffers are not empty, error!!!"
    END
  )

  ;-------------------- init sdram config routine -------------------------

  ;-- setting DDR SDRAM controller mode --
  DATA.SET &EBI1_CFG %long 0x1C080

  ;-- setting EBI1 pad code --
  &temp=data.long(RD:&WEB_MISC_WR)
  DATA.SET &WEB_MISC_WR %long (&temp|0x1<<2)
  DATA.SET &EBI1_PAD_PULL_0 %long 0x0
  DATA.SET &EBI1_PAD_PULL_1 %long 0x0

  ;-- disable auto refresh --
  DATA.SET &SDRAM_RFRSH_CFG %long 0x00301700 ;bit[3]=0 disable auto-refresh

  ;-- setting sdram clock phase --
  &temp=data.long(RD:&SDRAM_CTRL_CFG)
  DATA.SET &SDRAM_CTRL_CFG %long 0x2B110    ;turn off ddr clock
  &temp=data.long(RD:&SDRAM_CTRL_CFG)
  DATA.SET &SDRAM_CTRL_CFG %long 0x2F110    ;phase align ddr clk w.mem_clk
  &temp=data.long(RD:&SDRAM_CTRL_CFG)
  DATA.SET &SDRAM_CTRL_CFG %long 0x2E110    ;turn on ddr clock

  ;-- pre-charge sdram --
  &temp=data.long(RD:&SDRAM_DEV_INIT_CFG)
  DATA.SET &SDRAM_DEV_INIT_CFG %long 0x0    ;reset config/start_done to '0'
  DATA.SET &SDRAM_DEV_INIT_CFG %long 0x40000C2 ;start precharge on CS0/1
  &temp=data.long(RD:&SDRAM_DEV_INIT_CFG)
  &temp=&temp&0x200                         ;check precharge done
  while &temp!=0x200
  (
    &temp=data.long(RD:&SDRAM_DEV_INIT_CFG)
    &temp=&temp&0x200                       ;check precharge done
  )

  ;-- start refresh sequence --
  &temp=data.long(RD:&SDRAM_DEV_INIT_CFG)
  DATA.SET &SDRAM_DEV_INIT_CFG %long 0xC0   ;reset config/start done bits
                                            ;and select CS0/1
  &temp=data.long(RD:&SDRAM_DEV_INIT_CFG)
  DATA.SET &SDRAM_DEV_INIT_CFG %long 0xC4   ;start refresh on CS0/1
  &temp=data.long(RD:&SDRAM_DEV_INIT_CFG)
  &temp=&temp&0x400                         ;check refresh done
  while &temp!=0x400
  (
    &temp=data.long(RD:&SDRAM_DEV_INIT_CFG)
    &temp=&temp&0x400    ;check refresh done
  )

  ;-- start refresh sequence --
  &temp=data.long(RD:&SDRAM_DEV_INIT_CFG)
  DATA.SET &SDRAM_DEV_INIT_CFG %long 0xC0     ;reset config/start done bits
                                              ;and select CS0/1
  &temp=data.long(RD:&SDRAM_DEV_INIT_CFG)
  DATA.SET &SDRAM_DEV_INIT_CFG %long 0xC4     ;start refresh on CS0/1
  &temp=data.long(RD:&SDRAM_DEV_INIT_CFG)
  &temp=&temp&0x400                           ;check refresh done
  while &temp!=0x400
  (
    &temp=data.long(RD:&SDRAM_DEV_INIT_CFG)
    &temp=&temp&0x400                         ;check refresh done
  )

  ;-- start mode register settings --
  &temp=data.long(RD:&SDRAM_DEV_INIT_CFG)
  DATA.SET &SDRAM_DEV_INIT_CFG %long 0xC0     ;reset config/start done bits
                                              ;and select CS0/1
  &temp=data.long(RD:&SDRAM_DEV_INIT_CFG)
  DATA.SET &SDRAM_DEV_INIT_CFG %long 0x3200C1 ;set config start bit.
                                              ;[30:16]=modeReg[A15:A0]=0x32
                                              ;[18:16]=
                                              ;modeReg[A2:A0]=011b(BL=4)
                                              ;[19]=modeReg[A3]=0
                                              ;(burstType=seq)
                                              ;[22:20]=
                                              ;modeReg[A6:A4]=011b(CAS=3)
                                              ;Bank_addr[15:14]=0
                                              ;(for mode reg set)

  &temp=data.long(RD:&SDRAM_DEV_INIT_CFG)
  &temp=&temp&0x100    ;check config done
  while &temp!=0x100
  (
    &temp=data.long(RD:&SDRAM_DEV_INIT_CFG)
    &temp=&temp&0x100    ;check config done
  )

  ;-- start extended mode register settings --
  &temp=data.long(RD:&SDRAM_DEV_INIT_CFG)
  DATA.SET &SDRAM_DEV_INIT_CFG %long 0xC0     ;reset config/start done bits
                                              ;and select CS0/1
  &temp=data.long(RD:&SDRAM_DEV_INIT_CFG)
  DATA.SET &SDRAM_DEV_INIT_CFG %long 0x80C1   ;[30:16]=modeReg[A12:A0]=0x0
                                              ;[18:16]=
                                              ;modeReg[A2:A0]=0b(fullarray)
                                              ;[20:19]=
                                              ;modeReg[A4:A3]=0 (must be)
                                              ;[22:21]=modeReg[A6:A5]=0
                                              ;(dr_sten=full)
                                              ;[28:23]=
                                              ;modeReg[A12:A7]=0(must be)
                                              ;Bank_addr[15:14]=10b
                                              ;(for extend mode reg set)

  &temp=data.long(RD:&SDRAM_DEV_INIT_CFG)
  &temp=&temp&0x100    ;check config done
  while &temp!=0x100
  (
    &temp=data.long(RD:&SDRAM_DEV_INIT_CFG)
    &temp=&temp&0x100    ;check config done
  )

  &temp=data.long(RD:&SDRAM_DEV_INIT_CFG)
  DATA.SET &SDRAM_DEV_INIT_CFG %long 0x0  ;clear all config status bits

  DATA.SET &SDRAM_CTRL_CFG %long 0x2E110  ;set DQ_DQS_PAD_OE to 1(bit13)

    ;-- set refresh timer --
  &temp=data.long(RD:&SDRAM_RFRSH_CFG)
  DATA.SET &SDRAM_RFRSH_CFG %long 0x3302ED0 ;set 156 clocks at 96Mhz
                                            ;refresh period=64ms,
                                            ;clock period=10.4ns
  DATA.SET &SDRAM_RFRSH_CFG %long 0x3302ED8 ;set refresh enable bit to 1

  &temp=data.long(RD:&SDRAM_CDCM_CFG)
  DATA.SET &SDRAM_CDCM_CFG %long 0xA  ; Load CDC master
  DATA.SET &SDRAM_CDCM_CFG %long 0x12 ; Start calibration

  &temp=data.long(RD:&SDRAM_CDCM_STATUS)
  &temp=&temp&0x80    ;check cdcm calib done(bit7)
  while &temp!=0x80
  (
      &temp=data.long(RD:&SDRAM_CDCM_STATUS)
      &temp=&temp&0x80    ;check cdcm calib done(bit7)
  )

  DATA.SET &SDRAM_CDCM_CFG %long 0x182 ;[9:7]Enables Auto Calibration of CDC
                                       ;if freq > 80 MHz

  ;-- start CDC sequence --
  &temp=data.long(RD:&SDRAM_CDC0_CFG)
  DATA.SET &SDRAM_CDC0_CFG %long 0xC100
  DATA.SET &SDRAM_CDC0_CFG %long 0xC000     ;b[15]=1 if freq>80Mhz
  &temp=data.long(RD:&SDRAM_CDC1_CFG)
  DATA.SET &SDRAM_CDC1_CFG %long 0xC100
  DATA.SET &SDRAM_CDC1_CFG %long 0xC000     ;b[15]=1 if freq>80Mhz

  ;-- set sdram col,row and bank size --
  &temp=data.long(RD:&SDRAM_DEV_PARAM_CFG1)
  DATA.SET &SDRAM_DEV_PARAM_CFG1 %long 0x013A2471
                                 ;based on Infineon data sheet (64MB size)
                                 ;cas_lat[29:28]=0 (3 clocks)
                                 ;row_size[26:24]=1 (13 bits)
                                 ;col_size[22:20]=3 (10 bits)
                                 ;tRFC[19:16]=(roundup(110ns/10ns)-1,min=4
                                 ;tRP[14:12]=roundup(30ns/10ns)- 1
                                 ;tRAS[10:8]=roundup(50ns/10ns)-1
                                 ;tRC[7:4]=roundup(80ns/10ns)-1
                                 ;bank_size[3]=0 (2bits)
                                 ;bank_IL[1]=0x0 (linear memory map)
                                 ;clk_pwr_down_en[0]=0 (enable powersaving)

  DATA.SET &SDRAM_DEV_PARAM_CFG2 %long 0x12131241
                                 ;based on Infineon data sheet
                                 ;tMRD[30:28]=2 clocks - 1
                                 ;tXP[26:24]=roundup(25ns/10ns)-1
                                 ;tXSR[21:16]=roundup(200ns/10ns)-1
                                 ;tWR[14:12]=roundup(15ns/10ns)-1
                                 ;tRCD[10:8]=roundup(30ns/10ns)-1
                                 ;tDAL[6:4]
                                 ;=roundup(Trp/10ns)+roundup(Twr/10ns)-1
                                 ;tRRD[2:0]=roundup(15ns/10ns)-1


  DATA.SET &SDRAM_DEV_PARAM_CFG3 %long 0x00002120
                                 ;default value
                                 ;tCKE[14:12]=2 (2 cycle gap)
                                 ;tWTR[10:8]=1 (1 cycle gap)
                                 ;tiorun_val[6:4]=2 (2 cycle gap)
                                 ;burst_len[1:0]=0(4-word burst per access)

  ;-- setting AHB master port priority and ahb master timeout --
  &temp=data.long(RD:&SDRAM_OPT_CFG)

  ;-- set sdram optimizer disable --
  ;;;DATA.SET &SDRAM_OPT_CFG %long 0x1B0000 ;priority order:P0>P1>P2>P3
  ;;;DATA.SET &SDRAM_CTRL_CFG %long 0x2E110

  ;-- set sdram optimizer enable --
  DATA.SET &SDRAM_OPT_CFG %long 0x1100012  ;setting from Deepti
  DATA.SET &SDRAM_CTRL_CFG %long 0xF02E83E ;setting from Deepti

  ;-- enable multi-buffers mode --
  DATA.SET &EBI1_BUFC_CFG_0 %long 0x00400640 ;deepti suggest high_mark=6

  ;------------------ do a small block of memory test ---------------------
  local &indx &temp1 &temp2
  &indx=1
  while &indx<128
  (
    DATA.SET (0x0+4*(&indx)) %long 0x9999*(&indx)
    &indx=&indx+1
  )

  &indx=1
  while &indx<128
  (
    &temp1=data.long(RD:(0x0+4*(&indx)))
    &temp2=0x9999*(&indx)
    IF &temp1!=&temp2
    (
      area.reset
      Print "Failed to initialize the memory device on EBI1 !!!"
      Print "Could be one of the following problems: "
      Print "1. Doesn't work on the latest rumi build, try the old build"
      Print "2. Make sure you are using the following memory cards on EBI1"
      Print "   MCN #: Neuron 20-V9374-H1 or DDR 20-V9361-4 card"
      END
    )
    &indx=&indx+1
  )
  area.reset
  Print "You are using Infineon DDR memory card !!!"
  Print "DDR initialization at 96Mhz done !!!"
  wait 1200.ms
  ENDDO

) ;else

