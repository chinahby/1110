;*****************************************************************************************
;**                                                                        		**
;**           Call this script segment from any script to do an initial    		**
;**           configuration of Raven in preparation for a software load.  		**
;**           The settings in this script need to match with those in init.s 		**
;**                                                                        		**
;**	Changes:                                                     			**
;**   	04-21-04     First version                                    			**
;*****************************************************************************************

; This .cmm file is a general-purpose initialization file for the Raven MSM.
; The script configures some AHB peripheral registers, as well as commonly
; used GPIOs. 
; 
; In general, registers that need to be set up for the majority of verification
; work are configured below.  Registers with suitable default values are left
; as-is, unless it is difficult to verify that the default setting is actually working.
;
; Since many registers are not set up, (including clock configuration registers)
; this script is intended to be used after resetting the system. 


;--------------------------------------------------------------------------
; ARM clock controller registers
;--------------------------------------------------------------------------
; MICROPROCESSOR CLOCK CONFIGURATION
; After RESET, uP clock should default to TCXO/1. 
; Clocks are not initialized here since the default values should work
; properly. Turn all clocks on. 

d.set 80000000 %LONG 0	;MSM_CLK_HALTA
d.set 80000004 %LONG 0	;MSM_CLK_HALTB

;--------------------------------------------------------------------------
; Decoder registers
;--------------------------------------------------------------------------
;PAD_HDRIVE_SEL_0
DATA.SET 0x80000A1C %LONG 0xFCF

;EBI1_MPMC_STDY_SEL, configures static or dynamic memory on RAMCS2 and RAMCS3
DATA.SET 0x80000304 %LONG 0x00 ;static memory

;EBI1_PSRAM_CRE, controls the PSRAM CRE pin for synchronous Micron PSRAM
DATA.SET 0x80000308 %LONG 0x00  ; required for Micron PSRAM

;--------------------------------------------------------------------------
; GPIO  ALT FUNCTION    GPIO_PAGE	GPIO_CFG value
;                       bits 6:0	bits 5:2
; ------------------------------------------------------------
;  34	A2[20]		34=0x22		00 0100
;  35	XMEM2_CS_N[2]	35=0x23		00 0100
;  36	XMEM2_CS_N[3]	36=0x24		00 0100
;  37	LCD_EN		37=0x25		00 0100
;  38	LCD_CS_N	38=0x26		00 0100
;
;  75                   75=0x4b
;  76	XMEM1_CS_N[1]	76=0x4C		00 0100
;  77	XMEM1_CS_N[3]	77=0x4D		00 0100
;  78	A1[23]		78=0x4E		00 0100
;  79	A1[24]		79=0x4F		00 0100
; 

; GPIO78
DATA.SET 0x80000920 %long 0x4E
DATA.SET 0x80000924 %long 0x04

; GPIO33
DATA.SET 0x80000920 %long 0x21
DATA.SET 0x80000924 %long 0xB

; GPIO76
DATA.SET 0x80000920 %long 0x4C
DATA.SET 0x80000924 %long 0x04

; GPIO77
DATA.SET 0x80000920 %long 0x4D
DATA.SET 0x80000924 %long 0x04

; GPIO79
DATA.SET 0x80000920 %long 0x4F
DATA.SET 0x80000924 %long 0x04

;GPIO73
DATA.SET 0x80000920 %LONG 0x49
DATA.SET 0x80000924 %LONG 0x8

;GPIO74
DATA.SET 0x80000920 %LONG 0x4a
DATA.SET 0x80000924 %LONG 0x8

;GPIO75
DATA.SET 0x80000920 %LONG 0x4b
DATA.SET 0x80000924 %LONG 0x8

; GPIO34
DATA.SET 0x80000920 %long 0x22
DATA.SET 0x80000924 %long 0x04

; GPIO35
DATA.SET 0x80000920 %long 0x23
DATA.SET 0x80000924 %long 0x04

; GPIO36
DATA.SET 0x80000920 %long 0x24
DATA.SET 0x80000924 %long 0x04

; GPIO37
DATA.SET 0x80000920 %long 0x25
DATA.SET 0x80000924 %long 0x04

; GPIO38
DATA.SET 0x80000920 %long 0x26
DATA.SET 0x80000924 %long 0x04

;EBI1_CFG
DATA.SET 0x80000300 %LONG 0x10b0ca0 

;EBI1_CS0_CFG0, configures timing and page size for CS0
DATA.SET 0x8000030c %long 0x1112200 ; use the defaults for now

;EBI1_CS0_CFG1, configures timing and burst data
DATA.SET 0x80000310 %LONG 0x00 ; default is 0

;EBI1_CS1_CFG0
DATA.SET 0x80000314 %long 0x71112200 ;same as CS0_CFG0

;EBI1_CS1_CFG1
DATA.SET 0x80000318 %LONG 0x71000

;EBI1_MEM_CTLR_MODE probably don't want to write to this register
;0 is the default state which equal XMEMC
DATA.SET 0x8000032c %LONG 0x0

;EBI2_CFG, set for EBI2_CS_N[2] is controlled by NAND flash controler and ARM priority
DATA.SET 0x80000380 %LONG 0x02


ENDDO



