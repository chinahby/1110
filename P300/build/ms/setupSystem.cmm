;*************************************************************************
;**     setupSystem.cmm                                                 **
;**     Call this script to initialize to do the following:             **
;**             Set the correct "System Settings" for Trace32           **
;**                                                                     **
;**     Only contains functionality common to all cmm scripts           **
;**                                                                     **
;*************************************************************************
;  $PVCSPath:$
;  $Header: //depot/asic/qsc1100/build/ms/cmm/setupSystem.cmm#1 $
;
;
;*====*====*====*====*====*====*====*====*====*====*====*====*====*====*====*
;
;                           EDIT HISTORY FOR FILE
;
; This section contains comments describing changes made to the module.
; Notice that changes are listed in reverse chronological order.
;
; when       who     what, where, why
; --------   ---     --------------------------------------------------------
; 08/18/05   eav     Initial file
;
Entry

; Turbo mode of debug state accesses - CPU makes no checks of
; memory access in debug mode.
System.Option TURBO off
; Usage of TRST in system - Must be off if reset tied to trst.
System.Option.TRST on
System.Option.CFLUSH on
System.Option.ResBreak on
System.Option.ENRESET on
System.Option.WAITRESET on
System.CPU ARM926EJ
System.Option DACR ON
System.OPTION BIGENDIAN OFF
System.JtagClock RTCK


; Disable "Emulator berr error"
System.Option ShowError off

; Disassembler selection - Automatically selects correct one.
System.Option DisMode Auto
