;-----------------------------------------------------------------------------
; This script sets up the debug clock output on the GPIO pin to permit easy 
; probing of clock signals.
;
; Probe pin 17 of header J31 for the GPIO debug clock output signal.
;-----------------------------------------------------------------------------
;
; $Header: //depot/asic/qsc1100/build/ms/cmm/testclock_modem.cmm#3 $
; $DateTime: 2008/03/04 11:16:35 $
; $Author: bcalder $

if !y.exist(HWIO_GPIO2_PAGE_ADDR)
(
  do ..\..\drivers\hw\hwio.cmm
)

;-----------------------------------------------------------------------------
; Display available clock sources that can be output to the debug clock
; output on the GPIO pin and prompt for selection.
;-----------------------------------------------------------------------------

local &choice

Main_Menu:
  print "                                                                  "
  print " -------------- SC2X SURF Modem Clock Test ------------------"
  print "                                                                  "
  print "Choose clock to output on Pin 14 on Header J26                    "
  print "                                                                  "
  print "  0: EXIT                                                         "
  print "  1: chipxn        2: chipxn_div2   3: chipxn_div4   4:           "
  print "  5: edge          6: gsm           7: fb_ant0       8: fb_ant1   "
  print "  9: rxf_samp_ref 10:              11: cdma_rxf_samp_ref 12:      "
  print " 13:              14:              15:              16:           "
  print " 17: mdsp_hm      18: mdsp_intf    19: gps_chipx8   20: offline   "
  print " 21: gacc         22: cdxo_at_cut  23: cdxo_y_cut   24:           "
  print " 25: tx_pdm       26: tx_dac       27: tcxo_pdm     28: sleep     "    
  print " 29: slpfast_ref1 30: slpfast_ref2 31: slpfast_gsm  32: slpfast_fee"
  print " 33: bt           34: modem_sbi    35: modem_web    36:           "
  print " 37: bt_sbi       38: edge div 2   39:ssrv offline0 40:ssrv offline1"
  print " 41: wcdma chipxn 42: wcdma cxn/2  43:wcdma cxn/4   44:wcdmaslpfstchpxnref"
  print " 45: sym buf      46: cc ram       47: tx ram       48: gpschpx16 "
  print "                                                                  " 
  print " Please make a choice: "

&t32_cmm_stopped=1
enter &choice
&t32_cmm_stopped=0

;-----------------------------------------------------------------------------
; Enable the debug clock output on the GPIO 5.
;-----------------------------------------------------------------------------

d.out HWIO_GPIO2_PAGE_ADDR %word 5.
d.out HWIO_GPIO2_CFG_ADDR %word 0x8

local &gpio_pad_hdrive_msel_0
&gpio_pad_hdrive_msel_0=data.long(HWIO_GPIO_PAD_HDRIVE_MSEL_0_ADDR)
&gpio_pad_hdrive_msel_0=&gpio_pad_hdrive_msel_0|0x700000
data.set HWIO_GPIO_PAD_HDRIVE_MSEL_0_ADDR %long &gpio_pad_hdrive_msel_0

;enable modem clock output
d.out HWIO_WEB_MISC_WR_ADDR %word 0x8


;-----------------------------------------------------------------------------
; Determine the value to program into the CLK_TEST_SEL field of the CLK_TEST
; register for the specified clock signal.
;-----------------------------------------------------------------------------

local &value

if &choice==0  
  (
  print "exiting..."
  enddo
  )
else if &choice==1  
  (
  print "CHIXN clock (0x000) "
  &value=0x000
  )
else if &choice==2 
  (
  print "CHIPXN_DIV2 clock (0x040) "
  &value=0x40
  )
else if &choice==3
  (
  print "CHIPXN_DIV4 clock (0x080) "
  &value=0x080
  )
else if &choice==5  
  (
  print "EDGE clock (0x0C0) "
  &value=0x0C0
  )
else if &choice==6
  (
  print "GSM clock (0x100) "
  &value=0x100
  )
else if &choice==7  
  (
  print "FB ANT0 clock (0x140) "
  &value=0x140
  )
else if &choice==8  
  (
  print "FB ANT1 clock (0x180) "
  &value=0x180
  )
else if &choice==9
  (
  print "RXF_SAMP clock (0x1C0) "
  &value=0x1C0
  )
else if &choice==11 
  (
  print "CDMA_RXF_SAMP_REF clock (0x240) "
  &value=0x240
  )
else if &choice==17 
  (
  print "MDSP_HM clock (0x340) "
  &value=0x340
  )
else if &choice==18   
  (
  print "MDSP_INTF clock (0x380) "
  &value=0x380
  )
else if &choice==19
  (
  print "GPS CHIPx8 clock (0x3C0) "
  &value=0x3C0
  )
else if &choice==20
  (
  print "OFFLINE clock (0x400) "
  &value=0x400
  )
else if &choice==21
  (
  print "GACC clock (0x440) "
  &value=0x440
  )
else if &choice==22   
  (
  print "CDXO_AT_CUT clock (0x480) "
  &value=0x480
  )
else if &choice==23
  (
  print "CDXO_Y_CUT clock (0x4C0) "
  &value=0x4C0
  )
else if &choice==25
  (
  print "TX_PDM clock (0x540) "
  &value=0x540
  )
else if &choice==26 
  (
  print "TX_DAC clock (0x7C0) "
  &value=0x7C0
  )
else if &choice==27 
  (
  print "TCXO_PDM clock (0x580) "
  &value=0x580
  )
else if &choice==28
  (
  print "SLEEP clock (0x5C0) "
  &value=0x5C0
  )
else if &choice==29 
  (
  print "SLPFAST_REF1 clock (0x600) "
  &value=0x600
  )
else if &choice==30
  (
  print "SLPFAST_REF2 clock (0x640) "
  &value=0x640
  )
else if &choice==31   
  (
  print "SLPFAST_GSM clock (0x680) "
  &value=0x680
  )
else if &choice==32   
  (
  print "SLPFAST_FEE clock (0x6C0)"
  &value=0x6C0
  )
else if &choice==33
  (
  print "BT clock (0x700)"
  &value=0x700
  )
else if &choice==34
  (
  print "MODEM_SBI clock (0x740)"
  &value=0x740
  )
else if &choice==35       
  (
  print "MODEM_WEB clock (0x780) "
  &value=0x780
  )
else if &choice==37       
  (
  print "BT_SBI clock (0x800) "
  &value=0x800
  )
else if &choice==38       
  (
  print "EDGE DIV2 clock (0x840) "
  &value=0x840
  )
else if &choice==39       
  (
  print "SSRV OFFLINE 0 clock (0x880) "
  &value=0x880
  )
else if &choice==40       
  (
  print "SSRV OFFLINE 1 clock (0x8C0) "
  &value=0x8C0
  )
else if &choice==41       
  (
  print "WCDMA_CHIPXN clock (0x900) "
  &value=0x900
  )
else if &choice==42       
  (
  print "WCDMA_CHIPXN DIV2 clock (0x940) "
  &value=0x940
  )
else if &choice==43       
  (
  print "WCDMA_CHIPXN DIV4 clock (0x980) "
  &value=0x980
  )
else if &choice==44       
  (
  print "WCDMA_SLPFAST CHIPXN REF clock (0x9C0) "
  &value=0x9C0
  )
else if &choice==45       
  (
  print "SYM BUF clock (0xa00) "
  &value=0xa00
  )
else if &choice==46       
  (
  print "CC RAM clock (0xa40) "
  &value=0xa40
  )
else if &choice==47       
  (
  print "TX RAM clock (0xa80) "
  &value=0xa80
  )
else if &choice==48       
  (
  print "GPS CHIPX16 clock (0xac0) "
  &value=0xac0
  )
else 
  (
  print "Invalid selection: &choice "
  enddo
  )

;-----------------------------------------------------------------------------
; Program the WEB_MISC_WR and CLK_TEST registers to output the selected value.
;-----------------------------------------------------------------------------

d.out HWIO_MODEM_CLK_TEST_ADDR %word &value

;-----------------------------------------------------------------------------
; Return to the menu prompt.
;-----------------------------------------------------------------------------

goto Main_Menu

enddo
