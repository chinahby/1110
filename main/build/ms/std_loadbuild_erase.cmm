do erasechip.cmm
cd ....buildms
do jf SBNVALZ
