do erasechip.cmm
cd ..\..\build\ms
do jf Flexi
