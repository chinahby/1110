do erasechip.cmm
cd ....buildms
do jf W021
