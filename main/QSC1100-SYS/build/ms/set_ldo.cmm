radix.hex

;; this script can set the following LDOs' voltage:
;; be careful not to over voltage.
y.create.l	 MSMC  	  0x09  ; NMOS 
y.create.l	 MSMA 	  0x0A  ; 
y.create.l	 MSME2 	  0x0B  ; 
y.create.l	 RFA1 	  0x0D  ; NMOS 
y.create.l	 RFA2 	  0x0E  ; 
y.create.l	 XO 	  0x10  ;
y.create.l	 USB 	  0x11  ;
y.create.l	 RUIM 	  0x13  ;
y.create.l	 MPLL 	  0x14  ; NMOS
y.create.l	 MSME1 	  0x15  ;
y.create.done 


local &ldo &ldo_addr &voltage &value &val_hex &ans &data &max_voltage &min_voltage &voltage_step 

entry &ldo &voltage 

; display usage for SSBI_PMIC.cmm
;if ("&ldo"=="-h")||("&ldo"=="/?")||("&ldo"=="-help")||("&ldo"=="")
;(
;  print "do set_ldo <ldo> <voltage>; example: do set_ldo MSMC 1.2"
;  enddo
;)

; do without pop-up menu
if ("&voltage"!="")
(       
	; do NMOS
	if (&ldo==MSMC)||(&ldo==RFA1)||(&ldo==MPLL)
	(
		&max_voltage=1.525
		&min_voltage=0.75
		&voltage_step=0.025
	)
	; do PMOS. this script assume that the voltage references are already been set correclty
	if (&ldo==MSMA)||(&ldo==MSME2)||(&ldo==RFA2)||(&ldo==XO)||(&ldo==RUIM)||(&ldo==MSME1)
	(
		&max_voltage=3.05
		&min_voltage=1.5
		&voltage_step=0.05
	)
	; do USB
	if (&ldo==USB)
	(
		&max_voltage=6.1
		&min_voltage=3
		&voltage_step=0.1
	)

	&value=((&voltage-&min_voltage)/&voltage_step+0.5);
	&val_hex=0x1
	
	&ans=1
	while (&ans>=1)
	(
		&ans=&value-&val_hex
		&val_hex=&val_hex+1
	)
	&val_hex=&val_hex-1 	
        &voltage=&min_voltage+&voltage_step*&val_hex 

	&data=0xC0|&val_hex
	;;data.set 0x0 %long &data ; debug only	
y.create.l	 MSMC  	  0x09  ; NMOS 
y.create.l	 MSMA 	  0x0A  ; 
y.create.l	 MSME2 	  0x0B  ; 
y.create.l	 RFA1 	  0x0D  ; NMOS 
y.create.l	 RFA2 	  0x0E  ; 
y.create.l	 XO 	  0x10  ;
y.create.l	 USB 	  0x11  ;
y.create.l	 RUIM 	  0x13  ;
y.create.l	 MPLL 	  0x14  ; NMOS
y.create.l	 MSME1 	  0x15  ;


        if (&ldo==MSMC)
	(
           &ldo_addr=0x9
	)
	if (&ldo==MSMA)
	(
           &ldo_addr=0xA
	)
	if (&ldo==MSME2)
	(
           &ldo_addr=0xB
	)
	if (&ldo==RFA1)
	(
           &ldo_addr=0xD
	)
	if (&ldo==RFA2)
	(
           &ldo_addr=0xE
	)

        if (&ldo==XO)
	(
           &ldo_addr=0x10
	)
	if (&ldo==USB)
	(
           &ldo_addr=0x11
	)
	if (&ldo==RUIM)
	(
           &ldo_addr=0x13
	)
	if (&ldo==MPLL)
	(
           &ldo_addr=0x14
	)
	if (&ldo==MSME1)
	(
           &ldo_addr=0x15
	)
	do SSBI_PMIC &ldo_addr &data	
	print "&ldo = &voltage Volt"
	enddo
)

; pop-up menu 
if ("&voltage"=="")
(
	
	WINPAGE
	winpage.create P001
	winpage.select P001
	
	area.create Screen 500. 1000.  	
	area.select Screen
	area.view Screen

	print " Script to set the following LDOs:"
	print " MSMC MSMA MSME2 RFA1 RFA2 XO USB RUIM MPLL MSME1"
	print " "
	if ("&ldo"=="")
	(
		print " LDO: "
		enter &ldo      
	)
	else
	(
		print " LDO: &ldo"
	)	
        print " voltage: "
	enter &voltage

        area.reset
	WINPAGE
	winpage.delete P001

        do set_ldo &ldo &voltage
        enddo
)

enddo
