do erasechip.cmm
cd ....buildms
do jf SBNAALZ
