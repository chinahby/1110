;****************************************************************************
;**           attach_jtag_while_running.CMM                                **
;**           This script walks the user through the process               **
;**           of connecting a JTAG to a running phone, and asks            **
;**           them if they want to load the symbols and perform            **
;**           a JTAG dump (using ram_code_save).                           **
;**                                                                        **
;**           Changes:                                                     **
;**           10-15-04   First Version                                     **
;****************************************************************************

;This .cmm script acts as a main routine for setting up a MSM6250 platform.
;
; detect if this script has already been run -- only do this for parts that
;  get called when the jtag reconnects with the target
;
;

; Script aid in attaching T32 to a running target
;
; Copyright Qualcomm, 2004
; Author: Graham Roff, 10/07/04
;
; Modified 10/15/04 -- Added option to save JTAG logs (Tim Gold)
;

local &wait
local &loadsym

; Create an input area
Area.Create IO
Area.Select IO
Area IO

print ""
print ""
print ""
print ""
print "*** Script to attach T32/JTAG to a running target ***"
print ""

print "Configuring T32 for ARM9..."
sys.cpu arm926ej
System.Option DACR ON

print "Enabling real-time clock..."
sys.jtagclock rtck

print "Setting T32 to no-debug mode..."
sys.mode nodebug

print ""
print "On Saber/Jaguar, short pins 18 and 20 together on the FFA (bottom right 2 pins)."
print "Now attach the JTAG, very carefully connecting the top pins first."
print "Hit enter when connected."

enter &wait

print ""
print "Attaching to target..."
sys.mode attach

print ""
print "You are now attached to the target."
print "Load symbols (y/N)? "

enter &loadsym

if "&loadsym"=="y"
(
   if run()
   (
      break
   )
   print "Select elf file from browser"
   data.load.elf *.elf /nocode
   print "Symbols loaded."
)

print ""
print "Perform JTAG memory dump (y/N)?"

enter &dumpmem

if "&dumpmem"=="y"
(
   if run()
   (
      break
   )
   print "Executing ram_code_save.cmm"
   print "This will take a few minutes, please wait..."
   do ram_code_save.cmm
   print "Done saving logs."
)

if "&loadsim"=="y"
(
  d.l
  v.f
)

print "*** Script complete ***"
