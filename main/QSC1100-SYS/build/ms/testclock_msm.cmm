;-----------------------------------------------------------------------------
; This script sets up the debug clock output on the GPIO2 pin to permit easy 
; probing of clock signals.
;
; Probe pin 14 of header J39 for the GPIO2 debug clock output signal.
;-----------------------------------------------------------------------------
;
; $Header: //depot/asic/qsc1100/build/ms/cmm/testclock_msm.cmm#4 $
; $DateTime: 2008/03/01 12:18:25 $
; $Author: bcalder $
if !y.exist(HWIO_GPIO2_PAGE_ADDR)
(
  do ..\..\drivers\hw\hwio.cmm
)

;-----------------------------------------------------------------------------
; Display available clock sources that can be output to the debug clock
; output on the GPIO2 pin and prompt for selection.
;-----------------------------------------------------------------------------

local &choice

Main_Menu:
  print "                                                              "
  print " -------------- QSC1100 SURF ARM Clock Test ------------------"
  print "                                                              "
  print " Choose clock to output on Pin 14 on Header J26:              "
  print " 0 : exit                                                  "
  print " 1 : adsp       20 : ecodecif        38 : gsbi2            "
  print " 2 : adsp_intf  21 : adsp_video_intf 39 : i2c              "
  print " 3 : arm        22 : gsbi0           40 : perph_web_ahb    "
  print " 4 : adsp_ahb   23 : gsbi1           41 : sdcc_ahb         "
  print " 5 : ahb_ahb    24 : i2s_mstr        42 : sdcc             "
  print " 6 : uxmc_ahb   25 : i2s_bit         43 : gsbi0_sim        "
  print " 7 : audio_ahb  26 : icodec_2x_rx    44 : rfms_xo          "
  print " 8 : gsbi_ahb   27 : icodec_rx       45 : camclk_po        "
  print " 9 : modem_ahb  28 : icodec_tx       46 : video_vfe        "
  print "10 : mti_ahb    29 : efuse           47 : mdp_ahb          "
  print "11 : periph_ahb 30 : qmembist        48 : video_ahb        "
  print "12 : sec_ahb    31 : ssbi_pmic       49 : uart_dm_ahb      "
  print "13 : usb_ahb    32 : wdog_slp        50 : uart_dm          "
  print "14 : ebi1       33 : usb_fs          51 : icodec_rx_to_i2s "
  print "15 : ebi1_io    34 : ecodecif_po     52 : rxadc_data       "
  print "16 : imem       35 : rxadc           53 : test_hkadc       "
  print "17 : imem_io    36 : xo4             54 : ebi2             "
  print "18 : etm        37 : tlmm_gpio_ahb   55 : ebi2_io          "
  print "19 : ecodec "
  print "Please make a choice: "

&t32_cmm_stopped=1
enter &choice
&t32_cmm_stopped=0

;-----------------------------------------------------------------------------
; Determine the value to program into the CLK_TEST_SEL field of the CLK_TEST
; register for the specified clock signal.
;-----------------------------------------------------------------------------

local &value

if &choice==0  
  (
  print "exiting..."
  enddo
  )

  if &choice.<56.
  (
    &value=(2*(&choice.-1)+1)
  )
  else 
  (
  print "Invalid selection: &choice "
  enddo
  )

;-----------------------------------------------------------------------------
; Program the DBG_CFG_REG to the selected clock value
;-----------------------------------------------------------------------------

d.out HWIO_DBG_CFG_REG_ADDR %long &value

;-----------------------------------------------------------------------------
; Enable the debug clock output on the GPIO5 (will steal keysense4)
;-----------------------------------------------------------------------------

; Set GPIO5
d.out HWIO_GPIO2_PAGE_ADDR %long 0x5
; Alt function DBG_CLK_ALT, no pull
d.out HWIO_GPIO2_CFG_ADDR %word 0x0c

local &gpio_pad_hdrive_msel_0
&gpio_pad_hdrive_msel_0=data.long(HWIO_GPIO_PAD_HDRIVE_MSEL_0_ADDR)
&gpio_pad_hdrive_msel_0=&gpio_pad_hdrive_msel_0|0x700000
data.set HWIO_GPIO_PAD_HDRIVE_MSEL_0_ADDR %long &gpio_pad_hdrive_msel_0

print "The clock will show on Pin 14 of Header J26."

;-----------------------------------------------------------------------------
; Return to the menu prompt.
;-----------------------------------------------------------------------------

goto Main_Menu

enddo
