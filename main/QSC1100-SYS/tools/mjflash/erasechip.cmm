;============================================================================
;  Name:
;    ERASECHIP.CMM
;
;  Description:
;    FLASH Erasing Script file for Lauterbach JTAG/ICD TRACE32.
;
;  Execution:
;    Inside the debugger, type at the command line: "do ersechip".
;    The script will prompt youbefore erasing
;
; Copyright (c) 2006-2007 by QUALCOMM, Incorporated.  All Rights Reserved.
;----------------------------------------------------------------------------
;============================================================================
;
;                        EDIT HISTORY FOR MODULE
;
; $PVCSPath:  L:/src/asw/MSM6050/vcs/jf29pds322.cmm_v   1.1   20 Dec 2001 13:33:10   dionh  $
; $Header: //depot/asic/msmshared/tools/jflash/JFLASH.03.00/erasechip.cmm#2 $ $DateTime: 2007/03/05 17:09:05 $ $Author: mmiranda $
;
; when       who     what, where, why
; -------    ---     --------------------------------------------------------
; 12/28/06   rt      Handle bringing up terminal window automatically
; 12/06/06   rt      Initial release for multi-image NOR targets
;============================================================================;


;============================================================================
; Variables
;============================================================================

local &Verbose
local &TermUp
local &ClearWin
local &CurrentCmd
local &JtagSet

local &debug &DoDebug 

ENTRY &debug

; set some defaults
 &ClearWin="yes"
 &Verbose="yes"


;============================================================================
; Parse options and set up variables accordingly
;============================================================================

if "&debug"=="DEBUG"
  (
    &DoDebug="yes"
    &ClearWin="no"
    &TermUp="yes"
  )
else
  (
    &DoDebug="no"
  )



;============================================================================
; Prepare system
;============================================================================
 B:

;-------------------------------------------------------------------------------
; Turbo mode of debug state accesses - CPU makes no checks of memory access in
; debug mode
;-------------------------------------------------------------------------------
 sys.o.TURBO off
 sys.o.BigEndian off
 sys.o.ResBreak on
 sys.o.SHOWERROR off
 sys.o.EnReset on
 sys.o.TRST on
 sys.o.CFLUSH on

;-------------------------------------------------------------------------------
; Disassembler selection - Automatically selects correct one.
;-------------------------------------------------------------------------------
 sys.o.DisMode Auto

;-------------------------------------------------------------------------------
; select CPU type
;-------------------------------------------------------------------------------
 sys.CPU ARM926EJ
 sys.jtagclock RTCK

;-------------------------------------------------------------------------------
; restart CPU with debug mode
;-------------------------------------------------------------------------------
 sys.u

 &JtagSet="yes"


;============================================================================
; Set up the screen with only area window for reports 
; Variable set to "no" will not clear screen - for debug purposes
;============================================================================
 
if "&ClearWin"=="yes"  
  (  
     WinCLEAR
     WinPage.Reset
  )

 WINPOS 0. 0. 80. 20. 0. 0. W003
 area



;============================================================================
; don't proceed without user confirmation
;============================================================================
      
print "      "
print "      __        __               _             "
print "      \ \      / /_ _ _ __ _ __ (_)_ __   __ _ "
print "       \ \ /\ / / _` | '__| '_ \| | '_ \ / _` |"
print "        \ V  V / (_| | |  | | | | | | | | (_| |"
print "         \_/\_/ \__,_|_|  |_| |_|_|_| |_|\__, |"
print "                                         |___/ "
print " "
print
print
print
print " You are about to erase the entire flash"
print " "
print " "
print
print " Please enter YES to continue, any other value will abort::     "
  
&t32_cmm_stopped=1
enter &Choice
&t32_cmm_stopped=0
print
print
	 
if "&Choice"=="YES" 
  (  
    print "Erasing entire flash....."
    gosub SetupHardware
    gosub EraseChip
  )
else
  (
    print "Bailing out, correct answer not given" 
  )
  
enddo
 


;=====================================================
; --- Function to Erase entire chip
;=====================================================
EraseChip: 


    ;======================================================
    ; Load our flash programming routine and prepare flash
    ;======================================================
    d.load.elf "jflash.elf"
    ; need this breakpoint as per Lauterbach Spec so that we
    ; can hand back control to the Debugger
    break.delete /ALL
    break.set swbp 

	 ;--------------------------------------------------------
	 ; We have to set this command up by hand as it is one
	 ;  that we added to the flash.* protocol and JTAG does
	 ;  not know about it.
	 ;--------------------------------------------------------
	 ;
   if "&Verbose"=="yes"
   (
	   print "Erasing entire chip - will take several minutes"
	 )
   &Command="Erase Chip"
   data.set &ParmCmd  %LONG &EraseChipCmd
   data.set &ParmWidth %LONG &HardwarePresent 
   &CurrentCmd=&EraseChipCmd
	 
  ; set flash base address
	 data.set &ParmFlashaddr %LONG &JflashRomBegin
   
   r.s pc &StartAddr
   go

	 gosub check_status  ;; will not return if error 
	 
   if "&Verbose"=="yes"
   (
	   print "Entire Chip is Erased"                                             
   )
return


;=====================================================
; --- Function to check command status return
;       and exit if 0x100
;=====================================================
check_status:
	 wait !run()
	
	 &Result=data.long(A:&ParmStatus)
	 if &Result==0x100
	 (
	   print " " 
	   print "---- &Command failed"
	   &Result=data.long(A:&ParmReserved)
	   print "     Extended status is &Result"
	   print " "
	   print "EXITING due to failed command:: &Command"
	   end
	 )
	 else
	 (
     if &Result==&CurrentCmd
     (
       print "Command &Command failed - never completed"
     )
     else
     (
       if "&Verbose"=="yes"
       (
         print "+++++ &Command Succeeded"  
       )
     )
	 )
return



SetupHardware:
  ;============================================================================
  ; Set up a terminal window for JFLASH to print to - for debug purposes
  ;============================================================================

   
  if "&UseTerm"=="YES" 
    (  
    	;============================================================================
    	; Put up terminal window
    	;============================================================================
      term.close
      winclear MYTERM
      term.size 60 1000
      term.scroll on
      WinPOS 50% 0% 50% 100% ,, MYTERM
      term.view
      term.write term.out
  	 
      on error gosub
       (
         term.close
         print "terminal output closed"
         enddo
         return
       )
    )
  
  
  ;============================================================================
  ; Get variable data to use instead of hardcoded addresses for code and
  ; parameter block adresses and offsets
  ;============================================================================
   do jflash_param &JtagSet   ; Get MSM specific addresses
   
  ;============================================================================
  ; Init important MSM/ASB registers
  ;  use existing external script
  ;============================================================================
   do jf_msm_init
   
   do jf_addr_init   ; Get addresses built from MSM specific addresses
  
return


ENDDO



