;============================================================================
;  Name:
;    JF_MSM_INIT.CMM
;
;  Description:
;    Script to initialize the MSM for JFLASH program to run.  No h/w init
;    is done in JFLASH
;
;  Execution:
;    Called by jflash.cmm to init the MSM
;
;  Copyright (c) 2008 Qualcomm Incorporated. 
;  All Rights Reserved.
;  Qualcomm Confidential and Proprietary
;----------------------------------------------------------------------------
;============================================================================
;
;                        EDIT HISTORY FOR MODULE
;
; $Header: //depot/asic/qsc1100/tools/jflash/JFLASH.03.00/jf_msm_init.cmm#4 $ $DateTime: 2008/08/28 10:38:51 $ $Author: c_surven $
;
; when       who     what, where, why
; -------    ---     --------------------------------------------------------
; 08/06/08    sv      Added W18 NOR support
; 07/01/08    jz      Added Samsung NOR support
; 02/22/08    op      Pass partition mode to caller 
; 01/03/08    op      Initial version
;============================================================================;


; --------------------------------------------
; ---         Debugger System Setup        ---
; --------------------------------------------
; Turbo mode of debug state accesses - CPU makes no checks of
; memory access in debug mode.
System.Option TURBO off
; Usage of TRST in system - Must be off if reset tied to trst.
System.Option.TRST on
System.Option.CFLUSH on
System.Option.ResBreak on
System.Option.ENRESET on
System.Option.WAITRESET on
SYSTEM.CPU ARM926EJ
SYSTEM.OPTION BIGENDIAN OFF
SYSTEM.JtagClock RTCK

TRONCHIP.SET DABORT OFF 
TRONCHIP.SET PABORT OFF 
TRONCHIP.SET UNDEF OFF 

; Disable "Emulator berr error"
System.Option ShowError off

; Disassembler selection - Automatically selects correct one.
System.Option DisMode Auto

global &FlashManuId
gosub probeNorManuId    
entry &ManufacturerID
local &PartitionMode

&FlashManuId=&ManufacturerID
;print "Nor Manufucture ID" &ManufacturerID

; set partition mode 
&PartitionMode="no"

; Generate a reset
SYSTEM.DOWN
SYSTEM.UP

;------------------------------------------------------------
;  MSM configuration
;------------------------------------------------------------
; spansion or intel PSRAM

DO ../../build/ms/surf_init_clock_192MHz.cmm

enddo &PartitionMode

;------------------------------------------------------------
;  probeNorManuId
;  Read Nor device manufacturer ID 
;  Return device manufacturer ID to a calling function 
;------------------------------------------------------------
probeNorManuId:
local &ManufacturerID
local &DeviceID
area
sys.up

; First read device ID at address 0x0 
&ManufacturerID=0
&DeviceID=0
&norBaseAddr=0x00000000

; set to read array mode
data.set &norBaseAddr %word 0xF0
data.set &norBaseAddr %word 0xFF

; read device ID
data.set 0x00000AAA %word 0xAA
data.set 0x00000554 %word 0x55
data.set 0x00000AAA %word 0x90
&ManufacturerID=data.word(A:0x00000000)
&DeviceID=data.word(A:0x00000002)

; if not valid manufacturer ID
; then read device ID at address 0x38000000
if (&ManufacturerID!=0x1)&&(&ManufacturerID!=0x89)&&\
(&ManufacturerID!=0xEC)&&(&ManufacturerID!=0x20)&&(&ManufacturerID!=0x98)
(
	&norBaseAddr=0x38000000
	data.set &norBaseAddr %word 0xF0
	data.set &norBaseAddr %word 0xFF
	;Write the command sequence to place the device into Autoselect mode
	data.set 0x38000AAA %word 0xAA
	data.set 0x38000554 %word 0x55
	data.set 0x38000AAA %word 0x90
	&ManufacturerID=data.word(A:0x38000000)
)

;Write the command to reset the device to normal ROM mode 

print "Nor Manufacture ID " &ManufacturerID
print "Nor Device ID " &DeviceID

; check for valid manufacturer ID
if &ManufacturerID==0x1
(
	print "Nor Spansion " &ManufacturerID
	data.set &norBaseAddr %word 0xF0
)
else if &ManufacturerID==0xEC
(
	print "Nor Samsung " &ManufacturerID
	data.set &norBaseAddr %word 0xF0
)
else if (&ManufacturerID==0x89)||(&ManufacturerID==0x20)
(
	print "Nor Numonyx " &ManufacturerID
	data.set &norBaseAddr %word 0xFF
)
else if (&ManufacturerID==0x98)
(
	print "Nor Toshiba " &ManufacturerID
	data.set &norBaseAddr %word 0xF0
)
else
(
	print "Can not detect Nor Flash" &ManufacturerID
)

return &ManufacturerID ;probeNorManuId

