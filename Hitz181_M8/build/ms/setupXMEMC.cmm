;****************************************************************************
;**           SetupXMEMC.CMM                                               **
;**           This script sets up MSM6800 XMEMC on EBI1.                   **
;**                                                                        **
;**           Changes:                                                     **
;**           04-04-05   No longer place NOR flash in burst mode.          **
;**           03-31-05   Updated script to match MSM6800 configurations    **
;**           12-06-04   Ported to MSM6800                                 **
;**           10-21-04   Updated        for 16 and 32 PSRAM                **
;****************************************************************************

;  
; BEWARE that this script has different behavior based on the value in &HCLK_RATE
; -- timing values are calculated on the fly, based off HCLK_RATE


local &MemCardType
local &PSRAMSize
; the space ahead of the data.word is required -- T32 bug

 &MemCardType=data.word(RD:&FPGA_EBI1CardID)

IF &MemCardType==&FPGA_EBI1_16PSRAM 
(
  &PSRAMSize=16
)
ELSE IF &MemCardType==&FPGA_EBI1_16PSRAM16MB
( 
  &PSRAMSize=16
)
ELSE 
(
  &PSRAMSize=32
)

; 
; This initialization file supports the following EBI1 memory configuration:
; Chip-Select 0(CS0) - 16-bit Nor, WRAP8 bust mode
; Chip-Select 1(CS1) - 16-bit Micron PSRAM, continuous burst mode
;                                or
; Chip-Select 1(CS1) - 32-bit (2 x 16bit) Micron PSRAM, continuous burst mode
;
; EBI1_CFG initilization with command delay mode set to '1' provided in this .cmm file 
; has been tested up to PSRAM speeds of 73MHz (room temp, nominal test conditions). 
; Higher speeds may be possible by adjusting EBI1_CFG settings.
;


;--------------------------------------------------------------------------
; ARM clock controller registers
;--------------------------------------------------------------------------
; MICROPROCESSOR CLOCK CONFIGURATION
; After RESET, uP clock should default to TCXO/1. 
; Clocks are not initialized here since the default values should work
; properly. Turn all clocks on. 
d.set 80000000 %LONG 0	;MSM_CLK_HALTA
d.set 80000004 %LONG 0	;MSM_CLK_HALTB

;	set all the GPIOs

;-------------------------------------------------------------
; GPIO  ALT FUNCTION  for control signals
; ------------------------------------------------------------

IF &PSRAMSize==32
(
  DATA.SET &GPIO_PAGE %long 0x00000049  ;gpio73 - hlb_n for 32-bit
  DATA.SET &GPIO_CFG %long  0x00000008

  DATA.SET &GPIO_PAGE %long 0x0000004a  ;gpio74 - hub_n for 32-bit
  DATA.SET &GPIO_CFG %long  0x00000008       
)

DATA.SET &GPIO_PAGE %long 0x0000004C    ;GPIO76 -xmemc1_cs1
DATA.SET &GPIO_CFG %long  0x00000004

DATA.SET &GPIO_PAGE %long 0x0000004D    ;gpio77 - xmemc1_cs3
DATA.SET &GPIO_CFG %long  0x00000004

DATA.SET &GPIO_PAGE %long 0x0000004E    ;gpio78 - A(23)
DATA.SET &GPIO_CFG %long  0x00000004

DATA.SET &GPIO_PAGE %long 0x0000004F    ;gpio79 - a1(24)
DATA.SET &GPIO_CFG %long  0x00000004

DATA.SET &GPIO_PAGE %long 0x0000004b    ;gpio75 - A(25);
DATA.SET &GPIO_CFG %long  0x00000008

; Configure GPIO53 so that it shows bus speed.

; CLK_TEST
DATA.SET 0x80000150 %long 0x41
; GPIO53
DATA.SET 0x80004430 %long 0x35
DATA.SET 0x80004434 %long 0x04

;---------------------- Done GPIOs ----------------------------------------

;enable HALTB
DATA.SET &MSM_CLK_HALTB %long 0x0

D.OUT &PAD_HDRIVE_SEL_0 %LONG 0x00400	;set EBI1 ROM1 clock to high drive
D.OUT &GPIO_PAD_HDRIVE_SEL_2 %LONG 0x0	;set EBI1 addr/data/control signals to low drive

;-------------------------------------------------------------------------
; EBI registers - set to default value
;--------------------------------------------------------------------------
DATA.SET &EBI1_CS0_CFG0 %long 0x0033FC00   	; ebi1_cs0_cfg0
DATA.SET &EBI1_CS0_CFG1 %long 0x0000		; ebi1_cs0_cfg1
DATA.SET &EBI1_CS1_CFG0 %long 0x0033FC00    	; ebi1_cs1_cfg0
DATA.SET &EBI1_CS1_CFG1 %long 0x0000		; ebi1_cs1_cfg1

IF &PSRAMSize==32
  DATA.SET &EBI1_CS1_CFG1 %long 0x00071000  	; ebi1_cs1_cfg1, configure 32-bit data wide bus on CS1
                                            	; set bit[19:18] = 1 (avd_oe_recovery=1)
                                        	;     bit[17]    = 1 (addr_hold_en=1)
	                                        ;     bit[16]    = 1 (ENA_x32_interface =1)
        	                                ;     bit[12]    = 1 (AVD_PULSE_ENA=1)
;--------------------------------------------------------------------------

;disable the ROM1_CLK this ensures that the clock is turned off in a logic 0 state during the BCR write to the psram 
DATA.SET &EBI1_CFG %long 0x00040048	;set EBI1_CFG[22], ROM1_CLK_STATE=1
                                      	;set EBI1_CFG[10], PWRSAVE_HANDSHAKE_CTL=1 
                                      	;set EBI1_CFG[7] , PSRSAVE_CLK_DIS=1                    
;---------- ; Switch the Memory controller to XMEMC ------------
D.OUT &EBI1_MEM_CTLR_MODE %LONG 0x0	;only XMEMC will be used
;----------------- Done the memory controller switching --------


;--------------------------------- set AMD Flash in burst mode ----------------------------------------------
;d.set 0x00000AAA %word 0xaa
;d.set 0x00000554 %word 0x55
;d.set 0x00000AAA %word 0xd0
;d.set 0x00000000 %word 0x2ecb
;D.S SD:&EBI1_CS0_CFG0 %LE %LONG 0x01117300 ;cs0_cfg0
;D.S SD:&EBI1_CS0_CFG1 %LE %LONG 0x24   ;cs0_cfg1, wrap8 burst read
;-------------------------------------- done AMD flash -------------------------------------------------------

;EBI1_PSRAM_CRE, reset PSRAM CRE pin for synchronous Micron PSRAM
DATA.SET &EBI1_PSRAM_CRE %byte 0x01

;---------------------------------------- set BCR mode  -----------------------------------------------------------------
;configure 16-bit PSRAM on CS0 - BCR, shift one bit to left to match AHB address map(BCR A0 = AHB address A1)
;configure 32-bit PSRAM on CS1 - BCR, shift two bit to left to match AHB address map(BCR A0 = AHB address A2)
;Psram configure register     CS0x16     CS1x16   CS1x32
;        a20      reserved      0         0         0
;        a19       reg_sel      1         1         1   ;select bcr mode
;        a18:16   reserved      0         0         0
;        a15     oper_mode      0         0         0   ;set sync mode
;        a14      reserved      0         0         1   ;set '0' for x16 bus, set '1' for x32 bus(fixed initial-access latency)
;        a13:11    latency      3         3         3
;        a10      wait_pol      0         0         0   ;active low
;        a9       reserved      0         0         0
;        a8       wait_cfg      1         1         1   ;asserted one data cycle delay
;        a7       reserved      1         1         1   ;'1'- disable all asyn access
;        a6     clk_config      1         1         1   ;rising edge
;        a5       ouput_z0      0         0         0   ;full drive
;        a4       reserved      0         0         0
;        a3     burst_wrap      0         1         1   ;0-burst wraps within the burst length, 1-no wraps
;        a2:0 burst_length      3         7         7   ;7-continuous burst, 3-16 words, 2-8 words, 1-4 words

IF &PSRAMSize==32
 (
  ;d.s 0x0821673C %long 0x0  ; INCR mode on CS1x32, has to set bit[14]=1 in 32 bit mode for eagle
   d.s 0x0820673C %long 0x0  ; INCR mode on CS1x32, cofigure x32bit use vaiable latency,set bit[14]=0 in 32 bit mode
 )
ELSE
  d.s 0x0810339E %long 0x0  ; INCR mode on CS1x16
;---------------------------------------- done BCR mode  ----------------------------------------------------------------

;EBI1_PSRAM_CRE, reset PSRAM CRE pin for synchronous Micron PSRAM
DATA.SET &EBI1_PSRAM_CRE %byte 0x00

DATA.SET &EBI1_CFG %long 0x012C8CA0	    ;set EBI1_CFG[24],    CMD_DELAY_ENA=1
                                     	;set EBI1_CFG[22],    ROM1_CLK_STATE=1 
                                      	;set EBI1_CFG[21] ,   APP_LOCK_ENA=1
                                      	;set EBI1_CFG[19:14], FBCLK_PGM_DLY=0x34=52
                                      	;set EBI1_CFG[11],    FBCLK_SLEEP_OVERRIDE=1
                                      	;set EBI1_CFG[10] ,   PWRSAVE_HANDSHAKE_CTL=1
                                      	;set EBI1_CFG[7] ,    PWRDSBR_CLK_DIS=1
                                      	;set EBI1_CFG[5:0],   PGM_DLY_CTL=0x20=32 

;--------------------------------------------------------------------------
; EBI registers - set to burst mode
;--------------------------------------------------------------------------
;   EBI1_CSx_CFG0          CS0x16    CS1x16   CS1x32    
;   [30:28]page_size        0         6         7     ;3-16 hwords for 16-bit, 6-128 hwords for 16-bit, 7-128 hwords for 32-bit
;   [27:24]prech_cyc        1         1         1
;   [23:20]recovery         1         1         1
;   [19:16]hold_wait        1         1         1
;   [15:12]delta_wr         3         3         3
;   [11:8] delta_rd         3         3         3
;   [7:4 ] wait_wr          0         0         0
;   [3:0]  wait_rd          0         0         0
;+++++++++++++++++++++++++++++++++++++++++++++++++++++++
;   EBI1_CSx_CFG1          CS0x16    CS0x16   CS1x32    
;   [19:18]avd_oe_rec       0         0         1
;   [17]addr_hold_ena       0         0         1
;   [16]ena_x32_intfc       0         0         1
;   [14]incr_wr_mode        0         0         0
;   [13]we_timing           0         0         0
;   [12]avd_pulse_ena       0         0         1
;   [11:10]wr_prechg        0         0         0
;   [9:8]avd_recovery       0         0         0
;   [6]  write_prot         0         0         0
;   [5]  wrap8_mode         1         0         0  
;   [4]  avd_state          0         0         0
;   [3]  burst_wr_ena       1         1         1
;   [2]  burst_rd_ena       1         1         1
;   [1]  page_wr_ena        0         0         0
;   [0]  page_rd_ena        0         0         0

IF &PSRAMSize==32
(
  DATA.SET &EBI1_CS1_CFG0 %long 0x73113300    ; ebi1_cs1_cfg0, set precharge=2 to avoid micron memory bug
  DATA.SET &EBI1_CS1_CFG1 %long 0x7100C       ; ebi1_cs1_cfg1, incr mode
)
ELSE
(
  DATA.SET &EBI1_CS1_CFG0 %long 0x61113300    ; ebi1_cs1_cfg0
  DATA.SET &EBI1_CS1_CFG1 %long 0x0000c       ; ebi1_cs1_cfg1, incr mode  
)                                       
;---------------------------------------------------------------------------


;	Dummy Read is a must
DATA.IN 0x08000000 /long	;dummy read  


;----------------- Raise ARM speed to 146Mhz and 73Mhz for AHB BUS ----------
;Reset the PLL.
D.OUT &PLL1_MODE %LONG 0x2
;Configure the PLL for the new frequency. ARM:146Mhz
D.OUT &PLL1_L_VAL %LONG 0x8
D.OUT &PLL1_M_VAL %LONG 0xA1
D.OUT &PLL1_N_VAL %LONG 0xFA
D.OUT &PLL1_INTERNAL_1 %LONG 0x20010071
D.OUT &PLL1_INTERNAL_2 %LONG 0x01FF4920
D.OUT &PLL1_MODE %LONG 0x6
D.OUT 0x80000220,0x8000		;	PAUSE_TIMER
;Delay for 200ms 
wait 200.ms
D.OUT &PLL1_MODE %LONG 0x7

;-----------------------------------------------------------------------
; Set the memory bus clock divider before switching to the new frequency.
D.OUT &HCLK_DIV %LONG 0x2
D.OUT &IMEM_CFG %LONG 0x8

;Configure the CPU clock regime for the new frequency.
D.OUT &SWITCH_REF_CLK_SEL %LONG 0x5
D.OUT &MICRO_CLK_MD %LONG 0x0
D.OUT &MICRO_CLK_NS %LONG 0x5

;Switch the CPU clock source to the new frequency. 
D.OUT &SWITCH_CLK %LONG 0x1

enddo


