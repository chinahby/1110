do erasechip.cmm
cd ..\..\build\ms
do jf S5000
