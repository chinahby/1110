// T32 Fri Feb 08 13:22:39 2002

 B::
 
 TOOLBAR ON
 STATUSBAR ON
 

 WINPOS 89.625 125.0e-3 48. 24. 0. 0. W002
 register /spotlight
 
 WINPOS 0.0 32.625 87. 7. 0. 0. W003
 area
 
 WINPOS 89.75 27.0625 50. 11. 5. 0. W001
 Var.Frame /Locals /Caller
 
 WINPOS 0.0 0.0 87. 29. 13. 1. W000
 WINTABS 10. 10. 25. 62.
 data.list
 
 WINPAGE.SELECT P000     
 
 ENDDO
