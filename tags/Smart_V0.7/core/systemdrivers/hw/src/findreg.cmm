;============================================================================
;
;           M S M   R E G I S T E R  D E F I N I T I O N S
;
;                       *** AUTOGENERATED ***
;
; GENERAL DESCRIPTION
;   This script provides an easy way to find a peripheral register in Trace32.
;   It was generated with the following command options:
;   hwioreg.pl 
;     -f ARM_ADDRESS_FILE.FLAT 
;     -gen_parser 
;     -gen_per 
;     -cfg=msmreg.cfg 
;
; INITIALIZATION AND SEQUENCING REQUIREMENTS
;   Invoke this script, and enter the register you want to find.
;
;      Copyright (c) 2007 by QUALCOMM, Inc.  All Rights Reserved.
;============================================================================
ENTRY &choice

;-----------------------------------------------------------------------------
; Define the window
;-----------------------------------------------------------------------------

AREA.Create A000 80. 1000.
AREA.Select A000
AREA.View
winresize 80. 20.


;-----------------------------------------------------------------------------
; Run
;-----------------------------------------------------------------------------

Enter_Choice:

if "&choice"==""
(
  print " "
  print "Register (x to exit): "
  &t32_cmm_stopped=1
  &old_choice="&choice"
  enter &choice
  &t32_cmm_stopped=0
)

if "&choice"=="."
(
  &choice="&old_choice"
)

if "&choice"=="x"
(
  print "Exit"
  enddo
)
if "&choice"=="ADSP_RAMA_BASE"
(
  per.view hwioreg.per "ADSP,ADSP_RAMA_BASE"
)
if "&choice"=="ADSP_RAMB_BASE"
(
  per.view hwioreg.per "ADSP,ADSP_RAMB_BASE"
)
if "&choice"=="ADSP_RAMC_BASE"
(
  per.view hwioreg.per "ADSP,ADSP_RAMC_BASE"
)
if "&choice"=="ADSP_RAMI_BASE"
(
  per.view hwioreg.per "ADSP,ADSP_RAMI_BASE"
)
if "&choice"=="ADSP_CTL"
(
  per.view hwioreg.per "ADSP,ADSP_CTL"
)
if "&choice"=="ADSP_CLK_GATE_CTL"
(
  per.view hwioreg.per "ADSP,ADSP_CLK_GATE_CTL"
)
if "&choice"=="ADSP_CLK_STATUS"
(
  per.view hwioreg.per "ADSP,ADSP_CLK_STATUS"
)
if "&choice"=="ADSP_DBG_CTRL"
(
  per.view hwioreg.per "ADSP,ADSP_DBG_CTRL"
)
if "&choice"=="ADSP_PC_DBG"
(
  per.view hwioreg.per "ADSP,ADSP_PC_DBG"
)
if "&choice"=="ADSP_INT_MASK_DBG"
(
  per.view hwioreg.per "ADSP,ADSP_INT_MASK_DBG"
)
if "&choice"=="ADSP_INT_MASK2_DBG"
(
  per.view hwioreg.per "ADSP,ADSP_INT_MASK2_DBG"
)
if "&choice"=="ADSP_MEM_ACC_CTRL"
(
  per.view hwioreg.per "ADSP,ADSP_MEM_ACC_CTRL"
)
if "&choice"=="BOOT_ROM_CLOCK_ENABLE"
(
  per.view hwioreg.per "AHB,BOOT_ROM_CLOCK_ENABLE"
)
if "&choice"=="PAUSE_TIMER"
(
  per.view hwioreg.per "AHB,PAUSE_TIMER"
)
if "&choice"=="PAUSE_TIMER_CTL"
(
  per.view hwioreg.per "AHB,PAUSE_TIMER_CTL"
)
if "&choice"=="BPM_TRIGGER"
(
  per.view hwioreg.per "AHB,BPM_TRIGGER"
)
if "&choice"=="BPM_HSEL_SEL"
(
  per.view hwioreg.per "AHB,BPM_HSEL_SEL"
)
if "&choice"=="EBI1_CS0_CS1_SWAP"
(
  per.view hwioreg.per "AHB,EBI1_CS0_CS1_SWAP"
)
if "&choice"=="MSM_BRIDGE_CFG"
(
  per.view hwioreg.per "AHB,MSM_BRIDGE_CFG"
)
if "&choice"=="AHB_TEST_BUS_CTL"
(
  per.view hwioreg.per "AHB,AHB_TEST_BUS_CTL"
)
if "&choice"=="AHB_TEST_BUS"
(
  per.view hwioreg.per "AHB,AHB_TEST_BUS"
)
if "&choice"=="BOOT_FROM_ROM_STATUS"
(
  per.view hwioreg.per "AHB,BOOT_FROM_ROM_STATUS"
)
if "&choice"=="AHB_APP_BUS_PRIORITY"
(
  per.view hwioreg.per "AHB,AHB_APP_BUS_PRIORITY"
)
if "&choice"=="AHB_BUS_REQUEST"
(
  per.view hwioreg.per "AHB,AHB_BUS_REQUEST"
)
if "&choice"=="AHB_BUS_MASTERS"
(
  per.view hwioreg.per "AHB,AHB_BUS_MASTERS"
)
if "&choice"=="AHB_SYS_BUS_PRIORITY"
(
  per.view hwioreg.per "AHB,AHB_SYS_BUS_PRIORITY"
)
if "&choice"=="AHB_SYS_DUMMY0"
(
  per.view hwioreg.per "AHB,AHB_SYS_DUMMY0"
)
if "&choice"=="AHB_SYS_DUMMY1"
(
  per.view hwioreg.per "AHB,AHB_SYS_DUMMY1"
)
if "&choice"=="AHB_SYS_DUMMY2"
(
  per.view hwioreg.per "AHB,AHB_SYS_DUMMY2"
)
if "&choice"=="SYS_FINE_TABLE0"
(
  per.view hwioreg.per "AHB,SYS_FINE_TABLE0"
)
if "&choice"=="SYS_FINE_TABLE1"
(
  per.view hwioreg.per "AHB,SYS_FINE_TABLE1"
)
if "&choice"=="SYS_FINE_TABLE2"
(
  per.view hwioreg.per "AHB,SYS_FINE_TABLE2"
)
if "&choice"=="SYS_FINE_TABLE3"
(
  per.view hwioreg.per "AHB,SYS_FINE_TABLE3"
)
if "&choice"=="SYS_FINE_TABLE4"
(
  per.view hwioreg.per "AHB,SYS_FINE_TABLE4"
)
if "&choice"=="SYS_FINE_TABLE5"
(
  per.view hwioreg.per "AHB,SYS_FINE_TABLE5"
)
if "&choice"=="SYS_FINE_TABLE6"
(
  per.view hwioreg.per "AHB,SYS_FINE_TABLE6"
)
if "&choice"=="SYS_FINE_TABLE7"
(
  per.view hwioreg.per "AHB,SYS_FINE_TABLE7"
)
if "&choice"=="SYS_COARSE_TABLE0"
(
  per.view hwioreg.per "AHB,SYS_COARSE_TABLE0"
)
if "&choice"=="SYS_COARSE_TABLE1"
(
  per.view hwioreg.per "AHB,SYS_COARSE_TABLE1"
)
if "&choice"=="SYS_COARSE_TABLE2"
(
  per.view hwioreg.per "AHB,SYS_COARSE_TABLE2"
)
if "&choice"=="SYS_COARSE_TABLE3"
(
  per.view hwioreg.per "AHB,SYS_COARSE_TABLE3"
)
if "&choice"=="SYS_COARSE_TABLE4"
(
  per.view hwioreg.per "AHB,SYS_COARSE_TABLE4"
)
if "&choice"=="SYS_COARSE_TABLE5"
(
  per.view hwioreg.per "AHB,SYS_COARSE_TABLE5"
)
if "&choice"=="SYS_COARSE_TABLE6"
(
  per.view hwioreg.per "AHB,SYS_COARSE_TABLE6"
)
if "&choice"=="SYS_COARSE_TABLE7"
(
  per.view hwioreg.per "AHB,SYS_COARSE_TABLE7"
)
if "&choice"=="APP_FINE_TABLE0"
(
  per.view hwioreg.per "AHB,APP_FINE_TABLE0"
)
if "&choice"=="APP_FINE_TABLE1"
(
  per.view hwioreg.per "AHB,APP_FINE_TABLE1"
)
if "&choice"=="APP_FINE_TABLE2"
(
  per.view hwioreg.per "AHB,APP_FINE_TABLE2"
)
if "&choice"=="APP_FINE_TABLE3"
(
  per.view hwioreg.per "AHB,APP_FINE_TABLE3"
)
if "&choice"=="APP_FINE_TABLE4"
(
  per.view hwioreg.per "AHB,APP_FINE_TABLE4"
)
if "&choice"=="APP_FINE_TABLE5"
(
  per.view hwioreg.per "AHB,APP_FINE_TABLE5"
)
if "&choice"=="APP_FINE_TABLE6"
(
  per.view hwioreg.per "AHB,APP_FINE_TABLE6"
)
if "&choice"=="APP_FINE_TABLE7"
(
  per.view hwioreg.per "AHB,APP_FINE_TABLE7"
)
if "&choice"=="APP_COARSE_TABLE0"
(
  per.view hwioreg.per "AHB,APP_COARSE_TABLE0"
)
if "&choice"=="APP_COARSE_TABLE1"
(
  per.view hwioreg.per "AHB,APP_COARSE_TABLE1"
)
if "&choice"=="APP_COARSE_TABLE2"
(
  per.view hwioreg.per "AHB,APP_COARSE_TABLE2"
)
if "&choice"=="APP_COARSE_TABLE3"
(
  per.view hwioreg.per "AHB,APP_COARSE_TABLE3"
)
if "&choice"=="APP_COARSE_TABLE4"
(
  per.view hwioreg.per "AHB,APP_COARSE_TABLE4"
)
if "&choice"=="APP_COARSE_TABLE5"
(
  per.view hwioreg.per "AHB,APP_COARSE_TABLE5"
)
if "&choice"=="APP_COARSE_TABLE6"
(
  per.view hwioreg.per "AHB,APP_COARSE_TABLE6"
)
if "&choice"=="APP_COARSE_TABLE7"
(
  per.view hwioreg.per "AHB,APP_COARSE_TABLE7"
)
if "&choice"=="GT_SLOT_SIZE"
(
  per.view hwioreg.per "AHB,GT_SLOT_SIZE"
)
if "&choice"=="APP_MPU_ENABLE"
(
  per.view hwioreg.per "APP_MPU,APP_MPU_ENABLE"
)
if "&choice"=="APP_MPU_ERR_STATS"
(
  per.view hwioreg.per "APP_MPU,APP_MPU_ERR_STATS"
)
if "&choice"=="APP_MPU_DEF_PART_PERM0"
(
  per.view hwioreg.per "APP_MPU,APP_MPU_DEF_PART_PERM0"
)
if "&choice"=="APP_MPU_PART_START_ADDR0"
(
  per.view hwioreg.per "APP_MPU,APP_MPU_PART_START_ADDR0"
)
if "&choice"=="APP_MPU_PART_START_ADDR1"
(
  per.view hwioreg.per "APP_MPU,APP_MPU_PART_START_ADDR1"
)
if "&choice"=="APP_MPU_PART_START_ADDR2"
(
  per.view hwioreg.per "APP_MPU,APP_MPU_PART_START_ADDR2"
)
if "&choice"=="APP_MPU_PART_START_ADDR3"
(
  per.view hwioreg.per "APP_MPU,APP_MPU_PART_START_ADDR3"
)
if "&choice"=="APP_MPU_PART_END_ADDR0"
(
  per.view hwioreg.per "APP_MPU,APP_MPU_PART_END_ADDR0"
)
if "&choice"=="APP_MPU_PART_END_ADDR1"
(
  per.view hwioreg.per "APP_MPU,APP_MPU_PART_END_ADDR1"
)
if "&choice"=="APP_MPU_PART_END_ADDR2"
(
  per.view hwioreg.per "APP_MPU,APP_MPU_PART_END_ADDR2"
)
if "&choice"=="APP_MPU_PART_END_ADDR3"
(
  per.view hwioreg.per "APP_MPU,APP_MPU_PART_END_ADDR3"
)
if "&choice"=="APP_MPU_PART_PERM00"
(
  per.view hwioreg.per "APP_MPU,APP_MPU_PART_PERM00"
)
if "&choice"=="CHIP_ARM9_TEST_MEM_ADDR"
(
  per.view hwioreg.per "ARM9_MTI,CHIP_ARM9_TEST_MEM_ADDR"
)
if "&choice"=="CHIP_ARM9_TEST_MEM_WRITE"
(
  per.view hwioreg.per "ARM9_MTI,CHIP_ARM9_TEST_MEM_WRITE"
)
if "&choice"=="CHIP_ARM9_TEST_MEM_SEL"
(
  per.view hwioreg.per "ARM9_MTI,CHIP_ARM9_TEST_MEM_SEL"
)
if "&choice"=="CHIP_ARM9_TEST_MEM_READ0"
(
  per.view hwioreg.per "ARM9_MTI,CHIP_ARM9_TEST_MEM_READ0"
)
if "&choice"=="CHIP_ARM9_TEST_MEM_WRITE_NON_INCR"
(
  per.view hwioreg.per "ARM9_MTI,CHIP_ARM9_TEST_MEM_WRITE_NON_INCR"
)
if "&choice"=="CHIP_ARM9_TEST_MEM_READ0_NON_INCR"
(
  per.view hwioreg.per "ARM9_MTI,CHIP_ARM9_TEST_MEM_READ0_NON_INCR"
)
if "&choice"=="ARM9_11_MEM_ACC_CTRL"
(
  per.view hwioreg.per "ARM9_MTI,ARM9_11_MEM_ACC_CTRL"
)
if "&choice"=="AUX_CODEC_CTL"
(
  per.view hwioreg.per "AUDIO,AUX_CODEC_CTL"
)
if "&choice"=="PCM_PATH_CTL"
(
  per.view hwioreg.per "AUDIO,PCM_PATH_CTL"
)
if "&choice"=="AUX_CODEC_CTL_OUT"
(
  per.view hwioreg.per "AUDIO,AUX_CODEC_CTL_OUT"
)
if "&choice"=="WB_CODEC_TEST_CTL"
(
  per.view hwioreg.per "AUDIO,WB_CODEC_TEST_CTL"
)
if "&choice"=="WB_CODEC_FIFO_WR_REG"
(
  per.view hwioreg.per "AUDIO,WB_CODEC_FIFO_WR_REG"
)
if "&choice"=="WB_CODEC_FIFO_RD_REG"
(
  per.view hwioreg.per "AUDIO,WB_CODEC_FIFO_RD_REG"
)
if "&choice"=="WB_MISSED_ACKS_CNT"
(
  per.view hwioreg.per "AUDIO,WB_MISSED_ACKS_CNT"
)
if "&choice"=="WB_CODEC_CMD_REG"
(
  per.view hwioreg.per "AUDIO,WB_CODEC_CMD_REG"
)
if "&choice"=="WB_CODEC_SEL_ADSP"
(
  per.view hwioreg.per "AUDIO,WB_CODEC_SEL_ADSP"
)
if "&choice"=="BPM_CFG"
(
  per.view hwioreg.per "BPM,BPM_CFG"
)
if "&choice"=="BPM_CMD"
(
  per.view hwioreg.per "BPM,BPM_CMD"
)
if "&choice"=="BPM_MSTR_CFG"
(
  per.view hwioreg.per "BPM,BPM_MSTR_CFG"
)
if "&choice"=="BPM_TIMER"
(
  per.view hwioreg.per "BPM,BPM_TIMER"
)
if "&choice"=="BPM_CYC_CFG"
(
  per.view hwioreg.per "BPM,BPM_CYC_CFG"
)
if "&choice"=="BPM_CYC_OUT"
(
  per.view hwioreg.per "BPM,BPM_CYC_OUT"
)
if "&choice"=="BPM_C0_CFG0"
(
  per.view hwioreg.per "BPM,BPM_C0_CFG0"
)
if "&choice"=="BPM_C1_CFG0"
(
  per.view hwioreg.per "BPM,BPM_C1_CFG0"
)
if "&choice"=="BPM_C2_CFG0"
(
  per.view hwioreg.per "BPM,BPM_C2_CFG0"
)
if "&choice"=="BPM_C3_CFG0"
(
  per.view hwioreg.per "BPM,BPM_C3_CFG0"
)
if "&choice"=="BPM_C0_CFG1"
(
  per.view hwioreg.per "BPM,BPM_C0_CFG1"
)
if "&choice"=="BPM_C1_CFG1"
(
  per.view hwioreg.per "BPM,BPM_C1_CFG1"
)
if "&choice"=="BPM_C2_CFG1"
(
  per.view hwioreg.per "BPM,BPM_C2_CFG1"
)
if "&choice"=="BPM_C3_CFG1"
(
  per.view hwioreg.per "BPM,BPM_C3_CFG1"
)
if "&choice"=="BPM_C0_CFG2"
(
  per.view hwioreg.per "BPM,BPM_C0_CFG2"
)
if "&choice"=="BPM_C1_CFG2"
(
  per.view hwioreg.per "BPM,BPM_C1_CFG2"
)
if "&choice"=="BPM_C2_CFG2"
(
  per.view hwioreg.per "BPM,BPM_C2_CFG2"
)
if "&choice"=="BPM_C3_CFG2"
(
  per.view hwioreg.per "BPM,BPM_C3_CFG2"
)
if "&choice"=="BPM_C0_CFG3"
(
  per.view hwioreg.per "BPM,BPM_C0_CFG3"
)
if "&choice"=="BPM_C1_CFG3"
(
  per.view hwioreg.per "BPM,BPM_C1_CFG3"
)
if "&choice"=="BPM_C2_CFG3"
(
  per.view hwioreg.per "BPM,BPM_C2_CFG3"
)
if "&choice"=="BPM_C3_CFG3"
(
  per.view hwioreg.per "BPM,BPM_C3_CFG3"
)
if "&choice"=="BPM_C0_CFG4"
(
  per.view hwioreg.per "BPM,BPM_C0_CFG4"
)
if "&choice"=="BPM_C1_CFG4"
(
  per.view hwioreg.per "BPM,BPM_C1_CFG4"
)
if "&choice"=="BPM_C2_CFG4"
(
  per.view hwioreg.per "BPM,BPM_C2_CFG4"
)
if "&choice"=="BPM_C3_CFG4"
(
  per.view hwioreg.per "BPM,BPM_C3_CFG4"
)
if "&choice"=="BPM_C0_CFG5"
(
  per.view hwioreg.per "BPM,BPM_C0_CFG5"
)
if "&choice"=="BPM_C1_CFG5"
(
  per.view hwioreg.per "BPM,BPM_C1_CFG5"
)
if "&choice"=="BPM_C2_CFG5"
(
  per.view hwioreg.per "BPM,BPM_C2_CFG5"
)
if "&choice"=="BPM_C3_CFG5"
(
  per.view hwioreg.per "BPM,BPM_C3_CFG5"
)
if "&choice"=="BPM_C0_CFG6"
(
  per.view hwioreg.per "BPM,BPM_C0_CFG6"
)
if "&choice"=="BPM_C1_CFG6"
(
  per.view hwioreg.per "BPM,BPM_C1_CFG6"
)
if "&choice"=="BPM_C2_CFG6"
(
  per.view hwioreg.per "BPM,BPM_C2_CFG6"
)
if "&choice"=="BPM_C3_CFG6"
(
  per.view hwioreg.per "BPM,BPM_C3_CFG6"
)
if "&choice"=="BPM_C0_OUT"
(
  per.view hwioreg.per "BPM,BPM_C0_OUT"
)
if "&choice"=="BPM_C1_OUT"
(
  per.view hwioreg.per "BPM,BPM_C1_OUT"
)
if "&choice"=="BPM_C2_OUT"
(
  per.view hwioreg.per "BPM,BPM_C2_OUT"
)
if "&choice"=="BPM_C3_OUT"
(
  per.view hwioreg.per "BPM,BPM_C3_OUT"
)
if "&choice"=="BPM_DBG_CFG"
(
  per.view hwioreg.per "BPM,BPM_DBG_CFG"
)
if "&choice"=="CDMA_RTC_SYNC"
(
  per.view hwioreg.per "CDMA,CDMA_RTC,CDMA_RTC_SYNC"
)
if "&choice"=="RTC_CNT_1X"
(
  per.view hwioreg.per "CDMA,CDMA_RTC,RTC_CNT_1X"
)
if "&choice"=="RTC_SLEEP"
(
  per.view hwioreg.per "CDMA,CDMA_RTC,RTC_SLEEP"
)
if "&choice"=="RTC_OFFSET"
(
  per.view hwioreg.per "CDMA,CDMA_RTC,RTC_OFFSET"
)
if "&choice"=="RTC_LOAD"
(
  per.view hwioreg.per "CDMA,CDMA_RTC,RTC_LOAD"
)
if "&choice"=="RTC_CTL"
(
  per.view hwioreg.per "CDMA,CDMA_RTC,RTC_CTL"
)
if "&choice"=="RTC_GP_COMPARE1"
(
  per.view hwioreg.per "CDMA,CDMA_RTC,RTC_GP_COMPARE1"
)
if "&choice"=="RTC_GP_COMPARE2"
(
  per.view hwioreg.per "CDMA,CDMA_RTC,RTC_GP_COMPARE2"
)
if "&choice"=="RTC_DIFF_1XHDR"
(
  per.view hwioreg.per "CDMA,CDMA_RTC,RTC_DIFF_1XHDR"
)
if "&choice"=="RTC_INT_ENABLE"
(
  per.view hwioreg.per "CDMA,CDMA_RTC,RTC_INT_ENABLE"
)
if "&choice"=="RTC_INT_CLEAR"
(
  per.view hwioreg.per "CDMA,CDMA_RTC,RTC_INT_CLEAR"
)
if "&choice"=="RTC_INT_STATUS"
(
  per.view hwioreg.per "CDMA,CDMA_RTC,RTC_INT_STATUS"
)
if "&choice"=="RTC_INT_SELECT"
(
  per.view hwioreg.per "CDMA,CDMA_RTC,RTC_INT_SELECT"
)
if "&choice"=="RTC_TTRANS_CTL_1XHDR"
(
  per.view hwioreg.per "CDMA,CDMA_RTC,RTC_TTRANS_CTL_1XHDR"
)
if "&choice"=="RTC_DUMP_STATUS_1XHDR"
(
  per.view hwioreg.per "CDMA,CDMA_RTC,RTC_DUMP_STATUS_1XHDR"
)
if "&choice"=="RTC_TTRANS_TRIG_1X"
(
  per.view hwioreg.per "CDMA,CDMA_RTC,RTC_TTRANS_TRIG_1X"
)
if "&choice"=="RTC_TTRANS_TRIG_HDR"
(
  per.view hwioreg.per "CDMA,CDMA_RTC,RTC_TTRANS_TRIG_HDR"
)
if "&choice"=="RTC_DUMP_1X"
(
  per.view hwioreg.per "CDMA,CDMA_RTC,RTC_DUMP_1X"
)
if "&choice"=="RTC_DUMP_HDR"
(
  per.view hwioreg.per "CDMA,CDMA_RTC,RTC_DUMP_HDR"
)
if "&choice"=="CDMA_SAMPSRV_0_CTL"
(
  per.view hwioreg.per "CDMA,CDMA_SAMPSRV,CDMA_SAMPSRV_0_CTL"
)
if "&choice"=="CDMA_SAMPSRV_1_CTL"
(
  per.view hwioreg.per "CDMA,CDMA_SAMPSRV,CDMA_SAMPSRV_1_CTL"
)
if "&choice"=="CDMA_SAMPSRV_0_MODE"
(
  per.view hwioreg.per "CDMA,CDMA_SAMPSRV,CDMA_SAMPSRV_0_MODE"
)
if "&choice"=="CDMA_SAMPSRV_1_MODE"
(
  per.view hwioreg.per "CDMA,CDMA_SAMPSRV,CDMA_SAMPSRV_1_MODE"
)
if "&choice"=="CDMA_SAMPSRV_TEST_RAM_WE_CTL"
(
  per.view hwioreg.per "CDMA,CDMA_SAMPSRV,CDMA_SAMPSRV_TEST_RAM_WE_CTL"
)
if "&choice"=="CDMA_SAMPSRV_TEST_RAM_ADDR"
(
  per.view hwioreg.per "CDMA,CDMA_SAMPSRV,CDMA_SAMPSRV_TEST_RAM_ADDR"
)
if "&choice"=="CDMA_SAMPSRV_TEST_RAM_DATA"
(
  per.view hwioreg.per "CDMA,CDMA_SAMPSRV,CDMA_SAMPSRV_TEST_RAM_DATA"
)
if "&choice"=="CDMA_SAMPSRV_0_LATEST_RTC"
(
  per.view hwioreg.per "CDMA,CDMA_SAMPSRV,CDMA_SAMPSRV_0_LATEST_RTC"
)
if "&choice"=="CDMA_SAMPSRV_1_LATEST_RTC"
(
  per.view hwioreg.per "CDMA,CDMA_SAMPSRV,CDMA_SAMPSRV_1_LATEST_RTC"
)
if "&choice"=="CDMA_PNSRV_ROM_BIST_MODE"
(
  per.view hwioreg.per "CDMA,CDMA_SAMPSRV,CDMA_PNSRV_ROM_BIST_MODE"
)
if "&choice"=="CDMA_PNSRV_ROM_BIST_STATUS"
(
  per.view hwioreg.per "CDMA,CDMA_SAMPSRV,CDMA_PNSRV_ROM_BIST_STATUS"
)
if "&choice"=="CDMA_PNSRV_TEST_MODE"
(
  per.view hwioreg.per "CDMA,CDMA_SAMPSRV,CDMA_PNSRV_TEST_MODE"
)
if "&choice"=="CDMA_PNSRV_TEST_EXPORT_MISR"
(
  per.view hwioreg.per "CDMA,CDMA_SAMPSRV,CDMA_PNSRV_TEST_EXPORT_MISR"
)
if "&choice"=="CDMA_PNSRV_TEST_MISR_CURR_VAL"
(
  per.view hwioreg.per "CDMA,CDMA_SAMPSRV,CDMA_PNSRV_TEST_MISR_CURR_VAL"
)
if "&choice"=="CDMA_SAMPSRV_CLK_DISABLE"
(
  per.view hwioreg.per "CDMA,CDMA_SAMPSRV,CDMA_SAMPSRV_CLK_DISABLE"
)
if "&choice"=="CDMA_SAMPSRV_CLK_STATUS"
(
  per.view hwioreg.per "CDMA,CDMA_SAMPSRV,CDMA_SAMPSRV_CLK_STATUS"
)
if "&choice"=="CDMA_SAMPSRV_CTL_SEL"
(
  per.view hwioreg.per "CDMA,CDMA_SAMPSRV,CDMA_SAMPSRV_CTL_SEL"
)
if "&choice"=="MOD_MODE"
(
  per.view hwioreg.per "CDMA,CDMA_TX,MOD_MODE"
)
if "&choice"=="I_PN_STATE_0"
(
  per.view hwioreg.per "CDMA,CDMA_TX,I_PN_STATE_0"
)
if "&choice"=="I_PN_STATE_1"
(
  per.view hwioreg.per "CDMA,CDMA_TX,I_PN_STATE_1"
)
if "&choice"=="Q_PN_STATE_0"
(
  per.view hwioreg.per "CDMA,CDMA_TX,Q_PN_STATE_0"
)
if "&choice"=="Q_PN_STATE_1"
(
  per.view hwioreg.per "CDMA,CDMA_TX,Q_PN_STATE_1"
)
if "&choice"=="U_PN_STATE_0"
(
  per.view hwioreg.per "CDMA,CDMA_TX,U_PN_STATE_0"
)
if "&choice"=="U_PN_STATE_1"
(
  per.view hwioreg.per "CDMA,CDMA_TX,U_PN_STATE_1"
)
if "&choice"=="U_PN_STATE_2"
(
  per.view hwioreg.per "CDMA,CDMA_TX,U_PN_STATE_2"
)
if "&choice"=="U_PN_STATE_3"
(
  per.view hwioreg.per "CDMA,CDMA_TX,U_PN_STATE_3"
)
if "&choice"=="U_PN_STATE_4"
(
  per.view hwioreg.per "CDMA,CDMA_TX,U_PN_STATE_4"
)
if "&choice"=="U_PN_STATE_5"
(
  per.view hwioreg.per "CDMA,CDMA_TX,U_PN_STATE_5"
)
if "&choice"=="U_PN_MASK_0"
(
  per.view hwioreg.per "CDMA,CDMA_TX,U_PN_MASK_0"
)
if "&choice"=="U_PN_MASK_1"
(
  per.view hwioreg.per "CDMA,CDMA_TX,U_PN_MASK_1"
)
if "&choice"=="U_PN_MASK_2"
(
  per.view hwioreg.per "CDMA,CDMA_TX,U_PN_MASK_2"
)
if "&choice"=="U_PN_MASK_3"
(
  per.view hwioreg.per "CDMA,CDMA_TX,U_PN_MASK_3"
)
if "&choice"=="U_PN_MASK_4"
(
  per.view hwioreg.per "CDMA,CDMA_TX,U_PN_MASK_4"
)
if "&choice"=="U_PN_MASK_5"
(
  per.view hwioreg.per "CDMA,CDMA_TX,U_PN_MASK_5"
)
if "&choice"=="FRAME_OFF"
(
  per.view hwioreg.per "CDMA,CDMA_TX,FRAME_OFF"
)
if "&choice"=="MOD_STMR_MODIFIER_0"
(
  per.view hwioreg.per "CDMA,CDMA_TX,MOD_STMR_MODIFIER_0"
)
if "&choice"=="MOD_STMR_MODIFIER_1"
(
  per.view hwioreg.per "CDMA,CDMA_TX,MOD_STMR_MODIFIER_1"
)
if "&choice"=="TX_PCG_INT_ENABLE"
(
  per.view hwioreg.per "CDMA,CDMA_TX,TX_PCG_INT_ENABLE"
)
if "&choice"=="TX_PCG_INT_STATUS"
(
  per.view hwioreg.per "CDMA,CDMA_TX,TX_PCG_INT_STATUS"
)
if "&choice"=="MOD_TX_TIME_RD"
(
  per.view hwioreg.per "CDMA,CDMA_TX,MOD_TX_TIME_RD"
)
if "&choice"=="MOD_CH1_TIMING_CTL"
(
  per.view hwioreg.per "CDMA,CDMA_TX,MOD_CH1_TIMING_CTL"
)
if "&choice"=="MOD_CH2_TIMING_CTL"
(
  per.view hwioreg.per "CDMA,CDMA_TX,MOD_CH2_TIMING_CTL"
)
if "&choice"=="MOD_CH3_TIMING_CTL"
(
  per.view hwioreg.per "CDMA,CDMA_TX,MOD_CH3_TIMING_CTL"
)
if "&choice"=="MOD_WCOVER_SEL"
(
  per.view hwioreg.per "CDMA,CDMA_TX,MOD_WCOVER_SEL"
)
if "&choice"=="MOD_CH1_ENC_CTL"
(
  per.view hwioreg.per "CDMA,CDMA_TX,MOD_CH1_ENC_CTL"
)
if "&choice"=="MOD_CH1_CRC_POLY"
(
  per.view hwioreg.per "CDMA,CDMA_TX,MOD_CH1_CRC_POLY"
)
if "&choice"=="MOD_CH1_PUNCT_PATN_1"
(
  per.view hwioreg.per "CDMA,CDMA_TX,MOD_CH1_PUNCT_PATN_1"
)
if "&choice"=="MOD_CH1_PUNCT_PATN_0"
(
  per.view hwioreg.per "CDMA,CDMA_TX,MOD_CH1_PUNCT_PATN_0"
)
if "&choice"=="MOD_CH2_ENC_CTL_0"
(
  per.view hwioreg.per "CDMA,CDMA_TX,MOD_CH2_ENC_CTL_0"
)
if "&choice"=="MOD_CH2_ENC_CTL_1"
(
  per.view hwioreg.per "CDMA,CDMA_TX,MOD_CH2_ENC_CTL_1"
)
if "&choice"=="MOD_CH2_CRC_POLY"
(
  per.view hwioreg.per "CDMA,CDMA_TX,MOD_CH2_CRC_POLY"
)
if "&choice"=="MOD_CH2_PUNCT_PATN_1"
(
  per.view hwioreg.per "CDMA,CDMA_TX,MOD_CH2_PUNCT_PATN_1"
)
if "&choice"=="MOD_CH2_PUNCT_PATN_0"
(
  per.view hwioreg.per "CDMA,CDMA_TX,MOD_CH2_PUNCT_PATN_0"
)
if "&choice"=="MOD_CH3_ENC_CTL_0"
(
  per.view hwioreg.per "CDMA,CDMA_TX,MOD_CH3_ENC_CTL_0"
)
if "&choice"=="MOD_CH3_ENC_CTL_1"
(
  per.view hwioreg.per "CDMA,CDMA_TX,MOD_CH3_ENC_CTL_1"
)
if "&choice"=="MOD_CH3_CRC_POLY"
(
  per.view hwioreg.per "CDMA,CDMA_TX,MOD_CH3_CRC_POLY"
)
if "&choice"=="MOD_CH3_PUNCT_PATN_1"
(
  per.view hwioreg.per "CDMA,CDMA_TX,MOD_CH3_PUNCT_PATN_1"
)
if "&choice"=="MOD_CH3_PUNCT_PATN_0"
(
  per.view hwioreg.per "CDMA,CDMA_TX,MOD_CH3_PUNCT_PATN_0"
)
if "&choice"=="MOD_SCH_LTU_CTL"
(
  per.view hwioreg.per "CDMA,CDMA_TX,MOD_SCH_LTU_CTL"
)
if "&choice"=="MOD_MISC_CTL"
(
  per.view hwioreg.per "CDMA,CDMA_TX,MOD_MISC_CTL"
)
if "&choice"=="MOD_ROTATOR_MAP"
(
  per.view hwioreg.per "CDMA,CDMA_TX,MOD_ROTATOR_MAP"
)
if "&choice"=="MOD_WSYM_STATE"
(
  per.view hwioreg.per "CDMA,CDMA_TX,MOD_WSYM_STATE"
)
if "&choice"=="TX_VERY_EARLY_FRAME_CTL"
(
  per.view hwioreg.per "CDMA,CDMA_TX,TX_VERY_EARLY_FRAME_CTL"
)
if "&choice"=="TX_2_EARLY_PCG_CTL"
(
  per.view hwioreg.per "CDMA,CDMA_TX,TX_2_EARLY_PCG_CTL"
)
if "&choice"=="MOD_PICH_PCBIT_DATA"
(
  per.view hwioreg.per "CDMA,CDMA_TX,MOD_PICH_PCBIT_DATA"
)
if "&choice"=="MOD_PICH_PCBIT_MASK"
(
  per.view hwioreg.per "CDMA,CDMA_TX,MOD_PICH_PCBIT_MASK"
)
if "&choice"=="MOD_STATUS"
(
  per.view hwioreg.per "CDMA,CDMA_TX,MOD_STATUS"
)
if "&choice"=="MASK_DATA"
(
  per.view hwioreg.per "CDMA,CDMA_TX,MASK_DATA"
)
if "&choice"=="PA_PUNCT_FRAME_DIS"
(
  per.view hwioreg.per "CDMA,CDMA_TX,PA_PUNCT_FRAME_DIS"
)
if "&choice"=="PA_WARMUP"
(
  per.view hwioreg.per "CDMA,CDMA_TX,PA_WARMUP"
)
if "&choice"=="TX_WARMUP"
(
  per.view hwioreg.per "CDMA,CDMA_TX,TX_WARMUP"
)
if "&choice"=="MOD_TEST_CTL"
(
  per.view hwioreg.per "CDMA,CDMA_TX,MOD_TEST_CTL"
)
if "&choice"=="TX_I_CLK"
(
  per.view hwioreg.per "CDMA,CDMA_TX,TX_I_CLK"
)
if "&choice"=="MOD_CLK_CTL"
(
  per.view hwioreg.per "CDMA,CDMA_TX,MOD_CLK_CTL"
)
if "&choice"=="TX_DATA_TEST"
(
  per.view hwioreg.per "CDMA,CDMA_TX,TX_DATA_TEST"
)
if "&choice"=="TX_Q_DATA_TEST"
(
  per.view hwioreg.per "CDMA,CDMA_TX,TX_Q_DATA_TEST"
)
if "&choice"=="MOD_TEST_POINT_SEL"
(
  per.view hwioreg.per "CDMA,CDMA_TX,MOD_TEST_POINT_SEL"
)
if "&choice"=="MOD_TEST_MODE"
(
  per.view hwioreg.per "CDMA,CDMA_TX,MOD_TEST_MODE"
)
if "&choice"=="MOD_TEST_EXPORT_MISR"
(
  per.view hwioreg.per "CDMA,CDMA_TX,MOD_TEST_EXPORT_MISR"
)
if "&choice"=="MOD_TEST_MISR_EN"
(
  per.view hwioreg.per "CDMA,CDMA_TX,MOD_TEST_MISR_EN"
)
if "&choice"=="MOD_TEST_MISR_CTL"
(
  per.view hwioreg.per "CDMA,CDMA_TX,MOD_TEST_MISR_CTL"
)
if "&choice"=="MOD_TEST_MISR_DLY"
(
  per.view hwioreg.per "CDMA,CDMA_TX,MOD_TEST_MISR_DLY"
)
if "&choice"=="MOD_TEST_CURR_MISR_VAL"
(
  per.view hwioreg.per "CDMA,CDMA_TX,MOD_TEST_CURR_MISR_VAL"
)
if "&choice"=="MOD_PDCH_TIMING_CTL"
(
  per.view hwioreg.per "CDMA,CDMA_TX,MOD_PDCH_TIMING_CTL"
)
if "&choice"=="MOD_PDCH_CTL"
(
  per.view hwioreg.per "CDMA,CDMA_TX,MOD_PDCH_CTL"
)
if "&choice"=="MOD_PDCCH_CTL"
(
  per.view hwioreg.per "CDMA,CDMA_TX,MOD_PDCCH_CTL"
)
if "&choice"=="MOD_SPICH_CTL"
(
  per.view hwioreg.per "CDMA,CDMA_TX,MOD_SPICH_CTL"
)
if "&choice"=="MOD_VAR_GAIN_SHIFT_DLY"
(
  per.view hwioreg.per "CDMA,CDMA_TX,MOD_VAR_GAIN_SHIFT_DLY"
)
if "&choice"=="REVMOD_PN_LONG_STATE_0"
(
  per.view hwioreg.per "CDMA,CDMA_TX,REVMOD_PN_LONG_STATE_0"
)
if "&choice"=="REVMOD_PN_I_LONG_MASK_0"
(
  per.view hwioreg.per "CDMA,CDMA_TX,REVMOD_PN_I_LONG_MASK_0"
)
if "&choice"=="REVMOD_PN_I_LONG_MASK_1"
(
  per.view hwioreg.per "CDMA,CDMA_TX,REVMOD_PN_I_LONG_MASK_1"
)
if "&choice"=="REVMOD_PN_I_LONG_MASK_2"
(
  per.view hwioreg.per "CDMA,CDMA_TX,REVMOD_PN_I_LONG_MASK_2"
)
if "&choice"=="REVMOD_PN_Q_LONG_MASK_0"
(
  per.view hwioreg.per "CDMA,CDMA_TX,REVMOD_PN_Q_LONG_MASK_0"
)
if "&choice"=="REVMOD_PN_Q_LONG_MASK_1"
(
  per.view hwioreg.per "CDMA,CDMA_TX,REVMOD_PN_Q_LONG_MASK_1"
)
if "&choice"=="REVMOD_PN_Q_LONG_MASK_2"
(
  per.view hwioreg.per "CDMA,CDMA_TX,REVMOD_PN_Q_LONG_MASK_2"
)
if "&choice"=="REVMOD_PN_CTL"
(
  per.view hwioreg.per "CDMA,CDMA_TX,REVMOD_PN_CTL"
)
if "&choice"=="REVMOD_FRAME_OFFSET"
(
  per.view hwioreg.per "CDMA,CDMA_TX,REVMOD_FRAME_OFFSET"
)
if "&choice"=="REVMOD_TIME_STAMP_CTL"
(
  per.view hwioreg.per "CDMA,CDMA_TX,REVMOD_TIME_STAMP_CTL"
)
if "&choice"=="REVMOD_TIME_STAMP"
(
  per.view hwioreg.per "CDMA,CDMA_TX,REVMOD_TIME_STAMP"
)
if "&choice"=="REVMOD_TIME_STAMP2"
(
  per.view hwioreg.per "CDMA,CDMA_TX,REVMOD_TIME_STAMP2"
)
if "&choice"=="REVMOD_FRM_CNT_OFFSET"
(
  per.view hwioreg.per "CDMA,CDMA_TX,REVMOD_FRM_CNT_OFFSET"
)
if "&choice"=="REVMOD_FRM_CNT_OFFSET_CTL"
(
  per.view hwioreg.per "CDMA,CDMA_TX,REVMOD_FRM_CNT_OFFSET_CTL"
)
if "&choice"=="REVMOD_TX_TIME_RD"
(
  per.view hwioreg.per "CDMA,CDMA_TX,REVMOD_TX_TIME_RD"
)
if "&choice"=="REVMOD_FRAME_INT_OFFSET"
(
  per.view hwioreg.per "CDMA,CDMA_TX,REVMOD_FRAME_INT_OFFSET"
)
if "&choice"=="REVMOD_ENC_RATE"
(
  per.view hwioreg.per "CDMA,CDMA_TX,REVMOD_ENC_RATE"
)
if "&choice"=="REVMOD_EDI_CONTROL"
(
  per.view hwioreg.per "CDMA,CDMA_TX,REVMOD_EDI_CONTROL"
)
if "&choice"=="REVMOD_TENC_CTL"
(
  per.view hwioreg.per "CDMA,CDMA_TX,REVMOD_TENC_CTL"
)
if "&choice"=="REVMOD_TENC_STATUS"
(
  per.view hwioreg.per "CDMA,CDMA_TX,REVMOD_TENC_STATUS"
)
if "&choice"=="REVMOD_INBUF_STATUS"
(
  per.view hwioreg.per "CDMA,CDMA_TX,REVMOD_INBUF_STATUS"
)
if "&choice"=="REVMOD_OUTBUF_STATUS"
(
  per.view hwioreg.per "CDMA,CDMA_TX,REVMOD_OUTBUF_STATUS"
)
if "&choice"=="REVMOD_RRI_REQUEST"
(
  per.view hwioreg.per "CDMA,CDMA_TX,REVMOD_RRI_REQUEST"
)
if "&choice"=="REVMOD_MOD_CTL"
(
  per.view hwioreg.per "CDMA,CDMA_TX,REVMOD_MOD_CTL"
)
if "&choice"=="REVMOD_ENC_MODE"
(
  per.view hwioreg.per "CDMA,CDMA_TX,REVMOD_ENC_MODE"
)
if "&choice"=="REVMOD_PA_CTL"
(
  per.view hwioreg.per "CDMA,CDMA_TX,REVMOD_PA_CTL"
)
if "&choice"=="REVMOD_PA_WARMUP"
(
  per.view hwioreg.per "CDMA,CDMA_TX,REVMOD_PA_WARMUP"
)
if "&choice"=="REVMOD_TX_WARMUP"
(
  per.view hwioreg.per "CDMA,CDMA_TX,REVMOD_TX_WARMUP"
)
if "&choice"=="TX_AGC_CTL"
(
  per.view hwioreg.per "CDMA,CDMA_TX,TX_AGC_CTL"
)
if "&choice"=="TX_AGC_CTL2"
(
  per.view hwioreg.per "CDMA,CDMA_TX,TX_AGC_CTL2"
)
if "&choice"=="AGC_TEST_CTL"
(
  per.view hwioreg.per "CDMA,CDMA_TX,AGC_TEST_CTL"
)
if "&choice"=="AGC_TX_MASK_DATA_SEL"
(
  per.view hwioreg.per "CDMA,CDMA_TX,AGC_TX_MASK_DATA_SEL"
)
if "&choice"=="AGC_TX_RCCCH_FRAME_DELAY"
(
  per.view hwioreg.per "CDMA,CDMA_TX,AGC_TX_RCCCH_FRAME_DELAY"
)
if "&choice"=="PA_R_MAP"
(
  per.view hwioreg.per "CDMA,CDMA_TX,PA_R_MAP"
)
if "&choice"=="PA_R_TIMER"
(
  per.view hwioreg.per "CDMA,CDMA_TX,PA_R_TIMER"
)
if "&choice"=="PA_R1_FALL"
(
  per.view hwioreg.per "CDMA,CDMA_TX,PA_R1_FALL"
)
if "&choice"=="PA_R1_RISE"
(
  per.view hwioreg.per "CDMA,CDMA_TX,PA_R1_RISE"
)
if "&choice"=="PA_R2_FALL"
(
  per.view hwioreg.per "CDMA,CDMA_TX,PA_R2_FALL"
)
if "&choice"=="PA_R2_RISE"
(
  per.view hwioreg.per "CDMA,CDMA_TX,PA_R2_RISE"
)
if "&choice"=="PA_R3_FALL"
(
  per.view hwioreg.per "CDMA,CDMA_TX,PA_R3_FALL"
)
if "&choice"=="PA_R3_RISE"
(
  per.view hwioreg.per "CDMA,CDMA_TX,PA_R3_RISE"
)
if "&choice"=="PA_S0_OFFSET"
(
  per.view hwioreg.per "CDMA,CDMA_TX,PA_S0_OFFSET"
)
if "&choice"=="PA_S1_OFFSET"
(
  per.view hwioreg.per "CDMA,CDMA_TX,PA_S1_OFFSET"
)
if "&choice"=="PA_S2_OFFSET"
(
  per.view hwioreg.per "CDMA,CDMA_TX,PA_S2_OFFSET"
)
if "&choice"=="PA_S3_OFFSET"
(
  per.view hwioreg.per "CDMA,CDMA_TX,PA_S3_OFFSET"
)
if "&choice"=="PA_WARMUP_TIMER"
(
  per.view hwioreg.per "CDMA,CDMA_TX,PA_WARMUP_TIMER"
)
if "&choice"=="RAS_RAM_DATA"
(
  per.view hwioreg.per "CDMA,CDMA_TX,RAS_RAM_DATA"
)
if "&choice"=="SUBPCG_PA_WARMUP_DELAY"
(
  per.view hwioreg.per "CDMA,CDMA_TX,SUBPCG_PA_WARMUP_DELAY"
)
if "&choice"=="TX_ALIGN_DELAY"
(
  per.view hwioreg.per "CDMA,CDMA_TX,TX_ALIGN_DELAY"
)
if "&choice"=="TX_ATTEN_LIMIT_WR"
(
  per.view hwioreg.per "CDMA,CDMA_TX,TX_ATTEN_LIMIT_WR"
)
if "&choice"=="TX_GAIN_ADJ_WR"
(
  per.view hwioreg.per "CDMA,CDMA_TX,TX_GAIN_ADJ_WR"
)
if "&choice"=="TX_GAIN_LIMIT_WR"
(
  per.view hwioreg.per "CDMA,CDMA_TX,TX_GAIN_LIMIT_WR"
)
if "&choice"=="TX_OPEN_LOOP_WR"
(
  per.view hwioreg.per "CDMA,CDMA_TX,TX_OPEN_LOOP_WR"
)
if "&choice"=="TX_PDM_DELAY_VAL"
(
  per.view hwioreg.per "CDMA,CDMA_TX,TX_PDM_DELAY_VAL"
)
if "&choice"=="VERY_EARLY_FRAME_DELAY_REG"
(
  per.view hwioreg.per "CDMA,CDMA_TX,VERY_EARLY_FRAME_DELAY_REG"
)
if "&choice"=="TX_AGC_TEST_POINT_SEL"
(
  per.view hwioreg.per "CDMA,CDMA_TX,TX_AGC_TEST_POINT_SEL"
)
if "&choice"=="TX_PA_RD"
(
  per.view hwioreg.per "CDMA,CDMA_TX,TX_PA_RD"
)
if "&choice"=="RATCHET_BIT_DIS"
(
  per.view hwioreg.per "CDMA,CDMA_TX,RATCHET_BIT_DIS"
)
if "&choice"=="TX_AGC_ADJ_RD"
(
  per.view hwioreg.per "CDMA,CDMA_TX,TX_AGC_ADJ_RD"
)
if "&choice"=="TX_GAIN_ADJ_RD"
(
  per.view hwioreg.per "CDMA,CDMA_TX,TX_GAIN_ADJ_RD"
)
if "&choice"=="TX_GAIN_CTL_RD"
(
  per.view hwioreg.per "CDMA,CDMA_TX,TX_GAIN_CTL_RD"
)
if "&choice"=="TX_OPEN_LOOP_RD"
(
  per.view hwioreg.per "CDMA,CDMA_TX,TX_OPEN_LOOP_RD"
)
if "&choice"=="MOD_PA_ON_CTL"
(
  per.view hwioreg.per "CDMA,CDMA_TX,MOD_PA_ON_CTL"
)
if "&choice"=="MOD_TX_AGC_ADJ_CTL"
(
  per.view hwioreg.per "CDMA,CDMA_TX,MOD_TX_AGC_ADJ_CTL"
)
if "&choice"=="MOD_TX_AGC_ADJ"
(
  per.view hwioreg.per "CDMA,CDMA_TX,MOD_TX_AGC_ADJ"
)
if "&choice"=="MOD_TX_AGC_ODRIVE_DLY"
(
  per.view hwioreg.per "CDMA,CDMA_TX,MOD_TX_AGC_ODRIVE_DLY"
)
if "&choice"=="MOD_HW_CLK_CTL"
(
  per.view hwioreg.per "CDMA,CDMA_TX,MOD_HW_CLK_CTL"
)
if "&choice"=="MOD_MICRO_CLK_CTL"
(
  per.view hwioreg.per "CDMA,CDMA_TX,MOD_MICRO_CLK_CTL"
)
if "&choice"=="MOD_CLK_STATUS"
(
  per.view hwioreg.per "CDMA,CDMA_TX,MOD_CLK_STATUS"
)
if "&choice"=="MOD_TX_SLOT_INT_STATUS"
(
  per.view hwioreg.per "CDMA,CDMA_TX,MOD_TX_SLOT_INT_STATUS"
)
if "&choice"=="MOD_TX_SLOT_INT_EN"
(
  per.view hwioreg.per "CDMA,CDMA_TX,MOD_TX_SLOT_INT_EN"
)
if "&choice"=="MOD_TX_FR_INT_STATUS"
(
  per.view hwioreg.per "CDMA,CDMA_TX,MOD_TX_FR_INT_STATUS"
)
if "&choice"=="MOD_TX_FR_INT_EN"
(
  per.view hwioreg.per "CDMA,CDMA_TX,MOD_TX_FR_INT_EN"
)
if "&choice"=="MOD_TXCX8_SPARE_READ_REG_0"
(
  per.view hwioreg.per "CDMA,CDMA_TX,MOD_TXCX8_SPARE_READ_REG_0"
)
if "&choice"=="MOD_TXCX8_SPARE_READ_REG_1"
(
  per.view hwioreg.per "CDMA,CDMA_TX,MOD_TXCX8_SPARE_READ_REG_1"
)
if "&choice"=="MOD_TXCX8_SPARE_READ_REG_2"
(
  per.view hwioreg.per "CDMA,CDMA_TX,MOD_TXCX8_SPARE_READ_REG_2"
)
if "&choice"=="MOD_TXCX8_SPARE_READ_REG_3"
(
  per.view hwioreg.per "CDMA,CDMA_TX,MOD_TXCX8_SPARE_READ_REG_3"
)
if "&choice"=="NAND_FLASH_CMD"
(
  per.view hwioreg.per "CHIP_BASE_BASE,NAND_FLASH_CMD"
)
if "&choice"=="NAND_ADDR0"
(
  per.view hwioreg.per "CHIP_BASE_BASE,NAND_ADDR0"
)
if "&choice"=="NAND_ADDR1"
(
  per.view hwioreg.per "CHIP_BASE_BASE,NAND_ADDR1"
)
if "&choice"=="NAND_FLASH_CHIP_SELECT"
(
  per.view hwioreg.per "CHIP_BASE_BASE,NAND_FLASH_CHIP_SELECT"
)
if "&choice"=="NANDC_EXEC_CMD"
(
  per.view hwioreg.per "CHIP_BASE_BASE,NANDC_EXEC_CMD"
)
if "&choice"=="NAND_FLASH_STATUS"
(
  per.view hwioreg.per "CHIP_BASE_BASE,NAND_FLASH_STATUS"
)
if "&choice"=="NANDC_BUFFER_STATUS"
(
  per.view hwioreg.per "CHIP_BASE_BASE,NANDC_BUFFER_STATUS"
)
if "&choice"=="NAND_DEV0_CFG0"
(
  per.view hwioreg.per "CHIP_BASE_BASE,NAND_DEV0_CFG0"
)
if "&choice"=="NAND_DEV1_CFG0"
(
  per.view hwioreg.per "CHIP_BASE_BASE,NAND_DEV1_CFG0"
)
if "&choice"=="NAND_DEV0_CFG1"
(
  per.view hwioreg.per "CHIP_BASE_BASE,NAND_DEV0_CFG1"
)
if "&choice"=="NAND_DEV1_CFG1"
(
  per.view hwioreg.per "CHIP_BASE_BASE,NAND_DEV1_CFG1"
)
if "&choice"=="NAND_FLASH_READ_ID"
(
  per.view hwioreg.per "CHIP_BASE_BASE,NAND_FLASH_READ_ID"
)
if "&choice"=="NAND_FLASH_READ_STATUS"
(
  per.view hwioreg.per "CHIP_BASE_BASE,NAND_FLASH_READ_STATUS"
)
if "&choice"=="NAND_CONTROLLER_CFG"
(
  per.view hwioreg.per "CHIP_BASE_BASE,NAND_CONTROLLER_CFG"
)
if "&choice"=="NAND_FLASH_CONFIG_DATA"
(
  per.view hwioreg.per "CHIP_BASE_BASE,NAND_FLASH_CONFIG_DATA"
)
if "&choice"=="NAND_FLASH_CONFIG"
(
  per.view hwioreg.per "CHIP_BASE_BASE,NAND_FLASH_CONFIG"
)
if "&choice"=="NAND_FLASH_CONFIG_MODE"
(
  per.view hwioreg.per "CHIP_BASE_BASE,NAND_FLASH_CONFIG_MODE"
)
if "&choice"=="NAND_FLASH_CONFIG_STATUS"
(
  per.view hwioreg.per "CHIP_BASE_BASE,NAND_FLASH_CONFIG_STATUS"
)
if "&choice"=="FLASH_MACRO1_REG"
(
  per.view hwioreg.per "CHIP_BASE_BASE,FLASH_MACRO1_REG"
)
if "&choice"=="FLASH_XFR_STEP1"
(
  per.view hwioreg.per "CHIP_BASE_BASE,FLASH_XFR_STEP1"
)
if "&choice"=="FLASH_XFR_STEP2"
(
  per.view hwioreg.per "CHIP_BASE_BASE,FLASH_XFR_STEP2"
)
if "&choice"=="FLASH_XFR_STEP3"
(
  per.view hwioreg.per "CHIP_BASE_BASE,FLASH_XFR_STEP3"
)
if "&choice"=="FLASH_XFR_STEP4"
(
  per.view hwioreg.per "CHIP_BASE_BASE,FLASH_XFR_STEP4"
)
if "&choice"=="FLASH_XFR_STEP5"
(
  per.view hwioreg.per "CHIP_BASE_BASE,FLASH_XFR_STEP5"
)
if "&choice"=="FLASH_XFR_STEP6"
(
  per.view hwioreg.per "CHIP_BASE_BASE,FLASH_XFR_STEP6"
)
if "&choice"=="FLASH_XFR_STEP7"
(
  per.view hwioreg.per "CHIP_BASE_BASE,FLASH_XFR_STEP7"
)
if "&choice"=="NAND_CTLR_DEBUG_BUS_CFG"
(
  per.view hwioreg.per "CHIP_BASE_BASE,NAND_CTLR_DEBUG_BUS_CFG"
)
if "&choice"=="FLASH_DEV_CMD0"
(
  per.view hwioreg.per "CHIP_BASE_BASE,FLASH_DEV_CMD0"
)
if "&choice"=="FLASH_DEV_CMD1"
(
  per.view hwioreg.per "CHIP_BASE_BASE,FLASH_DEV_CMD1"
)
if "&choice"=="FLASH_DEV_CMD2"
(
  per.view hwioreg.per "CHIP_BASE_BASE,FLASH_DEV_CMD2"
)
if "&choice"=="FLASH_DEV_CMD_VLD"
(
  per.view hwioreg.per "CHIP_BASE_BASE,FLASH_DEV_CMD_VLD"
)
if "&choice"=="EBI2_MISR_SIG_REG"
(
  per.view hwioreg.per "CHIP_BASE_BASE,EBI2_MISR_SIG_REG"
)
if "&choice"=="NAND_ADDR2"
(
  per.view hwioreg.per "CHIP_BASE_BASE,NAND_ADDR2"
)
if "&choice"=="NAND_ADDR3"
(
  per.view hwioreg.per "CHIP_BASE_BASE,NAND_ADDR3"
)
if "&choice"=="NAND_ADDR4"
(
  per.view hwioreg.per "CHIP_BASE_BASE,NAND_ADDR4"
)
if "&choice"=="NAND_ADDR5"
(
  per.view hwioreg.per "CHIP_BASE_BASE,NAND_ADDR5"
)
if "&choice"=="FLASH_DEV_CMD3"
(
  per.view hwioreg.per "CHIP_BASE_BASE,FLASH_DEV_CMD3"
)
if "&choice"=="FLASH_DEV_CMD4"
(
  per.view hwioreg.per "CHIP_BASE_BASE,FLASH_DEV_CMD4"
)
if "&choice"=="FLASH_DEV_CMD5"
(
  per.view hwioreg.per "CHIP_BASE_BASE,FLASH_DEV_CMD5"
)
if "&choice"=="FLASH_DEV_CMD6"
(
  per.view hwioreg.per "CHIP_BASE_BASE,FLASH_DEV_CMD6"
)
if "&choice"=="FLASH_BURST_CFG"
(
  per.view hwioreg.per "CHIP_BASE_BASE,FLASH_BURST_CFG"
)
if "&choice"=="EBI2_ECC_BUF_CFG"
(
  per.view hwioreg.per "CHIP_BASE_BASE,EBI2_ECC_BUF_CFG"
)
if "&choice"=="NAND_FLASH_BIT_STREAM"
(
  per.view hwioreg.per "CHIP_BASE_BASE,NAND_FLASH_BIT_STREAM"
)
if "&choice"=="FLASH_BUFF0_ACC"
(
  per.view hwioreg.per "CHIP_BASE_BASE,FLASH_BUFF0_ACC"
)
if "&choice"=="ARM_MOD_REG"
(
  per.view hwioreg.per "CLK,ARM_MOD_REG"
)
if "&choice"=="ARM_CFG_REG"
(
  per.view hwioreg.per "CLK,ARM_CFG_REG"
)
if "&choice"=="ARM_CLK_EN_REG"
(
  per.view hwioreg.per "CLK,ARM_CLK_EN_REG"
)
if "&choice"=="ARM_CLK_INV_REG"
(
  per.view hwioreg.per "CLK,ARM_CLK_INV_REG"
)
if "&choice"=="ADSP_MND0_REG"
(
  per.view hwioreg.per "CLK,ADSP_MND0_REG"
)
if "&choice"=="ADSP_MND1_REG"
(
  per.view hwioreg.per "CLK,ADSP_MND1_REG"
)
if "&choice"=="ADSP_CFG_REG"
(
  per.view hwioreg.per "CLK,ADSP_CFG_REG"
)
if "&choice"=="ADSP_CLK_CTL_REG"
(
  per.view hwioreg.per "CLK,ADSP_CLK_CTL_REG"
)
if "&choice"=="ADSP_MODE_REG"
(
  per.view hwioreg.per "CLK,ADSP_MODE_REG"
)
if "&choice"=="ADSP_FS_CTL_REG"
(
  per.view hwioreg.per "CLK,ADSP_FS_CTL_REG"
)
if "&choice"=="ECODEC_MN_REG"
(
  per.view hwioreg.per "CLK,ECODEC_MN_REG"
)
if "&choice"=="ECODEC_CD_REG"
(
  per.view hwioreg.per "CLK,ECODEC_CD_REG"
)
if "&choice"=="GSBI0_MN_REG"
(
  per.view hwioreg.per "CLK,GSBI0_MN_REG"
)
if "&choice"=="GSBI0_CD_REG"
(
  per.view hwioreg.per "CLK,GSBI0_CD_REG"
)
if "&choice"=="GSBI1_MN_REG"
(
  per.view hwioreg.per "CLK,GSBI1_MN_REG"
)
if "&choice"=="GSBI1_CD_REG"
(
  per.view hwioreg.per "CLK,GSBI1_CD_REG"
)
if "&choice"=="GSBI2_MN_REG"
(
  per.view hwioreg.per "CLK,GSBI2_MN_REG"
)
if "&choice"=="GSBI2_CD_REG"
(
  per.view hwioreg.per "CLK,GSBI2_CD_REG"
)
if "&choice"=="I2S_MN_REG"
(
  per.view hwioreg.per "CLK,I2S_MN_REG"
)
if "&choice"=="I2S_CD_REG"
(
  per.view hwioreg.per "CLK,I2S_CD_REG"
)
if "&choice"=="ICODEC_RX_MN_REG"
(
  per.view hwioreg.per "CLK,ICODEC_RX_MN_REG"
)
if "&choice"=="ICODEC_RX_CD_REG"
(
  per.view hwioreg.per "CLK,ICODEC_RX_CD_REG"
)
if "&choice"=="ICODEC_TX_MN_REG"
(
  per.view hwioreg.per "CLK,ICODEC_TX_MN_REG"
)
if "&choice"=="ICODEC_TX_CD_REG"
(
  per.view hwioreg.per "CLK,ICODEC_TX_CD_REG"
)
if "&choice"=="SDCC_MN_REG"
(
  per.view hwioreg.per "CLK,SDCC_MN_REG"
)
if "&choice"=="SDCC_CD_REG"
(
  per.view hwioreg.per "CLK,SDCC_CD_REG"
)
if "&choice"=="MISC_CFG_REG"
(
  per.view hwioreg.per "CLK,MISC_CFG_REG"
)
if "&choice"=="UART_DM_MN_REG"
(
  per.view hwioreg.per "CLK,UART_DM_MN_REG"
)
if "&choice"=="UART_DM_CD_REG"
(
  per.view hwioreg.per "CLK,UART_DM_CD_REG"
)
if "&choice"=="USB_MN_REG"
(
  per.view hwioreg.per "CLK,USB_MN_REG"
)
if "&choice"=="USB_CD_REG"
(
  per.view hwioreg.per "CLK,USB_CD_REG"
)
if "&choice"=="CAMCLK_MN_REG"
(
  per.view hwioreg.per "CLK,CAMCLK_MN_REG"
)
if "&choice"=="CAMCLK_CD_REG"
(
  per.view hwioreg.per "CLK,CAMCLK_CD_REG"
)
if "&choice"=="VIDEO_VFE_MN_REG"
(
  per.view hwioreg.per "CLK,VIDEO_VFE_MN_REG"
)
if "&choice"=="VIDEO_VFE_CD_REG"
(
  per.view hwioreg.per "CLK,VIDEO_VFE_CD_REG"
)
if "&choice"=="CLK_OFF_A"
(
  per.view hwioreg.per "CLK,CLK_OFF_A"
)
if "&choice"=="CLK_OFF_B"
(
  per.view hwioreg.per "CLK,CLK_OFF_B"
)
if "&choice"=="DBG_CFG_REG"
(
  per.view hwioreg.per "CLK,DBG_CFG_REG"
)
if "&choice"=="SW_RESET_ALL_REG"
(
  per.view hwioreg.per "CLK,SW_RESET_ALL_REG"
)
if "&choice"=="RESET_STATUS_REG"
(
  per.view hwioreg.per "CLK,RESET_STATUS_REG"
)
if "&choice"=="SW_RESET_REG"
(
  per.view hwioreg.per "CLK,SW_RESET_REG"
)
if "&choice"=="PLL_TESTPAD_CFG_REG"
(
  per.view hwioreg.per "CLK,PLL_TESTPAD_CFG_REG"
)
if "&choice"=="PLL_MODE_REG"
(
  per.view hwioreg.per "CLK,PLL_MODE_REG"
)
if "&choice"=="PLL_L_VAL_REG"
(
  per.view hwioreg.per "CLK,PLL_L_VAL_REG"
)
if "&choice"=="PLL_M_VAL_REG"
(
  per.view hwioreg.per "CLK,PLL_M_VAL_REG"
)
if "&choice"=="PLL_N_VAL_REG"
(
  per.view hwioreg.per "CLK,PLL_N_VAL_REG"
)
if "&choice"=="PLL_CONFIG_REG"
(
  per.view hwioreg.per "CLK,PLL_CONFIG_REG"
)
if "&choice"=="PLL_TEST_CTL_REG"
(
  per.view hwioreg.per "CLK,PLL_TEST_CTL_REG"
)
if "&choice"=="PLL_STATUS_REG"
(
  per.view hwioreg.per "CLK,PLL_STATUS_REG"
)
if "&choice"=="UXMC_DEBUG_BUS_CTRL"
(
  per.view hwioreg.per "DEBUG_REGS,UXMC_DEBUG_BUS_CTRL"
)
if "&choice"=="DECOB_RESET"
(
  per.view hwioreg.per "DECOB,DECOB_RESET"
)
if "&choice"=="DECOB_BURST_IF_ACCESS"
(
  per.view hwioreg.per "DECOB,DECOB_BURST_IF_ACCESS"
)
if "&choice"=="DECOB_LONG_BUFFER_ADDR"
(
  per.view hwioreg.per "DECOB,DECOB_LONG_BUFFER_ADDR"
)
if "&choice"=="DECOB_LONG_BUFFER_DATA"
(
  per.view hwioreg.per "DECOB,DECOB_LONG_BUFFER_DATA"
)
if "&choice"=="DECOB_SHORT_BUFFER_ADDR"
(
  per.view hwioreg.per "DECOB,DECOB_SHORT_BUFFER_ADDR"
)
if "&choice"=="DECOB_SHORT_BUFFER_DATA"
(
  per.view hwioreg.per "DECOB,DECOB_SHORT_BUFFER_DATA"
)
if "&choice"=="DECOB_LONG_BUFFER_HUNT_CHAR"
(
  per.view hwioreg.per "DECOB,DECOB_LONG_BUFFER_HUNT_CHAR"
)
if "&choice"=="DECOB_LONG_BUFFER_DEBUG_WR_ADDR"
(
  per.view hwioreg.per "DECOB,DECOB_LONG_BUFFER_DEBUG_WR_ADDR"
)
if "&choice"=="DECOB_LONG_BUFFER_DEBUG_RD_ADDR"
(
  per.view hwioreg.per "DECOB,DECOB_LONG_BUFFER_DEBUG_RD_ADDR"
)
if "&choice"=="DECOB_PDCCH_0_DATA_RD0"
(
  per.view hwioreg.per "DECOB,DECOB_PDCCH_0_DATA_RD0"
)
if "&choice"=="DECOB_PDCCH_0_DATA_RD1"
(
  per.view hwioreg.per "DECOB,DECOB_PDCCH_0_DATA_RD1"
)
if "&choice"=="DECOB_PDCCH_0_DATA_RD2"
(
  per.view hwioreg.per "DECOB,DECOB_PDCCH_0_DATA_RD2"
)
if "&choice"=="DECOB_PDCCH_1_DATA_RD0"
(
  per.view hwioreg.per "DECOB,DECOB_PDCCH_1_DATA_RD0"
)
if "&choice"=="DECOB_PDCCH_1_DATA_RD1"
(
  per.view hwioreg.per "DECOB,DECOB_PDCCH_1_DATA_RD1"
)
if "&choice"=="DECOB_PDCCH_1_DATA_RD2"
(
  per.view hwioreg.per "DECOB,DECOB_PDCCH_1_DATA_RD2"
)
if "&choice"=="DECOB_PDCCH_0_STATUS_RD0"
(
  per.view hwioreg.per "DECOB,DECOB_PDCCH_0_STATUS_RD0"
)
if "&choice"=="DECOB_PDCCH_0_STATUS_RD1"
(
  per.view hwioreg.per "DECOB,DECOB_PDCCH_0_STATUS_RD1"
)
if "&choice"=="DECOB_PDCCH_0_STATUS_RD2"
(
  per.view hwioreg.per "DECOB,DECOB_PDCCH_0_STATUS_RD2"
)
if "&choice"=="DECOB_PDCCH_1_STATUS_RD0"
(
  per.view hwioreg.per "DECOB,DECOB_PDCCH_1_STATUS_RD0"
)
if "&choice"=="DECOB_PDCCH_1_STATUS_RD1"
(
  per.view hwioreg.per "DECOB,DECOB_PDCCH_1_STATUS_RD1"
)
if "&choice"=="DECOB_PDCCH_1_STATUS_RD2"
(
  per.view hwioreg.per "DECOB,DECOB_PDCCH_1_STATUS_RD2"
)
if "&choice"=="DECOB_GCH_0_DATA_RD"
(
  per.view hwioreg.per "DECOB,DECOB_GCH_0_DATA_RD"
)
if "&choice"=="DECOB_GCH_1_DATA_RD"
(
  per.view hwioreg.per "DECOB,DECOB_GCH_1_DATA_RD"
)
if "&choice"=="DECOB_GCH_0_STATUS_RD"
(
  per.view hwioreg.per "DECOB,DECOB_GCH_0_STATUS_RD"
)
if "&choice"=="DECOB_GCH_1_STATUS_RD"
(
  per.view hwioreg.per "DECOB,DECOB_GCH_1_STATUS_RD"
)
if "&choice"=="DECOB_TEST_CTL"
(
  per.view hwioreg.per "DECOB,DECOB_TEST_CTL"
)
if "&choice"=="DECOB_HW_CLK_CTL"
(
  per.view hwioreg.per "DECOB,DECOB_HW_CLK_CTL"
)
if "&choice"=="DECOB_MICRO_CLK_CTL"
(
  per.view hwioreg.per "DECOB,DECOB_MICRO_CLK_CTL"
)
if "&choice"=="DECOB_CLK_STATUS"
(
  per.view hwioreg.per "DECOB,DECOB_CLK_STATUS"
)
if "&choice"=="DECOB_CLK_SPARE_READ_REG0"
(
  per.view hwioreg.per "DECOB,DECOB_CLK_SPARE_READ_REG0"
)
if "&choice"=="DINT_RESET"
(
  per.view hwioreg.per "DEINT,DINT_RESET"
)
if "&choice"=="DINT_CFG"
(
  per.view hwioreg.per "DEINT,DINT_CFG"
)
if "&choice"=="DINT_CH0_CFG"
(
  per.view hwioreg.per "DEINT,DINT_CH0_CFG"
)
if "&choice"=="DINT_CH1_CFG"
(
  per.view hwioreg.per "DEINT,DINT_CH1_CFG"
)
if "&choice"=="DINT_CH2_CFG"
(
  per.view hwioreg.per "DEINT,DINT_CH2_CFG"
)
if "&choice"=="DINT_CH3_CFG"
(
  per.view hwioreg.per "DEINT,DINT_CH3_CFG"
)
if "&choice"=="TD_BLOCK_SIZE"
(
  per.view hwioreg.per "DEINT,TD_BLOCK_SIZE"
)
if "&choice"=="TD_INTLV_CFG_LO"
(
  per.view hwioreg.per "DEINT,TD_INTLV_CFG_LO"
)
if "&choice"=="TD_INTLV_CFG_HI"
(
  per.view hwioreg.per "DEINT,TD_INTLV_CFG_HI"
)
if "&choice"=="TD_INTLV_SIZE_LO"
(
  per.view hwioreg.per "DEINT,TD_INTLV_SIZE_LO"
)
if "&choice"=="TD_INTLV_SIZE_HI"
(
  per.view hwioreg.per "DEINT,TD_INTLV_SIZE_HI"
)
if "&choice"=="TD_PUNCT_LO"
(
  per.view hwioreg.per "DEINT,TD_PUNCT_LO"
)
if "&choice"=="TD_PUNCT_HI"
(
  per.view hwioreg.per "DEINT,TD_PUNCT_HI"
)
if "&choice"=="TD_PARAMS_LO"
(
  per.view hwioreg.per "DEINT,TD_PARAMS_LO"
)
if "&choice"=="TD_PARAMS_HI"
(
  per.view hwioreg.per "DEINT,TD_PARAMS_HI"
)
if "&choice"=="DINT_PKT_OFFSET"
(
  per.view hwioreg.per "DEINT,DINT_PKT_OFFSET"
)
if "&choice"=="DINT_PKT_CFG"
(
  per.view hwioreg.per "DEINT,DINT_PKT_CFG"
)
if "&choice"=="DINT_TASK_OFFSET"
(
  per.view hwioreg.per "DEINT,DINT_TASK_OFFSET"
)
if "&choice"=="DINT_TASK_LIST"
(
  per.view hwioreg.per "DEINT,DINT_TASK_LIST"
)
if "&choice"=="TST_SYNC_DINT"
(
  per.view hwioreg.per "DEINT,TST_SYNC_DINT"
)
if "&choice"=="TST_CH0_SYMS"
(
  per.view hwioreg.per "DEINT,TST_CH0_SYMS"
)
if "&choice"=="TST_CH1_SYMS"
(
  per.view hwioreg.per "DEINT,TST_CH1_SYMS"
)
if "&choice"=="TST_CH2_SYMS"
(
  per.view hwioreg.per "DEINT,TST_CH2_SYMS"
)
if "&choice"=="TST_SEQ_PROC_PHASE"
(
  per.view hwioreg.per "DEINT,TST_SEQ_PROC_PHASE"
)
if "&choice"=="TST_SEL_DINT"
(
  per.view hwioreg.per "DEINT,TST_SEL_DINT"
)
if "&choice"=="DINT_OTD_CFG"
(
  per.view hwioreg.per "DEINT,DINT_OTD_CFG"
)
if "&choice"=="TD_MIN_LLR_THRESH"
(
  per.view hwioreg.per "DEINT,TD_MIN_LLR_THRESH"
)
if "&choice"=="TD_INTLV_LEN_X2"
(
  per.view hwioreg.per "DEINT,TD_INTLV_LEN_X2"
)
if "&choice"=="TD_INTLV_LEN_X4"
(
  per.view hwioreg.per "DEINT,TD_INTLV_LEN_X4"
)
if "&choice"=="TD_INTLV_LEN_X8"
(
  per.view hwioreg.per "DEINT,TD_INTLV_LEN_X8"
)
if "&choice"=="TD_NUM_SLWIN_X2"
(
  per.view hwioreg.per "DEINT,TD_NUM_SLWIN_X2"
)
if "&choice"=="TD_NUM_SLWIN_X4"
(
  per.view hwioreg.per "DEINT,TD_NUM_SLWIN_X4"
)
if "&choice"=="TD_NUM_SLWIN_X8"
(
  per.view hwioreg.per "DEINT,TD_NUM_SLWIN_X8"
)
if "&choice"=="DINT_GCH_CFG0"
(
  per.view hwioreg.per "DEINT,DINT_GCH_CFG0"
)
if "&choice"=="DINT_GCH_CFG1"
(
  per.view hwioreg.per "DEINT,DINT_GCH_CFG1"
)
if "&choice"=="DINT_GCH_CFG2"
(
  per.view hwioreg.per "DEINT,DINT_GCH_CFG2"
)
if "&choice"=="DINT_GCH_CFG3"
(
  per.view hwioreg.per "DEINT,DINT_GCH_CFG3"
)
if "&choice"=="DINT_PDCCH_CFG"
(
  per.view hwioreg.per "DEINT,DINT_PDCCH_CFG"
)
if "&choice"=="DINT_PDCCH_HYP0_CFG0"
(
  per.view hwioreg.per "DEINT,DINT_PDCCH_HYP0_CFG0"
)
if "&choice"=="DINT_PDCCH_HYP1_CFG0"
(
  per.view hwioreg.per "DEINT,DINT_PDCCH_HYP1_CFG0"
)
if "&choice"=="DINT_PDCCH_HYP2_CFG0"
(
  per.view hwioreg.per "DEINT,DINT_PDCCH_HYP2_CFG0"
)
if "&choice"=="DINT_PDCCH_HYP0_CFG1"
(
  per.view hwioreg.per "DEINT,DINT_PDCCH_HYP0_CFG1"
)
if "&choice"=="DINT_PDCCH_HYP1_CFG1"
(
  per.view hwioreg.per "DEINT,DINT_PDCCH_HYP1_CFG1"
)
if "&choice"=="DINT_PDCCH_HYP2_CFG1"
(
  per.view hwioreg.per "DEINT,DINT_PDCCH_HYP2_CFG1"
)
if "&choice"=="DINT_TEST_MEM_SEL"
(
  per.view hwioreg.per "DEINT,DINT_TEST_MEM_SEL"
)
if "&choice"=="DINT_TEST_MEM_ADDR"
(
  per.view hwioreg.per "DEINT,DINT_TEST_MEM_ADDR"
)
if "&choice"=="DINT_TEST_MEM_WRITE"
(
  per.view hwioreg.per "DEINT,DINT_TEST_MEM_WRITE"
)
if "&choice"=="DINT_TEST_MEM_READ0"
(
  per.view hwioreg.per "DEINT,DINT_TEST_MEM_READ0"
)
if "&choice"=="TST_PDCCH_TASK"
(
  per.view hwioreg.per "DEINT,TST_PDCCH_TASK"
)
if "&choice"=="TST_SYS_TIME"
(
  per.view hwioreg.per "DEINT,TST_SYS_TIME"
)
if "&choice"=="DEINT_DBG_BUS_CTL"
(
  per.view hwioreg.per "DEINT,DEINT_DBG_BUS_CTL"
)
if "&choice"=="DEINT_CLK_SPARE_READ_REG0"
(
  per.view hwioreg.per "DEINT,DEINT_CLK_SPARE_READ_REG0"
)
if "&choice"=="DEINT_CLK_SPARE_READ_REG1"
(
  per.view hwioreg.per "DEINT,DEINT_CLK_SPARE_READ_REG1"
)
if "&choice"=="DEINT_HW_CLK_CTL"
(
  per.view hwioreg.per "DEINT,DEINT_HW_CLK_CTL"
)
if "&choice"=="DEINT_MICRO_CLK_CTL"
(
  per.view hwioreg.per "DEINT,DEINT_MICRO_CLK_CTL"
)
if "&choice"=="DEINT_CLK_STATUS"
(
  per.view hwioreg.per "DEINT,DEINT_CLK_STATUS"
)
if "&choice"=="DEC_DONE_INT_STATUS"
(
  per.view hwioreg.per "DEINT,DEC_DONE_INT_STATUS"
)
if "&choice"=="DEINT_TASK_STATUS"
(
  per.view hwioreg.per "DEINT,DEINT_TASK_STATUS"
)
if "&choice"=="DEINT_FRMHYP_STATUS"
(
  per.view hwioreg.per "DEINT,DEINT_FRMHYP_STATUS"
)
if "&choice"=="DINT_VD_RD_ADDR"
(
  per.view hwioreg.per "DEINT,DINT_VD_RD_ADDR"
)
if "&choice"=="DINT_TD_WR_ADDR"
(
  per.view hwioreg.per "DEINT,DINT_TD_WR_ADDR"
)
if "&choice"=="DEM1X_F0_PILOT_IMMED"
(
  per.view hwioreg.per "DEMOD,DEMOD_1X_OFFLINE,DEM1X_F0_PILOT_IMMED"
)
if "&choice"=="DEM1X_F1_PILOT_IMMED"
(
  per.view hwioreg.per "DEMOD,DEMOD_1X_OFFLINE,DEM1X_F1_PILOT_IMMED"
)
if "&choice"=="DEM1X_F2_PILOT_IMMED"
(
  per.view hwioreg.per "DEMOD,DEMOD_1X_OFFLINE,DEM1X_F2_PILOT_IMMED"
)
if "&choice"=="DEM1X_F3_PILOT_IMMED"
(
  per.view hwioreg.per "DEMOD,DEMOD_1X_OFFLINE,DEM1X_F3_PILOT_IMMED"
)
if "&choice"=="DEM1X_F4_PILOT_IMMED"
(
  per.view hwioreg.per "DEMOD,DEMOD_1X_OFFLINE,DEM1X_F4_PILOT_IMMED"
)
if "&choice"=="DEM1X_F5_PILOT_IMMED"
(
  per.view hwioreg.per "DEMOD,DEMOD_1X_OFFLINE,DEM1X_F5_PILOT_IMMED"
)
if "&choice"=="DEM1X_F6_PILOT_IMMED"
(
  per.view hwioreg.per "DEMOD,DEMOD_1X_OFFLINE,DEM1X_F6_PILOT_IMMED"
)
if "&choice"=="DEM1X_F7_PILOT_IMMED"
(
  per.view hwioreg.per "DEMOD,DEMOD_1X_OFFLINE,DEM1X_F7_PILOT_IMMED"
)
if "&choice"=="DEM1X_F0_DIVERSITY_IMMED"
(
  per.view hwioreg.per "DEMOD,DEMOD_1X_OFFLINE,DEM1X_F0_DIVERSITY_IMMED"
)
if "&choice"=="DEM1X_F1_DIVERSITY_IMMED"
(
  per.view hwioreg.per "DEMOD,DEMOD_1X_OFFLINE,DEM1X_F1_DIVERSITY_IMMED"
)
if "&choice"=="DEM1X_F2_DIVERSITY_IMMED"
(
  per.view hwioreg.per "DEMOD,DEMOD_1X_OFFLINE,DEM1X_F2_DIVERSITY_IMMED"
)
if "&choice"=="DEM1X_F3_DIVERSITY_IMMED"
(
  per.view hwioreg.per "DEMOD,DEMOD_1X_OFFLINE,DEM1X_F3_DIVERSITY_IMMED"
)
if "&choice"=="DEM1X_F4_DIVERSITY_IMMED"
(
  per.view hwioreg.per "DEMOD,DEMOD_1X_OFFLINE,DEM1X_F4_DIVERSITY_IMMED"
)
if "&choice"=="DEM1X_F5_DIVERSITY_IMMED"
(
  per.view hwioreg.per "DEMOD,DEMOD_1X_OFFLINE,DEM1X_F5_DIVERSITY_IMMED"
)
if "&choice"=="DEM1X_F6_DIVERSITY_IMMED"
(
  per.view hwioreg.per "DEMOD,DEMOD_1X_OFFLINE,DEM1X_F6_DIVERSITY_IMMED"
)
if "&choice"=="DEM1X_F7_DIVERSITY_IMMED"
(
  per.view hwioreg.per "DEMOD,DEMOD_1X_OFFLINE,DEM1X_F7_DIVERSITY_IMMED"
)
if "&choice"=="DEM1X_F0_WALSH_ACC0_IMMED"
(
  per.view hwioreg.per "DEMOD,DEMOD_1X_OFFLINE,DEM1X_F0_WALSH_ACC0_IMMED"
)
if "&choice"=="DEM1X_F0_WALSH_ACC1_IMMED"
(
  per.view hwioreg.per "DEMOD,DEMOD_1X_OFFLINE,DEM1X_F0_WALSH_ACC1_IMMED"
)
if "&choice"=="DEM1X_F0_WALSH_ACC2_IMMED"
(
  per.view hwioreg.per "DEMOD,DEMOD_1X_OFFLINE,DEM1X_F0_WALSH_ACC2_IMMED"
)
if "&choice"=="DEM1X_F0_WALSH_ACC3_IMMED"
(
  per.view hwioreg.per "DEMOD,DEMOD_1X_OFFLINE,DEM1X_F0_WALSH_ACC3_IMMED"
)
if "&choice"=="DEM1X_F0_WALSH_ACC4_IMMED"
(
  per.view hwioreg.per "DEMOD,DEMOD_1X_OFFLINE,DEM1X_F0_WALSH_ACC4_IMMED"
)
if "&choice"=="DEM1X_F0_WALSH_ACC5_IMMED"
(
  per.view hwioreg.per "DEMOD,DEMOD_1X_OFFLINE,DEM1X_F0_WALSH_ACC5_IMMED"
)
if "&choice"=="DEM1X_F0_WALSH_ACC6_IMMED"
(
  per.view hwioreg.per "DEMOD,DEMOD_1X_OFFLINE,DEM1X_F0_WALSH_ACC6_IMMED"
)
if "&choice"=="DEM1X_F0_WALSH_ACC7_IMMED"
(
  per.view hwioreg.per "DEMOD,DEMOD_1X_OFFLINE,DEM1X_F0_WALSH_ACC7_IMMED"
)
if "&choice"=="DEM1X_F0_WALSH_ACC8_IMMED"
(
  per.view hwioreg.per "DEMOD,DEMOD_1X_OFFLINE,DEM1X_F0_WALSH_ACC8_IMMED"
)
if "&choice"=="DEM1X_F0_WALSH_ACC9_IMMED"
(
  per.view hwioreg.per "DEMOD,DEMOD_1X_OFFLINE,DEM1X_F0_WALSH_ACC9_IMMED"
)
if "&choice"=="DEM1X_F0_WALSH_ACC10_IMMED"
(
  per.view hwioreg.per "DEMOD,DEMOD_1X_OFFLINE,DEM1X_F0_WALSH_ACC10_IMMED"
)
if "&choice"=="DEM1X_F0_WALSH_ACC11_IMMED"
(
  per.view hwioreg.per "DEMOD,DEMOD_1X_OFFLINE,DEM1X_F0_WALSH_ACC11_IMMED"
)
if "&choice"=="DEM1X_F0_WALSH_ACC12_IMMED"
(
  per.view hwioreg.per "DEMOD,DEMOD_1X_OFFLINE,DEM1X_F0_WALSH_ACC12_IMMED"
)
if "&choice"=="DEM1X_F0_WALSH_ACC13_IMMED"
(
  per.view hwioreg.per "DEMOD,DEMOD_1X_OFFLINE,DEM1X_F0_WALSH_ACC13_IMMED"
)
if "&choice"=="DEM1X_F1_WALSH_ACC0_IMMED"
(
  per.view hwioreg.per "DEMOD,DEMOD_1X_OFFLINE,DEM1X_F1_WALSH_ACC0_IMMED"
)
if "&choice"=="DEM1X_F1_WALSH_ACC1_IMMED"
(
  per.view hwioreg.per "DEMOD,DEMOD_1X_OFFLINE,DEM1X_F1_WALSH_ACC1_IMMED"
)
if "&choice"=="DEM1X_F1_WALSH_ACC2_IMMED"
(
  per.view hwioreg.per "DEMOD,DEMOD_1X_OFFLINE,DEM1X_F1_WALSH_ACC2_IMMED"
)
if "&choice"=="DEM1X_F1_WALSH_ACC3_IMMED"
(
  per.view hwioreg.per "DEMOD,DEMOD_1X_OFFLINE,DEM1X_F1_WALSH_ACC3_IMMED"
)
if "&choice"=="DEM1X_F1_WALSH_ACC4_IMMED"
(
  per.view hwioreg.per "DEMOD,DEMOD_1X_OFFLINE,DEM1X_F1_WALSH_ACC4_IMMED"
)
if "&choice"=="DEM1X_F1_WALSH_ACC5_IMMED"
(
  per.view hwioreg.per "DEMOD,DEMOD_1X_OFFLINE,DEM1X_F1_WALSH_ACC5_IMMED"
)
if "&choice"=="DEM1X_F1_WALSH_ACC6_IMMED"
(
  per.view hwioreg.per "DEMOD,DEMOD_1X_OFFLINE,DEM1X_F1_WALSH_ACC6_IMMED"
)
if "&choice"=="DEM1X_F1_WALSH_ACC7_IMMED"
(
  per.view hwioreg.per "DEMOD,DEMOD_1X_OFFLINE,DEM1X_F1_WALSH_ACC7_IMMED"
)
if "&choice"=="DEM1X_F1_WALSH_ACC8_IMMED"
(
  per.view hwioreg.per "DEMOD,DEMOD_1X_OFFLINE,DEM1X_F1_WALSH_ACC8_IMMED"
)
if "&choice"=="DEM1X_F1_WALSH_ACC9_IMMED"
(
  per.view hwioreg.per "DEMOD,DEMOD_1X_OFFLINE,DEM1X_F1_WALSH_ACC9_IMMED"
)
if "&choice"=="DEM1X_F1_WALSH_ACC10_IMMED"
(
  per.view hwioreg.per "DEMOD,DEMOD_1X_OFFLINE,DEM1X_F1_WALSH_ACC10_IMMED"
)
if "&choice"=="DEM1X_F1_WALSH_ACC11_IMMED"
(
  per.view hwioreg.per "DEMOD,DEMOD_1X_OFFLINE,DEM1X_F1_WALSH_ACC11_IMMED"
)
if "&choice"=="DEM1X_F1_WALSH_ACC12_IMMED"
(
  per.view hwioreg.per "DEMOD,DEMOD_1X_OFFLINE,DEM1X_F1_WALSH_ACC12_IMMED"
)
if "&choice"=="DEM1X_F1_WALSH_ACC13_IMMED"
(
  per.view hwioreg.per "DEMOD,DEMOD_1X_OFFLINE,DEM1X_F1_WALSH_ACC13_IMMED"
)
if "&choice"=="DEM1X_F2_WALSH_ACC0_IMMED"
(
  per.view hwioreg.per "DEMOD,DEMOD_1X_OFFLINE,DEM1X_F2_WALSH_ACC0_IMMED"
)
if "&choice"=="DEM1X_F2_WALSH_ACC1_IMMED"
(
  per.view hwioreg.per "DEMOD,DEMOD_1X_OFFLINE,DEM1X_F2_WALSH_ACC1_IMMED"
)
if "&choice"=="DEM1X_F2_WALSH_ACC2_IMMED"
(
  per.view hwioreg.per "DEMOD,DEMOD_1X_OFFLINE,DEM1X_F2_WALSH_ACC2_IMMED"
)
if "&choice"=="DEM1X_F2_WALSH_ACC3_IMMED"
(
  per.view hwioreg.per "DEMOD,DEMOD_1X_OFFLINE,DEM1X_F2_WALSH_ACC3_IMMED"
)
if "&choice"=="DEM1X_F2_WALSH_ACC4_IMMED"
(
  per.view hwioreg.per "DEMOD,DEMOD_1X_OFFLINE,DEM1X_F2_WALSH_ACC4_IMMED"
)
if "&choice"=="DEM1X_F2_WALSH_ACC5_IMMED"
(
  per.view hwioreg.per "DEMOD,DEMOD_1X_OFFLINE,DEM1X_F2_WALSH_ACC5_IMMED"
)
if "&choice"=="DEM1X_F2_WALSH_ACC6_IMMED"
(
  per.view hwioreg.per "DEMOD,DEMOD_1X_OFFLINE,DEM1X_F2_WALSH_ACC6_IMMED"
)
if "&choice"=="DEM1X_F2_WALSH_ACC7_IMMED"
(
  per.view hwioreg.per "DEMOD,DEMOD_1X_OFFLINE,DEM1X_F2_WALSH_ACC7_IMMED"
)
if "&choice"=="DEM1X_F2_WALSH_ACC8_IMMED"
(
  per.view hwioreg.per "DEMOD,DEMOD_1X_OFFLINE,DEM1X_F2_WALSH_ACC8_IMMED"
)
if "&choice"=="DEM1X_F2_WALSH_ACC9_IMMED"
(
  per.view hwioreg.per "DEMOD,DEMOD_1X_OFFLINE,DEM1X_F2_WALSH_ACC9_IMMED"
)
if "&choice"=="DEM1X_F2_WALSH_ACC10_IMMED"
(
  per.view hwioreg.per "DEMOD,DEMOD_1X_OFFLINE,DEM1X_F2_WALSH_ACC10_IMMED"
)
if "&choice"=="DEM1X_F2_WALSH_ACC11_IMMED"
(
  per.view hwioreg.per "DEMOD,DEMOD_1X_OFFLINE,DEM1X_F2_WALSH_ACC11_IMMED"
)
if "&choice"=="DEM1X_F2_WALSH_ACC12_IMMED"
(
  per.view hwioreg.per "DEMOD,DEMOD_1X_OFFLINE,DEM1X_F2_WALSH_ACC12_IMMED"
)
if "&choice"=="DEM1X_F2_WALSH_ACC13_IMMED"
(
  per.view hwioreg.per "DEMOD,DEMOD_1X_OFFLINE,DEM1X_F2_WALSH_ACC13_IMMED"
)
if "&choice"=="DEM1X_F3_WALSH_ACC0_IMMED"
(
  per.view hwioreg.per "DEMOD,DEMOD_1X_OFFLINE,DEM1X_F3_WALSH_ACC0_IMMED"
)
if "&choice"=="DEM1X_F3_WALSH_ACC1_IMMED"
(
  per.view hwioreg.per "DEMOD,DEMOD_1X_OFFLINE,DEM1X_F3_WALSH_ACC1_IMMED"
)
if "&choice"=="DEM1X_F3_WALSH_ACC2_IMMED"
(
  per.view hwioreg.per "DEMOD,DEMOD_1X_OFFLINE,DEM1X_F3_WALSH_ACC2_IMMED"
)
if "&choice"=="DEM1X_F3_WALSH_ACC3_IMMED"
(
  per.view hwioreg.per "DEMOD,DEMOD_1X_OFFLINE,DEM1X_F3_WALSH_ACC3_IMMED"
)
if "&choice"=="DEM1X_F3_WALSH_ACC4_IMMED"
(
  per.view hwioreg.per "DEMOD,DEMOD_1X_OFFLINE,DEM1X_F3_WALSH_ACC4_IMMED"
)
if "&choice"=="DEM1X_F3_WALSH_ACC5_IMMED"
(
  per.view hwioreg.per "DEMOD,DEMOD_1X_OFFLINE,DEM1X_F3_WALSH_ACC5_IMMED"
)
if "&choice"=="DEM1X_F3_WALSH_ACC6_IMMED"
(
  per.view hwioreg.per "DEMOD,DEMOD_1X_OFFLINE,DEM1X_F3_WALSH_ACC6_IMMED"
)
if "&choice"=="DEM1X_F3_WALSH_ACC7_IMMED"
(
  per.view hwioreg.per "DEMOD,DEMOD_1X_OFFLINE,DEM1X_F3_WALSH_ACC7_IMMED"
)
if "&choice"=="DEM1X_F3_WALSH_ACC8_IMMED"
(
  per.view hwioreg.per "DEMOD,DEMOD_1X_OFFLINE,DEM1X_F3_WALSH_ACC8_IMMED"
)
if "&choice"=="DEM1X_F3_WALSH_ACC9_IMMED"
(
  per.view hwioreg.per "DEMOD,DEMOD_1X_OFFLINE,DEM1X_F3_WALSH_ACC9_IMMED"
)
if "&choice"=="DEM1X_F3_WALSH_ACC10_IMMED"
(
  per.view hwioreg.per "DEMOD,DEMOD_1X_OFFLINE,DEM1X_F3_WALSH_ACC10_IMMED"
)
if "&choice"=="DEM1X_F3_WALSH_ACC11_IMMED"
(
  per.view hwioreg.per "DEMOD,DEMOD_1X_OFFLINE,DEM1X_F3_WALSH_ACC11_IMMED"
)
if "&choice"=="DEM1X_F3_WALSH_ACC12_IMMED"
(
  per.view hwioreg.per "DEMOD,DEMOD_1X_OFFLINE,DEM1X_F3_WALSH_ACC12_IMMED"
)
if "&choice"=="DEM1X_F3_WALSH_ACC13_IMMED"
(
  per.view hwioreg.per "DEMOD,DEMOD_1X_OFFLINE,DEM1X_F3_WALSH_ACC13_IMMED"
)
if "&choice"=="DEM1X_F4_WALSH_ACC0_IMMED"
(
  per.view hwioreg.per "DEMOD,DEMOD_1X_OFFLINE,DEM1X_F4_WALSH_ACC0_IMMED"
)
if "&choice"=="DEM1X_F4_WALSH_ACC1_IMMED"
(
  per.view hwioreg.per "DEMOD,DEMOD_1X_OFFLINE,DEM1X_F4_WALSH_ACC1_IMMED"
)
if "&choice"=="DEM1X_F4_WALSH_ACC2_IMMED"
(
  per.view hwioreg.per "DEMOD,DEMOD_1X_OFFLINE,DEM1X_F4_WALSH_ACC2_IMMED"
)
if "&choice"=="DEM1X_F4_WALSH_ACC3_IMMED"
(
  per.view hwioreg.per "DEMOD,DEMOD_1X_OFFLINE,DEM1X_F4_WALSH_ACC3_IMMED"
)
if "&choice"=="DEM1X_F4_WALSH_ACC4_IMMED"
(
  per.view hwioreg.per "DEMOD,DEMOD_1X_OFFLINE,DEM1X_F4_WALSH_ACC4_IMMED"
)
if "&choice"=="DEM1X_F4_WALSH_ACC5_IMMED"
(
  per.view hwioreg.per "DEMOD,DEMOD_1X_OFFLINE,DEM1X_F4_WALSH_ACC5_IMMED"
)
if "&choice"=="DEM1X_F4_WALSH_ACC6_IMMED"
(
  per.view hwioreg.per "DEMOD,DEMOD_1X_OFFLINE,DEM1X_F4_WALSH_ACC6_IMMED"
)
if "&choice"=="DEM1X_F4_WALSH_ACC7_IMMED"
(
  per.view hwioreg.per "DEMOD,DEMOD_1X_OFFLINE,DEM1X_F4_WALSH_ACC7_IMMED"
)
if "&choice"=="DEM1X_F4_WALSH_ACC8_IMMED"
(
  per.view hwioreg.per "DEMOD,DEMOD_1X_OFFLINE,DEM1X_F4_WALSH_ACC8_IMMED"
)
if "&choice"=="DEM1X_F4_WALSH_ACC9_IMMED"
(
  per.view hwioreg.per "DEMOD,DEMOD_1X_OFFLINE,DEM1X_F4_WALSH_ACC9_IMMED"
)
if "&choice"=="DEM1X_F4_WALSH_ACC10_IMMED"
(
  per.view hwioreg.per "DEMOD,DEMOD_1X_OFFLINE,DEM1X_F4_WALSH_ACC10_IMMED"
)
if "&choice"=="DEM1X_F4_WALSH_ACC11_IMMED"
(
  per.view hwioreg.per "DEMOD,DEMOD_1X_OFFLINE,DEM1X_F4_WALSH_ACC11_IMMED"
)
if "&choice"=="DEM1X_F4_WALSH_ACC12_IMMED"
(
  per.view hwioreg.per "DEMOD,DEMOD_1X_OFFLINE,DEM1X_F4_WALSH_ACC12_IMMED"
)
if "&choice"=="DEM1X_F4_WALSH_ACC13_IMMED"
(
  per.view hwioreg.per "DEMOD,DEMOD_1X_OFFLINE,DEM1X_F4_WALSH_ACC13_IMMED"
)
if "&choice"=="DEM1X_F5_WALSH_ACC0_IMMED"
(
  per.view hwioreg.per "DEMOD,DEMOD_1X_OFFLINE,DEM1X_F5_WALSH_ACC0_IMMED"
)
if "&choice"=="DEM1X_F5_WALSH_ACC1_IMMED"
(
  per.view hwioreg.per "DEMOD,DEMOD_1X_OFFLINE,DEM1X_F5_WALSH_ACC1_IMMED"
)
if "&choice"=="DEM1X_F5_WALSH_ACC2_IMMED"
(
  per.view hwioreg.per "DEMOD,DEMOD_1X_OFFLINE,DEM1X_F5_WALSH_ACC2_IMMED"
)
if "&choice"=="DEM1X_F5_WALSH_ACC3_IMMED"
(
  per.view hwioreg.per "DEMOD,DEMOD_1X_OFFLINE,DEM1X_F5_WALSH_ACC3_IMMED"
)
if "&choice"=="DEM1X_F5_WALSH_ACC4_IMMED"
(
  per.view hwioreg.per "DEMOD,DEMOD_1X_OFFLINE,DEM1X_F5_WALSH_ACC4_IMMED"
)
if "&choice"=="DEM1X_F5_WALSH_ACC5_IMMED"
(
  per.view hwioreg.per "DEMOD,DEMOD_1X_OFFLINE,DEM1X_F5_WALSH_ACC5_IMMED"
)
if "&choice"=="DEM1X_F5_WALSH_ACC6_IMMED"
(
  per.view hwioreg.per "DEMOD,DEMOD_1X_OFFLINE,DEM1X_F5_WALSH_ACC6_IMMED"
)
if "&choice"=="DEM1X_F5_WALSH_ACC7_IMMED"
(
  per.view hwioreg.per "DEMOD,DEMOD_1X_OFFLINE,DEM1X_F5_WALSH_ACC7_IMMED"
)
if "&choice"=="DEM1X_F5_WALSH_ACC8_IMMED"
(
  per.view hwioreg.per "DEMOD,DEMOD_1X_OFFLINE,DEM1X_F5_WALSH_ACC8_IMMED"
)
if "&choice"=="DEM1X_F5_WALSH_ACC9_IMMED"
(
  per.view hwioreg.per "DEMOD,DEMOD_1X_OFFLINE,DEM1X_F5_WALSH_ACC9_IMMED"
)
if "&choice"=="DEM1X_F5_WALSH_ACC10_IMMED"
(
  per.view hwioreg.per "DEMOD,DEMOD_1X_OFFLINE,DEM1X_F5_WALSH_ACC10_IMMED"
)
if "&choice"=="DEM1X_F5_WALSH_ACC11_IMMED"
(
  per.view hwioreg.per "DEMOD,DEMOD_1X_OFFLINE,DEM1X_F5_WALSH_ACC11_IMMED"
)
if "&choice"=="DEM1X_F5_WALSH_ACC12_IMMED"
(
  per.view hwioreg.per "DEMOD,DEMOD_1X_OFFLINE,DEM1X_F5_WALSH_ACC12_IMMED"
)
if "&choice"=="DEM1X_F5_WALSH_ACC13_IMMED"
(
  per.view hwioreg.per "DEMOD,DEMOD_1X_OFFLINE,DEM1X_F5_WALSH_ACC13_IMMED"
)
if "&choice"=="DEM1X_F6_WALSH_ACC0_IMMED"
(
  per.view hwioreg.per "DEMOD,DEMOD_1X_OFFLINE,DEM1X_F6_WALSH_ACC0_IMMED"
)
if "&choice"=="DEM1X_F6_WALSH_ACC1_IMMED"
(
  per.view hwioreg.per "DEMOD,DEMOD_1X_OFFLINE,DEM1X_F6_WALSH_ACC1_IMMED"
)
if "&choice"=="DEM1X_F6_WALSH_ACC2_IMMED"
(
  per.view hwioreg.per "DEMOD,DEMOD_1X_OFFLINE,DEM1X_F6_WALSH_ACC2_IMMED"
)
if "&choice"=="DEM1X_F6_WALSH_ACC3_IMMED"
(
  per.view hwioreg.per "DEMOD,DEMOD_1X_OFFLINE,DEM1X_F6_WALSH_ACC3_IMMED"
)
if "&choice"=="DEM1X_F6_WALSH_ACC4_IMMED"
(
  per.view hwioreg.per "DEMOD,DEMOD_1X_OFFLINE,DEM1X_F6_WALSH_ACC4_IMMED"
)
if "&choice"=="DEM1X_F6_WALSH_ACC5_IMMED"
(
  per.view hwioreg.per "DEMOD,DEMOD_1X_OFFLINE,DEM1X_F6_WALSH_ACC5_IMMED"
)
if "&choice"=="DEM1X_F6_WALSH_ACC6_IMMED"
(
  per.view hwioreg.per "DEMOD,DEMOD_1X_OFFLINE,DEM1X_F6_WALSH_ACC6_IMMED"
)
if "&choice"=="DEM1X_F6_WALSH_ACC7_IMMED"
(
  per.view hwioreg.per "DEMOD,DEMOD_1X_OFFLINE,DEM1X_F6_WALSH_ACC7_IMMED"
)
if "&choice"=="DEM1X_F6_WALSH_ACC8_IMMED"
(
  per.view hwioreg.per "DEMOD,DEMOD_1X_OFFLINE,DEM1X_F6_WALSH_ACC8_IMMED"
)
if "&choice"=="DEM1X_F6_WALSH_ACC9_IMMED"
(
  per.view hwioreg.per "DEMOD,DEMOD_1X_OFFLINE,DEM1X_F6_WALSH_ACC9_IMMED"
)
if "&choice"=="DEM1X_F6_WALSH_ACC10_IMMED"
(
  per.view hwioreg.per "DEMOD,DEMOD_1X_OFFLINE,DEM1X_F6_WALSH_ACC10_IMMED"
)
if "&choice"=="DEM1X_F6_WALSH_ACC11_IMMED"
(
  per.view hwioreg.per "DEMOD,DEMOD_1X_OFFLINE,DEM1X_F6_WALSH_ACC11_IMMED"
)
if "&choice"=="DEM1X_F6_WALSH_ACC12_IMMED"
(
  per.view hwioreg.per "DEMOD,DEMOD_1X_OFFLINE,DEM1X_F6_WALSH_ACC12_IMMED"
)
if "&choice"=="DEM1X_F6_WALSH_ACC13_IMMED"
(
  per.view hwioreg.per "DEMOD,DEMOD_1X_OFFLINE,DEM1X_F6_WALSH_ACC13_IMMED"
)
if "&choice"=="DEM1X_F7_WALSH_ACC0_IMMED"
(
  per.view hwioreg.per "DEMOD,DEMOD_1X_OFFLINE,DEM1X_F7_WALSH_ACC0_IMMED"
)
if "&choice"=="DEM1X_F7_WALSH_ACC1_IMMED"
(
  per.view hwioreg.per "DEMOD,DEMOD_1X_OFFLINE,DEM1X_F7_WALSH_ACC1_IMMED"
)
if "&choice"=="DEM1X_F7_WALSH_ACC2_IMMED"
(
  per.view hwioreg.per "DEMOD,DEMOD_1X_OFFLINE,DEM1X_F7_WALSH_ACC2_IMMED"
)
if "&choice"=="DEM1X_F7_WALSH_ACC3_IMMED"
(
  per.view hwioreg.per "DEMOD,DEMOD_1X_OFFLINE,DEM1X_F7_WALSH_ACC3_IMMED"
)
if "&choice"=="DEM1X_F7_WALSH_ACC4_IMMED"
(
  per.view hwioreg.per "DEMOD,DEMOD_1X_OFFLINE,DEM1X_F7_WALSH_ACC4_IMMED"
)
if "&choice"=="DEM1X_F7_WALSH_ACC5_IMMED"
(
  per.view hwioreg.per "DEMOD,DEMOD_1X_OFFLINE,DEM1X_F7_WALSH_ACC5_IMMED"
)
if "&choice"=="DEM1X_F7_WALSH_ACC6_IMMED"
(
  per.view hwioreg.per "DEMOD,DEMOD_1X_OFFLINE,DEM1X_F7_WALSH_ACC6_IMMED"
)
if "&choice"=="DEM1X_F7_WALSH_ACC7_IMMED"
(
  per.view hwioreg.per "DEMOD,DEMOD_1X_OFFLINE,DEM1X_F7_WALSH_ACC7_IMMED"
)
if "&choice"=="DEM1X_F7_WALSH_ACC8_IMMED"
(
  per.view hwioreg.per "DEMOD,DEMOD_1X_OFFLINE,DEM1X_F7_WALSH_ACC8_IMMED"
)
if "&choice"=="DEM1X_F7_WALSH_ACC9_IMMED"
(
  per.view hwioreg.per "DEMOD,DEMOD_1X_OFFLINE,DEM1X_F7_WALSH_ACC9_IMMED"
)
if "&choice"=="DEM1X_F7_WALSH_ACC10_IMMED"
(
  per.view hwioreg.per "DEMOD,DEMOD_1X_OFFLINE,DEM1X_F7_WALSH_ACC10_IMMED"
)
if "&choice"=="DEM1X_F7_WALSH_ACC11_IMMED"
(
  per.view hwioreg.per "DEMOD,DEMOD_1X_OFFLINE,DEM1X_F7_WALSH_ACC11_IMMED"
)
if "&choice"=="DEM1X_F7_WALSH_ACC12_IMMED"
(
  per.view hwioreg.per "DEMOD,DEMOD_1X_OFFLINE,DEM1X_F7_WALSH_ACC12_IMMED"
)
if "&choice"=="DEM1X_F7_WALSH_ACC13_IMMED"
(
  per.view hwioreg.per "DEMOD,DEMOD_1X_OFFLINE,DEM1X_F7_WALSH_ACC13_IMMED"
)
if "&choice"=="DEM1X_F0_WALSH_ACC0_FRAME"
(
  per.view hwioreg.per "DEMOD,DEMOD_1X_OFFLINE,DEM1X_F0_WALSH_ACC0_FRAME"
)
if "&choice"=="DEM1X_F0_WALSH_ACC1_FRAME"
(
  per.view hwioreg.per "DEMOD,DEMOD_1X_OFFLINE,DEM1X_F0_WALSH_ACC1_FRAME"
)
if "&choice"=="DEM1X_F0_WALSH_ACC2_FRAME"
(
  per.view hwioreg.per "DEMOD,DEMOD_1X_OFFLINE,DEM1X_F0_WALSH_ACC2_FRAME"
)
if "&choice"=="DEM1X_F0_WALSH_ACC3_FRAME"
(
  per.view hwioreg.per "DEMOD,DEMOD_1X_OFFLINE,DEM1X_F0_WALSH_ACC3_FRAME"
)
if "&choice"=="DEM1X_F0_WALSH_ACC4_FRAME"
(
  per.view hwioreg.per "DEMOD,DEMOD_1X_OFFLINE,DEM1X_F0_WALSH_ACC4_FRAME"
)
if "&choice"=="DEM1X_F0_WALSH_ACC5_FRAME"
(
  per.view hwioreg.per "DEMOD,DEMOD_1X_OFFLINE,DEM1X_F0_WALSH_ACC5_FRAME"
)
if "&choice"=="DEM1X_F0_WALSH_ACC6_FRAME"
(
  per.view hwioreg.per "DEMOD,DEMOD_1X_OFFLINE,DEM1X_F0_WALSH_ACC6_FRAME"
)
if "&choice"=="DEM1X_F0_WALSH_ACC7_FRAME"
(
  per.view hwioreg.per "DEMOD,DEMOD_1X_OFFLINE,DEM1X_F0_WALSH_ACC7_FRAME"
)
if "&choice"=="DEM1X_F0_WALSH_ACC8_FRAME"
(
  per.view hwioreg.per "DEMOD,DEMOD_1X_OFFLINE,DEM1X_F0_WALSH_ACC8_FRAME"
)
if "&choice"=="DEM1X_F0_WALSH_ACC9_FRAME"
(
  per.view hwioreg.per "DEMOD,DEMOD_1X_OFFLINE,DEM1X_F0_WALSH_ACC9_FRAME"
)
if "&choice"=="DEM1X_F0_WALSH_ACC10_FRAME"
(
  per.view hwioreg.per "DEMOD,DEMOD_1X_OFFLINE,DEM1X_F0_WALSH_ACC10_FRAME"
)
if "&choice"=="DEM1X_F0_WALSH_ACC11_FRAME"
(
  per.view hwioreg.per "DEMOD,DEMOD_1X_OFFLINE,DEM1X_F0_WALSH_ACC11_FRAME"
)
if "&choice"=="DEM1X_F0_WALSH_ACC12_FRAME"
(
  per.view hwioreg.per "DEMOD,DEMOD_1X_OFFLINE,DEM1X_F0_WALSH_ACC12_FRAME"
)
if "&choice"=="DEM1X_F0_WALSH_ACC13_FRAME"
(
  per.view hwioreg.per "DEMOD,DEMOD_1X_OFFLINE,DEM1X_F0_WALSH_ACC13_FRAME"
)
if "&choice"=="DEM1X_F1_WALSH_ACC0_FRAME"
(
  per.view hwioreg.per "DEMOD,DEMOD_1X_OFFLINE,DEM1X_F1_WALSH_ACC0_FRAME"
)
if "&choice"=="DEM1X_F1_WALSH_ACC1_FRAME"
(
  per.view hwioreg.per "DEMOD,DEMOD_1X_OFFLINE,DEM1X_F1_WALSH_ACC1_FRAME"
)
if "&choice"=="DEM1X_F1_WALSH_ACC2_FRAME"
(
  per.view hwioreg.per "DEMOD,DEMOD_1X_OFFLINE,DEM1X_F1_WALSH_ACC2_FRAME"
)
if "&choice"=="DEM1X_F1_WALSH_ACC3_FRAME"
(
  per.view hwioreg.per "DEMOD,DEMOD_1X_OFFLINE,DEM1X_F1_WALSH_ACC3_FRAME"
)
if "&choice"=="DEM1X_F1_WALSH_ACC4_FRAME"
(
  per.view hwioreg.per "DEMOD,DEMOD_1X_OFFLINE,DEM1X_F1_WALSH_ACC4_FRAME"
)
if "&choice"=="DEM1X_F1_WALSH_ACC5_FRAME"
(
  per.view hwioreg.per "DEMOD,DEMOD_1X_OFFLINE,DEM1X_F1_WALSH_ACC5_FRAME"
)
if "&choice"=="DEM1X_F1_WALSH_ACC6_FRAME"
(
  per.view hwioreg.per "DEMOD,DEMOD_1X_OFFLINE,DEM1X_F1_WALSH_ACC6_FRAME"
)
if "&choice"=="DEM1X_F1_WALSH_ACC7_FRAME"
(
  per.view hwioreg.per "DEMOD,DEMOD_1X_OFFLINE,DEM1X_F1_WALSH_ACC7_FRAME"
)
if "&choice"=="DEM1X_F1_WALSH_ACC8_FRAME"
(
  per.view hwioreg.per "DEMOD,DEMOD_1X_OFFLINE,DEM1X_F1_WALSH_ACC8_FRAME"
)
if "&choice"=="DEM1X_F1_WALSH_ACC9_FRAME"
(
  per.view hwioreg.per "DEMOD,DEMOD_1X_OFFLINE,DEM1X_F1_WALSH_ACC9_FRAME"
)
if "&choice"=="DEM1X_F1_WALSH_ACC10_FRAME"
(
  per.view hwioreg.per "DEMOD,DEMOD_1X_OFFLINE,DEM1X_F1_WALSH_ACC10_FRAME"
)
if "&choice"=="DEM1X_F1_WALSH_ACC11_FRAME"
(
  per.view hwioreg.per "DEMOD,DEMOD_1X_OFFLINE,DEM1X_F1_WALSH_ACC11_FRAME"
)
if "&choice"=="DEM1X_F1_WALSH_ACC12_FRAME"
(
  per.view hwioreg.per "DEMOD,DEMOD_1X_OFFLINE,DEM1X_F1_WALSH_ACC12_FRAME"
)
if "&choice"=="DEM1X_F1_WALSH_ACC13_FRAME"
(
  per.view hwioreg.per "DEMOD,DEMOD_1X_OFFLINE,DEM1X_F1_WALSH_ACC13_FRAME"
)
if "&choice"=="DEM1X_F2_WALSH_ACC0_FRAME"
(
  per.view hwioreg.per "DEMOD,DEMOD_1X_OFFLINE,DEM1X_F2_WALSH_ACC0_FRAME"
)
if "&choice"=="DEM1X_F2_WALSH_ACC1_FRAME"
(
  per.view hwioreg.per "DEMOD,DEMOD_1X_OFFLINE,DEM1X_F2_WALSH_ACC1_FRAME"
)
if "&choice"=="DEM1X_F2_WALSH_ACC2_FRAME"
(
  per.view hwioreg.per "DEMOD,DEMOD_1X_OFFLINE,DEM1X_F2_WALSH_ACC2_FRAME"
)
if "&choice"=="DEM1X_F2_WALSH_ACC3_FRAME"
(
  per.view hwioreg.per "DEMOD,DEMOD_1X_OFFLINE,DEM1X_F2_WALSH_ACC3_FRAME"
)
if "&choice"=="DEM1X_F2_WALSH_ACC4_FRAME"
(
  per.view hwioreg.per "DEMOD,DEMOD_1X_OFFLINE,DEM1X_F2_WALSH_ACC4_FRAME"
)
if "&choice"=="DEM1X_F2_WALSH_ACC5_FRAME"
(
  per.view hwioreg.per "DEMOD,DEMOD_1X_OFFLINE,DEM1X_F2_WALSH_ACC5_FRAME"
)
if "&choice"=="DEM1X_F2_WALSH_ACC6_FRAME"
(
  per.view hwioreg.per "DEMOD,DEMOD_1X_OFFLINE,DEM1X_F2_WALSH_ACC6_FRAME"
)
if "&choice"=="DEM1X_F2_WALSH_ACC7_FRAME"
(
  per.view hwioreg.per "DEMOD,DEMOD_1X_OFFLINE,DEM1X_F2_WALSH_ACC7_FRAME"
)
if "&choice"=="DEM1X_F2_WALSH_ACC8_FRAME"
(
  per.view hwioreg.per "DEMOD,DEMOD_1X_OFFLINE,DEM1X_F2_WALSH_ACC8_FRAME"
)
if "&choice"=="DEM1X_F2_WALSH_ACC9_FRAME"
(
  per.view hwioreg.per "DEMOD,DEMOD_1X_OFFLINE,DEM1X_F2_WALSH_ACC9_FRAME"
)
if "&choice"=="DEM1X_F2_WALSH_ACC10_FRAME"
(
  per.view hwioreg.per "DEMOD,DEMOD_1X_OFFLINE,DEM1X_F2_WALSH_ACC10_FRAME"
)
if "&choice"=="DEM1X_F2_WALSH_ACC11_FRAME"
(
  per.view hwioreg.per "DEMOD,DEMOD_1X_OFFLINE,DEM1X_F2_WALSH_ACC11_FRAME"
)
if "&choice"=="DEM1X_F2_WALSH_ACC12_FRAME"
(
  per.view hwioreg.per "DEMOD,DEMOD_1X_OFFLINE,DEM1X_F2_WALSH_ACC12_FRAME"
)
if "&choice"=="DEM1X_F2_WALSH_ACC13_FRAME"
(
  per.view hwioreg.per "DEMOD,DEMOD_1X_OFFLINE,DEM1X_F2_WALSH_ACC13_FRAME"
)
if "&choice"=="DEM1X_F3_WALSH_ACC0_FRAME"
(
  per.view hwioreg.per "DEMOD,DEMOD_1X_OFFLINE,DEM1X_F3_WALSH_ACC0_FRAME"
)
if "&choice"=="DEM1X_F3_WALSH_ACC1_FRAME"
(
  per.view hwioreg.per "DEMOD,DEMOD_1X_OFFLINE,DEM1X_F3_WALSH_ACC1_FRAME"
)
if "&choice"=="DEM1X_F3_WALSH_ACC2_FRAME"
(
  per.view hwioreg.per "DEMOD,DEMOD_1X_OFFLINE,DEM1X_F3_WALSH_ACC2_FRAME"
)
if "&choice"=="DEM1X_F3_WALSH_ACC3_FRAME"
(
  per.view hwioreg.per "DEMOD,DEMOD_1X_OFFLINE,DEM1X_F3_WALSH_ACC3_FRAME"
)
if "&choice"=="DEM1X_F3_WALSH_ACC4_FRAME"
(
  per.view hwioreg.per "DEMOD,DEMOD_1X_OFFLINE,DEM1X_F3_WALSH_ACC4_FRAME"
)
if "&choice"=="DEM1X_F3_WALSH_ACC5_FRAME"
(
  per.view hwioreg.per "DEMOD,DEMOD_1X_OFFLINE,DEM1X_F3_WALSH_ACC5_FRAME"
)
if "&choice"=="DEM1X_F3_WALSH_ACC6_FRAME"
(
  per.view hwioreg.per "DEMOD,DEMOD_1X_OFFLINE,DEM1X_F3_WALSH_ACC6_FRAME"
)
if "&choice"=="DEM1X_F3_WALSH_ACC7_FRAME"
(
  per.view hwioreg.per "DEMOD,DEMOD_1X_OFFLINE,DEM1X_F3_WALSH_ACC7_FRAME"
)
if "&choice"=="DEM1X_F3_WALSH_ACC8_FRAME"
(
  per.view hwioreg.per "DEMOD,DEMOD_1X_OFFLINE,DEM1X_F3_WALSH_ACC8_FRAME"
)
if "&choice"=="DEM1X_F3_WALSH_ACC9_FRAME"
(
  per.view hwioreg.per "DEMOD,DEMOD_1X_OFFLINE,DEM1X_F3_WALSH_ACC9_FRAME"
)
if "&choice"=="DEM1X_F3_WALSH_ACC10_FRAME"
(
  per.view hwioreg.per "DEMOD,DEMOD_1X_OFFLINE,DEM1X_F3_WALSH_ACC10_FRAME"
)
if "&choice"=="DEM1X_F3_WALSH_ACC11_FRAME"
(
  per.view hwioreg.per "DEMOD,DEMOD_1X_OFFLINE,DEM1X_F3_WALSH_ACC11_FRAME"
)
if "&choice"=="DEM1X_F3_WALSH_ACC12_FRAME"
(
  per.view hwioreg.per "DEMOD,DEMOD_1X_OFFLINE,DEM1X_F3_WALSH_ACC12_FRAME"
)
if "&choice"=="DEM1X_F3_WALSH_ACC13_FRAME"
(
  per.view hwioreg.per "DEMOD,DEMOD_1X_OFFLINE,DEM1X_F3_WALSH_ACC13_FRAME"
)
if "&choice"=="DEM1X_F4_WALSH_ACC0_FRAME"
(
  per.view hwioreg.per "DEMOD,DEMOD_1X_OFFLINE,DEM1X_F4_WALSH_ACC0_FRAME"
)
if "&choice"=="DEM1X_F4_WALSH_ACC1_FRAME"
(
  per.view hwioreg.per "DEMOD,DEMOD_1X_OFFLINE,DEM1X_F4_WALSH_ACC1_FRAME"
)
if "&choice"=="DEM1X_F4_WALSH_ACC2_FRAME"
(
  per.view hwioreg.per "DEMOD,DEMOD_1X_OFFLINE,DEM1X_F4_WALSH_ACC2_FRAME"
)
if "&choice"=="DEM1X_F4_WALSH_ACC3_FRAME"
(
  per.view hwioreg.per "DEMOD,DEMOD_1X_OFFLINE,DEM1X_F4_WALSH_ACC3_FRAME"
)
if "&choice"=="DEM1X_F4_WALSH_ACC4_FRAME"
(
  per.view hwioreg.per "DEMOD,DEMOD_1X_OFFLINE,DEM1X_F4_WALSH_ACC4_FRAME"
)
if "&choice"=="DEM1X_F4_WALSH_ACC5_FRAME"
(
  per.view hwioreg.per "DEMOD,DEMOD_1X_OFFLINE,DEM1X_F4_WALSH_ACC5_FRAME"
)
if "&choice"=="DEM1X_F4_WALSH_ACC6_FRAME"
(
  per.view hwioreg.per "DEMOD,DEMOD_1X_OFFLINE,DEM1X_F4_WALSH_ACC6_FRAME"
)
if "&choice"=="DEM1X_F4_WALSH_ACC7_FRAME"
(
  per.view hwioreg.per "DEMOD,DEMOD_1X_OFFLINE,DEM1X_F4_WALSH_ACC7_FRAME"
)
if "&choice"=="DEM1X_F4_WALSH_ACC8_FRAME"
(
  per.view hwioreg.per "DEMOD,DEMOD_1X_OFFLINE,DEM1X_F4_WALSH_ACC8_FRAME"
)
if "&choice"=="DEM1X_F4_WALSH_ACC9_FRAME"
(
  per.view hwioreg.per "DEMOD,DEMOD_1X_OFFLINE,DEM1X_F4_WALSH_ACC9_FRAME"
)
if "&choice"=="DEM1X_F4_WALSH_ACC10_FRAME"
(
  per.view hwioreg.per "DEMOD,DEMOD_1X_OFFLINE,DEM1X_F4_WALSH_ACC10_FRAME"
)
if "&choice"=="DEM1X_F4_WALSH_ACC11_FRAME"
(
  per.view hwioreg.per "DEMOD,DEMOD_1X_OFFLINE,DEM1X_F4_WALSH_ACC11_FRAME"
)
if "&choice"=="DEM1X_F4_WALSH_ACC12_FRAME"
(
  per.view hwioreg.per "DEMOD,DEMOD_1X_OFFLINE,DEM1X_F4_WALSH_ACC12_FRAME"
)
if "&choice"=="DEM1X_F4_WALSH_ACC13_FRAME"
(
  per.view hwioreg.per "DEMOD,DEMOD_1X_OFFLINE,DEM1X_F4_WALSH_ACC13_FRAME"
)
if "&choice"=="DEM1X_F5_WALSH_ACC0_FRAME"
(
  per.view hwioreg.per "DEMOD,DEMOD_1X_OFFLINE,DEM1X_F5_WALSH_ACC0_FRAME"
)
if "&choice"=="DEM1X_F5_WALSH_ACC1_FRAME"
(
  per.view hwioreg.per "DEMOD,DEMOD_1X_OFFLINE,DEM1X_F5_WALSH_ACC1_FRAME"
)
if "&choice"=="DEM1X_F5_WALSH_ACC2_FRAME"
(
  per.view hwioreg.per "DEMOD,DEMOD_1X_OFFLINE,DEM1X_F5_WALSH_ACC2_FRAME"
)
if "&choice"=="DEM1X_F5_WALSH_ACC3_FRAME"
(
  per.view hwioreg.per "DEMOD,DEMOD_1X_OFFLINE,DEM1X_F5_WALSH_ACC3_FRAME"
)
if "&choice"=="DEM1X_F5_WALSH_ACC4_FRAME"
(
  per.view hwioreg.per "DEMOD,DEMOD_1X_OFFLINE,DEM1X_F5_WALSH_ACC4_FRAME"
)
if "&choice"=="DEM1X_F5_WALSH_ACC5_FRAME"
(
  per.view hwioreg.per "DEMOD,DEMOD_1X_OFFLINE,DEM1X_F5_WALSH_ACC5_FRAME"
)
if "&choice"=="DEM1X_F5_WALSH_ACC6_FRAME"
(
  per.view hwioreg.per "DEMOD,DEMOD_1X_OFFLINE,DEM1X_F5_WALSH_ACC6_FRAME"
)
if "&choice"=="DEM1X_F5_WALSH_ACC7_FRAME"
(
  per.view hwioreg.per "DEMOD,DEMOD_1X_OFFLINE,DEM1X_F5_WALSH_ACC7_FRAME"
)
if "&choice"=="DEM1X_F5_WALSH_ACC8_FRAME"
(
  per.view hwioreg.per "DEMOD,DEMOD_1X_OFFLINE,DEM1X_F5_WALSH_ACC8_FRAME"
)
if "&choice"=="DEM1X_F5_WALSH_ACC9_FRAME"
(
  per.view hwioreg.per "DEMOD,DEMOD_1X_OFFLINE,DEM1X_F5_WALSH_ACC9_FRAME"
)
if "&choice"=="DEM1X_F5_WALSH_ACC10_FRAME"
(
  per.view hwioreg.per "DEMOD,DEMOD_1X_OFFLINE,DEM1X_F5_WALSH_ACC10_FRAME"
)
if "&choice"=="DEM1X_F5_WALSH_ACC11_FRAME"
(
  per.view hwioreg.per "DEMOD,DEMOD_1X_OFFLINE,DEM1X_F5_WALSH_ACC11_FRAME"
)
if "&choice"=="DEM1X_F5_WALSH_ACC12_FRAME"
(
  per.view hwioreg.per "DEMOD,DEMOD_1X_OFFLINE,DEM1X_F5_WALSH_ACC12_FRAME"
)
if "&choice"=="DEM1X_F5_WALSH_ACC13_FRAME"
(
  per.view hwioreg.per "DEMOD,DEMOD_1X_OFFLINE,DEM1X_F5_WALSH_ACC13_FRAME"
)
if "&choice"=="DEM1X_F6_WALSH_ACC0_FRAME"
(
  per.view hwioreg.per "DEMOD,DEMOD_1X_OFFLINE,DEM1X_F6_WALSH_ACC0_FRAME"
)
if "&choice"=="DEM1X_F6_WALSH_ACC1_FRAME"
(
  per.view hwioreg.per "DEMOD,DEMOD_1X_OFFLINE,DEM1X_F6_WALSH_ACC1_FRAME"
)
if "&choice"=="DEM1X_F6_WALSH_ACC2_FRAME"
(
  per.view hwioreg.per "DEMOD,DEMOD_1X_OFFLINE,DEM1X_F6_WALSH_ACC2_FRAME"
)
if "&choice"=="DEM1X_F6_WALSH_ACC3_FRAME"
(
  per.view hwioreg.per "DEMOD,DEMOD_1X_OFFLINE,DEM1X_F6_WALSH_ACC3_FRAME"
)
if "&choice"=="DEM1X_F6_WALSH_ACC4_FRAME"
(
  per.view hwioreg.per "DEMOD,DEMOD_1X_OFFLINE,DEM1X_F6_WALSH_ACC4_FRAME"
)
if "&choice"=="DEM1X_F6_WALSH_ACC5_FRAME"
(
  per.view hwioreg.per "DEMOD,DEMOD_1X_OFFLINE,DEM1X_F6_WALSH_ACC5_FRAME"
)
if "&choice"=="DEM1X_F6_WALSH_ACC6_FRAME"
(
  per.view hwioreg.per "DEMOD,DEMOD_1X_OFFLINE,DEM1X_F6_WALSH_ACC6_FRAME"
)
if "&choice"=="DEM1X_F6_WALSH_ACC7_FRAME"
(
  per.view hwioreg.per "DEMOD,DEMOD_1X_OFFLINE,DEM1X_F6_WALSH_ACC7_FRAME"
)
if "&choice"=="DEM1X_F6_WALSH_ACC8_FRAME"
(
  per.view hwioreg.per "DEMOD,DEMOD_1X_OFFLINE,DEM1X_F6_WALSH_ACC8_FRAME"
)
if "&choice"=="DEM1X_F6_WALSH_ACC9_FRAME"
(
  per.view hwioreg.per "DEMOD,DEMOD_1X_OFFLINE,DEM1X_F6_WALSH_ACC9_FRAME"
)
if "&choice"=="DEM1X_F6_WALSH_ACC10_FRAME"
(
  per.view hwioreg.per "DEMOD,DEMOD_1X_OFFLINE,DEM1X_F6_WALSH_ACC10_FRAME"
)
if "&choice"=="DEM1X_F6_WALSH_ACC11_FRAME"
(
  per.view hwioreg.per "DEMOD,DEMOD_1X_OFFLINE,DEM1X_F6_WALSH_ACC11_FRAME"
)
if "&choice"=="DEM1X_F6_WALSH_ACC12_FRAME"
(
  per.view hwioreg.per "DEMOD,DEMOD_1X_OFFLINE,DEM1X_F6_WALSH_ACC12_FRAME"
)
if "&choice"=="DEM1X_F6_WALSH_ACC13_FRAME"
(
  per.view hwioreg.per "DEMOD,DEMOD_1X_OFFLINE,DEM1X_F6_WALSH_ACC13_FRAME"
)
if "&choice"=="DEM1X_F7_WALSH_ACC0_FRAME"
(
  per.view hwioreg.per "DEMOD,DEMOD_1X_OFFLINE,DEM1X_F7_WALSH_ACC0_FRAME"
)
if "&choice"=="DEM1X_F7_WALSH_ACC1_FRAME"
(
  per.view hwioreg.per "DEMOD,DEMOD_1X_OFFLINE,DEM1X_F7_WALSH_ACC1_FRAME"
)
if "&choice"=="DEM1X_F7_WALSH_ACC2_FRAME"
(
  per.view hwioreg.per "DEMOD,DEMOD_1X_OFFLINE,DEM1X_F7_WALSH_ACC2_FRAME"
)
if "&choice"=="DEM1X_F7_WALSH_ACC3_FRAME"
(
  per.view hwioreg.per "DEMOD,DEMOD_1X_OFFLINE,DEM1X_F7_WALSH_ACC3_FRAME"
)
if "&choice"=="DEM1X_F7_WALSH_ACC4_FRAME"
(
  per.view hwioreg.per "DEMOD,DEMOD_1X_OFFLINE,DEM1X_F7_WALSH_ACC4_FRAME"
)
if "&choice"=="DEM1X_F7_WALSH_ACC5_FRAME"
(
  per.view hwioreg.per "DEMOD,DEMOD_1X_OFFLINE,DEM1X_F7_WALSH_ACC5_FRAME"
)
if "&choice"=="DEM1X_F7_WALSH_ACC6_FRAME"
(
  per.view hwioreg.per "DEMOD,DEMOD_1X_OFFLINE,DEM1X_F7_WALSH_ACC6_FRAME"
)
if "&choice"=="DEM1X_F7_WALSH_ACC7_FRAME"
(
  per.view hwioreg.per "DEMOD,DEMOD_1X_OFFLINE,DEM1X_F7_WALSH_ACC7_FRAME"
)
if "&choice"=="DEM1X_F7_WALSH_ACC8_FRAME"
(
  per.view hwioreg.per "DEMOD,DEMOD_1X_OFFLINE,DEM1X_F7_WALSH_ACC8_FRAME"
)
if "&choice"=="DEM1X_F7_WALSH_ACC9_FRAME"
(
  per.view hwioreg.per "DEMOD,DEMOD_1X_OFFLINE,DEM1X_F7_WALSH_ACC9_FRAME"
)
if "&choice"=="DEM1X_F7_WALSH_ACC10_FRAME"
(
  per.view hwioreg.per "DEMOD,DEMOD_1X_OFFLINE,DEM1X_F7_WALSH_ACC10_FRAME"
)
if "&choice"=="DEM1X_F7_WALSH_ACC11_FRAME"
(
  per.view hwioreg.per "DEMOD,DEMOD_1X_OFFLINE,DEM1X_F7_WALSH_ACC11_FRAME"
)
if "&choice"=="DEM1X_F7_WALSH_ACC12_FRAME"
(
  per.view hwioreg.per "DEMOD,DEMOD_1X_OFFLINE,DEM1X_F7_WALSH_ACC12_FRAME"
)
if "&choice"=="DEM1X_F7_WALSH_ACC13_FRAME"
(
  per.view hwioreg.per "DEMOD,DEMOD_1X_OFFLINE,DEM1X_F7_WALSH_ACC13_FRAME"
)
if "&choice"=="DEM1X_F0_HW_CH1_IMMED"
(
  per.view hwioreg.per "DEMOD,DEMOD_1X_OFFLINE,DEM1X_F0_HW_CH1_IMMED"
)
if "&choice"=="DEM1X_F1_HW_CH1_IMMED"
(
  per.view hwioreg.per "DEMOD,DEMOD_1X_OFFLINE,DEM1X_F1_HW_CH1_IMMED"
)
if "&choice"=="DEM1X_F2_HW_CH1_IMMED"
(
  per.view hwioreg.per "DEMOD,DEMOD_1X_OFFLINE,DEM1X_F2_HW_CH1_IMMED"
)
if "&choice"=="DEM1X_F3_HW_CH1_IMMED"
(
  per.view hwioreg.per "DEMOD,DEMOD_1X_OFFLINE,DEM1X_F3_HW_CH1_IMMED"
)
if "&choice"=="DEM1X_F4_HW_CH1_IMMED"
(
  per.view hwioreg.per "DEMOD,DEMOD_1X_OFFLINE,DEM1X_F4_HW_CH1_IMMED"
)
if "&choice"=="DEM1X_F5_HW_CH1_IMMED"
(
  per.view hwioreg.per "DEMOD,DEMOD_1X_OFFLINE,DEM1X_F5_HW_CH1_IMMED"
)
if "&choice"=="DEM1X_F6_HW_CH1_IMMED"
(
  per.view hwioreg.per "DEMOD,DEMOD_1X_OFFLINE,DEM1X_F6_HW_CH1_IMMED"
)
if "&choice"=="DEM1X_F7_HW_CH1_IMMED"
(
  per.view hwioreg.per "DEMOD,DEMOD_1X_OFFLINE,DEM1X_F7_HW_CH1_IMMED"
)
if "&choice"=="DEM1X_F0_HW_CH1_FRAME"
(
  per.view hwioreg.per "DEMOD,DEMOD_1X_OFFLINE,DEM1X_F0_HW_CH1_FRAME"
)
if "&choice"=="DEM1X_F1_HW_CH1_FRAME"
(
  per.view hwioreg.per "DEMOD,DEMOD_1X_OFFLINE,DEM1X_F1_HW_CH1_FRAME"
)
if "&choice"=="DEM1X_F2_HW_CH1_FRAME"
(
  per.view hwioreg.per "DEMOD,DEMOD_1X_OFFLINE,DEM1X_F2_HW_CH1_FRAME"
)
if "&choice"=="DEM1X_F3_HW_CH1_FRAME"
(
  per.view hwioreg.per "DEMOD,DEMOD_1X_OFFLINE,DEM1X_F3_HW_CH1_FRAME"
)
if "&choice"=="DEM1X_F4_HW_CH1_FRAME"
(
  per.view hwioreg.per "DEMOD,DEMOD_1X_OFFLINE,DEM1X_F4_HW_CH1_FRAME"
)
if "&choice"=="DEM1X_F5_HW_CH1_FRAME"
(
  per.view hwioreg.per "DEMOD,DEMOD_1X_OFFLINE,DEM1X_F5_HW_CH1_FRAME"
)
if "&choice"=="DEM1X_F6_HW_CH1_FRAME"
(
  per.view hwioreg.per "DEMOD,DEMOD_1X_OFFLINE,DEM1X_F6_HW_CH1_FRAME"
)
if "&choice"=="DEM1X_F7_HW_CH1_FRAME"
(
  per.view hwioreg.per "DEMOD,DEMOD_1X_OFFLINE,DEM1X_F7_HW_CH1_FRAME"
)
if "&choice"=="DEM1X_F0_HW_CH2_IMMED"
(
  per.view hwioreg.per "DEMOD,DEMOD_1X_OFFLINE,DEM1X_F0_HW_CH2_IMMED"
)
if "&choice"=="DEM1X_F1_HW_CH2_IMMED"
(
  per.view hwioreg.per "DEMOD,DEMOD_1X_OFFLINE,DEM1X_F1_HW_CH2_IMMED"
)
if "&choice"=="DEM1X_F2_HW_CH2_IMMED"
(
  per.view hwioreg.per "DEMOD,DEMOD_1X_OFFLINE,DEM1X_F2_HW_CH2_IMMED"
)
if "&choice"=="DEM1X_F3_HW_CH2_IMMED"
(
  per.view hwioreg.per "DEMOD,DEMOD_1X_OFFLINE,DEM1X_F3_HW_CH2_IMMED"
)
if "&choice"=="DEM1X_F4_HW_CH2_IMMED"
(
  per.view hwioreg.per "DEMOD,DEMOD_1X_OFFLINE,DEM1X_F4_HW_CH2_IMMED"
)
if "&choice"=="DEM1X_F5_HW_CH2_IMMED"
(
  per.view hwioreg.per "DEMOD,DEMOD_1X_OFFLINE,DEM1X_F5_HW_CH2_IMMED"
)
if "&choice"=="DEM1X_F6_HW_CH2_IMMED"
(
  per.view hwioreg.per "DEMOD,DEMOD_1X_OFFLINE,DEM1X_F6_HW_CH2_IMMED"
)
if "&choice"=="DEM1X_F7_HW_CH2_IMMED"
(
  per.view hwioreg.per "DEMOD,DEMOD_1X_OFFLINE,DEM1X_F7_HW_CH2_IMMED"
)
if "&choice"=="DEM1X_F0_HW_CH2_FRAME"
(
  per.view hwioreg.per "DEMOD,DEMOD_1X_OFFLINE,DEM1X_F0_HW_CH2_FRAME"
)
if "&choice"=="DEM1X_F1_HW_CH2_FRAME"
(
  per.view hwioreg.per "DEMOD,DEMOD_1X_OFFLINE,DEM1X_F1_HW_CH2_FRAME"
)
if "&choice"=="DEM1X_F2_HW_CH2_FRAME"
(
  per.view hwioreg.per "DEMOD,DEMOD_1X_OFFLINE,DEM1X_F2_HW_CH2_FRAME"
)
if "&choice"=="DEM1X_F3_HW_CH2_FRAME"
(
  per.view hwioreg.per "DEMOD,DEMOD_1X_OFFLINE,DEM1X_F3_HW_CH2_FRAME"
)
if "&choice"=="DEM1X_F4_HW_CH2_FRAME"
(
  per.view hwioreg.per "DEMOD,DEMOD_1X_OFFLINE,DEM1X_F4_HW_CH2_FRAME"
)
if "&choice"=="DEM1X_F5_HW_CH2_FRAME"
(
  per.view hwioreg.per "DEMOD,DEMOD_1X_OFFLINE,DEM1X_F5_HW_CH2_FRAME"
)
if "&choice"=="DEM1X_F6_HW_CH2_FRAME"
(
  per.view hwioreg.per "DEMOD,DEMOD_1X_OFFLINE,DEM1X_F6_HW_CH2_FRAME"
)
if "&choice"=="DEM1X_F7_HW_CH2_FRAME"
(
  per.view hwioreg.per "DEMOD,DEMOD_1X_OFFLINE,DEM1X_F7_HW_CH2_FRAME"
)
if "&choice"=="DEM1X_F0_HW_CH3_IMMED"
(
  per.view hwioreg.per "DEMOD,DEMOD_1X_OFFLINE,DEM1X_F0_HW_CH3_IMMED"
)
if "&choice"=="DEM1X_F1_HW_CH3_IMMED"
(
  per.view hwioreg.per "DEMOD,DEMOD_1X_OFFLINE,DEM1X_F1_HW_CH3_IMMED"
)
if "&choice"=="DEM1X_F2_HW_CH3_IMMED"
(
  per.view hwioreg.per "DEMOD,DEMOD_1X_OFFLINE,DEM1X_F2_HW_CH3_IMMED"
)
if "&choice"=="DEM1X_F3_HW_CH3_IMMED"
(
  per.view hwioreg.per "DEMOD,DEMOD_1X_OFFLINE,DEM1X_F3_HW_CH3_IMMED"
)
if "&choice"=="DEM1X_F4_HW_CH3_IMMED"
(
  per.view hwioreg.per "DEMOD,DEMOD_1X_OFFLINE,DEM1X_F4_HW_CH3_IMMED"
)
if "&choice"=="DEM1X_F5_HW_CH3_IMMED"
(
  per.view hwioreg.per "DEMOD,DEMOD_1X_OFFLINE,DEM1X_F5_HW_CH3_IMMED"
)
if "&choice"=="DEM1X_F6_HW_CH3_IMMED"
(
  per.view hwioreg.per "DEMOD,DEMOD_1X_OFFLINE,DEM1X_F6_HW_CH3_IMMED"
)
if "&choice"=="DEM1X_F7_HW_CH3_IMMED"
(
  per.view hwioreg.per "DEMOD,DEMOD_1X_OFFLINE,DEM1X_F7_HW_CH3_IMMED"
)
if "&choice"=="DEM1X_F0_HW_CH3_FRAME"
(
  per.view hwioreg.per "DEMOD,DEMOD_1X_OFFLINE,DEM1X_F0_HW_CH3_FRAME"
)
if "&choice"=="DEM1X_F1_HW_CH3_FRAME"
(
  per.view hwioreg.per "DEMOD,DEMOD_1X_OFFLINE,DEM1X_F1_HW_CH3_FRAME"
)
if "&choice"=="DEM1X_F2_HW_CH3_FRAME"
(
  per.view hwioreg.per "DEMOD,DEMOD_1X_OFFLINE,DEM1X_F2_HW_CH3_FRAME"
)
if "&choice"=="DEM1X_F3_HW_CH3_FRAME"
(
  per.view hwioreg.per "DEMOD,DEMOD_1X_OFFLINE,DEM1X_F3_HW_CH3_FRAME"
)
if "&choice"=="DEM1X_F4_HW_CH3_FRAME"
(
  per.view hwioreg.per "DEMOD,DEMOD_1X_OFFLINE,DEM1X_F4_HW_CH3_FRAME"
)
if "&choice"=="DEM1X_F5_HW_CH3_FRAME"
(
  per.view hwioreg.per "DEMOD,DEMOD_1X_OFFLINE,DEM1X_F5_HW_CH3_FRAME"
)
if "&choice"=="DEM1X_F6_HW_CH3_FRAME"
(
  per.view hwioreg.per "DEMOD,DEMOD_1X_OFFLINE,DEM1X_F6_HW_CH3_FRAME"
)
if "&choice"=="DEM1X_F7_HW_CH3_FRAME"
(
  per.view hwioreg.per "DEMOD,DEMOD_1X_OFFLINE,DEM1X_F7_HW_CH3_FRAME"
)
if "&choice"=="DEM1X_F0_WALSH_ACC14_IMMED"
(
  per.view hwioreg.per "DEMOD,DEMOD_1X_OFFLINE,DEM1X_F0_WALSH_ACC14_IMMED"
)
if "&choice"=="DEM1X_F0_WALSH_ACC15_IMMED"
(
  per.view hwioreg.per "DEMOD,DEMOD_1X_OFFLINE,DEM1X_F0_WALSH_ACC15_IMMED"
)
if "&choice"=="DEM1X_F0_WALSH_ACC16_IMMED"
(
  per.view hwioreg.per "DEMOD,DEMOD_1X_OFFLINE,DEM1X_F0_WALSH_ACC16_IMMED"
)
if "&choice"=="DEM1X_F0_WALSH_ACC17_IMMED"
(
  per.view hwioreg.per "DEMOD,DEMOD_1X_OFFLINE,DEM1X_F0_WALSH_ACC17_IMMED"
)
if "&choice"=="DEM1X_F0_WALSH_ACC18_IMMED"
(
  per.view hwioreg.per "DEMOD,DEMOD_1X_OFFLINE,DEM1X_F0_WALSH_ACC18_IMMED"
)
if "&choice"=="DEM1X_F0_WALSH_ACC19_IMMED"
(
  per.view hwioreg.per "DEMOD,DEMOD_1X_OFFLINE,DEM1X_F0_WALSH_ACC19_IMMED"
)
if "&choice"=="DEM1X_F0_WALSH_ACC20_IMMED"
(
  per.view hwioreg.per "DEMOD,DEMOD_1X_OFFLINE,DEM1X_F0_WALSH_ACC20_IMMED"
)
if "&choice"=="DEM1X_F0_WALSH_ACC21_IMMED"
(
  per.view hwioreg.per "DEMOD,DEMOD_1X_OFFLINE,DEM1X_F0_WALSH_ACC21_IMMED"
)
if "&choice"=="DEM1X_F1_WALSH_ACC14_IMMED"
(
  per.view hwioreg.per "DEMOD,DEMOD_1X_OFFLINE,DEM1X_F1_WALSH_ACC14_IMMED"
)
if "&choice"=="DEM1X_F1_WALSH_ACC15_IMMED"
(
  per.view hwioreg.per "DEMOD,DEMOD_1X_OFFLINE,DEM1X_F1_WALSH_ACC15_IMMED"
)
if "&choice"=="DEM1X_F1_WALSH_ACC16_IMMED"
(
  per.view hwioreg.per "DEMOD,DEMOD_1X_OFFLINE,DEM1X_F1_WALSH_ACC16_IMMED"
)
if "&choice"=="DEM1X_F1_WALSH_ACC17_IMMED"
(
  per.view hwioreg.per "DEMOD,DEMOD_1X_OFFLINE,DEM1X_F1_WALSH_ACC17_IMMED"
)
if "&choice"=="DEM1X_F1_WALSH_ACC18_IMMED"
(
  per.view hwioreg.per "DEMOD,DEMOD_1X_OFFLINE,DEM1X_F1_WALSH_ACC18_IMMED"
)
if "&choice"=="DEM1X_F1_WALSH_ACC19_IMMED"
(
  per.view hwioreg.per "DEMOD,DEMOD_1X_OFFLINE,DEM1X_F1_WALSH_ACC19_IMMED"
)
if "&choice"=="DEM1X_F1_WALSH_ACC20_IMMED"
(
  per.view hwioreg.per "DEMOD,DEMOD_1X_OFFLINE,DEM1X_F1_WALSH_ACC20_IMMED"
)
if "&choice"=="DEM1X_F1_WALSH_ACC21_IMMED"
(
  per.view hwioreg.per "DEMOD,DEMOD_1X_OFFLINE,DEM1X_F1_WALSH_ACC21_IMMED"
)
if "&choice"=="DEM1X_F2_WALSH_ACC14_IMMED"
(
  per.view hwioreg.per "DEMOD,DEMOD_1X_OFFLINE,DEM1X_F2_WALSH_ACC14_IMMED"
)
if "&choice"=="DEM1X_F2_WALSH_ACC15_IMMED"
(
  per.view hwioreg.per "DEMOD,DEMOD_1X_OFFLINE,DEM1X_F2_WALSH_ACC15_IMMED"
)
if "&choice"=="DEM1X_F2_WALSH_ACC16_IMMED"
(
  per.view hwioreg.per "DEMOD,DEMOD_1X_OFFLINE,DEM1X_F2_WALSH_ACC16_IMMED"
)
if "&choice"=="DEM1X_F2_WALSH_ACC17_IMMED"
(
  per.view hwioreg.per "DEMOD,DEMOD_1X_OFFLINE,DEM1X_F2_WALSH_ACC17_IMMED"
)
if "&choice"=="DEM1X_F2_WALSH_ACC18_IMMED"
(
  per.view hwioreg.per "DEMOD,DEMOD_1X_OFFLINE,DEM1X_F2_WALSH_ACC18_IMMED"
)
if "&choice"=="DEM1X_F2_WALSH_ACC19_IMMED"
(
  per.view hwioreg.per "DEMOD,DEMOD_1X_OFFLINE,DEM1X_F2_WALSH_ACC19_IMMED"
)
if "&choice"=="DEM1X_F2_WALSH_ACC20_IMMED"
(
  per.view hwioreg.per "DEMOD,DEMOD_1X_OFFLINE,DEM1X_F2_WALSH_ACC20_IMMED"
)
if "&choice"=="DEM1X_F2_WALSH_ACC21_IMMED"
(
  per.view hwioreg.per "DEMOD,DEMOD_1X_OFFLINE,DEM1X_F2_WALSH_ACC21_IMMED"
)
if "&choice"=="DEM1X_F3_WALSH_ACC14_IMMED"
(
  per.view hwioreg.per "DEMOD,DEMOD_1X_OFFLINE,DEM1X_F3_WALSH_ACC14_IMMED"
)
if "&choice"=="DEM1X_F3_WALSH_ACC15_IMMED"
(
  per.view hwioreg.per "DEMOD,DEMOD_1X_OFFLINE,DEM1X_F3_WALSH_ACC15_IMMED"
)
if "&choice"=="DEM1X_F3_WALSH_ACC16_IMMED"
(
  per.view hwioreg.per "DEMOD,DEMOD_1X_OFFLINE,DEM1X_F3_WALSH_ACC16_IMMED"
)
if "&choice"=="DEM1X_F3_WALSH_ACC17_IMMED"
(
  per.view hwioreg.per "DEMOD,DEMOD_1X_OFFLINE,DEM1X_F3_WALSH_ACC17_IMMED"
)
if "&choice"=="DEM1X_F3_WALSH_ACC18_IMMED"
(
  per.view hwioreg.per "DEMOD,DEMOD_1X_OFFLINE,DEM1X_F3_WALSH_ACC18_IMMED"
)
if "&choice"=="DEM1X_F3_WALSH_ACC19_IMMED"
(
  per.view hwioreg.per "DEMOD,DEMOD_1X_OFFLINE,DEM1X_F3_WALSH_ACC19_IMMED"
)
if "&choice"=="DEM1X_F3_WALSH_ACC20_IMMED"
(
  per.view hwioreg.per "DEMOD,DEMOD_1X_OFFLINE,DEM1X_F3_WALSH_ACC20_IMMED"
)
if "&choice"=="DEM1X_F3_WALSH_ACC21_IMMED"
(
  per.view hwioreg.per "DEMOD,DEMOD_1X_OFFLINE,DEM1X_F3_WALSH_ACC21_IMMED"
)
if "&choice"=="DEM1X_F4_WALSH_ACC14_IMMED"
(
  per.view hwioreg.per "DEMOD,DEMOD_1X_OFFLINE,DEM1X_F4_WALSH_ACC14_IMMED"
)
if "&choice"=="DEM1X_F4_WALSH_ACC15_IMMED"
(
  per.view hwioreg.per "DEMOD,DEMOD_1X_OFFLINE,DEM1X_F4_WALSH_ACC15_IMMED"
)
if "&choice"=="DEM1X_F4_WALSH_ACC16_IMMED"
(
  per.view hwioreg.per "DEMOD,DEMOD_1X_OFFLINE,DEM1X_F4_WALSH_ACC16_IMMED"
)
if "&choice"=="DEM1X_F4_WALSH_ACC17_IMMED"
(
  per.view hwioreg.per "DEMOD,DEMOD_1X_OFFLINE,DEM1X_F4_WALSH_ACC17_IMMED"
)
if "&choice"=="DEM1X_F4_WALSH_ACC18_IMMED"
(
  per.view hwioreg.per "DEMOD,DEMOD_1X_OFFLINE,DEM1X_F4_WALSH_ACC18_IMMED"
)
if "&choice"=="DEM1X_F4_WALSH_ACC19_IMMED"
(
  per.view hwioreg.per "DEMOD,DEMOD_1X_OFFLINE,DEM1X_F4_WALSH_ACC19_IMMED"
)
if "&choice"=="DEM1X_F4_WALSH_ACC20_IMMED"
(
  per.view hwioreg.per "DEMOD,DEMOD_1X_OFFLINE,DEM1X_F4_WALSH_ACC20_IMMED"
)
if "&choice"=="DEM1X_F4_WALSH_ACC21_IMMED"
(
  per.view hwioreg.per "DEMOD,DEMOD_1X_OFFLINE,DEM1X_F4_WALSH_ACC21_IMMED"
)
if "&choice"=="DEM1X_F5_WALSH_ACC14_IMMED"
(
  per.view hwioreg.per "DEMOD,DEMOD_1X_OFFLINE,DEM1X_F5_WALSH_ACC14_IMMED"
)
if "&choice"=="DEM1X_F5_WALSH_ACC15_IMMED"
(
  per.view hwioreg.per "DEMOD,DEMOD_1X_OFFLINE,DEM1X_F5_WALSH_ACC15_IMMED"
)
if "&choice"=="DEM1X_F5_WALSH_ACC16_IMMED"
(
  per.view hwioreg.per "DEMOD,DEMOD_1X_OFFLINE,DEM1X_F5_WALSH_ACC16_IMMED"
)
if "&choice"=="DEM1X_F5_WALSH_ACC17_IMMED"
(
  per.view hwioreg.per "DEMOD,DEMOD_1X_OFFLINE,DEM1X_F5_WALSH_ACC17_IMMED"
)
if "&choice"=="DEM1X_F5_WALSH_ACC18_IMMED"
(
  per.view hwioreg.per "DEMOD,DEMOD_1X_OFFLINE,DEM1X_F5_WALSH_ACC18_IMMED"
)
if "&choice"=="DEM1X_F5_WALSH_ACC19_IMMED"
(
  per.view hwioreg.per "DEMOD,DEMOD_1X_OFFLINE,DEM1X_F5_WALSH_ACC19_IMMED"
)
if "&choice"=="DEM1X_F5_WALSH_ACC20_IMMED"
(
  per.view hwioreg.per "DEMOD,DEMOD_1X_OFFLINE,DEM1X_F5_WALSH_ACC20_IMMED"
)
if "&choice"=="DEM1X_F5_WALSH_ACC21_IMMED"
(
  per.view hwioreg.per "DEMOD,DEMOD_1X_OFFLINE,DEM1X_F5_WALSH_ACC21_IMMED"
)
if "&choice"=="DEM1X_F6_WALSH_ACC14_IMMED"
(
  per.view hwioreg.per "DEMOD,DEMOD_1X_OFFLINE,DEM1X_F6_WALSH_ACC14_IMMED"
)
if "&choice"=="DEM1X_F6_WALSH_ACC15_IMMED"
(
  per.view hwioreg.per "DEMOD,DEMOD_1X_OFFLINE,DEM1X_F6_WALSH_ACC15_IMMED"
)
if "&choice"=="DEM1X_F6_WALSH_ACC16_IMMED"
(
  per.view hwioreg.per "DEMOD,DEMOD_1X_OFFLINE,DEM1X_F6_WALSH_ACC16_IMMED"
)
if "&choice"=="DEM1X_F6_WALSH_ACC17_IMMED"
(
  per.view hwioreg.per "DEMOD,DEMOD_1X_OFFLINE,DEM1X_F6_WALSH_ACC17_IMMED"
)
if "&choice"=="DEM1X_F6_WALSH_ACC18_IMMED"
(
  per.view hwioreg.per "DEMOD,DEMOD_1X_OFFLINE,DEM1X_F6_WALSH_ACC18_IMMED"
)
if "&choice"=="DEM1X_F6_WALSH_ACC19_IMMED"
(
  per.view hwioreg.per "DEMOD,DEMOD_1X_OFFLINE,DEM1X_F6_WALSH_ACC19_IMMED"
)
if "&choice"=="DEM1X_F6_WALSH_ACC20_IMMED"
(
  per.view hwioreg.per "DEMOD,DEMOD_1X_OFFLINE,DEM1X_F6_WALSH_ACC20_IMMED"
)
if "&choice"=="DEM1X_F6_WALSH_ACC21_IMMED"
(
  per.view hwioreg.per "DEMOD,DEMOD_1X_OFFLINE,DEM1X_F6_WALSH_ACC21_IMMED"
)
if "&choice"=="DEM1X_F7_WALSH_ACC14_IMMED"
(
  per.view hwioreg.per "DEMOD,DEMOD_1X_OFFLINE,DEM1X_F7_WALSH_ACC14_IMMED"
)
if "&choice"=="DEM1X_F7_WALSH_ACC15_IMMED"
(
  per.view hwioreg.per "DEMOD,DEMOD_1X_OFFLINE,DEM1X_F7_WALSH_ACC15_IMMED"
)
if "&choice"=="DEM1X_F7_WALSH_ACC16_IMMED"
(
  per.view hwioreg.per "DEMOD,DEMOD_1X_OFFLINE,DEM1X_F7_WALSH_ACC16_IMMED"
)
if "&choice"=="DEM1X_F7_WALSH_ACC17_IMMED"
(
  per.view hwioreg.per "DEMOD,DEMOD_1X_OFFLINE,DEM1X_F7_WALSH_ACC17_IMMED"
)
if "&choice"=="DEM1X_F7_WALSH_ACC18_IMMED"
(
  per.view hwioreg.per "DEMOD,DEMOD_1X_OFFLINE,DEM1X_F7_WALSH_ACC18_IMMED"
)
if "&choice"=="DEM1X_F7_WALSH_ACC19_IMMED"
(
  per.view hwioreg.per "DEMOD,DEMOD_1X_OFFLINE,DEM1X_F7_WALSH_ACC19_IMMED"
)
if "&choice"=="DEM1X_F7_WALSH_ACC20_IMMED"
(
  per.view hwioreg.per "DEMOD,DEMOD_1X_OFFLINE,DEM1X_F7_WALSH_ACC20_IMMED"
)
if "&choice"=="DEM1X_F7_WALSH_ACC21_IMMED"
(
  per.view hwioreg.per "DEMOD,DEMOD_1X_OFFLINE,DEM1X_F7_WALSH_ACC21_IMMED"
)
if "&choice"=="DEM1X_F0_WALSH_ACC14_FRAME"
(
  per.view hwioreg.per "DEMOD,DEMOD_1X_OFFLINE,DEM1X_F0_WALSH_ACC14_FRAME"
)
if "&choice"=="DEM1X_F0_WALSH_ACC15_FRAME"
(
  per.view hwioreg.per "DEMOD,DEMOD_1X_OFFLINE,DEM1X_F0_WALSH_ACC15_FRAME"
)
if "&choice"=="DEM1X_F0_WALSH_ACC16_FRAME"
(
  per.view hwioreg.per "DEMOD,DEMOD_1X_OFFLINE,DEM1X_F0_WALSH_ACC16_FRAME"
)
if "&choice"=="DEM1X_F0_WALSH_ACC17_FRAME"
(
  per.view hwioreg.per "DEMOD,DEMOD_1X_OFFLINE,DEM1X_F0_WALSH_ACC17_FRAME"
)
if "&choice"=="DEM1X_F0_WALSH_ACC18_FRAME"
(
  per.view hwioreg.per "DEMOD,DEMOD_1X_OFFLINE,DEM1X_F0_WALSH_ACC18_FRAME"
)
if "&choice"=="DEM1X_F0_WALSH_ACC19_FRAME"
(
  per.view hwioreg.per "DEMOD,DEMOD_1X_OFFLINE,DEM1X_F0_WALSH_ACC19_FRAME"
)
if "&choice"=="DEM1X_F0_WALSH_ACC20_FRAME"
(
  per.view hwioreg.per "DEMOD,DEMOD_1X_OFFLINE,DEM1X_F0_WALSH_ACC20_FRAME"
)
if "&choice"=="DEM1X_F0_WALSH_ACC21_FRAME"
(
  per.view hwioreg.per "DEMOD,DEMOD_1X_OFFLINE,DEM1X_F0_WALSH_ACC21_FRAME"
)
if "&choice"=="DEM1X_F1_WALSH_ACC14_FRAME"
(
  per.view hwioreg.per "DEMOD,DEMOD_1X_OFFLINE,DEM1X_F1_WALSH_ACC14_FRAME"
)
if "&choice"=="DEM1X_F1_WALSH_ACC15_FRAME"
(
  per.view hwioreg.per "DEMOD,DEMOD_1X_OFFLINE,DEM1X_F1_WALSH_ACC15_FRAME"
)
if "&choice"=="DEM1X_F1_WALSH_ACC16_FRAME"
(
  per.view hwioreg.per "DEMOD,DEMOD_1X_OFFLINE,DEM1X_F1_WALSH_ACC16_FRAME"
)
if "&choice"=="DEM1X_F1_WALSH_ACC17_FRAME"
(
  per.view hwioreg.per "DEMOD,DEMOD_1X_OFFLINE,DEM1X_F1_WALSH_ACC17_FRAME"
)
if "&choice"=="DEM1X_F1_WALSH_ACC18_FRAME"
(
  per.view hwioreg.per "DEMOD,DEMOD_1X_OFFLINE,DEM1X_F1_WALSH_ACC18_FRAME"
)
if "&choice"=="DEM1X_F1_WALSH_ACC19_FRAME"
(
  per.view hwioreg.per "DEMOD,DEMOD_1X_OFFLINE,DEM1X_F1_WALSH_ACC19_FRAME"
)
if "&choice"=="DEM1X_F1_WALSH_ACC20_FRAME"
(
  per.view hwioreg.per "DEMOD,DEMOD_1X_OFFLINE,DEM1X_F1_WALSH_ACC20_FRAME"
)
if "&choice"=="DEM1X_F1_WALSH_ACC21_FRAME"
(
  per.view hwioreg.per "DEMOD,DEMOD_1X_OFFLINE,DEM1X_F1_WALSH_ACC21_FRAME"
)
if "&choice"=="DEM1X_F2_WALSH_ACC14_FRAME"
(
  per.view hwioreg.per "DEMOD,DEMOD_1X_OFFLINE,DEM1X_F2_WALSH_ACC14_FRAME"
)
if "&choice"=="DEM1X_F2_WALSH_ACC15_FRAME"
(
  per.view hwioreg.per "DEMOD,DEMOD_1X_OFFLINE,DEM1X_F2_WALSH_ACC15_FRAME"
)
if "&choice"=="DEM1X_F2_WALSH_ACC16_FRAME"
(
  per.view hwioreg.per "DEMOD,DEMOD_1X_OFFLINE,DEM1X_F2_WALSH_ACC16_FRAME"
)
if "&choice"=="DEM1X_F2_WALSH_ACC17_FRAME"
(
  per.view hwioreg.per "DEMOD,DEMOD_1X_OFFLINE,DEM1X_F2_WALSH_ACC17_FRAME"
)
if "&choice"=="DEM1X_F2_WALSH_ACC18_FRAME"
(
  per.view hwioreg.per "DEMOD,DEMOD_1X_OFFLINE,DEM1X_F2_WALSH_ACC18_FRAME"
)
if "&choice"=="DEM1X_F2_WALSH_ACC19_FRAME"
(
  per.view hwioreg.per "DEMOD,DEMOD_1X_OFFLINE,DEM1X_F2_WALSH_ACC19_FRAME"
)
if "&choice"=="DEM1X_F2_WALSH_ACC20_FRAME"
(
  per.view hwioreg.per "DEMOD,DEMOD_1X_OFFLINE,DEM1X_F2_WALSH_ACC20_FRAME"
)
if "&choice"=="DEM1X_F2_WALSH_ACC21_FRAME"
(
  per.view hwioreg.per "DEMOD,DEMOD_1X_OFFLINE,DEM1X_F2_WALSH_ACC21_FRAME"
)
if "&choice"=="DEM1X_F3_WALSH_ACC14_FRAME"
(
  per.view hwioreg.per "DEMOD,DEMOD_1X_OFFLINE,DEM1X_F3_WALSH_ACC14_FRAME"
)
if "&choice"=="DEM1X_F3_WALSH_ACC15_FRAME"
(
  per.view hwioreg.per "DEMOD,DEMOD_1X_OFFLINE,DEM1X_F3_WALSH_ACC15_FRAME"
)
if "&choice"=="DEM1X_F3_WALSH_ACC16_FRAME"
(
  per.view hwioreg.per "DEMOD,DEMOD_1X_OFFLINE,DEM1X_F3_WALSH_ACC16_FRAME"
)
if "&choice"=="DEM1X_F3_WALSH_ACC17_FRAME"
(
  per.view hwioreg.per "DEMOD,DEMOD_1X_OFFLINE,DEM1X_F3_WALSH_ACC17_FRAME"
)
if "&choice"=="DEM1X_F3_WALSH_ACC18_FRAME"
(
  per.view hwioreg.per "DEMOD,DEMOD_1X_OFFLINE,DEM1X_F3_WALSH_ACC18_FRAME"
)
if "&choice"=="DEM1X_F3_WALSH_ACC19_FRAME"
(
  per.view hwioreg.per "DEMOD,DEMOD_1X_OFFLINE,DEM1X_F3_WALSH_ACC19_FRAME"
)
if "&choice"=="DEM1X_F3_WALSH_ACC20_FRAME"
(
  per.view hwioreg.per "DEMOD,DEMOD_1X_OFFLINE,DEM1X_F3_WALSH_ACC20_FRAME"
)
if "&choice"=="DEM1X_F3_WALSH_ACC21_FRAME"
(
  per.view hwioreg.per "DEMOD,DEMOD_1X_OFFLINE,DEM1X_F3_WALSH_ACC21_FRAME"
)
if "&choice"=="DEM1X_F4_WALSH_ACC14_FRAME"
(
  per.view hwioreg.per "DEMOD,DEMOD_1X_OFFLINE,DEM1X_F4_WALSH_ACC14_FRAME"
)
if "&choice"=="DEM1X_F4_WALSH_ACC15_FRAME"
(
  per.view hwioreg.per "DEMOD,DEMOD_1X_OFFLINE,DEM1X_F4_WALSH_ACC15_FRAME"
)
if "&choice"=="DEM1X_F4_WALSH_ACC16_FRAME"
(
  per.view hwioreg.per "DEMOD,DEMOD_1X_OFFLINE,DEM1X_F4_WALSH_ACC16_FRAME"
)
if "&choice"=="DEM1X_F4_WALSH_ACC17_FRAME"
(
  per.view hwioreg.per "DEMOD,DEMOD_1X_OFFLINE,DEM1X_F4_WALSH_ACC17_FRAME"
)
if "&choice"=="DEM1X_F4_WALSH_ACC18_FRAME"
(
  per.view hwioreg.per "DEMOD,DEMOD_1X_OFFLINE,DEM1X_F4_WALSH_ACC18_FRAME"
)
if "&choice"=="DEM1X_F4_WALSH_ACC19_FRAME"
(
  per.view hwioreg.per "DEMOD,DEMOD_1X_OFFLINE,DEM1X_F4_WALSH_ACC19_FRAME"
)
if "&choice"=="DEM1X_F4_WALSH_ACC20_FRAME"
(
  per.view hwioreg.per "DEMOD,DEMOD_1X_OFFLINE,DEM1X_F4_WALSH_ACC20_FRAME"
)
if "&choice"=="DEM1X_F4_WALSH_ACC21_FRAME"
(
  per.view hwioreg.per "DEMOD,DEMOD_1X_OFFLINE,DEM1X_F4_WALSH_ACC21_FRAME"
)
if "&choice"=="DEM1X_F5_WALSH_ACC14_FRAME"
(
  per.view hwioreg.per "DEMOD,DEMOD_1X_OFFLINE,DEM1X_F5_WALSH_ACC14_FRAME"
)
if "&choice"=="DEM1X_F5_WALSH_ACC15_FRAME"
(
  per.view hwioreg.per "DEMOD,DEMOD_1X_OFFLINE,DEM1X_F5_WALSH_ACC15_FRAME"
)
if "&choice"=="DEM1X_F5_WALSH_ACC16_FRAME"
(
  per.view hwioreg.per "DEMOD,DEMOD_1X_OFFLINE,DEM1X_F5_WALSH_ACC16_FRAME"
)
if "&choice"=="DEM1X_F5_WALSH_ACC17_FRAME"
(
  per.view hwioreg.per "DEMOD,DEMOD_1X_OFFLINE,DEM1X_F5_WALSH_ACC17_FRAME"
)
if "&choice"=="DEM1X_F5_WALSH_ACC18_FRAME"
(
  per.view hwioreg.per "DEMOD,DEMOD_1X_OFFLINE,DEM1X_F5_WALSH_ACC18_FRAME"
)
if "&choice"=="DEM1X_F5_WALSH_ACC19_FRAME"
(
  per.view hwioreg.per "DEMOD,DEMOD_1X_OFFLINE,DEM1X_F5_WALSH_ACC19_FRAME"
)
if "&choice"=="DEM1X_F5_WALSH_ACC20_FRAME"
(
  per.view hwioreg.per "DEMOD,DEMOD_1X_OFFLINE,DEM1X_F5_WALSH_ACC20_FRAME"
)
if "&choice"=="DEM1X_F5_WALSH_ACC21_FRAME"
(
  per.view hwioreg.per "DEMOD,DEMOD_1X_OFFLINE,DEM1X_F5_WALSH_ACC21_FRAME"
)
if "&choice"=="DEM1X_F6_WALSH_ACC14_FRAME"
(
  per.view hwioreg.per "DEMOD,DEMOD_1X_OFFLINE,DEM1X_F6_WALSH_ACC14_FRAME"
)
if "&choice"=="DEM1X_F6_WALSH_ACC15_FRAME"
(
  per.view hwioreg.per "DEMOD,DEMOD_1X_OFFLINE,DEM1X_F6_WALSH_ACC15_FRAME"
)
if "&choice"=="DEM1X_F6_WALSH_ACC16_FRAME"
(
  per.view hwioreg.per "DEMOD,DEMOD_1X_OFFLINE,DEM1X_F6_WALSH_ACC16_FRAME"
)
if "&choice"=="DEM1X_F6_WALSH_ACC17_FRAME"
(
  per.view hwioreg.per "DEMOD,DEMOD_1X_OFFLINE,DEM1X_F6_WALSH_ACC17_FRAME"
)
if "&choice"=="DEM1X_F6_WALSH_ACC18_FRAME"
(
  per.view hwioreg.per "DEMOD,DEMOD_1X_OFFLINE,DEM1X_F6_WALSH_ACC18_FRAME"
)
if "&choice"=="DEM1X_F6_WALSH_ACC19_FRAME"
(
  per.view hwioreg.per "DEMOD,DEMOD_1X_OFFLINE,DEM1X_F6_WALSH_ACC19_FRAME"
)
if "&choice"=="DEM1X_F6_WALSH_ACC20_FRAME"
(
  per.view hwioreg.per "DEMOD,DEMOD_1X_OFFLINE,DEM1X_F6_WALSH_ACC20_FRAME"
)
if "&choice"=="DEM1X_F6_WALSH_ACC21_FRAME"
(
  per.view hwioreg.per "DEMOD,DEMOD_1X_OFFLINE,DEM1X_F6_WALSH_ACC21_FRAME"
)
if "&choice"=="DEM1X_F7_WALSH_ACC14_FRAME"
(
  per.view hwioreg.per "DEMOD,DEMOD_1X_OFFLINE,DEM1X_F7_WALSH_ACC14_FRAME"
)
if "&choice"=="DEM1X_F7_WALSH_ACC15_FRAME"
(
  per.view hwioreg.per "DEMOD,DEMOD_1X_OFFLINE,DEM1X_F7_WALSH_ACC15_FRAME"
)
if "&choice"=="DEM1X_F7_WALSH_ACC16_FRAME"
(
  per.view hwioreg.per "DEMOD,DEMOD_1X_OFFLINE,DEM1X_F7_WALSH_ACC16_FRAME"
)
if "&choice"=="DEM1X_F7_WALSH_ACC17_FRAME"
(
  per.view hwioreg.per "DEMOD,DEMOD_1X_OFFLINE,DEM1X_F7_WALSH_ACC17_FRAME"
)
if "&choice"=="DEM1X_F7_WALSH_ACC18_FRAME"
(
  per.view hwioreg.per "DEMOD,DEMOD_1X_OFFLINE,DEM1X_F7_WALSH_ACC18_FRAME"
)
if "&choice"=="DEM1X_F7_WALSH_ACC19_FRAME"
(
  per.view hwioreg.per "DEMOD,DEMOD_1X_OFFLINE,DEM1X_F7_WALSH_ACC19_FRAME"
)
if "&choice"=="DEM1X_F7_WALSH_ACC20_FRAME"
(
  per.view hwioreg.per "DEMOD,DEMOD_1X_OFFLINE,DEM1X_F7_WALSH_ACC20_FRAME"
)
if "&choice"=="DEM1X_F7_WALSH_ACC21_FRAME"
(
  per.view hwioreg.per "DEMOD,DEMOD_1X_OFFLINE,DEM1X_F7_WALSH_ACC21_FRAME"
)
if "&choice"=="DEM1X_F0_HW_CH4_IMMED"
(
  per.view hwioreg.per "DEMOD,DEMOD_1X_OFFLINE,DEM1X_F0_HW_CH4_IMMED"
)
if "&choice"=="DEM1X_F1_HW_CH4_IMMED"
(
  per.view hwioreg.per "DEMOD,DEMOD_1X_OFFLINE,DEM1X_F1_HW_CH4_IMMED"
)
if "&choice"=="DEM1X_F2_HW_CH4_IMMED"
(
  per.view hwioreg.per "DEMOD,DEMOD_1X_OFFLINE,DEM1X_F2_HW_CH4_IMMED"
)
if "&choice"=="DEM1X_F3_HW_CH4_IMMED"
(
  per.view hwioreg.per "DEMOD,DEMOD_1X_OFFLINE,DEM1X_F3_HW_CH4_IMMED"
)
if "&choice"=="DEM1X_F4_HW_CH4_IMMED"
(
  per.view hwioreg.per "DEMOD,DEMOD_1X_OFFLINE,DEM1X_F4_HW_CH4_IMMED"
)
if "&choice"=="DEM1X_F5_HW_CH4_IMMED"
(
  per.view hwioreg.per "DEMOD,DEMOD_1X_OFFLINE,DEM1X_F5_HW_CH4_IMMED"
)
if "&choice"=="DEM1X_F6_HW_CH4_IMMED"
(
  per.view hwioreg.per "DEMOD,DEMOD_1X_OFFLINE,DEM1X_F6_HW_CH4_IMMED"
)
if "&choice"=="DEM1X_F7_HW_CH4_IMMED"
(
  per.view hwioreg.per "DEMOD,DEMOD_1X_OFFLINE,DEM1X_F7_HW_CH4_IMMED"
)
if "&choice"=="DEM1X_F0_HW_CH4_FRAME"
(
  per.view hwioreg.per "DEMOD,DEMOD_1X_OFFLINE,DEM1X_F0_HW_CH4_FRAME"
)
if "&choice"=="DEM1X_F1_HW_CH4_FRAME"
(
  per.view hwioreg.per "DEMOD,DEMOD_1X_OFFLINE,DEM1X_F1_HW_CH4_FRAME"
)
if "&choice"=="DEM1X_F2_HW_CH4_FRAME"
(
  per.view hwioreg.per "DEMOD,DEMOD_1X_OFFLINE,DEM1X_F2_HW_CH4_FRAME"
)
if "&choice"=="DEM1X_F3_HW_CH4_FRAME"
(
  per.view hwioreg.per "DEMOD,DEMOD_1X_OFFLINE,DEM1X_F3_HW_CH4_FRAME"
)
if "&choice"=="DEM1X_F4_HW_CH4_FRAME"
(
  per.view hwioreg.per "DEMOD,DEMOD_1X_OFFLINE,DEM1X_F4_HW_CH4_FRAME"
)
if "&choice"=="DEM1X_F5_HW_CH4_FRAME"
(
  per.view hwioreg.per "DEMOD,DEMOD_1X_OFFLINE,DEM1X_F5_HW_CH4_FRAME"
)
if "&choice"=="DEM1X_F6_HW_CH4_FRAME"
(
  per.view hwioreg.per "DEMOD,DEMOD_1X_OFFLINE,DEM1X_F6_HW_CH4_FRAME"
)
if "&choice"=="DEM1X_F7_HW_CH4_FRAME"
(
  per.view hwioreg.per "DEMOD,DEMOD_1X_OFFLINE,DEM1X_F7_HW_CH4_FRAME"
)
if "&choice"=="DEM1X_F0_HW_CH5_IMMED"
(
  per.view hwioreg.per "DEMOD,DEMOD_1X_OFFLINE,DEM1X_F0_HW_CH5_IMMED"
)
if "&choice"=="DEM1X_F1_HW_CH5_IMMED"
(
  per.view hwioreg.per "DEMOD,DEMOD_1X_OFFLINE,DEM1X_F1_HW_CH5_IMMED"
)
if "&choice"=="DEM1X_F2_HW_CH5_IMMED"
(
  per.view hwioreg.per "DEMOD,DEMOD_1X_OFFLINE,DEM1X_F2_HW_CH5_IMMED"
)
if "&choice"=="DEM1X_F3_HW_CH5_IMMED"
(
  per.view hwioreg.per "DEMOD,DEMOD_1X_OFFLINE,DEM1X_F3_HW_CH5_IMMED"
)
if "&choice"=="DEM1X_F4_HW_CH5_IMMED"
(
  per.view hwioreg.per "DEMOD,DEMOD_1X_OFFLINE,DEM1X_F4_HW_CH5_IMMED"
)
if "&choice"=="DEM1X_F5_HW_CH5_IMMED"
(
  per.view hwioreg.per "DEMOD,DEMOD_1X_OFFLINE,DEM1X_F5_HW_CH5_IMMED"
)
if "&choice"=="DEM1X_F6_HW_CH5_IMMED"
(
  per.view hwioreg.per "DEMOD,DEMOD_1X_OFFLINE,DEM1X_F6_HW_CH5_IMMED"
)
if "&choice"=="DEM1X_F7_HW_CH5_IMMED"
(
  per.view hwioreg.per "DEMOD,DEMOD_1X_OFFLINE,DEM1X_F7_HW_CH5_IMMED"
)
if "&choice"=="DEM1X_F0_HW_CH5_FRAME"
(
  per.view hwioreg.per "DEMOD,DEMOD_1X_OFFLINE,DEM1X_F0_HW_CH5_FRAME"
)
if "&choice"=="DEM1X_F1_HW_CH5_FRAME"
(
  per.view hwioreg.per "DEMOD,DEMOD_1X_OFFLINE,DEM1X_F1_HW_CH5_FRAME"
)
if "&choice"=="DEM1X_F2_HW_CH5_FRAME"
(
  per.view hwioreg.per "DEMOD,DEMOD_1X_OFFLINE,DEM1X_F2_HW_CH5_FRAME"
)
if "&choice"=="DEM1X_F3_HW_CH5_FRAME"
(
  per.view hwioreg.per "DEMOD,DEMOD_1X_OFFLINE,DEM1X_F3_HW_CH5_FRAME"
)
if "&choice"=="DEM1X_F4_HW_CH5_FRAME"
(
  per.view hwioreg.per "DEMOD,DEMOD_1X_OFFLINE,DEM1X_F4_HW_CH5_FRAME"
)
if "&choice"=="DEM1X_F5_HW_CH5_FRAME"
(
  per.view hwioreg.per "DEMOD,DEMOD_1X_OFFLINE,DEM1X_F5_HW_CH5_FRAME"
)
if "&choice"=="DEM1X_F6_HW_CH5_FRAME"
(
  per.view hwioreg.per "DEMOD,DEMOD_1X_OFFLINE,DEM1X_F6_HW_CH5_FRAME"
)
if "&choice"=="DEM1X_F7_HW_CH5_FRAME"
(
  per.view hwioreg.per "DEMOD,DEMOD_1X_OFFLINE,DEM1X_F7_HW_CH5_FRAME"
)
if "&choice"=="DEM1X_FFE_TEST"
(
  per.view hwioreg.per "DEMOD,DEMOD_1X_OFFLINE,DEM1X_FFE_TEST"
)
if "&choice"=="DEM1X_FFE_TEST_MODE"
(
  per.view hwioreg.per "DEMOD,DEMOD_1X_OFFLINE,DEM1X_FFE_TEST_MODE"
)
if "&choice"=="DEM1X_FFE_TEST_MISR_RESET"
(
  per.view hwioreg.per "DEMOD,DEMOD_1X_OFFLINE,DEM1X_FFE_TEST_MISR_RESET"
)
if "&choice"=="DEM1X_FFE_TEST_EXPORT_MISR"
(
  per.view hwioreg.per "DEMOD,DEMOD_1X_OFFLINE,DEM1X_FFE_TEST_EXPORT_MISR"
)
if "&choice"=="DEM1X_FFE_TEST_CAPTURED"
(
  per.view hwioreg.per "DEMOD,DEMOD_1X_OFFLINE,DEM1X_FFE_TEST_CAPTURED"
)
if "&choice"=="DEM1X_FFE_TEST_MISR_CURR_VAL"
(
  per.view hwioreg.per "DEMOD,DEMOD_1X_OFFLINE,DEM1X_FFE_TEST_MISR_CURR_VAL"
)
if "&choice"=="DEM1X_FFE_TEST_MISR_CAPT_VAL"
(
  per.view hwioreg.per "DEMOD,DEMOD_1X_OFFLINE,DEM1X_FFE_TEST_MISR_CAPT_VAL"
)
if "&choice"=="DEM1X_TEST_MEM_SEL"
(
  per.view hwioreg.per "DEMOD,DEMOD_1X_OFFLINE,DEM1X_TEST_MEM_SEL"
)
if "&choice"=="DEM1X_TEST_MEM_ADDR"
(
  per.view hwioreg.per "DEMOD,DEMOD_1X_OFFLINE,DEM1X_TEST_MEM_ADDR"
)
if "&choice"=="DEM1X_TEST_MEM_WRITE"
(
  per.view hwioreg.per "DEMOD,DEMOD_1X_OFFLINE,DEM1X_TEST_MEM_WRITE"
)
if "&choice"=="DEM1X_TEST_MEM_READ0"
(
  per.view hwioreg.per "DEMOD,DEMOD_1X_OFFLINE,DEM1X_TEST_MEM_READ0"
)
if "&choice"=="DEM1X_HW_OFFLINE_CLK_CTL"
(
  per.view hwioreg.per "DEMOD,DEMOD_1X_OFFLINE,DEM1X_HW_OFFLINE_CLK_CTL"
)
if "&choice"=="DEM1X_MICRO_OFFLINE_CLK_CTL"
(
  per.view hwioreg.per "DEMOD,DEMOD_1X_OFFLINE,DEM1X_MICRO_OFFLINE_CLK_CTL"
)
if "&choice"=="DEM1X_OFFLINE_CLK_STATUS"
(
  per.view hwioreg.per "DEMOD,DEMOD_1X_OFFLINE,DEM1X_OFFLINE_CLK_STATUS"
)
if "&choice"=="DEM1X_OFFLINE_SPARE_READ_REG0"
(
  per.view hwioreg.per "DEMOD,DEMOD_1X_OFFLINE,DEM1X_OFFLINE_SPARE_READ_REG0"
)
if "&choice"=="DEM1X_OFFLINE_SPARE_READ_REG1"
(
  per.view hwioreg.per "DEMOD,DEMOD_1X_OFFLINE,DEM1X_OFFLINE_SPARE_READ_REG1"
)
if "&choice"=="DEM1X_FFE_CONFIG_SPARE_READ_REG0"
(
  per.view hwioreg.per "DEMOD,DEMOD_1X_OFFLINE,DEM1X_FFE_CONFIG_SPARE_READ_REG0"
)
if "&choice"=="DEM1X_FFE_RESULTS_SPARE_READ_REG0"
(
  per.view hwioreg.per "DEMOD,DEMOD_1X_OFFLINE,DEM1X_FFE_RESULTS_SPARE_READ_REG0"
)
if "&choice"=="DEM1X_FFE_ENGINE_SPARE_READ_REG0"
(
  per.view hwioreg.per "DEMOD,DEMOD_1X_OFFLINE,DEM1X_FFE_ENGINE_SPARE_READ_REG0"
)
if "&choice"=="DEM1X_FFE_ENGINE_SPARE_READ_REG1"
(
  per.view hwioreg.per "DEMOD,DEMOD_1X_OFFLINE,DEM1X_FFE_ENGINE_SPARE_READ_REG1"
)
if "&choice"=="DEM1X_RESET"
(
  per.view hwioreg.per "DEMOD,DEMOD_1X_RXCHIPX8,DEM1X_RESET"
)
if "&choice"=="DEM1X_TRACKING"
(
  per.view hwioreg.per "DEMOD,DEMOD_1X_RXCHIPX8,DEM1X_TRACKING"
)
if "&choice"=="DEM1X_FRAME_OFFSET"
(
  per.view hwioreg.per "DEMOD,DEMOD_1X_RXCHIPX8,DEM1X_FRAME_OFFSET"
)
if "&choice"=="DEM1X_FINGER_MERGE"
(
  per.view hwioreg.per "DEMOD,DEMOD_1X_RXCHIPX8,DEM1X_FINGER_MERGE"
)
if "&choice"=="DEM1X_FINGER0"
(
  per.view hwioreg.per "DEMOD,DEMOD_1X_RXCHIPX8,DEM1X_FINGER0"
)
if "&choice"=="DEM1X_FINGER1"
(
  per.view hwioreg.per "DEMOD,DEMOD_1X_RXCHIPX8,DEM1X_FINGER1"
)
if "&choice"=="DEM1X_FINGER2"
(
  per.view hwioreg.per "DEMOD,DEMOD_1X_RXCHIPX8,DEM1X_FINGER2"
)
if "&choice"=="DEM1X_FINGER3"
(
  per.view hwioreg.per "DEMOD,DEMOD_1X_RXCHIPX8,DEM1X_FINGER3"
)
if "&choice"=="DEM1X_FINGER4"
(
  per.view hwioreg.per "DEMOD,DEMOD_1X_RXCHIPX8,DEM1X_FINGER4"
)
if "&choice"=="DEM1X_FINGER5"
(
  per.view hwioreg.per "DEMOD,DEMOD_1X_RXCHIPX8,DEM1X_FINGER5"
)
if "&choice"=="DEM1X_FINGER6"
(
  per.view hwioreg.per "DEMOD,DEMOD_1X_RXCHIPX8,DEM1X_FINGER6"
)
if "&choice"=="DEM1X_FINGER7"
(
  per.view hwioreg.per "DEMOD,DEMOD_1X_RXCHIPX8,DEM1X_FINGER7"
)
if "&choice"=="DEM1X_COMBINER_TIME_LOAD"
(
  per.view hwioreg.per "DEMOD,DEMOD_1X_RXCHIPX8,DEM1X_COMBINER_TIME_LOAD"
)
if "&choice"=="DEM1X_LC_STATE_LOAD_LO"
(
  per.view hwioreg.per "DEMOD,DEMOD_1X_RXCHIPX8,DEM1X_LC_STATE_LOAD_LO"
)
if "&choice"=="DEM1X_LC_STATE_LOAD_HI"
(
  per.view hwioreg.per "DEMOD,DEMOD_1X_RXCHIPX8,DEM1X_LC_STATE_LOAD_HI"
)
if "&choice"=="DEM1X_COMBINER_TIME"
(
  per.view hwioreg.per "DEMOD,DEMOD_1X_RXCHIPX8,DEM1X_COMBINER_TIME"
)
if "&choice"=="DEM1X_FRAME_COUNT"
(
  per.view hwioreg.per "DEMOD,DEMOD_1X_RXCHIPX8,DEM1X_FRAME_COUNT"
)
if "&choice"=="DEM1X_LC_STATE_LO"
(
  per.view hwioreg.per "DEMOD,DEMOD_1X_RXCHIPX8,DEM1X_LC_STATE_LO"
)
if "&choice"=="DEM1X_LC_STATE_HI"
(
  per.view hwioreg.per "DEMOD,DEMOD_1X_RXCHIPX8,DEM1X_LC_STATE_HI"
)
if "&choice"=="DEM1X_TRAFFIC_REV_PWR_CTL"
(
  per.view hwioreg.per "DEMOD,DEMOD_1X_RXCHIPX8,DEM1X_TRAFFIC_REV_PWR_CTL"
)
if "&choice"=="DEM1X_COMMON_REV_PWR_CTL"
(
  per.view hwioreg.per "DEMOD,DEMOD_1X_RXCHIPX8,DEM1X_COMMON_REV_PWR_CTL"
)
if "&choice"=="DEM1X_COMMON_REV_PWR_CTL2"
(
  per.view hwioreg.per "DEMOD,DEMOD_1X_RXCHIPX8,DEM1X_COMMON_REV_PWR_CTL2"
)
if "&choice"=="DEM1X_FWD_PWR_CTL_IMMED"
(
  per.view hwioreg.per "DEMOD,DEMOD_1X_RXCHIPX8,DEM1X_FWD_PWR_CTL_IMMED"
)
if "&choice"=="DEM1X_FWD_PWR_CTL_FRAME"
(
  per.view hwioreg.per "DEMOD,DEMOD_1X_RXCHIPX8,DEM1X_FWD_PWR_CTL_FRAME"
)
if "&choice"=="DEM1X_FWD_PWR_CTL_TIMING"
(
  per.view hwioreg.per "DEMOD,DEMOD_1X_RXCHIPX8,DEM1X_FWD_PWR_CTL_TIMING"
)
if "&choice"=="DEM1X_BETA_TIMING"
(
  per.view hwioreg.per "DEMOD,DEMOD_1X_RXCHIPX8,DEM1X_BETA_TIMING"
)
if "&choice"=="DEM1X_TIME_INT1_ENABLE"
(
  per.view hwioreg.per "DEMOD,DEMOD_1X_RXCHIPX8,DEM1X_TIME_INT1_ENABLE"
)
if "&choice"=="DEM1X_TIME_INT1_STATUS"
(
  per.view hwioreg.per "DEMOD,DEMOD_1X_RXCHIPX8,DEM1X_TIME_INT1_STATUS"
)
if "&choice"=="DEM1X_TIME_INT1_CLEAR"
(
  per.view hwioreg.per "DEMOD,DEMOD_1X_RXCHIPX8,DEM1X_TIME_INT1_CLEAR"
)
if "&choice"=="DEM1X_TIME_INT2_ENABLE"
(
  per.view hwioreg.per "DEMOD,DEMOD_1X_RXCHIPX8,DEM1X_TIME_INT2_ENABLE"
)
if "&choice"=="DEM1X_TIME_INT2_STATUS"
(
  per.view hwioreg.per "DEMOD,DEMOD_1X_RXCHIPX8,DEM1X_TIME_INT2_STATUS"
)
if "&choice"=="DEM1X_TIME_INT2_CLEAR"
(
  per.view hwioreg.per "DEMOD,DEMOD_1X_RXCHIPX8,DEM1X_TIME_INT2_CLEAR"
)
if "&choice"=="DEM1X_CH0_LC_MASK_LO_IMMED"
(
  per.view hwioreg.per "DEMOD,DEMOD_1X_RXCHIPX8,DEM1X_CH0_LC_MASK_LO_IMMED"
)
if "&choice"=="DEM1X_CH1_LC_MASK_LO_IMMED"
(
  per.view hwioreg.per "DEMOD,DEMOD_1X_RXCHIPX8,DEM1X_CH1_LC_MASK_LO_IMMED"
)
if "&choice"=="DEM1X_CH2_LC_MASK_LO_IMMED"
(
  per.view hwioreg.per "DEMOD,DEMOD_1X_RXCHIPX8,DEM1X_CH2_LC_MASK_LO_IMMED"
)
if "&choice"=="DEM1X_CH3_LC_MASK_LO_IMMED"
(
  per.view hwioreg.per "DEMOD,DEMOD_1X_RXCHIPX8,DEM1X_CH3_LC_MASK_LO_IMMED"
)
if "&choice"=="DEM1X_CH4_LC_MASK_LO_IMMED"
(
  per.view hwioreg.per "DEMOD,DEMOD_1X_RXCHIPX8,DEM1X_CH4_LC_MASK_LO_IMMED"
)
if "&choice"=="DEM1X_CH5_LC_MASK_LO_IMMED"
(
  per.view hwioreg.per "DEMOD,DEMOD_1X_RXCHIPX8,DEM1X_CH5_LC_MASK_LO_IMMED"
)
if "&choice"=="DEM1X_CH6_LC_MASK_LO_IMMED"
(
  per.view hwioreg.per "DEMOD,DEMOD_1X_RXCHIPX8,DEM1X_CH6_LC_MASK_LO_IMMED"
)
if "&choice"=="DEM1X_CH7_LC_MASK_LO_IMMED"
(
  per.view hwioreg.per "DEMOD,DEMOD_1X_RXCHIPX8,DEM1X_CH7_LC_MASK_LO_IMMED"
)
if "&choice"=="DEM1X_CH8_LC_MASK_LO_IMMED"
(
  per.view hwioreg.per "DEMOD,DEMOD_1X_RXCHIPX8,DEM1X_CH8_LC_MASK_LO_IMMED"
)
if "&choice"=="DEM1X_CH0_LC_MASK_HI_IMMED"
(
  per.view hwioreg.per "DEMOD,DEMOD_1X_RXCHIPX8,DEM1X_CH0_LC_MASK_HI_IMMED"
)
if "&choice"=="DEM1X_CH1_LC_MASK_HI_IMMED"
(
  per.view hwioreg.per "DEMOD,DEMOD_1X_RXCHIPX8,DEM1X_CH1_LC_MASK_HI_IMMED"
)
if "&choice"=="DEM1X_CH2_LC_MASK_HI_IMMED"
(
  per.view hwioreg.per "DEMOD,DEMOD_1X_RXCHIPX8,DEM1X_CH2_LC_MASK_HI_IMMED"
)
if "&choice"=="DEM1X_CH3_LC_MASK_HI_IMMED"
(
  per.view hwioreg.per "DEMOD,DEMOD_1X_RXCHIPX8,DEM1X_CH3_LC_MASK_HI_IMMED"
)
if "&choice"=="DEM1X_CH4_LC_MASK_HI_IMMED"
(
  per.view hwioreg.per "DEMOD,DEMOD_1X_RXCHIPX8,DEM1X_CH4_LC_MASK_HI_IMMED"
)
if "&choice"=="DEM1X_CH5_LC_MASK_HI_IMMED"
(
  per.view hwioreg.per "DEMOD,DEMOD_1X_RXCHIPX8,DEM1X_CH5_LC_MASK_HI_IMMED"
)
if "&choice"=="DEM1X_CH6_LC_MASK_HI_IMMED"
(
  per.view hwioreg.per "DEMOD,DEMOD_1X_RXCHIPX8,DEM1X_CH6_LC_MASK_HI_IMMED"
)
if "&choice"=="DEM1X_CH7_LC_MASK_HI_IMMED"
(
  per.view hwioreg.per "DEMOD,DEMOD_1X_RXCHIPX8,DEM1X_CH7_LC_MASK_HI_IMMED"
)
if "&choice"=="DEM1X_CH8_LC_MASK_HI_IMMED"
(
  per.view hwioreg.per "DEMOD,DEMOD_1X_RXCHIPX8,DEM1X_CH8_LC_MASK_HI_IMMED"
)
if "&choice"=="DEM1X_CH0_LC_MASK_LO_SPN_ROLL"
(
  per.view hwioreg.per "DEMOD,DEMOD_1X_RXCHIPX8,DEM1X_CH0_LC_MASK_LO_SPN_ROLL"
)
if "&choice"=="DEM1X_CH1_LC_MASK_LO_SPN_ROLL"
(
  per.view hwioreg.per "DEMOD,DEMOD_1X_RXCHIPX8,DEM1X_CH1_LC_MASK_LO_SPN_ROLL"
)
if "&choice"=="DEM1X_CH2_LC_MASK_LO_SPN_ROLL"
(
  per.view hwioreg.per "DEMOD,DEMOD_1X_RXCHIPX8,DEM1X_CH2_LC_MASK_LO_SPN_ROLL"
)
if "&choice"=="DEM1X_CH3_LC_MASK_LO_SPN_ROLL"
(
  per.view hwioreg.per "DEMOD,DEMOD_1X_RXCHIPX8,DEM1X_CH3_LC_MASK_LO_SPN_ROLL"
)
if "&choice"=="DEM1X_CH4_LC_MASK_LO_SPN_ROLL"
(
  per.view hwioreg.per "DEMOD,DEMOD_1X_RXCHIPX8,DEM1X_CH4_LC_MASK_LO_SPN_ROLL"
)
if "&choice"=="DEM1X_CH5_LC_MASK_LO_SPN_ROLL"
(
  per.view hwioreg.per "DEMOD,DEMOD_1X_RXCHIPX8,DEM1X_CH5_LC_MASK_LO_SPN_ROLL"
)
if "&choice"=="DEM1X_CH6_LC_MASK_LO_SPN_ROLL"
(
  per.view hwioreg.per "DEMOD,DEMOD_1X_RXCHIPX8,DEM1X_CH6_LC_MASK_LO_SPN_ROLL"
)
if "&choice"=="DEM1X_CH7_LC_MASK_LO_SPN_ROLL"
(
  per.view hwioreg.per "DEMOD,DEMOD_1X_RXCHIPX8,DEM1X_CH7_LC_MASK_LO_SPN_ROLL"
)
if "&choice"=="DEM1X_CH8_LC_MASK_LO_SPN_ROLL"
(
  per.view hwioreg.per "DEMOD,DEMOD_1X_RXCHIPX8,DEM1X_CH8_LC_MASK_LO_SPN_ROLL"
)
if "&choice"=="DEM1X_CH0_LC_MASK_HI_SPN_ROLL"
(
  per.view hwioreg.per "DEMOD,DEMOD_1X_RXCHIPX8,DEM1X_CH0_LC_MASK_HI_SPN_ROLL"
)
if "&choice"=="DEM1X_CH1_LC_MASK_HI_SPN_ROLL"
(
  per.view hwioreg.per "DEMOD,DEMOD_1X_RXCHIPX8,DEM1X_CH1_LC_MASK_HI_SPN_ROLL"
)
if "&choice"=="DEM1X_CH2_LC_MASK_HI_SPN_ROLL"
(
  per.view hwioreg.per "DEMOD,DEMOD_1X_RXCHIPX8,DEM1X_CH2_LC_MASK_HI_SPN_ROLL"
)
if "&choice"=="DEM1X_CH3_LC_MASK_HI_SPN_ROLL"
(
  per.view hwioreg.per "DEMOD,DEMOD_1X_RXCHIPX8,DEM1X_CH3_LC_MASK_HI_SPN_ROLL"
)
if "&choice"=="DEM1X_CH4_LC_MASK_HI_SPN_ROLL"
(
  per.view hwioreg.per "DEMOD,DEMOD_1X_RXCHIPX8,DEM1X_CH4_LC_MASK_HI_SPN_ROLL"
)
if "&choice"=="DEM1X_CH5_LC_MASK_HI_SPN_ROLL"
(
  per.view hwioreg.per "DEMOD,DEMOD_1X_RXCHIPX8,DEM1X_CH5_LC_MASK_HI_SPN_ROLL"
)
if "&choice"=="DEM1X_CH6_LC_MASK_HI_SPN_ROLL"
(
  per.view hwioreg.per "DEMOD,DEMOD_1X_RXCHIPX8,DEM1X_CH6_LC_MASK_HI_SPN_ROLL"
)
if "&choice"=="DEM1X_CH7_LC_MASK_HI_SPN_ROLL"
(
  per.view hwioreg.per "DEMOD,DEMOD_1X_RXCHIPX8,DEM1X_CH7_LC_MASK_HI_SPN_ROLL"
)
if "&choice"=="DEM1X_CH8_LC_MASK_HI_SPN_ROLL"
(
  per.view hwioreg.per "DEMOD,DEMOD_1X_RXCHIPX8,DEM1X_CH8_LC_MASK_HI_SPN_ROLL"
)
if "&choice"=="DEM1X_COMBINER_CTL"
(
  per.view hwioreg.per "DEMOD,DEMOD_1X_RXCHIPX8,DEM1X_COMBINER_CTL"
)
if "&choice"=="DEM1X_FW_CH_ENABLE_IMMED"
(
  per.view hwioreg.per "DEMOD,DEMOD_1X_RXCHIPX8,DEM1X_FW_CH_ENABLE_IMMED"
)
if "&choice"=="DEM1X_FW_CH_ENABLE_FRAME"
(
  per.view hwioreg.per "DEMOD,DEMOD_1X_RXCHIPX8,DEM1X_FW_CH_ENABLE_FRAME"
)
if "&choice"=="DEM1X_CHANNEL0_IMMED"
(
  per.view hwioreg.per "DEMOD,DEMOD_1X_RXCHIPX8,DEM1X_CHANNEL0_IMMED"
)
if "&choice"=="DEM1X_CHANNEL0_FRAME"
(
  per.view hwioreg.per "DEMOD,DEMOD_1X_RXCHIPX8,DEM1X_CHANNEL0_FRAME"
)
if "&choice"=="DEM1X_CHANNEL1_IMMED"
(
  per.view hwioreg.per "DEMOD,DEMOD_1X_RXCHIPX8,DEM1X_CHANNEL1_IMMED"
)
if "&choice"=="DEM1X_CHANNEL1_FRAME"
(
  per.view hwioreg.per "DEMOD,DEMOD_1X_RXCHIPX8,DEM1X_CHANNEL1_FRAME"
)
if "&choice"=="DEM1X_CHANNEL2_IMMED"
(
  per.view hwioreg.per "DEMOD,DEMOD_1X_RXCHIPX8,DEM1X_CHANNEL2_IMMED"
)
if "&choice"=="DEM1X_CHANNEL2_FRAME"
(
  per.view hwioreg.per "DEMOD,DEMOD_1X_RXCHIPX8,DEM1X_CHANNEL2_FRAME"
)
if "&choice"=="DEM1X_CHANNEL3_IMMED"
(
  per.view hwioreg.per "DEMOD,DEMOD_1X_RXCHIPX8,DEM1X_CHANNEL3_IMMED"
)
if "&choice"=="DEM1X_CHANNEL3_FRAME"
(
  per.view hwioreg.per "DEMOD,DEMOD_1X_RXCHIPX8,DEM1X_CHANNEL3_FRAME"
)
if "&choice"=="DEM1X_CHANNEL4_IMMED"
(
  per.view hwioreg.per "DEMOD,DEMOD_1X_RXCHIPX8,DEM1X_CHANNEL4_IMMED"
)
if "&choice"=="DEM1X_CHANNEL4_FRAME"
(
  per.view hwioreg.per "DEMOD,DEMOD_1X_RXCHIPX8,DEM1X_CHANNEL4_FRAME"
)
if "&choice"=="DEM1X_CHANNEL5_IMMED"
(
  per.view hwioreg.per "DEMOD,DEMOD_1X_RXCHIPX8,DEM1X_CHANNEL5_IMMED"
)
if "&choice"=="DEM1X_CHANNEL5_FRAME"
(
  per.view hwioreg.per "DEMOD,DEMOD_1X_RXCHIPX8,DEM1X_CHANNEL5_FRAME"
)
if "&choice"=="DEM1X_CHANNEL6_IMMED"
(
  per.view hwioreg.per "DEMOD,DEMOD_1X_RXCHIPX8,DEM1X_CHANNEL6_IMMED"
)
if "&choice"=="DEM1X_CHANNEL6_FRAME"
(
  per.view hwioreg.per "DEMOD,DEMOD_1X_RXCHIPX8,DEM1X_CHANNEL6_FRAME"
)
if "&choice"=="DEM1X_CHANNEL8_IMMED"
(
  per.view hwioreg.per "DEMOD,DEMOD_1X_RXCHIPX8,DEM1X_CHANNEL8_IMMED"
)
if "&choice"=="DEM1X_CHANNEL8_FRAME"
(
  per.view hwioreg.per "DEMOD,DEMOD_1X_RXCHIPX8,DEM1X_CHANNEL8_FRAME"
)
if "&choice"=="DEM1X_ACKCH_FINGER0_IMMED"
(
  per.view hwioreg.per "DEMOD,DEMOD_1X_RXCHIPX8,DEM1X_ACKCH_FINGER0_IMMED"
)
if "&choice"=="DEM1X_ACKCH_FINGER1_IMMED"
(
  per.view hwioreg.per "DEMOD,DEMOD_1X_RXCHIPX8,DEM1X_ACKCH_FINGER1_IMMED"
)
if "&choice"=="DEM1X_ACKCH_FINGER2_IMMED"
(
  per.view hwioreg.per "DEMOD,DEMOD_1X_RXCHIPX8,DEM1X_ACKCH_FINGER2_IMMED"
)
if "&choice"=="DEM1X_ACKCH_FINGER3_IMMED"
(
  per.view hwioreg.per "DEMOD,DEMOD_1X_RXCHIPX8,DEM1X_ACKCH_FINGER3_IMMED"
)
if "&choice"=="DEM1X_ACKCH_FINGER4_IMMED"
(
  per.view hwioreg.per "DEMOD,DEMOD_1X_RXCHIPX8,DEM1X_ACKCH_FINGER4_IMMED"
)
if "&choice"=="DEM1X_ACKCH_FINGER5_IMMED"
(
  per.view hwioreg.per "DEMOD,DEMOD_1X_RXCHIPX8,DEM1X_ACKCH_FINGER5_IMMED"
)
if "&choice"=="DEM1X_ACKCH_FINGER0_FRAME"
(
  per.view hwioreg.per "DEMOD,DEMOD_1X_RXCHIPX8,DEM1X_ACKCH_FINGER0_FRAME"
)
if "&choice"=="DEM1X_ACKCH_FINGER1_FRAME"
(
  per.view hwioreg.per "DEMOD,DEMOD_1X_RXCHIPX8,DEM1X_ACKCH_FINGER1_FRAME"
)
if "&choice"=="DEM1X_ACKCH_FINGER2_FRAME"
(
  per.view hwioreg.per "DEMOD,DEMOD_1X_RXCHIPX8,DEM1X_ACKCH_FINGER2_FRAME"
)
if "&choice"=="DEM1X_ACKCH_FINGER3_FRAME"
(
  per.view hwioreg.per "DEMOD,DEMOD_1X_RXCHIPX8,DEM1X_ACKCH_FINGER3_FRAME"
)
if "&choice"=="DEM1X_ACKCH_FINGER4_FRAME"
(
  per.view hwioreg.per "DEMOD,DEMOD_1X_RXCHIPX8,DEM1X_ACKCH_FINGER4_FRAME"
)
if "&choice"=="DEM1X_ACKCH_FINGER5_FRAME"
(
  per.view hwioreg.per "DEMOD,DEMOD_1X_RXCHIPX8,DEM1X_ACKCH_FINGER5_FRAME"
)
if "&choice"=="DEM1X_RCCH_CTL"
(
  per.view hwioreg.per "DEMOD,DEMOD_1X_RXCHIPX8,DEM1X_RCCH_CTL"
)
if "&choice"=="DEM1X_RCCH_CTL2"
(
  per.view hwioreg.per "DEMOD,DEMOD_1X_RXCHIPX8,DEM1X_RCCH_CTL2"
)
if "&choice"=="DEM1X_SYS_TIME_GP_COMPARE"
(
  per.view hwioreg.per "DEMOD,DEMOD_1X_RXCHIPX8,DEM1X_SYS_TIME_GP_COMPARE"
)
if "&choice"=="DEM1X_OFFLINE"
(
  per.view hwioreg.per "DEMOD,DEMOD_1X_RXCHIPX8,DEM1X_OFFLINE"
)
if "&choice"=="DEM1X_REF_COUNT"
(
  per.view hwioreg.per "DEMOD,DEMOD_1X_RXCHIPX8,DEM1X_REF_COUNT"
)
if "&choice"=="DEM1X_RTC_ADJUST"
(
  per.view hwioreg.per "DEMOD,DEMOD_1X_RXCHIPX8,DEM1X_RTC_ADJUST"
)
if "&choice"=="DEM1X_RTF_CTL_SEL"
(
  per.view hwioreg.per "DEMOD,DEMOD_1X_RXCHIPX8,DEM1X_RTF_CTL_SEL"
)
if "&choice"=="DEM1X_LPN_ADV"
(
  per.view hwioreg.per "DEMOD,DEMOD_1X_RXCHIPX8,DEM1X_LPN_ADV"
)
if "&choice"=="DEM1X_FINGER_MERGE_F8"
(
  per.view hwioreg.per "DEMOD,DEMOD_1X_RXCHIPX8,DEM1X_FINGER_MERGE_F8"
)
if "&choice"=="DEM1X_CX8_TEST_MODE"
(
  per.view hwioreg.per "DEMOD,DEMOD_1X_RXCHIPX8,DEM1X_CX8_TEST_MODE"
)
if "&choice"=="DEM1X_CX8_TEST_MISR_RESET"
(
  per.view hwioreg.per "DEMOD,DEMOD_1X_RXCHIPX8,DEM1X_CX8_TEST_MISR_RESET"
)
if "&choice"=="DEM1X_CX8_TEST_EXPORT_MISR"
(
  per.view hwioreg.per "DEMOD,DEMOD_1X_RXCHIPX8,DEM1X_CX8_TEST_EXPORT_MISR"
)
if "&choice"=="DEM1X_CX8_TEST_CAPTURED"
(
  per.view hwioreg.per "DEMOD,DEMOD_1X_RXCHIPX8,DEM1X_CX8_TEST_CAPTURED"
)
if "&choice"=="DEM1X_CX8_TEST_MISR_CURR_VAL"
(
  per.view hwioreg.per "DEMOD,DEMOD_1X_RXCHIPX8,DEM1X_CX8_TEST_MISR_CURR_VAL"
)
if "&choice"=="DEM1X_CX8_TEST_MISR_CAPT_VAL"
(
  per.view hwioreg.per "DEMOD,DEMOD_1X_RXCHIPX8,DEM1X_CX8_TEST_MISR_CAPT_VAL"
)
if "&choice"=="DEM1X_MICRO_CX8_CLK_CTL"
(
  per.view hwioreg.per "DEMOD,DEMOD_1X_RXCHIPX8,DEM1X_MICRO_CX8_CLK_CTL"
)
if "&choice"=="DEM1X_CX8_CLK_STATUS"
(
  per.view hwioreg.per "DEMOD,DEMOD_1X_RXCHIPX8,DEM1X_CX8_CLK_STATUS"
)
if "&choice"=="DEM1X_RXCX8_SPARE_READ_REG0"
(
  per.view hwioreg.per "DEMOD,DEMOD_1X_RXCHIPX8,DEM1X_RXCX8_SPARE_READ_REG0"
)
if "&choice"=="DEM1X_RXCX8_SPARE_READ_REG1"
(
  per.view hwioreg.per "DEMOD,DEMOD_1X_RXCHIPX8,DEM1X_RXCX8_SPARE_READ_REG1"
)
if "&choice"=="DEM1X_RXCX8_SPARE_READ_REG2"
(
  per.view hwioreg.per "DEMOD,DEMOD_1X_RXCHIPX8,DEM1X_RXCX8_SPARE_READ_REG2"
)
if "&choice"=="DEM1X_RXCX8_SPARE_READ_REG3"
(
  per.view hwioreg.per "DEMOD,DEMOD_1X_RXCHIPX8,DEM1X_RXCX8_SPARE_READ_REG3"
)
if "&choice"=="DEM1X_RXCX8WR_SPARE_READ_REG0"
(
  per.view hwioreg.per "DEMOD,DEMOD_1X_RXCHIPX8,DEM1X_RXCX8WR_SPARE_READ_REG0"
)
if "&choice"=="MDM_HI0_CH0_CMD_PTR_SD0"
(
  per.view hwioreg.per "DMH00,MDM_HI0_CH0_CMD_PTR_SD0"
)
if "&choice"=="MDM_HI0_CH0_CMD_PTR_SD1"
(
  per.view hwioreg.per "DMH00,MDM_HI0_CH0_CMD_PTR_SD1"
)
if "&choice"=="MDM_HI0_CH0_CMD_PTR_SD2"
(
  per.view hwioreg.per "DMH00,MDM_HI0_CH0_CMD_PTR_SD2"
)
if "&choice"=="MDM_HI0_CH0_CMD_PTR_SD3"
(
  per.view hwioreg.per "DMH00,MDM_HI0_CH0_CMD_PTR_SD3"
)
if "&choice"=="MDM_HI0_CH1_CMD_PTR_SD0"
(
  per.view hwioreg.per "DMH00,MDM_HI0_CH1_CMD_PTR_SD0"
)
if "&choice"=="MDM_HI0_CH1_CMD_PTR_SD1"
(
  per.view hwioreg.per "DMH00,MDM_HI0_CH1_CMD_PTR_SD1"
)
if "&choice"=="MDM_HI0_CH1_CMD_PTR_SD2"
(
  per.view hwioreg.per "DMH00,MDM_HI0_CH1_CMD_PTR_SD2"
)
if "&choice"=="MDM_HI0_CH1_CMD_PTR_SD3"
(
  per.view hwioreg.per "DMH00,MDM_HI0_CH1_CMD_PTR_SD3"
)
if "&choice"=="MDM_HI0_CH2_CMD_PTR_SD0"
(
  per.view hwioreg.per "DMH00,MDM_HI0_CH2_CMD_PTR_SD0"
)
if "&choice"=="MDM_HI0_CH2_CMD_PTR_SD1"
(
  per.view hwioreg.per "DMH00,MDM_HI0_CH2_CMD_PTR_SD1"
)
if "&choice"=="MDM_HI0_CH2_CMD_PTR_SD2"
(
  per.view hwioreg.per "DMH00,MDM_HI0_CH2_CMD_PTR_SD2"
)
if "&choice"=="MDM_HI0_CH2_CMD_PTR_SD3"
(
  per.view hwioreg.per "DMH00,MDM_HI0_CH2_CMD_PTR_SD3"
)
if "&choice"=="MDM_HI0_CH3_CMD_PTR_SD0"
(
  per.view hwioreg.per "DMH00,MDM_HI0_CH3_CMD_PTR_SD0"
)
if "&choice"=="MDM_HI0_CH3_CMD_PTR_SD1"
(
  per.view hwioreg.per "DMH00,MDM_HI0_CH3_CMD_PTR_SD1"
)
if "&choice"=="MDM_HI0_CH3_CMD_PTR_SD2"
(
  per.view hwioreg.per "DMH00,MDM_HI0_CH3_CMD_PTR_SD2"
)
if "&choice"=="MDM_HI0_CH3_CMD_PTR_SD3"
(
  per.view hwioreg.per "DMH00,MDM_HI0_CH3_CMD_PTR_SD3"
)
if "&choice"=="MDM_HI0_CH4_CMD_PTR_SD0"
(
  per.view hwioreg.per "DMH00,MDM_HI0_CH4_CMD_PTR_SD0"
)
if "&choice"=="MDM_HI0_CH4_CMD_PTR_SD1"
(
  per.view hwioreg.per "DMH00,MDM_HI0_CH4_CMD_PTR_SD1"
)
if "&choice"=="MDM_HI0_CH4_CMD_PTR_SD2"
(
  per.view hwioreg.per "DMH00,MDM_HI0_CH4_CMD_PTR_SD2"
)
if "&choice"=="MDM_HI0_CH4_CMD_PTR_SD3"
(
  per.view hwioreg.per "DMH00,MDM_HI0_CH4_CMD_PTR_SD3"
)
if "&choice"=="MDM_HI0_CH5_CMD_PTR_SD0"
(
  per.view hwioreg.per "DMH00,MDM_HI0_CH5_CMD_PTR_SD0"
)
if "&choice"=="MDM_HI0_CH5_CMD_PTR_SD1"
(
  per.view hwioreg.per "DMH00,MDM_HI0_CH5_CMD_PTR_SD1"
)
if "&choice"=="MDM_HI0_CH5_CMD_PTR_SD2"
(
  per.view hwioreg.per "DMH00,MDM_HI0_CH5_CMD_PTR_SD2"
)
if "&choice"=="MDM_HI0_CH5_CMD_PTR_SD3"
(
  per.view hwioreg.per "DMH00,MDM_HI0_CH5_CMD_PTR_SD3"
)
if "&choice"=="MDM_HI0_CH6_CMD_PTR_SD0"
(
  per.view hwioreg.per "DMH00,MDM_HI0_CH6_CMD_PTR_SD0"
)
if "&choice"=="MDM_HI0_CH6_CMD_PTR_SD1"
(
  per.view hwioreg.per "DMH00,MDM_HI0_CH6_CMD_PTR_SD1"
)
if "&choice"=="MDM_HI0_CH6_CMD_PTR_SD2"
(
  per.view hwioreg.per "DMH00,MDM_HI0_CH6_CMD_PTR_SD2"
)
if "&choice"=="MDM_HI0_CH6_CMD_PTR_SD3"
(
  per.view hwioreg.per "DMH00,MDM_HI0_CH6_CMD_PTR_SD3"
)
if "&choice"=="MDM_HI0_CH7_CMD_PTR_SD0"
(
  per.view hwioreg.per "DMH00,MDM_HI0_CH7_CMD_PTR_SD0"
)
if "&choice"=="MDM_HI0_CH7_CMD_PTR_SD1"
(
  per.view hwioreg.per "DMH00,MDM_HI0_CH7_CMD_PTR_SD1"
)
if "&choice"=="MDM_HI0_CH7_CMD_PTR_SD2"
(
  per.view hwioreg.per "DMH00,MDM_HI0_CH7_CMD_PTR_SD2"
)
if "&choice"=="MDM_HI0_CH7_CMD_PTR_SD3"
(
  per.view hwioreg.per "DMH00,MDM_HI0_CH7_CMD_PTR_SD3"
)
if "&choice"=="MDM_HI0_CH8_CMD_PTR_SD0"
(
  per.view hwioreg.per "DMH00,MDM_HI0_CH8_CMD_PTR_SD0"
)
if "&choice"=="MDM_HI0_CH8_CMD_PTR_SD1"
(
  per.view hwioreg.per "DMH00,MDM_HI0_CH8_CMD_PTR_SD1"
)
if "&choice"=="MDM_HI0_CH8_CMD_PTR_SD2"
(
  per.view hwioreg.per "DMH00,MDM_HI0_CH8_CMD_PTR_SD2"
)
if "&choice"=="MDM_HI0_CH8_CMD_PTR_SD3"
(
  per.view hwioreg.per "DMH00,MDM_HI0_CH8_CMD_PTR_SD3"
)
if "&choice"=="MDM_HI0_CH9_CMD_PTR_SD0"
(
  per.view hwioreg.per "DMH00,MDM_HI0_CH9_CMD_PTR_SD0"
)
if "&choice"=="MDM_HI0_CH9_CMD_PTR_SD1"
(
  per.view hwioreg.per "DMH00,MDM_HI0_CH9_CMD_PTR_SD1"
)
if "&choice"=="MDM_HI0_CH9_CMD_PTR_SD2"
(
  per.view hwioreg.per "DMH00,MDM_HI0_CH9_CMD_PTR_SD2"
)
if "&choice"=="MDM_HI0_CH9_CMD_PTR_SD3"
(
  per.view hwioreg.per "DMH00,MDM_HI0_CH9_CMD_PTR_SD3"
)
if "&choice"=="MDM_HI0_CH10_CMD_PTR_SD0"
(
  per.view hwioreg.per "DMH00,MDM_HI0_CH10_CMD_PTR_SD0"
)
if "&choice"=="MDM_HI0_CH10_CMD_PTR_SD1"
(
  per.view hwioreg.per "DMH00,MDM_HI0_CH10_CMD_PTR_SD1"
)
if "&choice"=="MDM_HI0_CH10_CMD_PTR_SD2"
(
  per.view hwioreg.per "DMH00,MDM_HI0_CH10_CMD_PTR_SD2"
)
if "&choice"=="MDM_HI0_CH10_CMD_PTR_SD3"
(
  per.view hwioreg.per "DMH00,MDM_HI0_CH10_CMD_PTR_SD3"
)
if "&choice"=="MDM_HI0_CH11_CMD_PTR_SD0"
(
  per.view hwioreg.per "DMH00,MDM_HI0_CH11_CMD_PTR_SD0"
)
if "&choice"=="MDM_HI0_CH11_CMD_PTR_SD1"
(
  per.view hwioreg.per "DMH00,MDM_HI0_CH11_CMD_PTR_SD1"
)
if "&choice"=="MDM_HI0_CH11_CMD_PTR_SD2"
(
  per.view hwioreg.per "DMH00,MDM_HI0_CH11_CMD_PTR_SD2"
)
if "&choice"=="MDM_HI0_CH11_CMD_PTR_SD3"
(
  per.view hwioreg.per "DMH00,MDM_HI0_CH11_CMD_PTR_SD3"
)
if "&choice"=="MDM_HI0_CH12_CMD_PTR_SD0"
(
  per.view hwioreg.per "DMH00,MDM_HI0_CH12_CMD_PTR_SD0"
)
if "&choice"=="MDM_HI0_CH12_CMD_PTR_SD1"
(
  per.view hwioreg.per "DMH00,MDM_HI0_CH12_CMD_PTR_SD1"
)
if "&choice"=="MDM_HI0_CH12_CMD_PTR_SD2"
(
  per.view hwioreg.per "DMH00,MDM_HI0_CH12_CMD_PTR_SD2"
)
if "&choice"=="MDM_HI0_CH12_CMD_PTR_SD3"
(
  per.view hwioreg.per "DMH00,MDM_HI0_CH12_CMD_PTR_SD3"
)
if "&choice"=="MDM_HI0_CH13_CMD_PTR_SD0"
(
  per.view hwioreg.per "DMH00,MDM_HI0_CH13_CMD_PTR_SD0"
)
if "&choice"=="MDM_HI0_CH13_CMD_PTR_SD1"
(
  per.view hwioreg.per "DMH00,MDM_HI0_CH13_CMD_PTR_SD1"
)
if "&choice"=="MDM_HI0_CH13_CMD_PTR_SD2"
(
  per.view hwioreg.per "DMH00,MDM_HI0_CH13_CMD_PTR_SD2"
)
if "&choice"=="MDM_HI0_CH13_CMD_PTR_SD3"
(
  per.view hwioreg.per "DMH00,MDM_HI0_CH13_CMD_PTR_SD3"
)
if "&choice"=="MDM_HI0_CH14_CMD_PTR_SD0"
(
  per.view hwioreg.per "DMH00,MDM_HI0_CH14_CMD_PTR_SD0"
)
if "&choice"=="MDM_HI0_CH14_CMD_PTR_SD1"
(
  per.view hwioreg.per "DMH00,MDM_HI0_CH14_CMD_PTR_SD1"
)
if "&choice"=="MDM_HI0_CH14_CMD_PTR_SD2"
(
  per.view hwioreg.per "DMH00,MDM_HI0_CH14_CMD_PTR_SD2"
)
if "&choice"=="MDM_HI0_CH14_CMD_PTR_SD3"
(
  per.view hwioreg.per "DMH00,MDM_HI0_CH14_CMD_PTR_SD3"
)
if "&choice"=="MDM_HI0_CH15_CMD_PTR_SD0"
(
  per.view hwioreg.per "DMH00,MDM_HI0_CH15_CMD_PTR_SD0"
)
if "&choice"=="MDM_HI0_CH15_CMD_PTR_SD1"
(
  per.view hwioreg.per "DMH00,MDM_HI0_CH15_CMD_PTR_SD1"
)
if "&choice"=="MDM_HI0_CH15_CMD_PTR_SD2"
(
  per.view hwioreg.per "DMH00,MDM_HI0_CH15_CMD_PTR_SD2"
)
if "&choice"=="MDM_HI0_CH15_CMD_PTR_SD3"
(
  per.view hwioreg.per "DMH00,MDM_HI0_CH15_CMD_PTR_SD3"
)
if "&choice"=="MDM_HI0_CH0_RSLT_SD0"
(
  per.view hwioreg.per "DMH00,MDM_HI0_CH0_RSLT_SD0"
)
if "&choice"=="MDM_HI0_CH0_RSLT_SD1"
(
  per.view hwioreg.per "DMH00,MDM_HI0_CH0_RSLT_SD1"
)
if "&choice"=="MDM_HI0_CH0_RSLT_SD2"
(
  per.view hwioreg.per "DMH00,MDM_HI0_CH0_RSLT_SD2"
)
if "&choice"=="MDM_HI0_CH0_RSLT_SD3"
(
  per.view hwioreg.per "DMH00,MDM_HI0_CH0_RSLT_SD3"
)
if "&choice"=="MDM_HI0_CH1_RSLT_SD0"
(
  per.view hwioreg.per "DMH00,MDM_HI0_CH1_RSLT_SD0"
)
if "&choice"=="MDM_HI0_CH1_RSLT_SD1"
(
  per.view hwioreg.per "DMH00,MDM_HI0_CH1_RSLT_SD1"
)
if "&choice"=="MDM_HI0_CH1_RSLT_SD2"
(
  per.view hwioreg.per "DMH00,MDM_HI0_CH1_RSLT_SD2"
)
if "&choice"=="MDM_HI0_CH1_RSLT_SD3"
(
  per.view hwioreg.per "DMH00,MDM_HI0_CH1_RSLT_SD3"
)
if "&choice"=="MDM_HI0_CH2_RSLT_SD0"
(
  per.view hwioreg.per "DMH00,MDM_HI0_CH2_RSLT_SD0"
)
if "&choice"=="MDM_HI0_CH2_RSLT_SD1"
(
  per.view hwioreg.per "DMH00,MDM_HI0_CH2_RSLT_SD1"
)
if "&choice"=="MDM_HI0_CH2_RSLT_SD2"
(
  per.view hwioreg.per "DMH00,MDM_HI0_CH2_RSLT_SD2"
)
if "&choice"=="MDM_HI0_CH2_RSLT_SD3"
(
  per.view hwioreg.per "DMH00,MDM_HI0_CH2_RSLT_SD3"
)
if "&choice"=="MDM_HI0_CH3_RSLT_SD0"
(
  per.view hwioreg.per "DMH00,MDM_HI0_CH3_RSLT_SD0"
)
if "&choice"=="MDM_HI0_CH3_RSLT_SD1"
(
  per.view hwioreg.per "DMH00,MDM_HI0_CH3_RSLT_SD1"
)
if "&choice"=="MDM_HI0_CH3_RSLT_SD2"
(
  per.view hwioreg.per "DMH00,MDM_HI0_CH3_RSLT_SD2"
)
if "&choice"=="MDM_HI0_CH3_RSLT_SD3"
(
  per.view hwioreg.per "DMH00,MDM_HI0_CH3_RSLT_SD3"
)
if "&choice"=="MDM_HI0_CH4_RSLT_SD0"
(
  per.view hwioreg.per "DMH00,MDM_HI0_CH4_RSLT_SD0"
)
if "&choice"=="MDM_HI0_CH4_RSLT_SD1"
(
  per.view hwioreg.per "DMH00,MDM_HI0_CH4_RSLT_SD1"
)
if "&choice"=="MDM_HI0_CH4_RSLT_SD2"
(
  per.view hwioreg.per "DMH00,MDM_HI0_CH4_RSLT_SD2"
)
if "&choice"=="MDM_HI0_CH4_RSLT_SD3"
(
  per.view hwioreg.per "DMH00,MDM_HI0_CH4_RSLT_SD3"
)
if "&choice"=="MDM_HI0_CH5_RSLT_SD0"
(
  per.view hwioreg.per "DMH00,MDM_HI0_CH5_RSLT_SD0"
)
if "&choice"=="MDM_HI0_CH5_RSLT_SD1"
(
  per.view hwioreg.per "DMH00,MDM_HI0_CH5_RSLT_SD1"
)
if "&choice"=="MDM_HI0_CH5_RSLT_SD2"
(
  per.view hwioreg.per "DMH00,MDM_HI0_CH5_RSLT_SD2"
)
if "&choice"=="MDM_HI0_CH5_RSLT_SD3"
(
  per.view hwioreg.per "DMH00,MDM_HI0_CH5_RSLT_SD3"
)
if "&choice"=="MDM_HI0_CH6_RSLT_SD0"
(
  per.view hwioreg.per "DMH00,MDM_HI0_CH6_RSLT_SD0"
)
if "&choice"=="MDM_HI0_CH6_RSLT_SD1"
(
  per.view hwioreg.per "DMH00,MDM_HI0_CH6_RSLT_SD1"
)
if "&choice"=="MDM_HI0_CH6_RSLT_SD2"
(
  per.view hwioreg.per "DMH00,MDM_HI0_CH6_RSLT_SD2"
)
if "&choice"=="MDM_HI0_CH6_RSLT_SD3"
(
  per.view hwioreg.per "DMH00,MDM_HI0_CH6_RSLT_SD3"
)
if "&choice"=="MDM_HI0_CH7_RSLT_SD0"
(
  per.view hwioreg.per "DMH00,MDM_HI0_CH7_RSLT_SD0"
)
if "&choice"=="MDM_HI0_CH7_RSLT_SD1"
(
  per.view hwioreg.per "DMH00,MDM_HI0_CH7_RSLT_SD1"
)
if "&choice"=="MDM_HI0_CH7_RSLT_SD2"
(
  per.view hwioreg.per "DMH00,MDM_HI0_CH7_RSLT_SD2"
)
if "&choice"=="MDM_HI0_CH7_RSLT_SD3"
(
  per.view hwioreg.per "DMH00,MDM_HI0_CH7_RSLT_SD3"
)
if "&choice"=="MDM_HI0_CH8_RSLT_SD0"
(
  per.view hwioreg.per "DMH00,MDM_HI0_CH8_RSLT_SD0"
)
if "&choice"=="MDM_HI0_CH8_RSLT_SD1"
(
  per.view hwioreg.per "DMH00,MDM_HI0_CH8_RSLT_SD1"
)
if "&choice"=="MDM_HI0_CH8_RSLT_SD2"
(
  per.view hwioreg.per "DMH00,MDM_HI0_CH8_RSLT_SD2"
)
if "&choice"=="MDM_HI0_CH8_RSLT_SD3"
(
  per.view hwioreg.per "DMH00,MDM_HI0_CH8_RSLT_SD3"
)
if "&choice"=="MDM_HI0_CH9_RSLT_SD0"
(
  per.view hwioreg.per "DMH00,MDM_HI0_CH9_RSLT_SD0"
)
if "&choice"=="MDM_HI0_CH9_RSLT_SD1"
(
  per.view hwioreg.per "DMH00,MDM_HI0_CH9_RSLT_SD1"
)
if "&choice"=="MDM_HI0_CH9_RSLT_SD2"
(
  per.view hwioreg.per "DMH00,MDM_HI0_CH9_RSLT_SD2"
)
if "&choice"=="MDM_HI0_CH9_RSLT_SD3"
(
  per.view hwioreg.per "DMH00,MDM_HI0_CH9_RSLT_SD3"
)
if "&choice"=="MDM_HI0_CH10_RSLT_SD0"
(
  per.view hwioreg.per "DMH00,MDM_HI0_CH10_RSLT_SD0"
)
if "&choice"=="MDM_HI0_CH10_RSLT_SD1"
(
  per.view hwioreg.per "DMH00,MDM_HI0_CH10_RSLT_SD1"
)
if "&choice"=="MDM_HI0_CH10_RSLT_SD2"
(
  per.view hwioreg.per "DMH00,MDM_HI0_CH10_RSLT_SD2"
)
if "&choice"=="MDM_HI0_CH10_RSLT_SD3"
(
  per.view hwioreg.per "DMH00,MDM_HI0_CH10_RSLT_SD3"
)
if "&choice"=="MDM_HI0_CH11_RSLT_SD0"
(
  per.view hwioreg.per "DMH00,MDM_HI0_CH11_RSLT_SD0"
)
if "&choice"=="MDM_HI0_CH11_RSLT_SD1"
(
  per.view hwioreg.per "DMH00,MDM_HI0_CH11_RSLT_SD1"
)
if "&choice"=="MDM_HI0_CH11_RSLT_SD2"
(
  per.view hwioreg.per "DMH00,MDM_HI0_CH11_RSLT_SD2"
)
if "&choice"=="MDM_HI0_CH11_RSLT_SD3"
(
  per.view hwioreg.per "DMH00,MDM_HI0_CH11_RSLT_SD3"
)
if "&choice"=="MDM_HI0_CH12_RSLT_SD0"
(
  per.view hwioreg.per "DMH00,MDM_HI0_CH12_RSLT_SD0"
)
if "&choice"=="MDM_HI0_CH12_RSLT_SD1"
(
  per.view hwioreg.per "DMH00,MDM_HI0_CH12_RSLT_SD1"
)
if "&choice"=="MDM_HI0_CH12_RSLT_SD2"
(
  per.view hwioreg.per "DMH00,MDM_HI0_CH12_RSLT_SD2"
)
if "&choice"=="MDM_HI0_CH12_RSLT_SD3"
(
  per.view hwioreg.per "DMH00,MDM_HI0_CH12_RSLT_SD3"
)
if "&choice"=="MDM_HI0_CH13_RSLT_SD0"
(
  per.view hwioreg.per "DMH00,MDM_HI0_CH13_RSLT_SD0"
)
if "&choice"=="MDM_HI0_CH13_RSLT_SD1"
(
  per.view hwioreg.per "DMH00,MDM_HI0_CH13_RSLT_SD1"
)
if "&choice"=="MDM_HI0_CH13_RSLT_SD2"
(
  per.view hwioreg.per "DMH00,MDM_HI0_CH13_RSLT_SD2"
)
if "&choice"=="MDM_HI0_CH13_RSLT_SD3"
(
  per.view hwioreg.per "DMH00,MDM_HI0_CH13_RSLT_SD3"
)
if "&choice"=="MDM_HI0_CH14_RSLT_SD0"
(
  per.view hwioreg.per "DMH00,MDM_HI0_CH14_RSLT_SD0"
)
if "&choice"=="MDM_HI0_CH14_RSLT_SD1"
(
  per.view hwioreg.per "DMH00,MDM_HI0_CH14_RSLT_SD1"
)
if "&choice"=="MDM_HI0_CH14_RSLT_SD2"
(
  per.view hwioreg.per "DMH00,MDM_HI0_CH14_RSLT_SD2"
)
if "&choice"=="MDM_HI0_CH14_RSLT_SD3"
(
  per.view hwioreg.per "DMH00,MDM_HI0_CH14_RSLT_SD3"
)
if "&choice"=="MDM_HI0_CH15_RSLT_SD0"
(
  per.view hwioreg.per "DMH00,MDM_HI0_CH15_RSLT_SD0"
)
if "&choice"=="MDM_HI0_CH15_RSLT_SD1"
(
  per.view hwioreg.per "DMH00,MDM_HI0_CH15_RSLT_SD1"
)
if "&choice"=="MDM_HI0_CH15_RSLT_SD2"
(
  per.view hwioreg.per "DMH00,MDM_HI0_CH15_RSLT_SD2"
)
if "&choice"=="MDM_HI0_CH15_RSLT_SD3"
(
  per.view hwioreg.per "DMH00,MDM_HI0_CH15_RSLT_SD3"
)
if "&choice"=="MDM_HI0_CH0_FLUSH_STATE0_SD0"
(
  per.view hwioreg.per "DMH00,MDM_HI0_CH0_FLUSH_STATE0_SD0"
)
if "&choice"=="MDM_HI0_CH0_FLUSH_STATE0_SD1"
(
  per.view hwioreg.per "DMH00,MDM_HI0_CH0_FLUSH_STATE0_SD1"
)
if "&choice"=="MDM_HI0_CH0_FLUSH_STATE0_SD2"
(
  per.view hwioreg.per "DMH00,MDM_HI0_CH0_FLUSH_STATE0_SD2"
)
if "&choice"=="MDM_HI0_CH0_FLUSH_STATE0_SD3"
(
  per.view hwioreg.per "DMH00,MDM_HI0_CH0_FLUSH_STATE0_SD3"
)
if "&choice"=="MDM_HI0_CH1_FLUSH_STATE0_SD0"
(
  per.view hwioreg.per "DMH00,MDM_HI0_CH1_FLUSH_STATE0_SD0"
)
if "&choice"=="MDM_HI0_CH1_FLUSH_STATE0_SD1"
(
  per.view hwioreg.per "DMH00,MDM_HI0_CH1_FLUSH_STATE0_SD1"
)
if "&choice"=="MDM_HI0_CH1_FLUSH_STATE0_SD2"
(
  per.view hwioreg.per "DMH00,MDM_HI0_CH1_FLUSH_STATE0_SD2"
)
if "&choice"=="MDM_HI0_CH1_FLUSH_STATE0_SD3"
(
  per.view hwioreg.per "DMH00,MDM_HI0_CH1_FLUSH_STATE0_SD3"
)
if "&choice"=="MDM_HI0_CH2_FLUSH_STATE0_SD0"
(
  per.view hwioreg.per "DMH00,MDM_HI0_CH2_FLUSH_STATE0_SD0"
)
if "&choice"=="MDM_HI0_CH2_FLUSH_STATE0_SD1"
(
  per.view hwioreg.per "DMH00,MDM_HI0_CH2_FLUSH_STATE0_SD1"
)
if "&choice"=="MDM_HI0_CH2_FLUSH_STATE0_SD2"
(
  per.view hwioreg.per "DMH00,MDM_HI0_CH2_FLUSH_STATE0_SD2"
)
if "&choice"=="MDM_HI0_CH2_FLUSH_STATE0_SD3"
(
  per.view hwioreg.per "DMH00,MDM_HI0_CH2_FLUSH_STATE0_SD3"
)
if "&choice"=="MDM_HI0_CH3_FLUSH_STATE0_SD0"
(
  per.view hwioreg.per "DMH00,MDM_HI0_CH3_FLUSH_STATE0_SD0"
)
if "&choice"=="MDM_HI0_CH3_FLUSH_STATE0_SD1"
(
  per.view hwioreg.per "DMH00,MDM_HI0_CH3_FLUSH_STATE0_SD1"
)
if "&choice"=="MDM_HI0_CH3_FLUSH_STATE0_SD2"
(
  per.view hwioreg.per "DMH00,MDM_HI0_CH3_FLUSH_STATE0_SD2"
)
if "&choice"=="MDM_HI0_CH3_FLUSH_STATE0_SD3"
(
  per.view hwioreg.per "DMH00,MDM_HI0_CH3_FLUSH_STATE0_SD3"
)
if "&choice"=="MDM_HI0_CH4_FLUSH_STATE0_SD0"
(
  per.view hwioreg.per "DMH00,MDM_HI0_CH4_FLUSH_STATE0_SD0"
)
if "&choice"=="MDM_HI0_CH4_FLUSH_STATE0_SD1"
(
  per.view hwioreg.per "DMH00,MDM_HI0_CH4_FLUSH_STATE0_SD1"
)
if "&choice"=="MDM_HI0_CH4_FLUSH_STATE0_SD2"
(
  per.view hwioreg.per "DMH00,MDM_HI0_CH4_FLUSH_STATE0_SD2"
)
if "&choice"=="MDM_HI0_CH4_FLUSH_STATE0_SD3"
(
  per.view hwioreg.per "DMH00,MDM_HI0_CH4_FLUSH_STATE0_SD3"
)
if "&choice"=="MDM_HI0_CH5_FLUSH_STATE0_SD0"
(
  per.view hwioreg.per "DMH00,MDM_HI0_CH5_FLUSH_STATE0_SD0"
)
if "&choice"=="MDM_HI0_CH5_FLUSH_STATE0_SD1"
(
  per.view hwioreg.per "DMH00,MDM_HI0_CH5_FLUSH_STATE0_SD1"
)
if "&choice"=="MDM_HI0_CH5_FLUSH_STATE0_SD2"
(
  per.view hwioreg.per "DMH00,MDM_HI0_CH5_FLUSH_STATE0_SD2"
)
if "&choice"=="MDM_HI0_CH5_FLUSH_STATE0_SD3"
(
  per.view hwioreg.per "DMH00,MDM_HI0_CH5_FLUSH_STATE0_SD3"
)
if "&choice"=="MDM_HI0_CH6_FLUSH_STATE0_SD0"
(
  per.view hwioreg.per "DMH00,MDM_HI0_CH6_FLUSH_STATE0_SD0"
)
if "&choice"=="MDM_HI0_CH6_FLUSH_STATE0_SD1"
(
  per.view hwioreg.per "DMH00,MDM_HI0_CH6_FLUSH_STATE0_SD1"
)
if "&choice"=="MDM_HI0_CH6_FLUSH_STATE0_SD2"
(
  per.view hwioreg.per "DMH00,MDM_HI0_CH6_FLUSH_STATE0_SD2"
)
if "&choice"=="MDM_HI0_CH6_FLUSH_STATE0_SD3"
(
  per.view hwioreg.per "DMH00,MDM_HI0_CH6_FLUSH_STATE0_SD3"
)
if "&choice"=="MDM_HI0_CH7_FLUSH_STATE0_SD0"
(
  per.view hwioreg.per "DMH00,MDM_HI0_CH7_FLUSH_STATE0_SD0"
)
if "&choice"=="MDM_HI0_CH7_FLUSH_STATE0_SD1"
(
  per.view hwioreg.per "DMH00,MDM_HI0_CH7_FLUSH_STATE0_SD1"
)
if "&choice"=="MDM_HI0_CH7_FLUSH_STATE0_SD2"
(
  per.view hwioreg.per "DMH00,MDM_HI0_CH7_FLUSH_STATE0_SD2"
)
if "&choice"=="MDM_HI0_CH7_FLUSH_STATE0_SD3"
(
  per.view hwioreg.per "DMH00,MDM_HI0_CH7_FLUSH_STATE0_SD3"
)
if "&choice"=="MDM_HI0_CH8_FLUSH_STATE0_SD0"
(
  per.view hwioreg.per "DMH00,MDM_HI0_CH8_FLUSH_STATE0_SD0"
)
if "&choice"=="MDM_HI0_CH8_FLUSH_STATE0_SD1"
(
  per.view hwioreg.per "DMH00,MDM_HI0_CH8_FLUSH_STATE0_SD1"
)
if "&choice"=="MDM_HI0_CH8_FLUSH_STATE0_SD2"
(
  per.view hwioreg.per "DMH00,MDM_HI0_CH8_FLUSH_STATE0_SD2"
)
if "&choice"=="MDM_HI0_CH8_FLUSH_STATE0_SD3"
(
  per.view hwioreg.per "DMH00,MDM_HI0_CH8_FLUSH_STATE0_SD3"
)
if "&choice"=="MDM_HI0_CH9_FLUSH_STATE0_SD0"
(
  per.view hwioreg.per "DMH00,MDM_HI0_CH9_FLUSH_STATE0_SD0"
)
if "&choice"=="MDM_HI0_CH9_FLUSH_STATE0_SD1"
(
  per.view hwioreg.per "DMH00,MDM_HI0_CH9_FLUSH_STATE0_SD1"
)
if "&choice"=="MDM_HI0_CH9_FLUSH_STATE0_SD2"
(
  per.view hwioreg.per "DMH00,MDM_HI0_CH9_FLUSH_STATE0_SD2"
)
if "&choice"=="MDM_HI0_CH9_FLUSH_STATE0_SD3"
(
  per.view hwioreg.per "DMH00,MDM_HI0_CH9_FLUSH_STATE0_SD3"
)
if "&choice"=="MDM_HI0_CH10_FLUSH_STATE0_SD0"
(
  per.view hwioreg.per "DMH00,MDM_HI0_CH10_FLUSH_STATE0_SD0"
)
if "&choice"=="MDM_HI0_CH10_FLUSH_STATE0_SD1"
(
  per.view hwioreg.per "DMH00,MDM_HI0_CH10_FLUSH_STATE0_SD1"
)
if "&choice"=="MDM_HI0_CH10_FLUSH_STATE0_SD2"
(
  per.view hwioreg.per "DMH00,MDM_HI0_CH10_FLUSH_STATE0_SD2"
)
if "&choice"=="MDM_HI0_CH10_FLUSH_STATE0_SD3"
(
  per.view hwioreg.per "DMH00,MDM_HI0_CH10_FLUSH_STATE0_SD3"
)
if "&choice"=="MDM_HI0_CH11_FLUSH_STATE0_SD0"
(
  per.view hwioreg.per "DMH00,MDM_HI0_CH11_FLUSH_STATE0_SD0"
)
if "&choice"=="MDM_HI0_CH11_FLUSH_STATE0_SD1"
(
  per.view hwioreg.per "DMH00,MDM_HI0_CH11_FLUSH_STATE0_SD1"
)
if "&choice"=="MDM_HI0_CH11_FLUSH_STATE0_SD2"
(
  per.view hwioreg.per "DMH00,MDM_HI0_CH11_FLUSH_STATE0_SD2"
)
if "&choice"=="MDM_HI0_CH11_FLUSH_STATE0_SD3"
(
  per.view hwioreg.per "DMH00,MDM_HI0_CH11_FLUSH_STATE0_SD3"
)
if "&choice"=="MDM_HI0_CH12_FLUSH_STATE0_SD0"
(
  per.view hwioreg.per "DMH00,MDM_HI0_CH12_FLUSH_STATE0_SD0"
)
if "&choice"=="MDM_HI0_CH12_FLUSH_STATE0_SD1"
(
  per.view hwioreg.per "DMH00,MDM_HI0_CH12_FLUSH_STATE0_SD1"
)
if "&choice"=="MDM_HI0_CH12_FLUSH_STATE0_SD2"
(
  per.view hwioreg.per "DMH00,MDM_HI0_CH12_FLUSH_STATE0_SD2"
)
if "&choice"=="MDM_HI0_CH12_FLUSH_STATE0_SD3"
(
  per.view hwioreg.per "DMH00,MDM_HI0_CH12_FLUSH_STATE0_SD3"
)
if "&choice"=="MDM_HI0_CH13_FLUSH_STATE0_SD0"
(
  per.view hwioreg.per "DMH00,MDM_HI0_CH13_FLUSH_STATE0_SD0"
)
if "&choice"=="MDM_HI0_CH13_FLUSH_STATE0_SD1"
(
  per.view hwioreg.per "DMH00,MDM_HI0_CH13_FLUSH_STATE0_SD1"
)
if "&choice"=="MDM_HI0_CH13_FLUSH_STATE0_SD2"
(
  per.view hwioreg.per "DMH00,MDM_HI0_CH13_FLUSH_STATE0_SD2"
)
if "&choice"=="MDM_HI0_CH13_FLUSH_STATE0_SD3"
(
  per.view hwioreg.per "DMH00,MDM_HI0_CH13_FLUSH_STATE0_SD3"
)
if "&choice"=="MDM_HI0_CH14_FLUSH_STATE0_SD0"
(
  per.view hwioreg.per "DMH00,MDM_HI0_CH14_FLUSH_STATE0_SD0"
)
if "&choice"=="MDM_HI0_CH14_FLUSH_STATE0_SD1"
(
  per.view hwioreg.per "DMH00,MDM_HI0_CH14_FLUSH_STATE0_SD1"
)
if "&choice"=="MDM_HI0_CH14_FLUSH_STATE0_SD2"
(
  per.view hwioreg.per "DMH00,MDM_HI0_CH14_FLUSH_STATE0_SD2"
)
if "&choice"=="MDM_HI0_CH14_FLUSH_STATE0_SD3"
(
  per.view hwioreg.per "DMH00,MDM_HI0_CH14_FLUSH_STATE0_SD3"
)
if "&choice"=="MDM_HI0_CH15_FLUSH_STATE0_SD0"
(
  per.view hwioreg.per "DMH00,MDM_HI0_CH15_FLUSH_STATE0_SD0"
)
if "&choice"=="MDM_HI0_CH15_FLUSH_STATE0_SD1"
(
  per.view hwioreg.per "DMH00,MDM_HI0_CH15_FLUSH_STATE0_SD1"
)
if "&choice"=="MDM_HI0_CH15_FLUSH_STATE0_SD2"
(
  per.view hwioreg.per "DMH00,MDM_HI0_CH15_FLUSH_STATE0_SD2"
)
if "&choice"=="MDM_HI0_CH15_FLUSH_STATE0_SD3"
(
  per.view hwioreg.per "DMH00,MDM_HI0_CH15_FLUSH_STATE0_SD3"
)
if "&choice"=="MDM_HI0_CH0_FLUSH_STATE1_SD0"
(
  per.view hwioreg.per "DMH00,MDM_HI0_CH0_FLUSH_STATE1_SD0"
)
if "&choice"=="MDM_HI0_CH0_FLUSH_STATE1_SD1"
(
  per.view hwioreg.per "DMH00,MDM_HI0_CH0_FLUSH_STATE1_SD1"
)
if "&choice"=="MDM_HI0_CH0_FLUSH_STATE1_SD2"
(
  per.view hwioreg.per "DMH00,MDM_HI0_CH0_FLUSH_STATE1_SD2"
)
if "&choice"=="MDM_HI0_CH0_FLUSH_STATE1_SD3"
(
  per.view hwioreg.per "DMH00,MDM_HI0_CH0_FLUSH_STATE1_SD3"
)
if "&choice"=="MDM_HI0_CH1_FLUSH_STATE1_SD0"
(
  per.view hwioreg.per "DMH00,MDM_HI0_CH1_FLUSH_STATE1_SD0"
)
if "&choice"=="MDM_HI0_CH1_FLUSH_STATE1_SD1"
(
  per.view hwioreg.per "DMH00,MDM_HI0_CH1_FLUSH_STATE1_SD1"
)
if "&choice"=="MDM_HI0_CH1_FLUSH_STATE1_SD2"
(
  per.view hwioreg.per "DMH00,MDM_HI0_CH1_FLUSH_STATE1_SD2"
)
if "&choice"=="MDM_HI0_CH1_FLUSH_STATE1_SD3"
(
  per.view hwioreg.per "DMH00,MDM_HI0_CH1_FLUSH_STATE1_SD3"
)
if "&choice"=="MDM_HI0_CH2_FLUSH_STATE1_SD0"
(
  per.view hwioreg.per "DMH00,MDM_HI0_CH2_FLUSH_STATE1_SD0"
)
if "&choice"=="MDM_HI0_CH2_FLUSH_STATE1_SD1"
(
  per.view hwioreg.per "DMH00,MDM_HI0_CH2_FLUSH_STATE1_SD1"
)
if "&choice"=="MDM_HI0_CH2_FLUSH_STATE1_SD2"
(
  per.view hwioreg.per "DMH00,MDM_HI0_CH2_FLUSH_STATE1_SD2"
)
if "&choice"=="MDM_HI0_CH2_FLUSH_STATE1_SD3"
(
  per.view hwioreg.per "DMH00,MDM_HI0_CH2_FLUSH_STATE1_SD3"
)
if "&choice"=="MDM_HI0_CH3_FLUSH_STATE1_SD0"
(
  per.view hwioreg.per "DMH00,MDM_HI0_CH3_FLUSH_STATE1_SD0"
)
if "&choice"=="MDM_HI0_CH3_FLUSH_STATE1_SD1"
(
  per.view hwioreg.per "DMH00,MDM_HI0_CH3_FLUSH_STATE1_SD1"
)
if "&choice"=="MDM_HI0_CH3_FLUSH_STATE1_SD2"
(
  per.view hwioreg.per "DMH00,MDM_HI0_CH3_FLUSH_STATE1_SD2"
)
if "&choice"=="MDM_HI0_CH3_FLUSH_STATE1_SD3"
(
  per.view hwioreg.per "DMH00,MDM_HI0_CH3_FLUSH_STATE1_SD3"
)
if "&choice"=="MDM_HI0_CH4_FLUSH_STATE1_SD0"
(
  per.view hwioreg.per "DMH00,MDM_HI0_CH4_FLUSH_STATE1_SD0"
)
if "&choice"=="MDM_HI0_CH4_FLUSH_STATE1_SD1"
(
  per.view hwioreg.per "DMH00,MDM_HI0_CH4_FLUSH_STATE1_SD1"
)
if "&choice"=="MDM_HI0_CH4_FLUSH_STATE1_SD2"
(
  per.view hwioreg.per "DMH00,MDM_HI0_CH4_FLUSH_STATE1_SD2"
)
if "&choice"=="MDM_HI0_CH4_FLUSH_STATE1_SD3"
(
  per.view hwioreg.per "DMH00,MDM_HI0_CH4_FLUSH_STATE1_SD3"
)
if "&choice"=="MDM_HI0_CH5_FLUSH_STATE1_SD0"
(
  per.view hwioreg.per "DMH00,MDM_HI0_CH5_FLUSH_STATE1_SD0"
)
if "&choice"=="MDM_HI0_CH5_FLUSH_STATE1_SD1"
(
  per.view hwioreg.per "DMH00,MDM_HI0_CH5_FLUSH_STATE1_SD1"
)
if "&choice"=="MDM_HI0_CH5_FLUSH_STATE1_SD2"
(
  per.view hwioreg.per "DMH00,MDM_HI0_CH5_FLUSH_STATE1_SD2"
)
if "&choice"=="MDM_HI0_CH5_FLUSH_STATE1_SD3"
(
  per.view hwioreg.per "DMH00,MDM_HI0_CH5_FLUSH_STATE1_SD3"
)
if "&choice"=="MDM_HI0_CH6_FLUSH_STATE1_SD0"
(
  per.view hwioreg.per "DMH00,MDM_HI0_CH6_FLUSH_STATE1_SD0"
)
if "&choice"=="MDM_HI0_CH6_FLUSH_STATE1_SD1"
(
  per.view hwioreg.per "DMH00,MDM_HI0_CH6_FLUSH_STATE1_SD1"
)
if "&choice"=="MDM_HI0_CH6_FLUSH_STATE1_SD2"
(
  per.view hwioreg.per "DMH00,MDM_HI0_CH6_FLUSH_STATE1_SD2"
)
if "&choice"=="MDM_HI0_CH6_FLUSH_STATE1_SD3"
(
  per.view hwioreg.per "DMH00,MDM_HI0_CH6_FLUSH_STATE1_SD3"
)
if "&choice"=="MDM_HI0_CH7_FLUSH_STATE1_SD0"
(
  per.view hwioreg.per "DMH00,MDM_HI0_CH7_FLUSH_STATE1_SD0"
)
if "&choice"=="MDM_HI0_CH7_FLUSH_STATE1_SD1"
(
  per.view hwioreg.per "DMH00,MDM_HI0_CH7_FLUSH_STATE1_SD1"
)
if "&choice"=="MDM_HI0_CH7_FLUSH_STATE1_SD2"
(
  per.view hwioreg.per "DMH00,MDM_HI0_CH7_FLUSH_STATE1_SD2"
)
if "&choice"=="MDM_HI0_CH7_FLUSH_STATE1_SD3"
(
  per.view hwioreg.per "DMH00,MDM_HI0_CH7_FLUSH_STATE1_SD3"
)
if "&choice"=="MDM_HI0_CH8_FLUSH_STATE1_SD0"
(
  per.view hwioreg.per "DMH00,MDM_HI0_CH8_FLUSH_STATE1_SD0"
)
if "&choice"=="MDM_HI0_CH8_FLUSH_STATE1_SD1"
(
  per.view hwioreg.per "DMH00,MDM_HI0_CH8_FLUSH_STATE1_SD1"
)
if "&choice"=="MDM_HI0_CH8_FLUSH_STATE1_SD2"
(
  per.view hwioreg.per "DMH00,MDM_HI0_CH8_FLUSH_STATE1_SD2"
)
if "&choice"=="MDM_HI0_CH8_FLUSH_STATE1_SD3"
(
  per.view hwioreg.per "DMH00,MDM_HI0_CH8_FLUSH_STATE1_SD3"
)
if "&choice"=="MDM_HI0_CH9_FLUSH_STATE1_SD0"
(
  per.view hwioreg.per "DMH00,MDM_HI0_CH9_FLUSH_STATE1_SD0"
)
if "&choice"=="MDM_HI0_CH9_FLUSH_STATE1_SD1"
(
  per.view hwioreg.per "DMH00,MDM_HI0_CH9_FLUSH_STATE1_SD1"
)
if "&choice"=="MDM_HI0_CH9_FLUSH_STATE1_SD2"
(
  per.view hwioreg.per "DMH00,MDM_HI0_CH9_FLUSH_STATE1_SD2"
)
if "&choice"=="MDM_HI0_CH9_FLUSH_STATE1_SD3"
(
  per.view hwioreg.per "DMH00,MDM_HI0_CH9_FLUSH_STATE1_SD3"
)
if "&choice"=="MDM_HI0_CH10_FLUSH_STATE1_SD0"
(
  per.view hwioreg.per "DMH00,MDM_HI0_CH10_FLUSH_STATE1_SD0"
)
if "&choice"=="MDM_HI0_CH10_FLUSH_STATE1_SD1"
(
  per.view hwioreg.per "DMH00,MDM_HI0_CH10_FLUSH_STATE1_SD1"
)
if "&choice"=="MDM_HI0_CH10_FLUSH_STATE1_SD2"
(
  per.view hwioreg.per "DMH00,MDM_HI0_CH10_FLUSH_STATE1_SD2"
)
if "&choice"=="MDM_HI0_CH10_FLUSH_STATE1_SD3"
(
  per.view hwioreg.per "DMH00,MDM_HI0_CH10_FLUSH_STATE1_SD3"
)
if "&choice"=="MDM_HI0_CH11_FLUSH_STATE1_SD0"
(
  per.view hwioreg.per "DMH00,MDM_HI0_CH11_FLUSH_STATE1_SD0"
)
if "&choice"=="MDM_HI0_CH11_FLUSH_STATE1_SD1"
(
  per.view hwioreg.per "DMH00,MDM_HI0_CH11_FLUSH_STATE1_SD1"
)
if "&choice"=="MDM_HI0_CH11_FLUSH_STATE1_SD2"
(
  per.view hwioreg.per "DMH00,MDM_HI0_CH11_FLUSH_STATE1_SD2"
)
if "&choice"=="MDM_HI0_CH11_FLUSH_STATE1_SD3"
(
  per.view hwioreg.per "DMH00,MDM_HI0_CH11_FLUSH_STATE1_SD3"
)
if "&choice"=="MDM_HI0_CH12_FLUSH_STATE1_SD0"
(
  per.view hwioreg.per "DMH00,MDM_HI0_CH12_FLUSH_STATE1_SD0"
)
if "&choice"=="MDM_HI0_CH12_FLUSH_STATE1_SD1"
(
  per.view hwioreg.per "DMH00,MDM_HI0_CH12_FLUSH_STATE1_SD1"
)
if "&choice"=="MDM_HI0_CH12_FLUSH_STATE1_SD2"
(
  per.view hwioreg.per "DMH00,MDM_HI0_CH12_FLUSH_STATE1_SD2"
)
if "&choice"=="MDM_HI0_CH12_FLUSH_STATE1_SD3"
(
  per.view hwioreg.per "DMH00,MDM_HI0_CH12_FLUSH_STATE1_SD3"
)
if "&choice"=="MDM_HI0_CH13_FLUSH_STATE1_SD0"
(
  per.view hwioreg.per "DMH00,MDM_HI0_CH13_FLUSH_STATE1_SD0"
)
if "&choice"=="MDM_HI0_CH13_FLUSH_STATE1_SD1"
(
  per.view hwioreg.per "DMH00,MDM_HI0_CH13_FLUSH_STATE1_SD1"
)
if "&choice"=="MDM_HI0_CH13_FLUSH_STATE1_SD2"
(
  per.view hwioreg.per "DMH00,MDM_HI0_CH13_FLUSH_STATE1_SD2"
)
if "&choice"=="MDM_HI0_CH13_FLUSH_STATE1_SD3"
(
  per.view hwioreg.per "DMH00,MDM_HI0_CH13_FLUSH_STATE1_SD3"
)
if "&choice"=="MDM_HI0_CH14_FLUSH_STATE1_SD0"
(
  per.view hwioreg.per "DMH00,MDM_HI0_CH14_FLUSH_STATE1_SD0"
)
if "&choice"=="MDM_HI0_CH14_FLUSH_STATE1_SD1"
(
  per.view hwioreg.per "DMH00,MDM_HI0_CH14_FLUSH_STATE1_SD1"
)
if "&choice"=="MDM_HI0_CH14_FLUSH_STATE1_SD2"
(
  per.view hwioreg.per "DMH00,MDM_HI0_CH14_FLUSH_STATE1_SD2"
)
if "&choice"=="MDM_HI0_CH14_FLUSH_STATE1_SD3"
(
  per.view hwioreg.per "DMH00,MDM_HI0_CH14_FLUSH_STATE1_SD3"
)
if "&choice"=="MDM_HI0_CH15_FLUSH_STATE1_SD0"
(
  per.view hwioreg.per "DMH00,MDM_HI0_CH15_FLUSH_STATE1_SD0"
)
if "&choice"=="MDM_HI0_CH15_FLUSH_STATE1_SD1"
(
  per.view hwioreg.per "DMH00,MDM_HI0_CH15_FLUSH_STATE1_SD1"
)
if "&choice"=="MDM_HI0_CH15_FLUSH_STATE1_SD2"
(
  per.view hwioreg.per "DMH00,MDM_HI0_CH15_FLUSH_STATE1_SD2"
)
if "&choice"=="MDM_HI0_CH15_FLUSH_STATE1_SD3"
(
  per.view hwioreg.per "DMH00,MDM_HI0_CH15_FLUSH_STATE1_SD3"
)
if "&choice"=="MDM_HI0_CH0_FLUSH_STATE2_SD0"
(
  per.view hwioreg.per "DMH00,MDM_HI0_CH0_FLUSH_STATE2_SD0"
)
if "&choice"=="MDM_HI0_CH0_FLUSH_STATE2_SD1"
(
  per.view hwioreg.per "DMH00,MDM_HI0_CH0_FLUSH_STATE2_SD1"
)
if "&choice"=="MDM_HI0_CH0_FLUSH_STATE2_SD2"
(
  per.view hwioreg.per "DMH00,MDM_HI0_CH0_FLUSH_STATE2_SD2"
)
if "&choice"=="MDM_HI0_CH0_FLUSH_STATE2_SD3"
(
  per.view hwioreg.per "DMH00,MDM_HI0_CH0_FLUSH_STATE2_SD3"
)
if "&choice"=="MDM_HI0_CH1_FLUSH_STATE2_SD0"
(
  per.view hwioreg.per "DMH00,MDM_HI0_CH1_FLUSH_STATE2_SD0"
)
if "&choice"=="MDM_HI0_CH1_FLUSH_STATE2_SD1"
(
  per.view hwioreg.per "DMH00,MDM_HI0_CH1_FLUSH_STATE2_SD1"
)
if "&choice"=="MDM_HI0_CH1_FLUSH_STATE2_SD2"
(
  per.view hwioreg.per "DMH00,MDM_HI0_CH1_FLUSH_STATE2_SD2"
)
if "&choice"=="MDM_HI0_CH1_FLUSH_STATE2_SD3"
(
  per.view hwioreg.per "DMH00,MDM_HI0_CH1_FLUSH_STATE2_SD3"
)
if "&choice"=="MDM_HI0_CH2_FLUSH_STATE2_SD0"
(
  per.view hwioreg.per "DMH00,MDM_HI0_CH2_FLUSH_STATE2_SD0"
)
if "&choice"=="MDM_HI0_CH2_FLUSH_STATE2_SD1"
(
  per.view hwioreg.per "DMH00,MDM_HI0_CH2_FLUSH_STATE2_SD1"
)
if "&choice"=="MDM_HI0_CH2_FLUSH_STATE2_SD2"
(
  per.view hwioreg.per "DMH00,MDM_HI0_CH2_FLUSH_STATE2_SD2"
)
if "&choice"=="MDM_HI0_CH2_FLUSH_STATE2_SD3"
(
  per.view hwioreg.per "DMH00,MDM_HI0_CH2_FLUSH_STATE2_SD3"
)
if "&choice"=="MDM_HI0_CH3_FLUSH_STATE2_SD0"
(
  per.view hwioreg.per "DMH00,MDM_HI0_CH3_FLUSH_STATE2_SD0"
)
if "&choice"=="MDM_HI0_CH3_FLUSH_STATE2_SD1"
(
  per.view hwioreg.per "DMH00,MDM_HI0_CH3_FLUSH_STATE2_SD1"
)
if "&choice"=="MDM_HI0_CH3_FLUSH_STATE2_SD2"
(
  per.view hwioreg.per "DMH00,MDM_HI0_CH3_FLUSH_STATE2_SD2"
)
if "&choice"=="MDM_HI0_CH3_FLUSH_STATE2_SD3"
(
  per.view hwioreg.per "DMH00,MDM_HI0_CH3_FLUSH_STATE2_SD3"
)
if "&choice"=="MDM_HI0_CH4_FLUSH_STATE2_SD0"
(
  per.view hwioreg.per "DMH00,MDM_HI0_CH4_FLUSH_STATE2_SD0"
)
if "&choice"=="MDM_HI0_CH4_FLUSH_STATE2_SD1"
(
  per.view hwioreg.per "DMH00,MDM_HI0_CH4_FLUSH_STATE2_SD1"
)
if "&choice"=="MDM_HI0_CH4_FLUSH_STATE2_SD2"
(
  per.view hwioreg.per "DMH00,MDM_HI0_CH4_FLUSH_STATE2_SD2"
)
if "&choice"=="MDM_HI0_CH4_FLUSH_STATE2_SD3"
(
  per.view hwioreg.per "DMH00,MDM_HI0_CH4_FLUSH_STATE2_SD3"
)
if "&choice"=="MDM_HI0_CH5_FLUSH_STATE2_SD0"
(
  per.view hwioreg.per "DMH00,MDM_HI0_CH5_FLUSH_STATE2_SD0"
)
if "&choice"=="MDM_HI0_CH5_FLUSH_STATE2_SD1"
(
  per.view hwioreg.per "DMH00,MDM_HI0_CH5_FLUSH_STATE2_SD1"
)
if "&choice"=="MDM_HI0_CH5_FLUSH_STATE2_SD2"
(
  per.view hwioreg.per "DMH00,MDM_HI0_CH5_FLUSH_STATE2_SD2"
)
if "&choice"=="MDM_HI0_CH5_FLUSH_STATE2_SD3"
(
  per.view hwioreg.per "DMH00,MDM_HI0_CH5_FLUSH_STATE2_SD3"
)
if "&choice"=="MDM_HI0_CH6_FLUSH_STATE2_SD0"
(
  per.view hwioreg.per "DMH00,MDM_HI0_CH6_FLUSH_STATE2_SD0"
)
if "&choice"=="MDM_HI0_CH6_FLUSH_STATE2_SD1"
(
  per.view hwioreg.per "DMH00,MDM_HI0_CH6_FLUSH_STATE2_SD1"
)
if "&choice"=="MDM_HI0_CH6_FLUSH_STATE2_SD2"
(
  per.view hwioreg.per "DMH00,MDM_HI0_CH6_FLUSH_STATE2_SD2"
)
if "&choice"=="MDM_HI0_CH6_FLUSH_STATE2_SD3"
(
  per.view hwioreg.per "DMH00,MDM_HI0_CH6_FLUSH_STATE2_SD3"
)
if "&choice"=="MDM_HI0_CH7_FLUSH_STATE2_SD0"
(
  per.view hwioreg.per "DMH00,MDM_HI0_CH7_FLUSH_STATE2_SD0"
)
if "&choice"=="MDM_HI0_CH7_FLUSH_STATE2_SD1"
(
  per.view hwioreg.per "DMH00,MDM_HI0_CH7_FLUSH_STATE2_SD1"
)
if "&choice"=="MDM_HI0_CH7_FLUSH_STATE2_SD2"
(
  per.view hwioreg.per "DMH00,MDM_HI0_CH7_FLUSH_STATE2_SD2"
)
if "&choice"=="MDM_HI0_CH7_FLUSH_STATE2_SD3"
(
  per.view hwioreg.per "DMH00,MDM_HI0_CH7_FLUSH_STATE2_SD3"
)
if "&choice"=="MDM_HI0_CH8_FLUSH_STATE2_SD0"
(
  per.view hwioreg.per "DMH00,MDM_HI0_CH8_FLUSH_STATE2_SD0"
)
if "&choice"=="MDM_HI0_CH8_FLUSH_STATE2_SD1"
(
  per.view hwioreg.per "DMH00,MDM_HI0_CH8_FLUSH_STATE2_SD1"
)
if "&choice"=="MDM_HI0_CH8_FLUSH_STATE2_SD2"
(
  per.view hwioreg.per "DMH00,MDM_HI0_CH8_FLUSH_STATE2_SD2"
)
if "&choice"=="MDM_HI0_CH8_FLUSH_STATE2_SD3"
(
  per.view hwioreg.per "DMH00,MDM_HI0_CH8_FLUSH_STATE2_SD3"
)
if "&choice"=="MDM_HI0_CH9_FLUSH_STATE2_SD0"
(
  per.view hwioreg.per "DMH00,MDM_HI0_CH9_FLUSH_STATE2_SD0"
)
if "&choice"=="MDM_HI0_CH9_FLUSH_STATE2_SD1"
(
  per.view hwioreg.per "DMH00,MDM_HI0_CH9_FLUSH_STATE2_SD1"
)
if "&choice"=="MDM_HI0_CH9_FLUSH_STATE2_SD2"
(
  per.view hwioreg.per "DMH00,MDM_HI0_CH9_FLUSH_STATE2_SD2"
)
if "&choice"=="MDM_HI0_CH9_FLUSH_STATE2_SD3"
(
  per.view hwioreg.per "DMH00,MDM_HI0_CH9_FLUSH_STATE2_SD3"
)
if "&choice"=="MDM_HI0_CH10_FLUSH_STATE2_SD0"
(
  per.view hwioreg.per "DMH00,MDM_HI0_CH10_FLUSH_STATE2_SD0"
)
if "&choice"=="MDM_HI0_CH10_FLUSH_STATE2_SD1"
(
  per.view hwioreg.per "DMH00,MDM_HI0_CH10_FLUSH_STATE2_SD1"
)
if "&choice"=="MDM_HI0_CH10_FLUSH_STATE2_SD2"
(
  per.view hwioreg.per "DMH00,MDM_HI0_CH10_FLUSH_STATE2_SD2"
)
if "&choice"=="MDM_HI0_CH10_FLUSH_STATE2_SD3"
(
  per.view hwioreg.per "DMH00,MDM_HI0_CH10_FLUSH_STATE2_SD3"
)
if "&choice"=="MDM_HI0_CH11_FLUSH_STATE2_SD0"
(
  per.view hwioreg.per "DMH00,MDM_HI0_CH11_FLUSH_STATE2_SD0"
)
if "&choice"=="MDM_HI0_CH11_FLUSH_STATE2_SD1"
(
  per.view hwioreg.per "DMH00,MDM_HI0_CH11_FLUSH_STATE2_SD1"
)
if "&choice"=="MDM_HI0_CH11_FLUSH_STATE2_SD2"
(
  per.view hwioreg.per "DMH00,MDM_HI0_CH11_FLUSH_STATE2_SD2"
)
if "&choice"=="MDM_HI0_CH11_FLUSH_STATE2_SD3"
(
  per.view hwioreg.per "DMH00,MDM_HI0_CH11_FLUSH_STATE2_SD3"
)
if "&choice"=="MDM_HI0_CH12_FLUSH_STATE2_SD0"
(
  per.view hwioreg.per "DMH00,MDM_HI0_CH12_FLUSH_STATE2_SD0"
)
if "&choice"=="MDM_HI0_CH12_FLUSH_STATE2_SD1"
(
  per.view hwioreg.per "DMH00,MDM_HI0_CH12_FLUSH_STATE2_SD1"
)
if "&choice"=="MDM_HI0_CH12_FLUSH_STATE2_SD2"
(
  per.view hwioreg.per "DMH00,MDM_HI0_CH12_FLUSH_STATE2_SD2"
)
if "&choice"=="MDM_HI0_CH12_FLUSH_STATE2_SD3"
(
  per.view hwioreg.per "DMH00,MDM_HI0_CH12_FLUSH_STATE2_SD3"
)
if "&choice"=="MDM_HI0_CH13_FLUSH_STATE2_SD0"
(
  per.view hwioreg.per "DMH00,MDM_HI0_CH13_FLUSH_STATE2_SD0"
)
if "&choice"=="MDM_HI0_CH13_FLUSH_STATE2_SD1"
(
  per.view hwioreg.per "DMH00,MDM_HI0_CH13_FLUSH_STATE2_SD1"
)
if "&choice"=="MDM_HI0_CH13_FLUSH_STATE2_SD2"
(
  per.view hwioreg.per "DMH00,MDM_HI0_CH13_FLUSH_STATE2_SD2"
)
if "&choice"=="MDM_HI0_CH13_FLUSH_STATE2_SD3"
(
  per.view hwioreg.per "DMH00,MDM_HI0_CH13_FLUSH_STATE2_SD3"
)
if "&choice"=="MDM_HI0_CH14_FLUSH_STATE2_SD0"
(
  per.view hwioreg.per "DMH00,MDM_HI0_CH14_FLUSH_STATE2_SD0"
)
if "&choice"=="MDM_HI0_CH14_FLUSH_STATE2_SD1"
(
  per.view hwioreg.per "DMH00,MDM_HI0_CH14_FLUSH_STATE2_SD1"
)
if "&choice"=="MDM_HI0_CH14_FLUSH_STATE2_SD2"
(
  per.view hwioreg.per "DMH00,MDM_HI0_CH14_FLUSH_STATE2_SD2"
)
if "&choice"=="MDM_HI0_CH14_FLUSH_STATE2_SD3"
(
  per.view hwioreg.per "DMH00,MDM_HI0_CH14_FLUSH_STATE2_SD3"
)
if "&choice"=="MDM_HI0_CH15_FLUSH_STATE2_SD0"
(
  per.view hwioreg.per "DMH00,MDM_HI0_CH15_FLUSH_STATE2_SD0"
)
if "&choice"=="MDM_HI0_CH15_FLUSH_STATE2_SD1"
(
  per.view hwioreg.per "DMH00,MDM_HI0_CH15_FLUSH_STATE2_SD1"
)
if "&choice"=="MDM_HI0_CH15_FLUSH_STATE2_SD2"
(
  per.view hwioreg.per "DMH00,MDM_HI0_CH15_FLUSH_STATE2_SD2"
)
if "&choice"=="MDM_HI0_CH15_FLUSH_STATE2_SD3"
(
  per.view hwioreg.per "DMH00,MDM_HI0_CH15_FLUSH_STATE2_SD3"
)
if "&choice"=="MDM_HI0_CH0_FLUSH_STATE3_SD0"
(
  per.view hwioreg.per "DMH00,MDM_HI0_CH0_FLUSH_STATE3_SD0"
)
if "&choice"=="MDM_HI0_CH0_FLUSH_STATE3_SD1"
(
  per.view hwioreg.per "DMH00,MDM_HI0_CH0_FLUSH_STATE3_SD1"
)
if "&choice"=="MDM_HI0_CH0_FLUSH_STATE3_SD2"
(
  per.view hwioreg.per "DMH00,MDM_HI0_CH0_FLUSH_STATE3_SD2"
)
if "&choice"=="MDM_HI0_CH0_FLUSH_STATE3_SD3"
(
  per.view hwioreg.per "DMH00,MDM_HI0_CH0_FLUSH_STATE3_SD3"
)
if "&choice"=="MDM_HI0_CH1_FLUSH_STATE3_SD0"
(
  per.view hwioreg.per "DMH00,MDM_HI0_CH1_FLUSH_STATE3_SD0"
)
if "&choice"=="MDM_HI0_CH1_FLUSH_STATE3_SD1"
(
  per.view hwioreg.per "DMH00,MDM_HI0_CH1_FLUSH_STATE3_SD1"
)
if "&choice"=="MDM_HI0_CH1_FLUSH_STATE3_SD2"
(
  per.view hwioreg.per "DMH00,MDM_HI0_CH1_FLUSH_STATE3_SD2"
)
if "&choice"=="MDM_HI0_CH1_FLUSH_STATE3_SD3"
(
  per.view hwioreg.per "DMH00,MDM_HI0_CH1_FLUSH_STATE3_SD3"
)
if "&choice"=="MDM_HI0_CH2_FLUSH_STATE3_SD0"
(
  per.view hwioreg.per "DMH00,MDM_HI0_CH2_FLUSH_STATE3_SD0"
)
if "&choice"=="MDM_HI0_CH2_FLUSH_STATE3_SD1"
(
  per.view hwioreg.per "DMH00,MDM_HI0_CH2_FLUSH_STATE3_SD1"
)
if "&choice"=="MDM_HI0_CH2_FLUSH_STATE3_SD2"
(
  per.view hwioreg.per "DMH00,MDM_HI0_CH2_FLUSH_STATE3_SD2"
)
if "&choice"=="MDM_HI0_CH2_FLUSH_STATE3_SD3"
(
  per.view hwioreg.per "DMH00,MDM_HI0_CH2_FLUSH_STATE3_SD3"
)
if "&choice"=="MDM_HI0_CH3_FLUSH_STATE3_SD0"
(
  per.view hwioreg.per "DMH00,MDM_HI0_CH3_FLUSH_STATE3_SD0"
)
if "&choice"=="MDM_HI0_CH3_FLUSH_STATE3_SD1"
(
  per.view hwioreg.per "DMH00,MDM_HI0_CH3_FLUSH_STATE3_SD1"
)
if "&choice"=="MDM_HI0_CH3_FLUSH_STATE3_SD2"
(
  per.view hwioreg.per "DMH00,MDM_HI0_CH3_FLUSH_STATE3_SD2"
)
if "&choice"=="MDM_HI0_CH3_FLUSH_STATE3_SD3"
(
  per.view hwioreg.per "DMH00,MDM_HI0_CH3_FLUSH_STATE3_SD3"
)
if "&choice"=="MDM_HI0_CH4_FLUSH_STATE3_SD0"
(
  per.view hwioreg.per "DMH00,MDM_HI0_CH4_FLUSH_STATE3_SD0"
)
if "&choice"=="MDM_HI0_CH4_FLUSH_STATE3_SD1"
(
  per.view hwioreg.per "DMH00,MDM_HI0_CH4_FLUSH_STATE3_SD1"
)
if "&choice"=="MDM_HI0_CH4_FLUSH_STATE3_SD2"
(
  per.view hwioreg.per "DMH00,MDM_HI0_CH4_FLUSH_STATE3_SD2"
)
if "&choice"=="MDM_HI0_CH4_FLUSH_STATE3_SD3"
(
  per.view hwioreg.per "DMH00,MDM_HI0_CH4_FLUSH_STATE3_SD3"
)
if "&choice"=="MDM_HI0_CH5_FLUSH_STATE3_SD0"
(
  per.view hwioreg.per "DMH00,MDM_HI0_CH5_FLUSH_STATE3_SD0"
)
if "&choice"=="MDM_HI0_CH5_FLUSH_STATE3_SD1"
(
  per.view hwioreg.per "DMH00,MDM_HI0_CH5_FLUSH_STATE3_SD1"
)
if "&choice"=="MDM_HI0_CH5_FLUSH_STATE3_SD2"
(
  per.view hwioreg.per "DMH00,MDM_HI0_CH5_FLUSH_STATE3_SD2"
)
if "&choice"=="MDM_HI0_CH5_FLUSH_STATE3_SD3"
(
  per.view hwioreg.per "DMH00,MDM_HI0_CH5_FLUSH_STATE3_SD3"
)
if "&choice"=="MDM_HI0_CH6_FLUSH_STATE3_SD0"
(
  per.view hwioreg.per "DMH00,MDM_HI0_CH6_FLUSH_STATE3_SD0"
)
if "&choice"=="MDM_HI0_CH6_FLUSH_STATE3_SD1"
(
  per.view hwioreg.per "DMH00,MDM_HI0_CH6_FLUSH_STATE3_SD1"
)
if "&choice"=="MDM_HI0_CH6_FLUSH_STATE3_SD2"
(
  per.view hwioreg.per "DMH00,MDM_HI0_CH6_FLUSH_STATE3_SD2"
)
if "&choice"=="MDM_HI0_CH6_FLUSH_STATE3_SD3"
(
  per.view hwioreg.per "DMH00,MDM_HI0_CH6_FLUSH_STATE3_SD3"
)
if "&choice"=="MDM_HI0_CH7_FLUSH_STATE3_SD0"
(
  per.view hwioreg.per "DMH00,MDM_HI0_CH7_FLUSH_STATE3_SD0"
)
if "&choice"=="MDM_HI0_CH7_FLUSH_STATE3_SD1"
(
  per.view hwioreg.per "DMH00,MDM_HI0_CH7_FLUSH_STATE3_SD1"
)
if "&choice"=="MDM_HI0_CH7_FLUSH_STATE3_SD2"
(
  per.view hwioreg.per "DMH00,MDM_HI0_CH7_FLUSH_STATE3_SD2"
)
if "&choice"=="MDM_HI0_CH7_FLUSH_STATE3_SD3"
(
  per.view hwioreg.per "DMH00,MDM_HI0_CH7_FLUSH_STATE3_SD3"
)
if "&choice"=="MDM_HI0_CH8_FLUSH_STATE3_SD0"
(
  per.view hwioreg.per "DMH00,MDM_HI0_CH8_FLUSH_STATE3_SD0"
)
if "&choice"=="MDM_HI0_CH8_FLUSH_STATE3_SD1"
(
  per.view hwioreg.per "DMH00,MDM_HI0_CH8_FLUSH_STATE3_SD1"
)
if "&choice"=="MDM_HI0_CH8_FLUSH_STATE3_SD2"
(
  per.view hwioreg.per "DMH00,MDM_HI0_CH8_FLUSH_STATE3_SD2"
)
if "&choice"=="MDM_HI0_CH8_FLUSH_STATE3_SD3"
(
  per.view hwioreg.per "DMH00,MDM_HI0_CH8_FLUSH_STATE3_SD3"
)
if "&choice"=="MDM_HI0_CH9_FLUSH_STATE3_SD0"
(
  per.view hwioreg.per "DMH00,MDM_HI0_CH9_FLUSH_STATE3_SD0"
)
if "&choice"=="MDM_HI0_CH9_FLUSH_STATE3_SD1"
(
  per.view hwioreg.per "DMH00,MDM_HI0_CH9_FLUSH_STATE3_SD1"
)
if "&choice"=="MDM_HI0_CH9_FLUSH_STATE3_SD2"
(
  per.view hwioreg.per "DMH00,MDM_HI0_CH9_FLUSH_STATE3_SD2"
)
if "&choice"=="MDM_HI0_CH9_FLUSH_STATE3_SD3"
(
  per.view hwioreg.per "DMH00,MDM_HI0_CH9_FLUSH_STATE3_SD3"
)
if "&choice"=="MDM_HI0_CH10_FLUSH_STATE3_SD0"
(
  per.view hwioreg.per "DMH00,MDM_HI0_CH10_FLUSH_STATE3_SD0"
)
if "&choice"=="MDM_HI0_CH10_FLUSH_STATE3_SD1"
(
  per.view hwioreg.per "DMH00,MDM_HI0_CH10_FLUSH_STATE3_SD1"
)
if "&choice"=="MDM_HI0_CH10_FLUSH_STATE3_SD2"
(
  per.view hwioreg.per "DMH00,MDM_HI0_CH10_FLUSH_STATE3_SD2"
)
if "&choice"=="MDM_HI0_CH10_FLUSH_STATE3_SD3"
(
  per.view hwioreg.per "DMH00,MDM_HI0_CH10_FLUSH_STATE3_SD3"
)
if "&choice"=="MDM_HI0_CH11_FLUSH_STATE3_SD0"
(
  per.view hwioreg.per "DMH00,MDM_HI0_CH11_FLUSH_STATE3_SD0"
)
if "&choice"=="MDM_HI0_CH11_FLUSH_STATE3_SD1"
(
  per.view hwioreg.per "DMH00,MDM_HI0_CH11_FLUSH_STATE3_SD1"
)
if "&choice"=="MDM_HI0_CH11_FLUSH_STATE3_SD2"
(
  per.view hwioreg.per "DMH00,MDM_HI0_CH11_FLUSH_STATE3_SD2"
)
if "&choice"=="MDM_HI0_CH11_FLUSH_STATE3_SD3"
(
  per.view hwioreg.per "DMH00,MDM_HI0_CH11_FLUSH_STATE3_SD3"
)
if "&choice"=="MDM_HI0_CH12_FLUSH_STATE3_SD0"
(
  per.view hwioreg.per "DMH00,MDM_HI0_CH12_FLUSH_STATE3_SD0"
)
if "&choice"=="MDM_HI0_CH12_FLUSH_STATE3_SD1"
(
  per.view hwioreg.per "DMH00,MDM_HI0_CH12_FLUSH_STATE3_SD1"
)
if "&choice"=="MDM_HI0_CH12_FLUSH_STATE3_SD2"
(
  per.view hwioreg.per "DMH00,MDM_HI0_CH12_FLUSH_STATE3_SD2"
)
if "&choice"=="MDM_HI0_CH12_FLUSH_STATE3_SD3"
(
  per.view hwioreg.per "DMH00,MDM_HI0_CH12_FLUSH_STATE3_SD3"
)
if "&choice"=="MDM_HI0_CH13_FLUSH_STATE3_SD0"
(
  per.view hwioreg.per "DMH00,MDM_HI0_CH13_FLUSH_STATE3_SD0"
)
if "&choice"=="MDM_HI0_CH13_FLUSH_STATE3_SD1"
(
  per.view hwioreg.per "DMH00,MDM_HI0_CH13_FLUSH_STATE3_SD1"
)
if "&choice"=="MDM_HI0_CH13_FLUSH_STATE3_SD2"
(
  per.view hwioreg.per "DMH00,MDM_HI0_CH13_FLUSH_STATE3_SD2"
)
if "&choice"=="MDM_HI0_CH13_FLUSH_STATE3_SD3"
(
  per.view hwioreg.per "DMH00,MDM_HI0_CH13_FLUSH_STATE3_SD3"
)
if "&choice"=="MDM_HI0_CH14_FLUSH_STATE3_SD0"
(
  per.view hwioreg.per "DMH00,MDM_HI0_CH14_FLUSH_STATE3_SD0"
)
if "&choice"=="MDM_HI0_CH14_FLUSH_STATE3_SD1"
(
  per.view hwioreg.per "DMH00,MDM_HI0_CH14_FLUSH_STATE3_SD1"
)
if "&choice"=="MDM_HI0_CH14_FLUSH_STATE3_SD2"
(
  per.view hwioreg.per "DMH00,MDM_HI0_CH14_FLUSH_STATE3_SD2"
)
if "&choice"=="MDM_HI0_CH14_FLUSH_STATE3_SD3"
(
  per.view hwioreg.per "DMH00,MDM_HI0_CH14_FLUSH_STATE3_SD3"
)
if "&choice"=="MDM_HI0_CH15_FLUSH_STATE3_SD0"
(
  per.view hwioreg.per "DMH00,MDM_HI0_CH15_FLUSH_STATE3_SD0"
)
if "&choice"=="MDM_HI0_CH15_FLUSH_STATE3_SD1"
(
  per.view hwioreg.per "DMH00,MDM_HI0_CH15_FLUSH_STATE3_SD1"
)
if "&choice"=="MDM_HI0_CH15_FLUSH_STATE3_SD2"
(
  per.view hwioreg.per "DMH00,MDM_HI0_CH15_FLUSH_STATE3_SD2"
)
if "&choice"=="MDM_HI0_CH15_FLUSH_STATE3_SD3"
(
  per.view hwioreg.per "DMH00,MDM_HI0_CH15_FLUSH_STATE3_SD3"
)
if "&choice"=="MDM_HI0_CH0_FLUSH_STATE4_SD0"
(
  per.view hwioreg.per "DMH00,MDM_HI0_CH0_FLUSH_STATE4_SD0"
)
if "&choice"=="MDM_HI0_CH0_FLUSH_STATE4_SD1"
(
  per.view hwioreg.per "DMH00,MDM_HI0_CH0_FLUSH_STATE4_SD1"
)
if "&choice"=="MDM_HI0_CH0_FLUSH_STATE4_SD2"
(
  per.view hwioreg.per "DMH00,MDM_HI0_CH0_FLUSH_STATE4_SD2"
)
if "&choice"=="MDM_HI0_CH0_FLUSH_STATE4_SD3"
(
  per.view hwioreg.per "DMH00,MDM_HI0_CH0_FLUSH_STATE4_SD3"
)
if "&choice"=="MDM_HI0_CH1_FLUSH_STATE4_SD0"
(
  per.view hwioreg.per "DMH00,MDM_HI0_CH1_FLUSH_STATE4_SD0"
)
if "&choice"=="MDM_HI0_CH1_FLUSH_STATE4_SD1"
(
  per.view hwioreg.per "DMH00,MDM_HI0_CH1_FLUSH_STATE4_SD1"
)
if "&choice"=="MDM_HI0_CH1_FLUSH_STATE4_SD2"
(
  per.view hwioreg.per "DMH00,MDM_HI0_CH1_FLUSH_STATE4_SD2"
)
if "&choice"=="MDM_HI0_CH1_FLUSH_STATE4_SD3"
(
  per.view hwioreg.per "DMH00,MDM_HI0_CH1_FLUSH_STATE4_SD3"
)
if "&choice"=="MDM_HI0_CH2_FLUSH_STATE4_SD0"
(
  per.view hwioreg.per "DMH00,MDM_HI0_CH2_FLUSH_STATE4_SD0"
)
if "&choice"=="MDM_HI0_CH2_FLUSH_STATE4_SD1"
(
  per.view hwioreg.per "DMH00,MDM_HI0_CH2_FLUSH_STATE4_SD1"
)
if "&choice"=="MDM_HI0_CH2_FLUSH_STATE4_SD2"
(
  per.view hwioreg.per "DMH00,MDM_HI0_CH2_FLUSH_STATE4_SD2"
)
if "&choice"=="MDM_HI0_CH2_FLUSH_STATE4_SD3"
(
  per.view hwioreg.per "DMH00,MDM_HI0_CH2_FLUSH_STATE4_SD3"
)
if "&choice"=="MDM_HI0_CH3_FLUSH_STATE4_SD0"
(
  per.view hwioreg.per "DMH00,MDM_HI0_CH3_FLUSH_STATE4_SD0"
)
if "&choice"=="MDM_HI0_CH3_FLUSH_STATE4_SD1"
(
  per.view hwioreg.per "DMH00,MDM_HI0_CH3_FLUSH_STATE4_SD1"
)
if "&choice"=="MDM_HI0_CH3_FLUSH_STATE4_SD2"
(
  per.view hwioreg.per "DMH00,MDM_HI0_CH3_FLUSH_STATE4_SD2"
)
if "&choice"=="MDM_HI0_CH3_FLUSH_STATE4_SD3"
(
  per.view hwioreg.per "DMH00,MDM_HI0_CH3_FLUSH_STATE4_SD3"
)
if "&choice"=="MDM_HI0_CH4_FLUSH_STATE4_SD0"
(
  per.view hwioreg.per "DMH00,MDM_HI0_CH4_FLUSH_STATE4_SD0"
)
if "&choice"=="MDM_HI0_CH4_FLUSH_STATE4_SD1"
(
  per.view hwioreg.per "DMH00,MDM_HI0_CH4_FLUSH_STATE4_SD1"
)
if "&choice"=="MDM_HI0_CH4_FLUSH_STATE4_SD2"
(
  per.view hwioreg.per "DMH00,MDM_HI0_CH4_FLUSH_STATE4_SD2"
)
if "&choice"=="MDM_HI0_CH4_FLUSH_STATE4_SD3"
(
  per.view hwioreg.per "DMH00,MDM_HI0_CH4_FLUSH_STATE4_SD3"
)
if "&choice"=="MDM_HI0_CH5_FLUSH_STATE4_SD0"
(
  per.view hwioreg.per "DMH00,MDM_HI0_CH5_FLUSH_STATE4_SD0"
)
if "&choice"=="MDM_HI0_CH5_FLUSH_STATE4_SD1"
(
  per.view hwioreg.per "DMH00,MDM_HI0_CH5_FLUSH_STATE4_SD1"
)
if "&choice"=="MDM_HI0_CH5_FLUSH_STATE4_SD2"
(
  per.view hwioreg.per "DMH00,MDM_HI0_CH5_FLUSH_STATE4_SD2"
)
if "&choice"=="MDM_HI0_CH5_FLUSH_STATE4_SD3"
(
  per.view hwioreg.per "DMH00,MDM_HI0_CH5_FLUSH_STATE4_SD3"
)
if "&choice"=="MDM_HI0_CH6_FLUSH_STATE4_SD0"
(
  per.view hwioreg.per "DMH00,MDM_HI0_CH6_FLUSH_STATE4_SD0"
)
if "&choice"=="MDM_HI0_CH6_FLUSH_STATE4_SD1"
(
  per.view hwioreg.per "DMH00,MDM_HI0_CH6_FLUSH_STATE4_SD1"
)
if "&choice"=="MDM_HI0_CH6_FLUSH_STATE4_SD2"
(
  per.view hwioreg.per "DMH00,MDM_HI0_CH6_FLUSH_STATE4_SD2"
)
if "&choice"=="MDM_HI0_CH6_FLUSH_STATE4_SD3"
(
  per.view hwioreg.per "DMH00,MDM_HI0_CH6_FLUSH_STATE4_SD3"
)
if "&choice"=="MDM_HI0_CH7_FLUSH_STATE4_SD0"
(
  per.view hwioreg.per "DMH00,MDM_HI0_CH7_FLUSH_STATE4_SD0"
)
if "&choice"=="MDM_HI0_CH7_FLUSH_STATE4_SD1"
(
  per.view hwioreg.per "DMH00,MDM_HI0_CH7_FLUSH_STATE4_SD1"
)
if "&choice"=="MDM_HI0_CH7_FLUSH_STATE4_SD2"
(
  per.view hwioreg.per "DMH00,MDM_HI0_CH7_FLUSH_STATE4_SD2"
)
if "&choice"=="MDM_HI0_CH7_FLUSH_STATE4_SD3"
(
  per.view hwioreg.per "DMH00,MDM_HI0_CH7_FLUSH_STATE4_SD3"
)
if "&choice"=="MDM_HI0_CH8_FLUSH_STATE4_SD0"
(
  per.view hwioreg.per "DMH00,MDM_HI0_CH8_FLUSH_STATE4_SD0"
)
if "&choice"=="MDM_HI0_CH8_FLUSH_STATE4_SD1"
(
  per.view hwioreg.per "DMH00,MDM_HI0_CH8_FLUSH_STATE4_SD1"
)
if "&choice"=="MDM_HI0_CH8_FLUSH_STATE4_SD2"
(
  per.view hwioreg.per "DMH00,MDM_HI0_CH8_FLUSH_STATE4_SD2"
)
if "&choice"=="MDM_HI0_CH8_FLUSH_STATE4_SD3"
(
  per.view hwioreg.per "DMH00,MDM_HI0_CH8_FLUSH_STATE4_SD3"
)
if "&choice"=="MDM_HI0_CH9_FLUSH_STATE4_SD0"
(
  per.view hwioreg.per "DMH00,MDM_HI0_CH9_FLUSH_STATE4_SD0"
)
if "&choice"=="MDM_HI0_CH9_FLUSH_STATE4_SD1"
(
  per.view hwioreg.per "DMH00,MDM_HI0_CH9_FLUSH_STATE4_SD1"
)
if "&choice"=="MDM_HI0_CH9_FLUSH_STATE4_SD2"
(
  per.view hwioreg.per "DMH00,MDM_HI0_CH9_FLUSH_STATE4_SD2"
)
if "&choice"=="MDM_HI0_CH9_FLUSH_STATE4_SD3"
(
  per.view hwioreg.per "DMH00,MDM_HI0_CH9_FLUSH_STATE4_SD3"
)
if "&choice"=="MDM_HI0_CH10_FLUSH_STATE4_SD0"
(
  per.view hwioreg.per "DMH00,MDM_HI0_CH10_FLUSH_STATE4_SD0"
)
if "&choice"=="MDM_HI0_CH10_FLUSH_STATE4_SD1"
(
  per.view hwioreg.per "DMH00,MDM_HI0_CH10_FLUSH_STATE4_SD1"
)
if "&choice"=="MDM_HI0_CH10_FLUSH_STATE4_SD2"
(
  per.view hwioreg.per "DMH00,MDM_HI0_CH10_FLUSH_STATE4_SD2"
)
if "&choice"=="MDM_HI0_CH10_FLUSH_STATE4_SD3"
(
  per.view hwioreg.per "DMH00,MDM_HI0_CH10_FLUSH_STATE4_SD3"
)
if "&choice"=="MDM_HI0_CH11_FLUSH_STATE4_SD0"
(
  per.view hwioreg.per "DMH00,MDM_HI0_CH11_FLUSH_STATE4_SD0"
)
if "&choice"=="MDM_HI0_CH11_FLUSH_STATE4_SD1"
(
  per.view hwioreg.per "DMH00,MDM_HI0_CH11_FLUSH_STATE4_SD1"
)
if "&choice"=="MDM_HI0_CH11_FLUSH_STATE4_SD2"
(
  per.view hwioreg.per "DMH00,MDM_HI0_CH11_FLUSH_STATE4_SD2"
)
if "&choice"=="MDM_HI0_CH11_FLUSH_STATE4_SD3"
(
  per.view hwioreg.per "DMH00,MDM_HI0_CH11_FLUSH_STATE4_SD3"
)
if "&choice"=="MDM_HI0_CH12_FLUSH_STATE4_SD0"
(
  per.view hwioreg.per "DMH00,MDM_HI0_CH12_FLUSH_STATE4_SD0"
)
if "&choice"=="MDM_HI0_CH12_FLUSH_STATE4_SD1"
(
  per.view hwioreg.per "DMH00,MDM_HI0_CH12_FLUSH_STATE4_SD1"
)
if "&choice"=="MDM_HI0_CH12_FLUSH_STATE4_SD2"
(
  per.view hwioreg.per "DMH00,MDM_HI0_CH12_FLUSH_STATE4_SD2"
)
if "&choice"=="MDM_HI0_CH12_FLUSH_STATE4_SD3"
(
  per.view hwioreg.per "DMH00,MDM_HI0_CH12_FLUSH_STATE4_SD3"
)
if "&choice"=="MDM_HI0_CH13_FLUSH_STATE4_SD0"
(
  per.view hwioreg.per "DMH00,MDM_HI0_CH13_FLUSH_STATE4_SD0"
)
if "&choice"=="MDM_HI0_CH13_FLUSH_STATE4_SD1"
(
  per.view hwioreg.per "DMH00,MDM_HI0_CH13_FLUSH_STATE4_SD1"
)
if "&choice"=="MDM_HI0_CH13_FLUSH_STATE4_SD2"
(
  per.view hwioreg.per "DMH00,MDM_HI0_CH13_FLUSH_STATE4_SD2"
)
if "&choice"=="MDM_HI0_CH13_FLUSH_STATE4_SD3"
(
  per.view hwioreg.per "DMH00,MDM_HI0_CH13_FLUSH_STATE4_SD3"
)
if "&choice"=="MDM_HI0_CH14_FLUSH_STATE4_SD0"
(
  per.view hwioreg.per "DMH00,MDM_HI0_CH14_FLUSH_STATE4_SD0"
)
if "&choice"=="MDM_HI0_CH14_FLUSH_STATE4_SD1"
(
  per.view hwioreg.per "DMH00,MDM_HI0_CH14_FLUSH_STATE4_SD1"
)
if "&choice"=="MDM_HI0_CH14_FLUSH_STATE4_SD2"
(
  per.view hwioreg.per "DMH00,MDM_HI0_CH14_FLUSH_STATE4_SD2"
)
if "&choice"=="MDM_HI0_CH14_FLUSH_STATE4_SD3"
(
  per.view hwioreg.per "DMH00,MDM_HI0_CH14_FLUSH_STATE4_SD3"
)
if "&choice"=="MDM_HI0_CH15_FLUSH_STATE4_SD0"
(
  per.view hwioreg.per "DMH00,MDM_HI0_CH15_FLUSH_STATE4_SD0"
)
if "&choice"=="MDM_HI0_CH15_FLUSH_STATE4_SD1"
(
  per.view hwioreg.per "DMH00,MDM_HI0_CH15_FLUSH_STATE4_SD1"
)
if "&choice"=="MDM_HI0_CH15_FLUSH_STATE4_SD2"
(
  per.view hwioreg.per "DMH00,MDM_HI0_CH15_FLUSH_STATE4_SD2"
)
if "&choice"=="MDM_HI0_CH15_FLUSH_STATE4_SD3"
(
  per.view hwioreg.per "DMH00,MDM_HI0_CH15_FLUSH_STATE4_SD3"
)
if "&choice"=="MDM_HI0_CH0_FLUSH_STATE5_SD0"
(
  per.view hwioreg.per "DMH00,MDM_HI0_CH0_FLUSH_STATE5_SD0"
)
if "&choice"=="MDM_HI0_CH0_FLUSH_STATE5_SD1"
(
  per.view hwioreg.per "DMH00,MDM_HI0_CH0_FLUSH_STATE5_SD1"
)
if "&choice"=="MDM_HI0_CH0_FLUSH_STATE5_SD2"
(
  per.view hwioreg.per "DMH00,MDM_HI0_CH0_FLUSH_STATE5_SD2"
)
if "&choice"=="MDM_HI0_CH0_FLUSH_STATE5_SD3"
(
  per.view hwioreg.per "DMH00,MDM_HI0_CH0_FLUSH_STATE5_SD3"
)
if "&choice"=="MDM_HI0_CH1_FLUSH_STATE5_SD0"
(
  per.view hwioreg.per "DMH00,MDM_HI0_CH1_FLUSH_STATE5_SD0"
)
if "&choice"=="MDM_HI0_CH1_FLUSH_STATE5_SD1"
(
  per.view hwioreg.per "DMH00,MDM_HI0_CH1_FLUSH_STATE5_SD1"
)
if "&choice"=="MDM_HI0_CH1_FLUSH_STATE5_SD2"
(
  per.view hwioreg.per "DMH00,MDM_HI0_CH1_FLUSH_STATE5_SD2"
)
if "&choice"=="MDM_HI0_CH1_FLUSH_STATE5_SD3"
(
  per.view hwioreg.per "DMH00,MDM_HI0_CH1_FLUSH_STATE5_SD3"
)
if "&choice"=="MDM_HI0_CH2_FLUSH_STATE5_SD0"
(
  per.view hwioreg.per "DMH00,MDM_HI0_CH2_FLUSH_STATE5_SD0"
)
if "&choice"=="MDM_HI0_CH2_FLUSH_STATE5_SD1"
(
  per.view hwioreg.per "DMH00,MDM_HI0_CH2_FLUSH_STATE5_SD1"
)
if "&choice"=="MDM_HI0_CH2_FLUSH_STATE5_SD2"
(
  per.view hwioreg.per "DMH00,MDM_HI0_CH2_FLUSH_STATE5_SD2"
)
if "&choice"=="MDM_HI0_CH2_FLUSH_STATE5_SD3"
(
  per.view hwioreg.per "DMH00,MDM_HI0_CH2_FLUSH_STATE5_SD3"
)
if "&choice"=="MDM_HI0_CH3_FLUSH_STATE5_SD0"
(
  per.view hwioreg.per "DMH00,MDM_HI0_CH3_FLUSH_STATE5_SD0"
)
if "&choice"=="MDM_HI0_CH3_FLUSH_STATE5_SD1"
(
  per.view hwioreg.per "DMH00,MDM_HI0_CH3_FLUSH_STATE5_SD1"
)
if "&choice"=="MDM_HI0_CH3_FLUSH_STATE5_SD2"
(
  per.view hwioreg.per "DMH00,MDM_HI0_CH3_FLUSH_STATE5_SD2"
)
if "&choice"=="MDM_HI0_CH3_FLUSH_STATE5_SD3"
(
  per.view hwioreg.per "DMH00,MDM_HI0_CH3_FLUSH_STATE5_SD3"
)
if "&choice"=="MDM_HI0_CH4_FLUSH_STATE5_SD0"
(
  per.view hwioreg.per "DMH00,MDM_HI0_CH4_FLUSH_STATE5_SD0"
)
if "&choice"=="MDM_HI0_CH4_FLUSH_STATE5_SD1"
(
  per.view hwioreg.per "DMH00,MDM_HI0_CH4_FLUSH_STATE5_SD1"
)
if "&choice"=="MDM_HI0_CH4_FLUSH_STATE5_SD2"
(
  per.view hwioreg.per "DMH00,MDM_HI0_CH4_FLUSH_STATE5_SD2"
)
if "&choice"=="MDM_HI0_CH4_FLUSH_STATE5_SD3"
(
  per.view hwioreg.per "DMH00,MDM_HI0_CH4_FLUSH_STATE5_SD3"
)
if "&choice"=="MDM_HI0_CH5_FLUSH_STATE5_SD0"
(
  per.view hwioreg.per "DMH00,MDM_HI0_CH5_FLUSH_STATE5_SD0"
)
if "&choice"=="MDM_HI0_CH5_FLUSH_STATE5_SD1"
(
  per.view hwioreg.per "DMH00,MDM_HI0_CH5_FLUSH_STATE5_SD1"
)
if "&choice"=="MDM_HI0_CH5_FLUSH_STATE5_SD2"
(
  per.view hwioreg.per "DMH00,MDM_HI0_CH5_FLUSH_STATE5_SD2"
)
if "&choice"=="MDM_HI0_CH5_FLUSH_STATE5_SD3"
(
  per.view hwioreg.per "DMH00,MDM_HI0_CH5_FLUSH_STATE5_SD3"
)
if "&choice"=="MDM_HI0_CH6_FLUSH_STATE5_SD0"
(
  per.view hwioreg.per "DMH00,MDM_HI0_CH6_FLUSH_STATE5_SD0"
)
if "&choice"=="MDM_HI0_CH6_FLUSH_STATE5_SD1"
(
  per.view hwioreg.per "DMH00,MDM_HI0_CH6_FLUSH_STATE5_SD1"
)
if "&choice"=="MDM_HI0_CH6_FLUSH_STATE5_SD2"
(
  per.view hwioreg.per "DMH00,MDM_HI0_CH6_FLUSH_STATE5_SD2"
)
if "&choice"=="MDM_HI0_CH6_FLUSH_STATE5_SD3"
(
  per.view hwioreg.per "DMH00,MDM_HI0_CH6_FLUSH_STATE5_SD3"
)
if "&choice"=="MDM_HI0_CH7_FLUSH_STATE5_SD0"
(
  per.view hwioreg.per "DMH00,MDM_HI0_CH7_FLUSH_STATE5_SD0"
)
if "&choice"=="MDM_HI0_CH7_FLUSH_STATE5_SD1"
(
  per.view hwioreg.per "DMH00,MDM_HI0_CH7_FLUSH_STATE5_SD1"
)
if "&choice"=="MDM_HI0_CH7_FLUSH_STATE5_SD2"
(
  per.view hwioreg.per "DMH00,MDM_HI0_CH7_FLUSH_STATE5_SD2"
)
if "&choice"=="MDM_HI0_CH7_FLUSH_STATE5_SD3"
(
  per.view hwioreg.per "DMH00,MDM_HI0_CH7_FLUSH_STATE5_SD3"
)
if "&choice"=="MDM_HI0_CH8_FLUSH_STATE5_SD0"
(
  per.view hwioreg.per "DMH00,MDM_HI0_CH8_FLUSH_STATE5_SD0"
)
if "&choice"=="MDM_HI0_CH8_FLUSH_STATE5_SD1"
(
  per.view hwioreg.per "DMH00,MDM_HI0_CH8_FLUSH_STATE5_SD1"
)
if "&choice"=="MDM_HI0_CH8_FLUSH_STATE5_SD2"
(
  per.view hwioreg.per "DMH00,MDM_HI0_CH8_FLUSH_STATE5_SD2"
)
if "&choice"=="MDM_HI0_CH8_FLUSH_STATE5_SD3"
(
  per.view hwioreg.per "DMH00,MDM_HI0_CH8_FLUSH_STATE5_SD3"
)
if "&choice"=="MDM_HI0_CH9_FLUSH_STATE5_SD0"
(
  per.view hwioreg.per "DMH00,MDM_HI0_CH9_FLUSH_STATE5_SD0"
)
if "&choice"=="MDM_HI0_CH9_FLUSH_STATE5_SD1"
(
  per.view hwioreg.per "DMH00,MDM_HI0_CH9_FLUSH_STATE5_SD1"
)
if "&choice"=="MDM_HI0_CH9_FLUSH_STATE5_SD2"
(
  per.view hwioreg.per "DMH00,MDM_HI0_CH9_FLUSH_STATE5_SD2"
)
if "&choice"=="MDM_HI0_CH9_FLUSH_STATE5_SD3"
(
  per.view hwioreg.per "DMH00,MDM_HI0_CH9_FLUSH_STATE5_SD3"
)
if "&choice"=="MDM_HI0_CH10_FLUSH_STATE5_SD0"
(
  per.view hwioreg.per "DMH00,MDM_HI0_CH10_FLUSH_STATE5_SD0"
)
if "&choice"=="MDM_HI0_CH10_FLUSH_STATE5_SD1"
(
  per.view hwioreg.per "DMH00,MDM_HI0_CH10_FLUSH_STATE5_SD1"
)
if "&choice"=="MDM_HI0_CH10_FLUSH_STATE5_SD2"
(
  per.view hwioreg.per "DMH00,MDM_HI0_CH10_FLUSH_STATE5_SD2"
)
if "&choice"=="MDM_HI0_CH10_FLUSH_STATE5_SD3"
(
  per.view hwioreg.per "DMH00,MDM_HI0_CH10_FLUSH_STATE5_SD3"
)
if "&choice"=="MDM_HI0_CH11_FLUSH_STATE5_SD0"
(
  per.view hwioreg.per "DMH00,MDM_HI0_CH11_FLUSH_STATE5_SD0"
)
if "&choice"=="MDM_HI0_CH11_FLUSH_STATE5_SD1"
(
  per.view hwioreg.per "DMH00,MDM_HI0_CH11_FLUSH_STATE5_SD1"
)
if "&choice"=="MDM_HI0_CH11_FLUSH_STATE5_SD2"
(
  per.view hwioreg.per "DMH00,MDM_HI0_CH11_FLUSH_STATE5_SD2"
)
if "&choice"=="MDM_HI0_CH11_FLUSH_STATE5_SD3"
(
  per.view hwioreg.per "DMH00,MDM_HI0_CH11_FLUSH_STATE5_SD3"
)
if "&choice"=="MDM_HI0_CH12_FLUSH_STATE5_SD0"
(
  per.view hwioreg.per "DMH00,MDM_HI0_CH12_FLUSH_STATE5_SD0"
)
if "&choice"=="MDM_HI0_CH12_FLUSH_STATE5_SD1"
(
  per.view hwioreg.per "DMH00,MDM_HI0_CH12_FLUSH_STATE5_SD1"
)
if "&choice"=="MDM_HI0_CH12_FLUSH_STATE5_SD2"
(
  per.view hwioreg.per "DMH00,MDM_HI0_CH12_FLUSH_STATE5_SD2"
)
if "&choice"=="MDM_HI0_CH12_FLUSH_STATE5_SD3"
(
  per.view hwioreg.per "DMH00,MDM_HI0_CH12_FLUSH_STATE5_SD3"
)
if "&choice"=="MDM_HI0_CH13_FLUSH_STATE5_SD0"
(
  per.view hwioreg.per "DMH00,MDM_HI0_CH13_FLUSH_STATE5_SD0"
)
if "&choice"=="MDM_HI0_CH13_FLUSH_STATE5_SD1"
(
  per.view hwioreg.per "DMH00,MDM_HI0_CH13_FLUSH_STATE5_SD1"
)
if "&choice"=="MDM_HI0_CH13_FLUSH_STATE5_SD2"
(
  per.view hwioreg.per "DMH00,MDM_HI0_CH13_FLUSH_STATE5_SD2"
)
if "&choice"=="MDM_HI0_CH13_FLUSH_STATE5_SD3"
(
  per.view hwioreg.per "DMH00,MDM_HI0_CH13_FLUSH_STATE5_SD3"
)
if "&choice"=="MDM_HI0_CH14_FLUSH_STATE5_SD0"
(
  per.view hwioreg.per "DMH00,MDM_HI0_CH14_FLUSH_STATE5_SD0"
)
if "&choice"=="MDM_HI0_CH14_FLUSH_STATE5_SD1"
(
  per.view hwioreg.per "DMH00,MDM_HI0_CH14_FLUSH_STATE5_SD1"
)
if "&choice"=="MDM_HI0_CH14_FLUSH_STATE5_SD2"
(
  per.view hwioreg.per "DMH00,MDM_HI0_CH14_FLUSH_STATE5_SD2"
)
if "&choice"=="MDM_HI0_CH14_FLUSH_STATE5_SD3"
(
  per.view hwioreg.per "DMH00,MDM_HI0_CH14_FLUSH_STATE5_SD3"
)
if "&choice"=="MDM_HI0_CH15_FLUSH_STATE5_SD0"
(
  per.view hwioreg.per "DMH00,MDM_HI0_CH15_FLUSH_STATE5_SD0"
)
if "&choice"=="MDM_HI0_CH15_FLUSH_STATE5_SD1"
(
  per.view hwioreg.per "DMH00,MDM_HI0_CH15_FLUSH_STATE5_SD1"
)
if "&choice"=="MDM_HI0_CH15_FLUSH_STATE5_SD2"
(
  per.view hwioreg.per "DMH00,MDM_HI0_CH15_FLUSH_STATE5_SD2"
)
if "&choice"=="MDM_HI0_CH15_FLUSH_STATE5_SD3"
(
  per.view hwioreg.per "DMH00,MDM_HI0_CH15_FLUSH_STATE5_SD3"
)
if "&choice"=="MDM_HI0_SEC_DOMAIN_IRQ_STATUS_SD0"
(
  per.view hwioreg.per "DMH00,MDM_HI0_SEC_DOMAIN_IRQ_STATUS_SD0"
)
if "&choice"=="MDM_HI0_SEC_DOMAIN_IRQ_STATUS_SD1"
(
  per.view hwioreg.per "DMH00,MDM_HI0_SEC_DOMAIN_IRQ_STATUS_SD1"
)
if "&choice"=="MDM_HI0_SEC_DOMAIN_IRQ_STATUS_SD2"
(
  per.view hwioreg.per "DMH00,MDM_HI0_SEC_DOMAIN_IRQ_STATUS_SD2"
)
if "&choice"=="MDM_HI0_SEC_DOMAIN_IRQ_STATUS_SD3"
(
  per.view hwioreg.per "DMH00,MDM_HI0_SEC_DOMAIN_IRQ_STATUS_SD3"
)
if "&choice"=="MDM_HI0_CH0_RSLT_CONF_SD0"
(
  per.view hwioreg.per "DMH00,MDM_HI0_CH0_RSLT_CONF_SD0"
)
if "&choice"=="MDM_HI0_CH0_RSLT_CONF_SD1"
(
  per.view hwioreg.per "DMH00,MDM_HI0_CH0_RSLT_CONF_SD1"
)
if "&choice"=="MDM_HI0_CH0_RSLT_CONF_SD2"
(
  per.view hwioreg.per "DMH00,MDM_HI0_CH0_RSLT_CONF_SD2"
)
if "&choice"=="MDM_HI0_CH0_RSLT_CONF_SD3"
(
  per.view hwioreg.per "DMH00,MDM_HI0_CH0_RSLT_CONF_SD3"
)
if "&choice"=="MDM_HI0_CH1_RSLT_CONF_SD0"
(
  per.view hwioreg.per "DMH00,MDM_HI0_CH1_RSLT_CONF_SD0"
)
if "&choice"=="MDM_HI0_CH1_RSLT_CONF_SD1"
(
  per.view hwioreg.per "DMH00,MDM_HI0_CH1_RSLT_CONF_SD1"
)
if "&choice"=="MDM_HI0_CH1_RSLT_CONF_SD2"
(
  per.view hwioreg.per "DMH00,MDM_HI0_CH1_RSLT_CONF_SD2"
)
if "&choice"=="MDM_HI0_CH1_RSLT_CONF_SD3"
(
  per.view hwioreg.per "DMH00,MDM_HI0_CH1_RSLT_CONF_SD3"
)
if "&choice"=="MDM_HI0_CH2_RSLT_CONF_SD0"
(
  per.view hwioreg.per "DMH00,MDM_HI0_CH2_RSLT_CONF_SD0"
)
if "&choice"=="MDM_HI0_CH2_RSLT_CONF_SD1"
(
  per.view hwioreg.per "DMH00,MDM_HI0_CH2_RSLT_CONF_SD1"
)
if "&choice"=="MDM_HI0_CH2_RSLT_CONF_SD2"
(
  per.view hwioreg.per "DMH00,MDM_HI0_CH2_RSLT_CONF_SD2"
)
if "&choice"=="MDM_HI0_CH2_RSLT_CONF_SD3"
(
  per.view hwioreg.per "DMH00,MDM_HI0_CH2_RSLT_CONF_SD3"
)
if "&choice"=="MDM_HI0_CH3_RSLT_CONF_SD0"
(
  per.view hwioreg.per "DMH00,MDM_HI0_CH3_RSLT_CONF_SD0"
)
if "&choice"=="MDM_HI0_CH3_RSLT_CONF_SD1"
(
  per.view hwioreg.per "DMH00,MDM_HI0_CH3_RSLT_CONF_SD1"
)
if "&choice"=="MDM_HI0_CH3_RSLT_CONF_SD2"
(
  per.view hwioreg.per "DMH00,MDM_HI0_CH3_RSLT_CONF_SD2"
)
if "&choice"=="MDM_HI0_CH3_RSLT_CONF_SD3"
(
  per.view hwioreg.per "DMH00,MDM_HI0_CH3_RSLT_CONF_SD3"
)
if "&choice"=="MDM_HI0_CH4_RSLT_CONF_SD0"
(
  per.view hwioreg.per "DMH00,MDM_HI0_CH4_RSLT_CONF_SD0"
)
if "&choice"=="MDM_HI0_CH4_RSLT_CONF_SD1"
(
  per.view hwioreg.per "DMH00,MDM_HI0_CH4_RSLT_CONF_SD1"
)
if "&choice"=="MDM_HI0_CH4_RSLT_CONF_SD2"
(
  per.view hwioreg.per "DMH00,MDM_HI0_CH4_RSLT_CONF_SD2"
)
if "&choice"=="MDM_HI0_CH4_RSLT_CONF_SD3"
(
  per.view hwioreg.per "DMH00,MDM_HI0_CH4_RSLT_CONF_SD3"
)
if "&choice"=="MDM_HI0_CH5_RSLT_CONF_SD0"
(
  per.view hwioreg.per "DMH00,MDM_HI0_CH5_RSLT_CONF_SD0"
)
if "&choice"=="MDM_HI0_CH5_RSLT_CONF_SD1"
(
  per.view hwioreg.per "DMH00,MDM_HI0_CH5_RSLT_CONF_SD1"
)
if "&choice"=="MDM_HI0_CH5_RSLT_CONF_SD2"
(
  per.view hwioreg.per "DMH00,MDM_HI0_CH5_RSLT_CONF_SD2"
)
if "&choice"=="MDM_HI0_CH5_RSLT_CONF_SD3"
(
  per.view hwioreg.per "DMH00,MDM_HI0_CH5_RSLT_CONF_SD3"
)
if "&choice"=="MDM_HI0_CH6_RSLT_CONF_SD0"
(
  per.view hwioreg.per "DMH00,MDM_HI0_CH6_RSLT_CONF_SD0"
)
if "&choice"=="MDM_HI0_CH6_RSLT_CONF_SD1"
(
  per.view hwioreg.per "DMH00,MDM_HI0_CH6_RSLT_CONF_SD1"
)
if "&choice"=="MDM_HI0_CH6_RSLT_CONF_SD2"
(
  per.view hwioreg.per "DMH00,MDM_HI0_CH6_RSLT_CONF_SD2"
)
if "&choice"=="MDM_HI0_CH6_RSLT_CONF_SD3"
(
  per.view hwioreg.per "DMH00,MDM_HI0_CH6_RSLT_CONF_SD3"
)
if "&choice"=="MDM_HI0_CH7_RSLT_CONF_SD0"
(
  per.view hwioreg.per "DMH00,MDM_HI0_CH7_RSLT_CONF_SD0"
)
if "&choice"=="MDM_HI0_CH7_RSLT_CONF_SD1"
(
  per.view hwioreg.per "DMH00,MDM_HI0_CH7_RSLT_CONF_SD1"
)
if "&choice"=="MDM_HI0_CH7_RSLT_CONF_SD2"
(
  per.view hwioreg.per "DMH00,MDM_HI0_CH7_RSLT_CONF_SD2"
)
if "&choice"=="MDM_HI0_CH7_RSLT_CONF_SD3"
(
  per.view hwioreg.per "DMH00,MDM_HI0_CH7_RSLT_CONF_SD3"
)
if "&choice"=="MDM_HI0_CH8_RSLT_CONF_SD0"
(
  per.view hwioreg.per "DMH00,MDM_HI0_CH8_RSLT_CONF_SD0"
)
if "&choice"=="MDM_HI0_CH8_RSLT_CONF_SD1"
(
  per.view hwioreg.per "DMH00,MDM_HI0_CH8_RSLT_CONF_SD1"
)
if "&choice"=="MDM_HI0_CH8_RSLT_CONF_SD2"
(
  per.view hwioreg.per "DMH00,MDM_HI0_CH8_RSLT_CONF_SD2"
)
if "&choice"=="MDM_HI0_CH8_RSLT_CONF_SD3"
(
  per.view hwioreg.per "DMH00,MDM_HI0_CH8_RSLT_CONF_SD3"
)
if "&choice"=="MDM_HI0_CH9_RSLT_CONF_SD0"
(
  per.view hwioreg.per "DMH00,MDM_HI0_CH9_RSLT_CONF_SD0"
)
if "&choice"=="MDM_HI0_CH9_RSLT_CONF_SD1"
(
  per.view hwioreg.per "DMH00,MDM_HI0_CH9_RSLT_CONF_SD1"
)
if "&choice"=="MDM_HI0_CH9_RSLT_CONF_SD2"
(
  per.view hwioreg.per "DMH00,MDM_HI0_CH9_RSLT_CONF_SD2"
)
if "&choice"=="MDM_HI0_CH9_RSLT_CONF_SD3"
(
  per.view hwioreg.per "DMH00,MDM_HI0_CH9_RSLT_CONF_SD3"
)
if "&choice"=="MDM_HI0_CH10_RSLT_CONF_SD0"
(
  per.view hwioreg.per "DMH00,MDM_HI0_CH10_RSLT_CONF_SD0"
)
if "&choice"=="MDM_HI0_CH10_RSLT_CONF_SD1"
(
  per.view hwioreg.per "DMH00,MDM_HI0_CH10_RSLT_CONF_SD1"
)
if "&choice"=="MDM_HI0_CH10_RSLT_CONF_SD2"
(
  per.view hwioreg.per "DMH00,MDM_HI0_CH10_RSLT_CONF_SD2"
)
if "&choice"=="MDM_HI0_CH10_RSLT_CONF_SD3"
(
  per.view hwioreg.per "DMH00,MDM_HI0_CH10_RSLT_CONF_SD3"
)
if "&choice"=="MDM_HI0_CH11_RSLT_CONF_SD0"
(
  per.view hwioreg.per "DMH00,MDM_HI0_CH11_RSLT_CONF_SD0"
)
if "&choice"=="MDM_HI0_CH11_RSLT_CONF_SD1"
(
  per.view hwioreg.per "DMH00,MDM_HI0_CH11_RSLT_CONF_SD1"
)
if "&choice"=="MDM_HI0_CH11_RSLT_CONF_SD2"
(
  per.view hwioreg.per "DMH00,MDM_HI0_CH11_RSLT_CONF_SD2"
)
if "&choice"=="MDM_HI0_CH11_RSLT_CONF_SD3"
(
  per.view hwioreg.per "DMH00,MDM_HI0_CH11_RSLT_CONF_SD3"
)
if "&choice"=="MDM_HI0_CH12_RSLT_CONF_SD0"
(
  per.view hwioreg.per "DMH00,MDM_HI0_CH12_RSLT_CONF_SD0"
)
if "&choice"=="MDM_HI0_CH12_RSLT_CONF_SD1"
(
  per.view hwioreg.per "DMH00,MDM_HI0_CH12_RSLT_CONF_SD1"
)
if "&choice"=="MDM_HI0_CH12_RSLT_CONF_SD2"
(
  per.view hwioreg.per "DMH00,MDM_HI0_CH12_RSLT_CONF_SD2"
)
if "&choice"=="MDM_HI0_CH12_RSLT_CONF_SD3"
(
  per.view hwioreg.per "DMH00,MDM_HI0_CH12_RSLT_CONF_SD3"
)
if "&choice"=="MDM_HI0_CH13_RSLT_CONF_SD0"
(
  per.view hwioreg.per "DMH00,MDM_HI0_CH13_RSLT_CONF_SD0"
)
if "&choice"=="MDM_HI0_CH13_RSLT_CONF_SD1"
(
  per.view hwioreg.per "DMH00,MDM_HI0_CH13_RSLT_CONF_SD1"
)
if "&choice"=="MDM_HI0_CH13_RSLT_CONF_SD2"
(
  per.view hwioreg.per "DMH00,MDM_HI0_CH13_RSLT_CONF_SD2"
)
if "&choice"=="MDM_HI0_CH13_RSLT_CONF_SD3"
(
  per.view hwioreg.per "DMH00,MDM_HI0_CH13_RSLT_CONF_SD3"
)
if "&choice"=="MDM_HI0_CH14_RSLT_CONF_SD0"
(
  per.view hwioreg.per "DMH00,MDM_HI0_CH14_RSLT_CONF_SD0"
)
if "&choice"=="MDM_HI0_CH14_RSLT_CONF_SD1"
(
  per.view hwioreg.per "DMH00,MDM_HI0_CH14_RSLT_CONF_SD1"
)
if "&choice"=="MDM_HI0_CH14_RSLT_CONF_SD2"
(
  per.view hwioreg.per "DMH00,MDM_HI0_CH14_RSLT_CONF_SD2"
)
if "&choice"=="MDM_HI0_CH14_RSLT_CONF_SD3"
(
  per.view hwioreg.per "DMH00,MDM_HI0_CH14_RSLT_CONF_SD3"
)
if "&choice"=="MDM_HI0_CH15_RSLT_CONF_SD0"
(
  per.view hwioreg.per "DMH00,MDM_HI0_CH15_RSLT_CONF_SD0"
)
if "&choice"=="MDM_HI0_CH15_RSLT_CONF_SD1"
(
  per.view hwioreg.per "DMH00,MDM_HI0_CH15_RSLT_CONF_SD1"
)
if "&choice"=="MDM_HI0_CH15_RSLT_CONF_SD2"
(
  per.view hwioreg.per "DMH00,MDM_HI0_CH15_RSLT_CONF_SD2"
)
if "&choice"=="MDM_HI0_CH15_RSLT_CONF_SD3"
(
  per.view hwioreg.per "DMH00,MDM_HI0_CH15_RSLT_CONF_SD3"
)
if "&choice"=="MDM_HI0_CH0_STATUS_SD0"
(
  per.view hwioreg.per "DMH00,MDM_HI0_CH0_STATUS_SD0"
)
if "&choice"=="MDM_HI0_CH0_STATUS_SD1"
(
  per.view hwioreg.per "DMH00,MDM_HI0_CH0_STATUS_SD1"
)
if "&choice"=="MDM_HI0_CH0_STATUS_SD2"
(
  per.view hwioreg.per "DMH00,MDM_HI0_CH0_STATUS_SD2"
)
if "&choice"=="MDM_HI0_CH0_STATUS_SD3"
(
  per.view hwioreg.per "DMH00,MDM_HI0_CH0_STATUS_SD3"
)
if "&choice"=="MDM_HI0_CH1_STATUS_SD0"
(
  per.view hwioreg.per "DMH00,MDM_HI0_CH1_STATUS_SD0"
)
if "&choice"=="MDM_HI0_CH1_STATUS_SD1"
(
  per.view hwioreg.per "DMH00,MDM_HI0_CH1_STATUS_SD1"
)
if "&choice"=="MDM_HI0_CH1_STATUS_SD2"
(
  per.view hwioreg.per "DMH00,MDM_HI0_CH1_STATUS_SD2"
)
if "&choice"=="MDM_HI0_CH1_STATUS_SD3"
(
  per.view hwioreg.per "DMH00,MDM_HI0_CH1_STATUS_SD3"
)
if "&choice"=="MDM_HI0_CH2_STATUS_SD0"
(
  per.view hwioreg.per "DMH00,MDM_HI0_CH2_STATUS_SD0"
)
if "&choice"=="MDM_HI0_CH2_STATUS_SD1"
(
  per.view hwioreg.per "DMH00,MDM_HI0_CH2_STATUS_SD1"
)
if "&choice"=="MDM_HI0_CH2_STATUS_SD2"
(
  per.view hwioreg.per "DMH00,MDM_HI0_CH2_STATUS_SD2"
)
if "&choice"=="MDM_HI0_CH2_STATUS_SD3"
(
  per.view hwioreg.per "DMH00,MDM_HI0_CH2_STATUS_SD3"
)
if "&choice"=="MDM_HI0_CH3_STATUS_SD0"
(
  per.view hwioreg.per "DMH00,MDM_HI0_CH3_STATUS_SD0"
)
if "&choice"=="MDM_HI0_CH3_STATUS_SD1"
(
  per.view hwioreg.per "DMH00,MDM_HI0_CH3_STATUS_SD1"
)
if "&choice"=="MDM_HI0_CH3_STATUS_SD2"
(
  per.view hwioreg.per "DMH00,MDM_HI0_CH3_STATUS_SD2"
)
if "&choice"=="MDM_HI0_CH3_STATUS_SD3"
(
  per.view hwioreg.per "DMH00,MDM_HI0_CH3_STATUS_SD3"
)
if "&choice"=="MDM_HI0_CH4_STATUS_SD0"
(
  per.view hwioreg.per "DMH00,MDM_HI0_CH4_STATUS_SD0"
)
if "&choice"=="MDM_HI0_CH4_STATUS_SD1"
(
  per.view hwioreg.per "DMH00,MDM_HI0_CH4_STATUS_SD1"
)
if "&choice"=="MDM_HI0_CH4_STATUS_SD2"
(
  per.view hwioreg.per "DMH00,MDM_HI0_CH4_STATUS_SD2"
)
if "&choice"=="MDM_HI0_CH4_STATUS_SD3"
(
  per.view hwioreg.per "DMH00,MDM_HI0_CH4_STATUS_SD3"
)
if "&choice"=="MDM_HI0_CH5_STATUS_SD0"
(
  per.view hwioreg.per "DMH00,MDM_HI0_CH5_STATUS_SD0"
)
if "&choice"=="MDM_HI0_CH5_STATUS_SD1"
(
  per.view hwioreg.per "DMH00,MDM_HI0_CH5_STATUS_SD1"
)
if "&choice"=="MDM_HI0_CH5_STATUS_SD2"
(
  per.view hwioreg.per "DMH00,MDM_HI0_CH5_STATUS_SD2"
)
if "&choice"=="MDM_HI0_CH5_STATUS_SD3"
(
  per.view hwioreg.per "DMH00,MDM_HI0_CH5_STATUS_SD3"
)
if "&choice"=="MDM_HI0_CH6_STATUS_SD0"
(
  per.view hwioreg.per "DMH00,MDM_HI0_CH6_STATUS_SD0"
)
if "&choice"=="MDM_HI0_CH6_STATUS_SD1"
(
  per.view hwioreg.per "DMH00,MDM_HI0_CH6_STATUS_SD1"
)
if "&choice"=="MDM_HI0_CH6_STATUS_SD2"
(
  per.view hwioreg.per "DMH00,MDM_HI0_CH6_STATUS_SD2"
)
if "&choice"=="MDM_HI0_CH6_STATUS_SD3"
(
  per.view hwioreg.per "DMH00,MDM_HI0_CH6_STATUS_SD3"
)
if "&choice"=="MDM_HI0_CH7_STATUS_SD0"
(
  per.view hwioreg.per "DMH00,MDM_HI0_CH7_STATUS_SD0"
)
if "&choice"=="MDM_HI0_CH7_STATUS_SD1"
(
  per.view hwioreg.per "DMH00,MDM_HI0_CH7_STATUS_SD1"
)
if "&choice"=="MDM_HI0_CH7_STATUS_SD2"
(
  per.view hwioreg.per "DMH00,MDM_HI0_CH7_STATUS_SD2"
)
if "&choice"=="MDM_HI0_CH7_STATUS_SD3"
(
  per.view hwioreg.per "DMH00,MDM_HI0_CH7_STATUS_SD3"
)
if "&choice"=="MDM_HI0_CH8_STATUS_SD0"
(
  per.view hwioreg.per "DMH00,MDM_HI0_CH8_STATUS_SD0"
)
if "&choice"=="MDM_HI0_CH8_STATUS_SD1"
(
  per.view hwioreg.per "DMH00,MDM_HI0_CH8_STATUS_SD1"
)
if "&choice"=="MDM_HI0_CH8_STATUS_SD2"
(
  per.view hwioreg.per "DMH00,MDM_HI0_CH8_STATUS_SD2"
)
if "&choice"=="MDM_HI0_CH8_STATUS_SD3"
(
  per.view hwioreg.per "DMH00,MDM_HI0_CH8_STATUS_SD3"
)
if "&choice"=="MDM_HI0_CH9_STATUS_SD0"
(
  per.view hwioreg.per "DMH00,MDM_HI0_CH9_STATUS_SD0"
)
if "&choice"=="MDM_HI0_CH9_STATUS_SD1"
(
  per.view hwioreg.per "DMH00,MDM_HI0_CH9_STATUS_SD1"
)
if "&choice"=="MDM_HI0_CH9_STATUS_SD2"
(
  per.view hwioreg.per "DMH00,MDM_HI0_CH9_STATUS_SD2"
)
if "&choice"=="MDM_HI0_CH9_STATUS_SD3"
(
  per.view hwioreg.per "DMH00,MDM_HI0_CH9_STATUS_SD3"
)
if "&choice"=="MDM_HI0_CH10_STATUS_SD0"
(
  per.view hwioreg.per "DMH00,MDM_HI0_CH10_STATUS_SD0"
)
if "&choice"=="MDM_HI0_CH10_STATUS_SD1"
(
  per.view hwioreg.per "DMH00,MDM_HI0_CH10_STATUS_SD1"
)
if "&choice"=="MDM_HI0_CH10_STATUS_SD2"
(
  per.view hwioreg.per "DMH00,MDM_HI0_CH10_STATUS_SD2"
)
if "&choice"=="MDM_HI0_CH10_STATUS_SD3"
(
  per.view hwioreg.per "DMH00,MDM_HI0_CH10_STATUS_SD3"
)
if "&choice"=="MDM_HI0_CH11_STATUS_SD0"
(
  per.view hwioreg.per "DMH00,MDM_HI0_CH11_STATUS_SD0"
)
if "&choice"=="MDM_HI0_CH11_STATUS_SD1"
(
  per.view hwioreg.per "DMH00,MDM_HI0_CH11_STATUS_SD1"
)
if "&choice"=="MDM_HI0_CH11_STATUS_SD2"
(
  per.view hwioreg.per "DMH00,MDM_HI0_CH11_STATUS_SD2"
)
if "&choice"=="MDM_HI0_CH11_STATUS_SD3"
(
  per.view hwioreg.per "DMH00,MDM_HI0_CH11_STATUS_SD3"
)
if "&choice"=="MDM_HI0_CH12_STATUS_SD0"
(
  per.view hwioreg.per "DMH00,MDM_HI0_CH12_STATUS_SD0"
)
if "&choice"=="MDM_HI0_CH12_STATUS_SD1"
(
  per.view hwioreg.per "DMH00,MDM_HI0_CH12_STATUS_SD1"
)
if "&choice"=="MDM_HI0_CH12_STATUS_SD2"
(
  per.view hwioreg.per "DMH00,MDM_HI0_CH12_STATUS_SD2"
)
if "&choice"=="MDM_HI0_CH12_STATUS_SD3"
(
  per.view hwioreg.per "DMH00,MDM_HI0_CH12_STATUS_SD3"
)
if "&choice"=="MDM_HI0_CH13_STATUS_SD0"
(
  per.view hwioreg.per "DMH00,MDM_HI0_CH13_STATUS_SD0"
)
if "&choice"=="MDM_HI0_CH13_STATUS_SD1"
(
  per.view hwioreg.per "DMH00,MDM_HI0_CH13_STATUS_SD1"
)
if "&choice"=="MDM_HI0_CH13_STATUS_SD2"
(
  per.view hwioreg.per "DMH00,MDM_HI0_CH13_STATUS_SD2"
)
if "&choice"=="MDM_HI0_CH13_STATUS_SD3"
(
  per.view hwioreg.per "DMH00,MDM_HI0_CH13_STATUS_SD3"
)
if "&choice"=="MDM_HI0_CH14_STATUS_SD0"
(
  per.view hwioreg.per "DMH00,MDM_HI0_CH14_STATUS_SD0"
)
if "&choice"=="MDM_HI0_CH14_STATUS_SD1"
(
  per.view hwioreg.per "DMH00,MDM_HI0_CH14_STATUS_SD1"
)
if "&choice"=="MDM_HI0_CH14_STATUS_SD2"
(
  per.view hwioreg.per "DMH00,MDM_HI0_CH14_STATUS_SD2"
)
if "&choice"=="MDM_HI0_CH14_STATUS_SD3"
(
  per.view hwioreg.per "DMH00,MDM_HI0_CH14_STATUS_SD3"
)
if "&choice"=="MDM_HI0_CH15_STATUS_SD0"
(
  per.view hwioreg.per "DMH00,MDM_HI0_CH15_STATUS_SD0"
)
if "&choice"=="MDM_HI0_CH15_STATUS_SD1"
(
  per.view hwioreg.per "DMH00,MDM_HI0_CH15_STATUS_SD1"
)
if "&choice"=="MDM_HI0_CH15_STATUS_SD2"
(
  per.view hwioreg.per "DMH00,MDM_HI0_CH15_STATUS_SD2"
)
if "&choice"=="MDM_HI0_CH15_STATUS_SD3"
(
  per.view hwioreg.per "DMH00,MDM_HI0_CH15_STATUS_SD3"
)
if "&choice"=="MDM_HI0_CH0_CONF"
(
  per.view hwioreg.per "DMH00,MDM_HI0_CH0_CONF"
)
if "&choice"=="MDM_HI0_CH1_CONF"
(
  per.view hwioreg.per "DMH00,MDM_HI0_CH1_CONF"
)
if "&choice"=="MDM_HI0_CH2_CONF"
(
  per.view hwioreg.per "DMH00,MDM_HI0_CH2_CONF"
)
if "&choice"=="MDM_HI0_CH3_CONF"
(
  per.view hwioreg.per "DMH00,MDM_HI0_CH3_CONF"
)
if "&choice"=="MDM_HI0_CH4_CONF"
(
  per.view hwioreg.per "DMH00,MDM_HI0_CH4_CONF"
)
if "&choice"=="MDM_HI0_CH5_CONF"
(
  per.view hwioreg.per "DMH00,MDM_HI0_CH5_CONF"
)
if "&choice"=="MDM_HI0_CH6_CONF"
(
  per.view hwioreg.per "DMH00,MDM_HI0_CH6_CONF"
)
if "&choice"=="MDM_HI0_CH7_CONF"
(
  per.view hwioreg.per "DMH00,MDM_HI0_CH7_CONF"
)
if "&choice"=="MDM_HI0_CH8_CONF"
(
  per.view hwioreg.per "DMH00,MDM_HI0_CH8_CONF"
)
if "&choice"=="MDM_HI0_CH9_CONF"
(
  per.view hwioreg.per "DMH00,MDM_HI0_CH9_CONF"
)
if "&choice"=="MDM_HI0_CH10_CONF"
(
  per.view hwioreg.per "DMH00,MDM_HI0_CH10_CONF"
)
if "&choice"=="MDM_HI0_CH11_CONF"
(
  per.view hwioreg.per "DMH00,MDM_HI0_CH11_CONF"
)
if "&choice"=="MDM_HI0_CH12_CONF"
(
  per.view hwioreg.per "DMH00,MDM_HI0_CH12_CONF"
)
if "&choice"=="MDM_HI0_CH13_CONF"
(
  per.view hwioreg.per "DMH00,MDM_HI0_CH13_CONF"
)
if "&choice"=="MDM_HI0_CH14_CONF"
(
  per.view hwioreg.per "DMH00,MDM_HI0_CH14_CONF"
)
if "&choice"=="MDM_HI0_CH15_CONF"
(
  per.view hwioreg.per "DMH00,MDM_HI0_CH15_CONF"
)
if "&choice"=="MDM_HI0_CH0_DBG_0"
(
  per.view hwioreg.per "DMH00,MDM_HI0_CH0_DBG_0"
)
if "&choice"=="MDM_HI0_CH1_DBG_0"
(
  per.view hwioreg.per "DMH00,MDM_HI0_CH1_DBG_0"
)
if "&choice"=="MDM_HI0_CH2_DBG_0"
(
  per.view hwioreg.per "DMH00,MDM_HI0_CH2_DBG_0"
)
if "&choice"=="MDM_HI0_CH3_DBG_0"
(
  per.view hwioreg.per "DMH00,MDM_HI0_CH3_DBG_0"
)
if "&choice"=="MDM_HI0_CH4_DBG_0"
(
  per.view hwioreg.per "DMH00,MDM_HI0_CH4_DBG_0"
)
if "&choice"=="MDM_HI0_CH5_DBG_0"
(
  per.view hwioreg.per "DMH00,MDM_HI0_CH5_DBG_0"
)
if "&choice"=="MDM_HI0_CH6_DBG_0"
(
  per.view hwioreg.per "DMH00,MDM_HI0_CH6_DBG_0"
)
if "&choice"=="MDM_HI0_CH7_DBG_0"
(
  per.view hwioreg.per "DMH00,MDM_HI0_CH7_DBG_0"
)
if "&choice"=="MDM_HI0_CH8_DBG_0"
(
  per.view hwioreg.per "DMH00,MDM_HI0_CH8_DBG_0"
)
if "&choice"=="MDM_HI0_CH9_DBG_0"
(
  per.view hwioreg.per "DMH00,MDM_HI0_CH9_DBG_0"
)
if "&choice"=="MDM_HI0_CH10_DBG_0"
(
  per.view hwioreg.per "DMH00,MDM_HI0_CH10_DBG_0"
)
if "&choice"=="MDM_HI0_CH11_DBG_0"
(
  per.view hwioreg.per "DMH00,MDM_HI0_CH11_DBG_0"
)
if "&choice"=="MDM_HI0_CH12_DBG_0"
(
  per.view hwioreg.per "DMH00,MDM_HI0_CH12_DBG_0"
)
if "&choice"=="MDM_HI0_CH13_DBG_0"
(
  per.view hwioreg.per "DMH00,MDM_HI0_CH13_DBG_0"
)
if "&choice"=="MDM_HI0_CH14_DBG_0"
(
  per.view hwioreg.per "DMH00,MDM_HI0_CH14_DBG_0"
)
if "&choice"=="MDM_HI0_CH15_DBG_0"
(
  per.view hwioreg.per "DMH00,MDM_HI0_CH15_DBG_0"
)
if "&choice"=="MDM_HI0_CH0_DBG_1"
(
  per.view hwioreg.per "DMH00,MDM_HI0_CH0_DBG_1"
)
if "&choice"=="MDM_HI0_CH1_DBG_1"
(
  per.view hwioreg.per "DMH00,MDM_HI0_CH1_DBG_1"
)
if "&choice"=="MDM_HI0_CH2_DBG_1"
(
  per.view hwioreg.per "DMH00,MDM_HI0_CH2_DBG_1"
)
if "&choice"=="MDM_HI0_CH3_DBG_1"
(
  per.view hwioreg.per "DMH00,MDM_HI0_CH3_DBG_1"
)
if "&choice"=="MDM_HI0_CH4_DBG_1"
(
  per.view hwioreg.per "DMH00,MDM_HI0_CH4_DBG_1"
)
if "&choice"=="MDM_HI0_CH5_DBG_1"
(
  per.view hwioreg.per "DMH00,MDM_HI0_CH5_DBG_1"
)
if "&choice"=="MDM_HI0_CH6_DBG_1"
(
  per.view hwioreg.per "DMH00,MDM_HI0_CH6_DBG_1"
)
if "&choice"=="MDM_HI0_CH7_DBG_1"
(
  per.view hwioreg.per "DMH00,MDM_HI0_CH7_DBG_1"
)
if "&choice"=="MDM_HI0_CH8_DBG_1"
(
  per.view hwioreg.per "DMH00,MDM_HI0_CH8_DBG_1"
)
if "&choice"=="MDM_HI0_CH9_DBG_1"
(
  per.view hwioreg.per "DMH00,MDM_HI0_CH9_DBG_1"
)
if "&choice"=="MDM_HI0_CH10_DBG_1"
(
  per.view hwioreg.per "DMH00,MDM_HI0_CH10_DBG_1"
)
if "&choice"=="MDM_HI0_CH11_DBG_1"
(
  per.view hwioreg.per "DMH00,MDM_HI0_CH11_DBG_1"
)
if "&choice"=="MDM_HI0_CH12_DBG_1"
(
  per.view hwioreg.per "DMH00,MDM_HI0_CH12_DBG_1"
)
if "&choice"=="MDM_HI0_CH13_DBG_1"
(
  per.view hwioreg.per "DMH00,MDM_HI0_CH13_DBG_1"
)
if "&choice"=="MDM_HI0_CH14_DBG_1"
(
  per.view hwioreg.per "DMH00,MDM_HI0_CH14_DBG_1"
)
if "&choice"=="MDM_HI0_CH15_DBG_1"
(
  per.view hwioreg.per "DMH00,MDM_HI0_CH15_DBG_1"
)
if "&choice"=="MDM_HI0_CI0_CONF"
(
  per.view hwioreg.per "DMH00,MDM_HI0_CI0_CONF"
)
if "&choice"=="MDM_HI0_CI1_CONF"
(
  per.view hwioreg.per "DMH00,MDM_HI0_CI1_CONF"
)
if "&choice"=="MDM_HI0_CI2_CONF"
(
  per.view hwioreg.per "DMH00,MDM_HI0_CI2_CONF"
)
if "&choice"=="MDM_HI0_CI3_CONF"
(
  per.view hwioreg.per "DMH00,MDM_HI0_CI3_CONF"
)
if "&choice"=="MDM_HI0_CI4_CONF"
(
  per.view hwioreg.per "DMH00,MDM_HI0_CI4_CONF"
)
if "&choice"=="MDM_HI0_CI5_CONF"
(
  per.view hwioreg.per "DMH00,MDM_HI0_CI5_CONF"
)
if "&choice"=="MDM_HI0_CI6_CONF"
(
  per.view hwioreg.per "DMH00,MDM_HI0_CI6_CONF"
)
if "&choice"=="MDM_HI0_CI7_CONF"
(
  per.view hwioreg.per "DMH00,MDM_HI0_CI7_CONF"
)
if "&choice"=="MDM_HI0_CI0_DBG_ERR"
(
  per.view hwioreg.per "DMH00,MDM_HI0_CI0_DBG_ERR"
)
if "&choice"=="MDM_HI0_CI1_DBG_ERR"
(
  per.view hwioreg.per "DMH00,MDM_HI0_CI1_DBG_ERR"
)
if "&choice"=="MDM_HI0_CI2_DBG_ERR"
(
  per.view hwioreg.per "DMH00,MDM_HI0_CI2_DBG_ERR"
)
if "&choice"=="MDM_HI0_CI3_DBG_ERR"
(
  per.view hwioreg.per "DMH00,MDM_HI0_CI3_DBG_ERR"
)
if "&choice"=="MDM_HI0_CI4_DBG_ERR"
(
  per.view hwioreg.per "DMH00,MDM_HI0_CI4_DBG_ERR"
)
if "&choice"=="MDM_HI0_CI5_DBG_ERR"
(
  per.view hwioreg.per "DMH00,MDM_HI0_CI5_DBG_ERR"
)
if "&choice"=="MDM_HI0_CI6_DBG_ERR"
(
  per.view hwioreg.per "DMH00,MDM_HI0_CI6_DBG_ERR"
)
if "&choice"=="MDM_HI0_CI7_DBG_ERR"
(
  per.view hwioreg.per "DMH00,MDM_HI0_CI7_DBG_ERR"
)
if "&choice"=="MDM_HI0_CRCI_DBG"
(
  per.view hwioreg.per "DMH00,MDM_HI0_CRCI_DBG"
)
if "&choice"=="MDM_HI0_CRCI_STATUS"
(
  per.view hwioreg.per "DMH00,MDM_HI0_CRCI_STATUS"
)
if "&choice"=="MDM_HI0_GP_CTL"
(
  per.view hwioreg.per "DMH00,MDM_HI0_GP_CTL"
)
if "&choice"=="MDM_HI0_GP_STATUS"
(
  per.view hwioreg.per "DMH00,MDM_HI0_GP_STATUS"
)
if "&choice"=="MDM_HI0_GLBL_DBG_CMD_ENG"
(
  per.view hwioreg.per "DMH00,MDM_HI0_GLBL_DBG_CMD_ENG"
)
if "&choice"=="MDM_HI0_GLBL_DBG_REQ_ENG"
(
  per.view hwioreg.per "DMH00,MDM_HI0_GLBL_DBG_REQ_ENG"
)
if "&choice"=="MDM_HI0_GLBL_DBG_XFR_ENG"
(
  per.view hwioreg.per "DMH00,MDM_HI0_GLBL_DBG_XFR_ENG"
)
if "&choice"=="MDM_HI0_GLBL_DBG_CHAN_BLK"
(
  per.view hwioreg.per "DMH00,MDM_HI0_GLBL_DBG_CHAN_BLK"
)
if "&choice"=="MDM_HI0_GLBL_DBG_CHAN_BLK_CLR"
(
  per.view hwioreg.per "DMH00,MDM_HI0_GLBL_DBG_CHAN_BLK_CLR"
)
if "&choice"=="MDM_HI0_GLBL_DBG_TEST_SEL"
(
  per.view hwioreg.per "DMH00,MDM_HI0_GLBL_DBG_TEST_SEL"
)
if "&choice"=="EBI1_CFG"
(
  per.view hwioreg.per "EBI,EBI1_REGS,EBI1_CFG"
)
if "&choice"=="EBI1_CS0_CFG0"
(
  per.view hwioreg.per "EBI,EBI1_REGS,EBI1_CS0_CFG0"
)
if "&choice"=="EBI1_CS1_CFG0"
(
  per.view hwioreg.per "EBI,EBI1_REGS,EBI1_CS1_CFG0"
)
if "&choice"=="EBI1_CS2_CFG0"
(
  per.view hwioreg.per "EBI,EBI1_REGS,EBI1_CS2_CFG0"
)
if "&choice"=="EBI1_CS3_CFG0"
(
  per.view hwioreg.per "EBI,EBI1_REGS,EBI1_CS3_CFG0"
)
if "&choice"=="EBI1_CS0_CFG1"
(
  per.view hwioreg.per "EBI,EBI1_REGS,EBI1_CS0_CFG1"
)
if "&choice"=="EBI1_CS1_CFG1"
(
  per.view hwioreg.per "EBI,EBI1_REGS,EBI1_CS1_CFG1"
)
if "&choice"=="EBI1_CS2_CFG1"
(
  per.view hwioreg.per "EBI,EBI1_REGS,EBI1_CS2_CFG1"
)
if "&choice"=="EBI1_CS3_CFG1"
(
  per.view hwioreg.per "EBI,EBI1_REGS,EBI1_CS3_CFG1"
)
if "&choice"=="EBI1_AHB_RD_PRIORITY"
(
  per.view hwioreg.per "EBI,EBI1_REGS,EBI1_AHB_RD_PRIORITY"
)
if "&choice"=="EBI1_AHB_WR_PRIORITY"
(
  per.view hwioreg.per "EBI,EBI1_REGS,EBI1_AHB_WR_PRIORITY"
)
if "&choice"=="EBI1_BUFC_CFG"
(
  per.view hwioreg.per "EBI,EBI1_REGS,EBI1_BUFC_CFG"
)
if "&choice"=="EBI1_BUFC_STATUS"
(
  per.view hwioreg.per "EBI,EBI1_REGS,EBI1_BUFC_STATUS"
)
if "&choice"=="EBI1_BUFC_PROF_COUNT_CFG"
(
  per.view hwioreg.per "EBI,EBI1_REGS,EBI1_BUFC_PROF_COUNT_CFG"
)
if "&choice"=="EBI1_PSRAM_REFRESH_CFG"
(
  per.view hwioreg.per "EBI,EBI1_REGS,EBI1_PSRAM_REFRESH_CFG"
)
if "&choice"=="EBI1_BUFC_PROF_COUNT0"
(
  per.view hwioreg.per "EBI,EBI1_REGS,EBI1_BUFC_PROF_COUNT0"
)
if "&choice"=="EBI1_BUFC_PROF_COUNT1"
(
  per.view hwioreg.per "EBI,EBI1_REGS,EBI1_BUFC_PROF_COUNT1"
)
if "&choice"=="EBI1_BUFC_PROF_COUNT2"
(
  per.view hwioreg.per "EBI,EBI1_REGS,EBI1_BUFC_PROF_COUNT2"
)
if "&choice"=="EBI1_DEBUG_BUS_CFG0"
(
  per.view hwioreg.per "EBI,EBI1_REGS,EBI1_DEBUG_BUS_CFG0"
)
if "&choice"=="EBI1_DEBUG_BUS_CFG1"
(
  per.view hwioreg.per "EBI,EBI1_REGS,EBI1_DEBUG_BUS_CFG1"
)
if "&choice"=="EBI1_DEBUG_WORD0_BUFC"
(
  per.view hwioreg.per "EBI,EBI1_REGS,EBI1_DEBUG_WORD0_BUFC"
)
if "&choice"=="EBI1_DEBUG_WORD1_BUFC"
(
  per.view hwioreg.per "EBI,EBI1_REGS,EBI1_DEBUG_WORD1_BUFC"
)
if "&choice"=="EBI1_DEBUG_WORD2_BUFC"
(
  per.view hwioreg.per "EBI,EBI1_REGS,EBI1_DEBUG_WORD2_BUFC"
)
if "&choice"=="EBI1_DEBUG_WORD3_BUFC"
(
  per.view hwioreg.per "EBI,EBI1_REGS,EBI1_DEBUG_WORD3_BUFC"
)
if "&choice"=="EBI1_DEBUG_WORD4_BUFC"
(
  per.view hwioreg.per "EBI,EBI1_REGS,EBI1_DEBUG_WORD4_BUFC"
)
if "&choice"=="EBI1_DEBUG_WORD5_BUFC"
(
  per.view hwioreg.per "EBI,EBI1_REGS,EBI1_DEBUG_WORD5_BUFC"
)
if "&choice"=="EBI1_DEBUG_WORD6_BUFC"
(
  per.view hwioreg.per "EBI,EBI1_REGS,EBI1_DEBUG_WORD6_BUFC"
)
if "&choice"=="EBI1_DEBUG_WORD7_BUFC"
(
  per.view hwioreg.per "EBI,EBI1_REGS,EBI1_DEBUG_WORD7_BUFC"
)
if "&choice"=="EBI1_DEBUG_WORD_EN0_BUFC"
(
  per.view hwioreg.per "EBI,EBI1_REGS,EBI1_DEBUG_WORD_EN0_BUFC"
)
if "&choice"=="EBI1_DEBUG_WORD_EN1_BUFC"
(
  per.view hwioreg.per "EBI,EBI1_REGS,EBI1_DEBUG_WORD_EN1_BUFC"
)
if "&choice"=="EBI1_DEBUG_WORD_EN2_BUFC"
(
  per.view hwioreg.per "EBI,EBI1_REGS,EBI1_DEBUG_WORD_EN2_BUFC"
)
if "&choice"=="EBI1_DEBUG_WORD_EN3_BUFC"
(
  per.view hwioreg.per "EBI,EBI1_REGS,EBI1_DEBUG_WORD_EN3_BUFC"
)
if "&choice"=="EBI1_DEBUG_WORD_EN4_BUFC"
(
  per.view hwioreg.per "EBI,EBI1_REGS,EBI1_DEBUG_WORD_EN4_BUFC"
)
if "&choice"=="EBI1_DEBUG_WORD_EN5_BUFC"
(
  per.view hwioreg.per "EBI,EBI1_REGS,EBI1_DEBUG_WORD_EN5_BUFC"
)
if "&choice"=="EBI1_DEBUG_WORD_EN6_BUFC"
(
  per.view hwioreg.per "EBI,EBI1_REGS,EBI1_DEBUG_WORD_EN6_BUFC"
)
if "&choice"=="EBI1_DEBUG_WORD_EN7_BUFC"
(
  per.view hwioreg.per "EBI,EBI1_REGS,EBI1_DEBUG_WORD_EN7_BUFC"
)
if "&choice"=="EBI1_DEBUG_BUFC_CFG"
(
  per.view hwioreg.per "EBI,EBI1_REGS,EBI1_DEBUG_BUFC_CFG"
)
if "&choice"=="EBI1_DEBUG_BUFC_TAG_RD0"
(
  per.view hwioreg.per "EBI,EBI1_REGS,EBI1_DEBUG_BUFC_TAG_RD0"
)
if "&choice"=="EBI1_DEBUG_BUFC_TAG_RD1"
(
  per.view hwioreg.per "EBI,EBI1_REGS,EBI1_DEBUG_BUFC_TAG_RD1"
)
if "&choice"=="EBI1_BUFC_PROFILING_CFG"
(
  per.view hwioreg.per "EBI,EBI1_REGS,EBI1_BUFC_PROFILING_CFG"
)
if "&choice"=="EBI1_CS0_CFG2"
(
  per.view hwioreg.per "EBI,EBI1_REGS,EBI1_CS0_CFG2"
)
if "&choice"=="EBI1_CS1_CFG2"
(
  per.view hwioreg.per "EBI,EBI1_REGS,EBI1_CS1_CFG2"
)
if "&choice"=="EBI1_CS2_CFG2"
(
  per.view hwioreg.per "EBI,EBI1_REGS,EBI1_CS2_CFG2"
)
if "&choice"=="EBI1_CS3_CFG2"
(
  per.view hwioreg.per "EBI,EBI1_REGS,EBI1_CS3_CFG2"
)
if "&choice"=="EBI1_LCD_CFG"
(
  per.view hwioreg.per "EBI,EBI1_REGS,EBI1_LCD_CFG"
)
if "&choice"=="EBI1_2X_XLTR_CFG"
(
  per.view hwioreg.per "EBI,EBI1_REGS,EBI1_2X_XLTR_CFG"
)
if "&choice"=="EBI2_CFG"
(
  per.view hwioreg.per "EBI,EBI2_REGS,EBI2_CFG"
)
if "&choice"=="LCD_CFG0"
(
  per.view hwioreg.per "EBI,EBI2_REGS,LCD_CFG0"
)
if "&choice"=="LCD_CFG1"
(
  per.view hwioreg.per "EBI,EBI2_REGS,LCD_CFG1"
)
if "&choice"=="EBI2_CS0_CFG0"
(
  per.view hwioreg.per "EBI,EBI2_REGS,EBI2_CS0_CFG0"
)
if "&choice"=="EBI2_CS1_CFG0"
(
  per.view hwioreg.per "EBI,EBI2_REGS,EBI2_CS1_CFG0"
)
if "&choice"=="EBI2_CS2_CFG0"
(
  per.view hwioreg.per "EBI,EBI2_REGS,EBI2_CS2_CFG0"
)
if "&choice"=="EBI2_CS3_CFG0"
(
  per.view hwioreg.per "EBI,EBI2_REGS,EBI2_CS3_CFG0"
)
if "&choice"=="EBI2_CS0_CFG1"
(
  per.view hwioreg.per "EBI,EBI2_REGS,EBI2_CS0_CFG1"
)
if "&choice"=="EBI2_CS1_CFG1"
(
  per.view hwioreg.per "EBI,EBI2_REGS,EBI2_CS1_CFG1"
)
if "&choice"=="EBI2_CS2_CFG1"
(
  per.view hwioreg.per "EBI,EBI2_REGS,EBI2_CS2_CFG1"
)
if "&choice"=="EBI2_CS3_CFG1"
(
  per.view hwioreg.per "EBI,EBI2_REGS,EBI2_CS3_CFG1"
)
if "&choice"=="EBI2_CS0_CFG2"
(
  per.view hwioreg.per "EBI,EBI2_REGS,EBI2_CS0_CFG2"
)
if "&choice"=="EBI2_CS1_CFG2"
(
  per.view hwioreg.per "EBI,EBI2_REGS,EBI2_CS1_CFG2"
)
if "&choice"=="EBI2_CS2_CFG2"
(
  per.view hwioreg.per "EBI,EBI2_REGS,EBI2_CS2_CFG2"
)
if "&choice"=="EBI2_CS3_CFG2"
(
  per.view hwioreg.per "EBI,EBI2_REGS,EBI2_CS3_CFG2"
)
if "&choice"=="ETM_GPIO2_CFG0"
(
  per.view hwioreg.per "EBI,EBI2_REGS,ETM_GPIO2_CFG0"
)
if "&choice"=="ETM_GPIO2_CFG1"
(
  per.view hwioreg.per "EBI,EBI2_REGS,ETM_GPIO2_CFG1"
)
if "&choice"=="EBI2_DEBUG_BUS_CFG"
(
  per.view hwioreg.per "EBI,EBI2_REGS,EBI2_DEBUG_BUS_CFG"
)
if "&choice"=="EBI2_PROFILING_CFG"
(
  per.view hwioreg.per "EBI,EBI2_REGS,EBI2_PROFILING_CFG"
)
if "&choice"=="EBI2_SWBM_AHB_PRIORITY"
(
  per.view hwioreg.per "EBI,EBI2_REGS,EBI2_SWBM_AHB_PRIORITY"
)
if "&choice"=="EBI2_SWBM_STATUS"
(
  per.view hwioreg.per "EBI,EBI2_REGS,EBI2_SWBM_STATUS"
)
if "&choice"=="EBI2_SWBM_DEBUG_BUS_CFG"
(
  per.view hwioreg.per "EBI,EBI2_REGS,EBI2_SWBM_DEBUG_BUS_CFG"
)
if "&choice"=="EBI2_CBC_AHB_RD_PRIORITY"
(
  per.view hwioreg.per "EBI,EBI2_REGS,EBI2_CBC_AHB_RD_PRIORITY"
)
if "&choice"=="EBI2_CBC_AHB_WR_PRIORITY"
(
  per.view hwioreg.per "EBI,EBI2_REGS,EBI2_CBC_AHB_WR_PRIORITY"
)
if "&choice"=="EBI2_CBC_BUFC_CFG"
(
  per.view hwioreg.per "EBI,EBI2_REGS,EBI2_CBC_BUFC_CFG"
)
if "&choice"=="EBI2_CBC_BUFC_STATUS"
(
  per.view hwioreg.per "EBI,EBI2_REGS,EBI2_CBC_BUFC_STATUS"
)
if "&choice"=="EBI2_CBC_PRF_CNT_CFG"
(
  per.view hwioreg.per "EBI,EBI2_REGS,EBI2_CBC_PRF_CNT_CFG"
)
if "&choice"=="EBI2_CBC_PRF_CNT0"
(
  per.view hwioreg.per "EBI,EBI2_REGS,EBI2_CBC_PRF_CNT0"
)
if "&choice"=="EBI2_CBC_PRF_CNT1"
(
  per.view hwioreg.per "EBI,EBI2_REGS,EBI2_CBC_PRF_CNT1"
)
if "&choice"=="EBI2_CBC_PRF_CNT2"
(
  per.view hwioreg.per "EBI,EBI2_REGS,EBI2_CBC_PRF_CNT2"
)
if "&choice"=="EBI2_CBC_DEBUG_BUS_CFG0"
(
  per.view hwioreg.per "EBI,EBI2_REGS,EBI2_CBC_DEBUG_BUS_CFG0"
)
if "&choice"=="EBI2_CBC_DEBUG_WORD0"
(
  per.view hwioreg.per "EBI,EBI2_REGS,EBI2_CBC_DEBUG_WORD0"
)
if "&choice"=="EBI2_CBC_DEBUG_WORD1"
(
  per.view hwioreg.per "EBI,EBI2_REGS,EBI2_CBC_DEBUG_WORD1"
)
if "&choice"=="EBI2_CBC_DEBUG_WORD2"
(
  per.view hwioreg.per "EBI,EBI2_REGS,EBI2_CBC_DEBUG_WORD2"
)
if "&choice"=="EBI2_CBC_DEBUG_WORD3"
(
  per.view hwioreg.per "EBI,EBI2_REGS,EBI2_CBC_DEBUG_WORD3"
)
if "&choice"=="EBI2_CBC_DEBUG_WORD4"
(
  per.view hwioreg.per "EBI,EBI2_REGS,EBI2_CBC_DEBUG_WORD4"
)
if "&choice"=="EBI2_CBC_DEBUG_WORD5"
(
  per.view hwioreg.per "EBI,EBI2_REGS,EBI2_CBC_DEBUG_WORD5"
)
if "&choice"=="EBI2_CBC_DEBUG_WORD6"
(
  per.view hwioreg.per "EBI,EBI2_REGS,EBI2_CBC_DEBUG_WORD6"
)
if "&choice"=="EBI2_CBC_DEBUG_WORD7"
(
  per.view hwioreg.per "EBI,EBI2_REGS,EBI2_CBC_DEBUG_WORD7"
)
if "&choice"=="EBI2_CBC_DEBUG_WORD_EN0"
(
  per.view hwioreg.per "EBI,EBI2_REGS,EBI2_CBC_DEBUG_WORD_EN0"
)
if "&choice"=="EBI2_CBC_DEBUG_WORD_EN1"
(
  per.view hwioreg.per "EBI,EBI2_REGS,EBI2_CBC_DEBUG_WORD_EN1"
)
if "&choice"=="EBI2_CBC_DEBUG_WORD_EN2"
(
  per.view hwioreg.per "EBI,EBI2_REGS,EBI2_CBC_DEBUG_WORD_EN2"
)
if "&choice"=="EBI2_CBC_DEBUG_WORD_EN3"
(
  per.view hwioreg.per "EBI,EBI2_REGS,EBI2_CBC_DEBUG_WORD_EN3"
)
if "&choice"=="EBI2_CBC_DEBUG_WORD_EN4"
(
  per.view hwioreg.per "EBI,EBI2_REGS,EBI2_CBC_DEBUG_WORD_EN4"
)
if "&choice"=="EBI2_CBC_DEBUG_WORD_EN5"
(
  per.view hwioreg.per "EBI,EBI2_REGS,EBI2_CBC_DEBUG_WORD_EN5"
)
if "&choice"=="EBI2_CBC_DEBUG_WORD_EN6"
(
  per.view hwioreg.per "EBI,EBI2_REGS,EBI2_CBC_DEBUG_WORD_EN6"
)
if "&choice"=="EBI2_CBC_DEBUG_WORD_EN7"
(
  per.view hwioreg.per "EBI,EBI2_REGS,EBI2_CBC_DEBUG_WORD_EN7"
)
if "&choice"=="EBI2_CBC_DEBUG_CFG"
(
  per.view hwioreg.per "EBI,EBI2_REGS,EBI2_CBC_DEBUG_CFG"
)
if "&choice"=="EBI2_CBC_DEBUG_TAG_RD0"
(
  per.view hwioreg.per "EBI,EBI2_REGS,EBI2_CBC_DEBUG_TAG_RD0"
)
if "&choice"=="EBI2_CBC_DEBUG_TAG_RD1"
(
  per.view hwioreg.per "EBI,EBI2_REGS,EBI2_CBC_DEBUG_TAG_RD1"
)
if "&choice"=="EBI2_CBC_PRF_CFG"
(
  per.view hwioreg.per "EBI,EBI2_REGS,EBI2_CBC_PRF_CFG"
)
if "&choice"=="EF_CHAIN_SEL"
(
  per.view hwioreg.per "EFUSE,EFUSE,EF_CHAIN_SEL"
)
if "&choice"=="EF_BLOW_TIMER"
(
  per.view hwioreg.per "EFUSE,EFUSE,EF_BLOW_TIMER"
)
if "&choice"=="EF_BLOW_VALUE"
(
  per.view hwioreg.per "EFUSE,EFUSE,EF_BLOW_VALUE"
)
if "&choice"=="EF_SHIFT_VALUE"
(
  per.view hwioreg.per "EFUSE,EFUSE,EF_SHIFT_VALUE"
)
if "&choice"=="EF_STATUS"
(
  per.view hwioreg.per "EFUSE,EFUSE,EF_STATUS"
)
if "&choice"=="EF_PWR_CTL"
(
  per.view hwioreg.per "EFUSE,EFUSE,EF_PWR_CTL"
)
if "&choice"=="EF_CONFIG_LSB"
(
  per.view hwioreg.per "EFUSE,EFUSE,EF_CONFIG_LSB"
)
if "&choice"=="EF_CONFIG_MSB"
(
  per.view hwioreg.per "EFUSE,EFUSE,EF_CONFIG_MSB"
)
if "&choice"=="ENABLE_ARM9_JTAG"
(
  per.view hwioreg.per "EFUSE,EFUSE,ENABLE_ARM9_JTAG"
)
if "&choice"=="RF_CAL_PART1"
(
  per.view hwioreg.per "EFUSE,EFUSE2,RF_CAL_PART1"
)
if "&choice"=="RF_CAL_PART2"
(
  per.view hwioreg.per "EFUSE,EFUSE2,RF_CAL_PART2"
)
if "&choice"=="RF_CAL_PART3"
(
  per.view hwioreg.per "EFUSE,EFUSE2,RF_CAL_PART3"
)
if "&choice"=="EMU_ANT_RAM_ADDR_VAL"
(
  per.view hwioreg.per "EMU,EMU_ANTRAM,EMU_ANT_RAM_ADDR_VAL"
)
if "&choice"=="EMU_ANT_RAM_DATA"
(
  per.view hwioreg.per "EMU,EMU_ANTRAM,EMU_ANT_RAM_DATA"
)
if "&choice"=="EMU_ANT_RAM_RTCMATCH"
(
  per.view hwioreg.per "EMU,EMU_ANTRAM,EMU_ANT_RAM_RTCMATCH"
)
if "&choice"=="EMU_ANT_RAM_CTL"
(
  per.view hwioreg.per "EMU,EMU_ANTRAM,EMU_ANT_RAM_CTL"
)
if "&choice"=="EMU_ANT_RAM_DEBUG_CTL"
(
  per.view hwioreg.per "EMU,EMU_ANTRAM,EMU_ANT_RAM_DEBUG_CTL"
)
if "&choice"=="EMU_ANT_RAM_GPO"
(
  per.view hwioreg.per "EMU,EMU_ANTRAM,EMU_ANT_RAM_GPO"
)
if "&choice"=="EMU_ANT_RAM_DEBUG2_CTL"
(
  per.view hwioreg.per "EMU,EMU_ANTRAM,EMU_ANT_RAM_DEBUG2_CTL"
)
if "&choice"=="EMU_RXFPGA_MODE_SEL"
(
  per.view hwioreg.per "EMU,EMU_ANTRAM,EMU_RXFPGA_MODE_SEL"
)
if "&choice"=="EMU_QDSP_CTL_ADDR"
(
  per.view hwioreg.per "EMU,EMU_ANTRAM,EMU_QDSP_CTL_ADDR"
)
if "&choice"=="EMU_QDSP_PC_DEBIG"
(
  per.view hwioreg.per "EMU,EMU_ANTRAM,EMU_QDSP_PC_DEBIG"
)
if "&choice"=="EMU_USB_CTL"
(
  per.view hwioreg.per "EMU,EMU_ANTRAM,EMU_USB_CTL"
)
if "&choice"=="EMU_USB_DET"
(
  per.view hwioreg.per "EMU,EMU_ANTRAM,EMU_USB_DET"
)
if "&choice"=="EMU_RX_FPGA_VERSION_RD"
(
  per.view hwioreg.per "EMU,EMU_RXFPGA,EMU_RX_FPGA_VERSION_RD"
)
if "&choice"=="EMU_TDEC_FPGA_VERSION_RD"
(
  per.view hwioreg.per "EMU,EMU_TDECFPGA,EMU_TDEC_FPGA_VERSION_RD"
)
if "&choice"=="EMU_TDEC_DBG_BUS_RD"
(
  per.view hwioreg.per "EMU,EMU_TDECFPGA,EMU_TDEC_DBG_BUS_RD"
)
if "&choice"=="EMU_TDEC_DSP_PC_RD"
(
  per.view hwioreg.per "EMU,EMU_TDECFPGA,EMU_TDEC_DSP_PC_RD"
)
if "&choice"=="EMU_TDEC_DSP_XMEMC_SIG_RD"
(
  per.view hwioreg.per "EMU,EMU_TDECFPGA,EMU_TDEC_DSP_XMEMC_SIG_RD"
)
if "&choice"=="EMU_TX_FPGA_VERSION_RD"
(
  per.view hwioreg.per "EMU,EMU_TXFPGA,EMU_TX_FPGA_VERSION_RD"
)
if "&choice"=="EMU_TX_SYSTEM_MODE"
(
  per.view hwioreg.per "EMU,EMU_TXFPGA,EMU_TX_SYSTEM_MODE"
)
if "&choice"=="EMU_TX_GPIO_WR"
(
  per.view hwioreg.per "EMU,EMU_TXFPGA,EMU_TX_GPIO_WR"
)
if "&choice"=="EMU_TX_GPIO_STATUS_RD"
(
  per.view hwioreg.per "EMU,EMU_TXFPGA,EMU_TX_GPIO_STATUS_RD"
)
if "&choice"=="EMU_TX_GPIO_OE"
(
  per.view hwioreg.per "EMU,EMU_TXFPGA,EMU_TX_GPIO_OE"
)
if "&choice"=="EMU_PA_ON_CTL"
(
  per.view hwioreg.per "EMU,EMU_TXFPGA,EMU_PA_ON_CTL"
)
if "&choice"=="EMU_PA_ON_STATUS_RD"
(
  per.view hwioreg.per "EMU,EMU_TXFPGA,EMU_PA_ON_STATUS_RD"
)
if "&choice"=="FL_SYM_BUFF_MODE"
(
  per.view hwioreg.per "FL_SYM_BUFF,FL_SYM_BUFF_MODE"
)
if "&choice"=="FL_SYM_BUFF_CLK_CTL"
(
  per.view hwioreg.per "FL_SYM_BUFF,FL_SYM_BUFF_CLK_CTL"
)
if "&choice"=="FL_SYM_BUFF_CLK_OVERRIDE"
(
  per.view hwioreg.per "FL_SYM_BUFF,FL_SYM_BUFF_CLK_OVERRIDE"
)
if "&choice"=="FL_SYM_BUFF_CLK_STATUS_RD"
(
  per.view hwioreg.per "FL_SYM_BUFF,FL_SYM_BUFF_CLK_STATUS_RD"
)
if "&choice"=="FL_SYM_BUFF_MEM_RD"
(
  per.view hwioreg.per "FL_SYM_BUFF,FL_SYM_BUFF_MEM_RD"
)
if "&choice"=="GACC_DM_BYPASS"
(
  per.view hwioreg.per "GACC,GACC_DM_BYPASS"
)
if "&choice"=="GACC_CLK_CTL"
(
  per.view hwioreg.per "GACC,GACC_CLK_CTL"
)
if "&choice"=="GACC_TEST_BUS_OUT"
(
  per.view hwioreg.per "GACC,GACC_TEST_BUS_OUT"
)
if "&choice"=="GACC_RTC_WAIT_ALT"
(
  per.view hwioreg.per "GACC,GACC_RTC_WAIT_ALT"
)
if "&choice"=="GACC_START_ADDR_ALT"
(
  per.view hwioreg.per "GACC,GACC_START_ADDR_ALT"
)
if "&choice"=="GACC_COUNT_ALT"
(
  per.view hwioreg.per "GACC,GACC_COUNT_ALT"
)
if "&choice"=="GACC_INCR_ALT"
(
  per.view hwioreg.per "GACC,GACC_INCR_ALT"
)
if "&choice"=="GACC_FREQ_ALT"
(
  per.view hwioreg.per "GACC,GACC_FREQ_ALT"
)
if "&choice"=="GACC_CONFIG_ALT"
(
  per.view hwioreg.per "GACC,GACC_CONFIG_ALT"
)
if "&choice"=="GACC_PEAK_ALT"
(
  per.view hwioreg.per "GACC,GACC_PEAK_ALT"
)
if "&choice"=="GACC_DONE_ALT"
(
  per.view hwioreg.per "GACC,GACC_DONE_ALT"
)
if "&choice"=="GACC_RTC_ALT"
(
  per.view hwioreg.per "GACC,GACC_RTC_ALT"
)
if "&choice"=="GACC_SAMPLE_MEM_START_ADDR_ALT"
(
  per.view hwioreg.per "GACC,GACC_SAMPLE_MEM_START_ADDR_ALT"
)
if "&choice"=="GACC_SAMPLE_MEM_END_ADDR_ALT"
(
  per.view hwioreg.per "GACC,GACC_SAMPLE_MEM_END_ADDR_ALT"
)
if "&choice"=="GACC_ENERGY_MEM_START_ADDR_ALT"
(
  per.view hwioreg.per "GACC,GACC_ENERGY_MEM_START_ADDR_ALT"
)
if "&choice"=="GACC_ENERGY_MEM_END_ADDR_ALT"
(
  per.view hwioreg.per "GACC,GACC_ENERGY_MEM_END_ADDR_ALT"
)
if "&choice"=="GACC_RTC_WAIT"
(
  per.view hwioreg.per "GACC,GACC_RTC_WAIT"
)
if "&choice"=="GACC_START_ADDR"
(
  per.view hwioreg.per "GACC,GACC_START_ADDR"
)
if "&choice"=="GACC_COUNT"
(
  per.view hwioreg.per "GACC,GACC_COUNT"
)
if "&choice"=="GACC_INCR"
(
  per.view hwioreg.per "GACC,GACC_INCR"
)
if "&choice"=="GACC_FREQ"
(
  per.view hwioreg.per "GACC,GACC_FREQ"
)
if "&choice"=="GACC_CONFIG"
(
  per.view hwioreg.per "GACC,GACC_CONFIG"
)
if "&choice"=="GACC_PEAK"
(
  per.view hwioreg.per "GACC,GACC_PEAK"
)
if "&choice"=="GACC_DONE"
(
  per.view hwioreg.per "GACC,GACC_DONE"
)
if "&choice"=="GACC_RTC"
(
  per.view hwioreg.per "GACC,GACC_RTC"
)
if "&choice"=="GACC_SAMPLE_MEM_START_ADDR"
(
  per.view hwioreg.per "GACC,GACC_SAMPLE_MEM_START_ADDR"
)
if "&choice"=="GACC_SAMPLE_MEM_END_ADDR"
(
  per.view hwioreg.per "GACC,GACC_SAMPLE_MEM_END_ADDR"
)
if "&choice"=="GACC_ENERGY_MEM_START_ADDR"
(
  per.view hwioreg.per "GACC,GACC_ENERGY_MEM_START_ADDR"
)
if "&choice"=="GACC_ENERGY_MEM_END_ADDR"
(
  per.view hwioreg.per "GACC,GACC_ENERGY_MEM_END_ADDR"
)
if "&choice"=="GPIO_OUT_0"
(
  per.view hwioreg.per "GPIO,GPIO,GPIO_OUT_0"
)
if "&choice"=="GPIO_OUT_1"
(
  per.view hwioreg.per "GPIO,GPIO,GPIO_OUT_1"
)
if "&choice"=="GPIO_OE_0"
(
  per.view hwioreg.per "GPIO,GPIO,GPIO_OE_0"
)
if "&choice"=="GPIO_OE_1"
(
  per.view hwioreg.per "GPIO,GPIO,GPIO_OE_1"
)
if "&choice"=="GPIO_PAGE"
(
  per.view hwioreg.per "GPIO,GPIO,GPIO_PAGE"
)
if "&choice"=="GPIO_CFG"
(
  per.view hwioreg.per "GPIO,GPIO,GPIO_CFG"
)
if "&choice"=="GPIO_IN_0"
(
  per.view hwioreg.per "GPIO,GPIO,GPIO_IN_0"
)
if "&choice"=="GPIO_IN_1"
(
  per.view hwioreg.per "GPIO,GPIO,GPIO_IN_1"
)
if "&choice"=="GPIO2_OE_0"
(
  per.view hwioreg.per "GPIO,GPIO2,GPIO2_OE_0"
)
if "&choice"=="GPIO2_OE_1"
(
  per.view hwioreg.per "GPIO,GPIO2,GPIO2_OE_1"
)
if "&choice"=="GPIO2_OUT_0"
(
  per.view hwioreg.per "GPIO,GPIO2,GPIO2_OUT_0"
)
if "&choice"=="GPIO2_OUT_1"
(
  per.view hwioreg.per "GPIO,GPIO2,GPIO2_OUT_1"
)
if "&choice"=="GPIO2_PAGE"
(
  per.view hwioreg.per "GPIO,GPIO2,GPIO2_PAGE"
)
if "&choice"=="GPIO2_CFG"
(
  per.view hwioreg.per "GPIO,GPIO2,GPIO2_CFG"
)
if "&choice"=="GPIO2_IN_0"
(
  per.view hwioreg.per "GPIO,GPIO2,GPIO2_IN_0"
)
if "&choice"=="GPIO2_IN_1"
(
  per.view hwioreg.per "GPIO,GPIO2,GPIO2_IN_1"
)
if "&choice"=="GPS_SRCH_DM_BYPASS"
(
  per.view hwioreg.per "GPS_SRCH,GPS_SRCH_DM_BYPASS"
)
if "&choice"=="GPS_SRCH_RESET"
(
  per.view hwioreg.per "GPS_SRCH,GPS_SRCH_RESET"
)
if "&choice"=="GPS_SRCH_CTL"
(
  per.view hwioreg.per "GPS_SRCH,GPS_SRCH_CTL"
)
if "&choice"=="GPS_SRCH_TESTBUS_OUT"
(
  per.view hwioreg.per "GPS_SRCH,GPS_SRCH_TESTBUS_OUT"
)
if "&choice"=="GPS_SRCH_SS_TESTBUS_OUT"
(
  per.view hwioreg.per "GPS_SRCH,GPS_SRCH_SS_TESTBUS_OUT"
)
if "&choice"=="ALT_GPS_SRCH_CMD"
(
  per.view hwioreg.per "GPS_SRCH,ALT_GPS_SRCH_CMD"
)
if "&choice"=="ALT_GPS_SRCH_OUT"
(
  per.view hwioreg.per "GPS_SRCH,ALT_GPS_SRCH_OUT"
)
if "&choice"=="GPS_SRCH_CMD_START_ADDR"
(
  per.view hwioreg.per "GPS_SRCH,GPS_SRCH_CMD_START_ADDR"
)
if "&choice"=="GPS_SRCH_CMD_END_ADDR"
(
  per.view hwioreg.per "GPS_SRCH,GPS_SRCH_CMD_END_ADDR"
)
if "&choice"=="GPS_SRCH_OUT_START_ADDR"
(
  per.view hwioreg.per "GPS_SRCH,GPS_SRCH_OUT_START_ADDR"
)
if "&choice"=="GPS_SRCH_OUT_END_ADDR"
(
  per.view hwioreg.per "GPS_SRCH,GPS_SRCH_OUT_END_ADDR"
)
if "&choice"=="GPS_SRCH_CMD_ST0"
(
  per.view hwioreg.per "GPS_SRCH,GPS_SRCH_CMD_ST0"
)
if "&choice"=="GPS_SRCH_CMD_DIAG0"
(
  per.view hwioreg.per "GPS_SRCH,GPS_SRCH_CMD_DIAG0"
)
if "&choice"=="GPS_SRCH_CMD_WD0"
(
  per.view hwioreg.per "GPS_SRCH,GPS_SRCH_CMD_WD0"
)
if "&choice"=="GPS_SRCH_CMD_WD1"
(
  per.view hwioreg.per "GPS_SRCH,GPS_SRCH_CMD_WD1"
)
if "&choice"=="GPS_SRCH_CMD_WD2"
(
  per.view hwioreg.per "GPS_SRCH,GPS_SRCH_CMD_WD2"
)
if "&choice"=="GPS_SRCH_CMD_CDMA_WD3"
(
  per.view hwioreg.per "GPS_SRCH,GPS_SRCH_CMD_CDMA_WD3"
)
if "&choice"=="GPS_SRCH_CMD_GPS_WD3"
(
  per.view hwioreg.per "GPS_SRCH,GPS_SRCH_CMD_GPS_WD3"
)
if "&choice"=="GPS_SRCH_CMD_HDR_WD3"
(
  per.view hwioreg.per "GPS_SRCH,GPS_SRCH_CMD_HDR_WD3"
)
if "&choice"=="IBI0_CFG"
(
  per.view hwioreg.per "IBI_REGS,IBI0_CFG"
)
if "&choice"=="IBI1_CFG"
(
  per.view hwioreg.per "IBI_REGS,IBI1_CFG"
)
if "&choice"=="IBI0_AHB_PRIORITY"
(
  per.view hwioreg.per "IBI_REGS,IBI0_AHB_PRIORITY"
)
if "&choice"=="IBI1_AHB_PRIORITY"
(
  per.view hwioreg.per "IBI_REGS,IBI1_AHB_PRIORITY"
)
if "&choice"=="IMEM0_CFG"
(
  per.view hwioreg.per "IBI_REGS,IMEM0_CFG"
)
if "&choice"=="IMEM1_CFG"
(
  per.view hwioreg.per "IBI_REGS,IMEM1_CFG"
)
if "&choice"=="IMEM2_CFG"
(
  per.view hwioreg.per "IBI_REGS,IMEM2_CFG"
)
if "&choice"=="IMEM3_CFG"
(
  per.view hwioreg.per "IBI_REGS,IMEM3_CFG"
)
if "&choice"=="IMEM0_BASE_ADDR"
(
  per.view hwioreg.per "IBI_REGS,IMEM0_BASE_ADDR"
)
if "&choice"=="IMEM1_BASE_ADDR"
(
  per.view hwioreg.per "IBI_REGS,IMEM1_BASE_ADDR"
)
if "&choice"=="IMEM2_BASE_ADDR"
(
  per.view hwioreg.per "IBI_REGS,IMEM2_BASE_ADDR"
)
if "&choice"=="IMEM3_BASE_ADDR"
(
  per.view hwioreg.per "IBI_REGS,IMEM3_BASE_ADDR"
)
if "&choice"=="IMEM_BASE_ADDR_EN"
(
  per.view hwioreg.per "IBI_REGS,IMEM_BASE_ADDR_EN"
)
if "&choice"=="IBI0_DEBUG_BUS_CFG"
(
  per.view hwioreg.per "IBI_REGS,IBI0_DEBUG_BUS_CFG"
)
if "&choice"=="IBI1_DEBUG_BUS_CFG"
(
  per.view hwioreg.per "IBI_REGS,IBI1_DEBUG_BUS_CFG"
)
if "&choice"=="IBI0_PROFILING_CFG"
(
  per.view hwioreg.per "IBI_REGS,IBI0_PROFILING_CFG"
)
if "&choice"=="IBI1_PROFILING_CFG"
(
  per.view hwioreg.per "IBI_REGS,IBI1_PROFILING_CFG"
)
if "&choice"=="INT_POL_SET"
(
  per.view hwioreg.per "INT,INT_CTL,INT_POL_SET"
)
if "&choice"=="IRQ_EN_0"
(
  per.view hwioreg.per "INT,INT_CTL,IRQ_EN_0"
)
if "&choice"=="IRQ_EN_1"
(
  per.view hwioreg.per "INT,INT_CTL,IRQ_EN_1"
)
if "&choice"=="FIQ_EN_0"
(
  per.view hwioreg.per "INT,INT_CTL,FIQ_EN_0"
)
if "&choice"=="FIQ_EN_1"
(
  per.view hwioreg.per "INT,INT_CTL,FIQ_EN_1"
)
if "&choice"=="INT_DET_REG_0"
(
  per.view hwioreg.per "INT,INT_CTL,INT_DET_REG_0"
)
if "&choice"=="INT_DET_REG_1"
(
  per.view hwioreg.per "INT,INT_CTL,INT_DET_REG_1"
)
if "&choice"=="IRQ_STATUS_0"
(
  per.view hwioreg.per "INT,INT_CTL,IRQ_STATUS_0"
)
if "&choice"=="IRQ_STATUS_1"
(
  per.view hwioreg.per "INT,INT_CTL,IRQ_STATUS_1"
)
if "&choice"=="FIQ_STATUS_0"
(
  per.view hwioreg.per "INT,INT_CTL,FIQ_STATUS_0"
)
if "&choice"=="FIQ_STATUS_1"
(
  per.view hwioreg.per "INT,INT_CTL,FIQ_STATUS_1"
)
if "&choice"=="IRQ_VEC_INDEX_RD"
(
  per.view hwioreg.per "INT,INT_CTL,IRQ_VEC_INDEX_RD"
)
if "&choice"=="IRQ_VEC_INDEX_PEND_RD"
(
  per.view hwioreg.per "INT,INT_CTL,IRQ_VEC_INDEX_PEND_RD"
)
if "&choice"=="IRQ_IN_SERVICE_RD"
(
  per.view hwioreg.per "INT,INT_CTL,IRQ_IN_SERVICE_RD"
)
if "&choice"=="IRQ_IN_STACK_RD"
(
  per.view hwioreg.per "INT,INT_CTL,IRQ_IN_STACK_RD"
)
if "&choice"=="INT_0_PRIORITY"
(
  per.view hwioreg.per "INT,INT_CTL,INT_0_PRIORITY"
)
if "&choice"=="INT_1_PRIORITY"
(
  per.view hwioreg.per "INT,INT_CTL,INT_1_PRIORITY"
)
if "&choice"=="INT_2_PRIORITY"
(
  per.view hwioreg.per "INT,INT_CTL,INT_2_PRIORITY"
)
if "&choice"=="INT_3_PRIORITY"
(
  per.view hwioreg.per "INT,INT_CTL,INT_3_PRIORITY"
)
if "&choice"=="INT_4_PRIORITY"
(
  per.view hwioreg.per "INT,INT_CTL,INT_4_PRIORITY"
)
if "&choice"=="INT_5_PRIORITY"
(
  per.view hwioreg.per "INT,INT_CTL,INT_5_PRIORITY"
)
if "&choice"=="INT_6_PRIORITY"
(
  per.view hwioreg.per "INT,INT_CTL,INT_6_PRIORITY"
)
if "&choice"=="INT_7_PRIORITY"
(
  per.view hwioreg.per "INT,INT_CTL,INT_7_PRIORITY"
)
if "&choice"=="INT_8_PRIORITY"
(
  per.view hwioreg.per "INT,INT_CTL,INT_8_PRIORITY"
)
if "&choice"=="INT_9_PRIORITY"
(
  per.view hwioreg.per "INT,INT_CTL,INT_9_PRIORITY"
)
if "&choice"=="INT_10_PRIORITY"
(
  per.view hwioreg.per "INT,INT_CTL,INT_10_PRIORITY"
)
if "&choice"=="INT_11_PRIORITY"
(
  per.view hwioreg.per "INT,INT_CTL,INT_11_PRIORITY"
)
if "&choice"=="INT_12_PRIORITY"
(
  per.view hwioreg.per "INT,INT_CTL,INT_12_PRIORITY"
)
if "&choice"=="INT_13_PRIORITY"
(
  per.view hwioreg.per "INT,INT_CTL,INT_13_PRIORITY"
)
if "&choice"=="INT_14_PRIORITY"
(
  per.view hwioreg.per "INT,INT_CTL,INT_14_PRIORITY"
)
if "&choice"=="INT_15_PRIORITY"
(
  per.view hwioreg.per "INT,INT_CTL,INT_15_PRIORITY"
)
if "&choice"=="INT_16_PRIORITY"
(
  per.view hwioreg.per "INT,INT_CTL,INT_16_PRIORITY"
)
if "&choice"=="INT_17_PRIORITY"
(
  per.view hwioreg.per "INT,INT_CTL,INT_17_PRIORITY"
)
if "&choice"=="INT_18_PRIORITY"
(
  per.view hwioreg.per "INT,INT_CTL,INT_18_PRIORITY"
)
if "&choice"=="INT_19_PRIORITY"
(
  per.view hwioreg.per "INT,INT_CTL,INT_19_PRIORITY"
)
if "&choice"=="INT_20_PRIORITY"
(
  per.view hwioreg.per "INT,INT_CTL,INT_20_PRIORITY"
)
if "&choice"=="INT_21_PRIORITY"
(
  per.view hwioreg.per "INT,INT_CTL,INT_21_PRIORITY"
)
if "&choice"=="INT_22_PRIORITY"
(
  per.view hwioreg.per "INT,INT_CTL,INT_22_PRIORITY"
)
if "&choice"=="INT_23_PRIORITY"
(
  per.view hwioreg.per "INT,INT_CTL,INT_23_PRIORITY"
)
if "&choice"=="INT_24_PRIORITY"
(
  per.view hwioreg.per "INT,INT_CTL,INT_24_PRIORITY"
)
if "&choice"=="INT_25_PRIORITY"
(
  per.view hwioreg.per "INT,INT_CTL,INT_25_PRIORITY"
)
if "&choice"=="INT_26_PRIORITY"
(
  per.view hwioreg.per "INT,INT_CTL,INT_26_PRIORITY"
)
if "&choice"=="INT_27_PRIORITY"
(
  per.view hwioreg.per "INT,INT_CTL,INT_27_PRIORITY"
)
if "&choice"=="INT_28_PRIORITY"
(
  per.view hwioreg.per "INT,INT_CTL,INT_28_PRIORITY"
)
if "&choice"=="INT_29_PRIORITY"
(
  per.view hwioreg.per "INT,INT_CTL,INT_29_PRIORITY"
)
if "&choice"=="INT_30_PRIORITY"
(
  per.view hwioreg.per "INT,INT_CTL,INT_30_PRIORITY"
)
if "&choice"=="INT_31_PRIORITY"
(
  per.view hwioreg.per "INT,INT_CTL,INT_31_PRIORITY"
)
if "&choice"=="INT_32_PRIORITY"
(
  per.view hwioreg.per "INT,INT_CTL,INT_32_PRIORITY"
)
if "&choice"=="INT_33_PRIORITY"
(
  per.view hwioreg.per "INT,INT_CTL,INT_33_PRIORITY"
)
if "&choice"=="INT_34_PRIORITY"
(
  per.view hwioreg.per "INT,INT_CTL,INT_34_PRIORITY"
)
if "&choice"=="INT_35_PRIORITY"
(
  per.view hwioreg.per "INT,INT_CTL,INT_35_PRIORITY"
)
if "&choice"=="INT_36_PRIORITY"
(
  per.view hwioreg.per "INT,INT_CTL,INT_36_PRIORITY"
)
if "&choice"=="INT_37_PRIORITY"
(
  per.view hwioreg.per "INT,INT_CTL,INT_37_PRIORITY"
)
if "&choice"=="INT_38_PRIORITY"
(
  per.view hwioreg.per "INT,INT_CTL,INT_38_PRIORITY"
)
if "&choice"=="INT_39_PRIORITY"
(
  per.view hwioreg.per "INT,INT_CTL,INT_39_PRIORITY"
)
if "&choice"=="INT_40_PRIORITY"
(
  per.view hwioreg.per "INT,INT_CTL,INT_40_PRIORITY"
)
if "&choice"=="INT_41_PRIORITY"
(
  per.view hwioreg.per "INT,INT_CTL,INT_41_PRIORITY"
)
if "&choice"=="INT_42_PRIORITY"
(
  per.view hwioreg.per "INT,INT_CTL,INT_42_PRIORITY"
)
if "&choice"=="INT_43_PRIORITY"
(
  per.view hwioreg.per "INT,INT_CTL,INT_43_PRIORITY"
)
if "&choice"=="INT_44_PRIORITY"
(
  per.view hwioreg.per "INT,INT_CTL,INT_44_PRIORITY"
)
if "&choice"=="INT_45_PRIORITY"
(
  per.view hwioreg.per "INT,INT_CTL,INT_45_PRIORITY"
)
if "&choice"=="INT_46_PRIORITY"
(
  per.view hwioreg.per "INT,INT_CTL,INT_46_PRIORITY"
)
if "&choice"=="INT_47_PRIORITY"
(
  per.view hwioreg.per "INT,INT_CTL,INT_47_PRIORITY"
)
if "&choice"=="INT_48_PRIORITY"
(
  per.view hwioreg.per "INT,INT_CTL,INT_48_PRIORITY"
)
if "&choice"=="INT_49_PRIORITY"
(
  per.view hwioreg.per "INT,INT_CTL,INT_49_PRIORITY"
)
if "&choice"=="INT_50_PRIORITY"
(
  per.view hwioreg.per "INT,INT_CTL,INT_50_PRIORITY"
)
if "&choice"=="INT_51_PRIORITY"
(
  per.view hwioreg.per "INT,INT_CTL,INT_51_PRIORITY"
)
if "&choice"=="INT_52_PRIORITY"
(
  per.view hwioreg.per "INT,INT_CTL,INT_52_PRIORITY"
)
if "&choice"=="INT_53_PRIORITY"
(
  per.view hwioreg.per "INT,INT_CTL,INT_53_PRIORITY"
)
if "&choice"=="INT_54_PRIORITY"
(
  per.view hwioreg.per "INT,INT_CTL,INT_54_PRIORITY"
)
if "&choice"=="INT_55_PRIORITY"
(
  per.view hwioreg.per "INT,INT_CTL,INT_55_PRIORITY"
)
if "&choice"=="INT_56_PRIORITY"
(
  per.view hwioreg.per "INT,INT_CTL,INT_56_PRIORITY"
)
if "&choice"=="INT_57_PRIORITY"
(
  per.view hwioreg.per "INT,INT_CTL,INT_57_PRIORITY"
)
if "&choice"=="INT_58_PRIORITY"
(
  per.view hwioreg.per "INT,INT_CTL,INT_58_PRIORITY"
)
if "&choice"=="INT_59_PRIORITY"
(
  per.view hwioreg.per "INT,INT_CTL,INT_59_PRIORITY"
)
if "&choice"=="MSM_GPIO1_INT_EN_0"
(
  per.view hwioreg.per "INT,INT_CTL,MSM_GPIO1_INT_EN_0"
)
if "&choice"=="MSM_GPIO1_INT_POLARITY_0"
(
  per.view hwioreg.per "INT,INT_CTL,MSM_GPIO1_INT_POLARITY_0"
)
if "&choice"=="MSM_GPIO1_DETECT_CTL_0"
(
  per.view hwioreg.per "INT,INT_CTL,MSM_GPIO1_DETECT_CTL_0"
)
if "&choice"=="MSM_GPIO1_INT_STATUS_0"
(
  per.view hwioreg.per "INT,INT_CTL,MSM_GPIO1_INT_STATUS_0"
)
if "&choice"=="MSM_GPIO1_INT_EN_1"
(
  per.view hwioreg.per "INT,INT_CTL,MSM_GPIO1_INT_EN_1"
)
if "&choice"=="MSM_GPIO1_INT_POLARITY_1"
(
  per.view hwioreg.per "INT,INT_CTL,MSM_GPIO1_INT_POLARITY_1"
)
if "&choice"=="MSM_GPIO1_DETECT_CTL_1"
(
  per.view hwioreg.per "INT,INT_CTL,MSM_GPIO1_DETECT_CTL_1"
)
if "&choice"=="MSM_GPIO1_INT_STATUS_1"
(
  per.view hwioreg.per "INT,INT_CTL,MSM_GPIO1_INT_STATUS_1"
)
if "&choice"=="MSM_INT_EN"
(
  per.view hwioreg.per "INT,INT_CTL_GPIO2,MSM_INT_EN"
)
if "&choice"=="MSM_INT_POLARITY"
(
  per.view hwioreg.per "INT,INT_CTL_GPIO2,MSM_INT_POLARITY"
)
if "&choice"=="MSM_DETECT_CTL"
(
  per.view hwioreg.per "INT,INT_CTL_GPIO2,MSM_DETECT_CTL"
)
if "&choice"=="MSM_INT_STATUS"
(
  per.view hwioreg.per "INT,INT_CTL_GPIO2,MSM_INT_STATUS"
)
if "&choice"=="MSM_KEYSENSE_GROUP_STATUS"
(
  per.view hwioreg.per "INT,INT_CTL_GPIO2,MSM_KEYSENSE_GROUP_STATUS"
)
if "&choice"=="MSM_GPIO2_INT_EN"
(
  per.view hwioreg.per "INT,INT_CTL_GPIO2,MSM_GPIO2_INT_EN"
)
if "&choice"=="MSM_GPIO2_INT_POLARITY"
(
  per.view hwioreg.per "INT,INT_CTL_GPIO2,MSM_GPIO2_INT_POLARITY"
)
if "&choice"=="MSM_GPIO2_DETECT_CTL"
(
  per.view hwioreg.per "INT,INT_CTL_GPIO2,MSM_GPIO2_DETECT_CTL"
)
if "&choice"=="MSM_GPIO2_INT_STATUS"
(
  per.view hwioreg.per "INT,INT_CTL_GPIO2,MSM_GPIO2_INT_STATUS"
)
if "&choice"=="MDP_TEST_MODE"
(
  per.view hwioreg.per "MDP,MDP_TEST_MODE"
)
if "&choice"=="MDP_COMMAND"
(
  per.view hwioreg.per "MDP,MDP_COMMAND"
)
if "&choice"=="MDP_SCRIPT_ADDR"
(
  per.view hwioreg.per "MDP,MDP_SCRIPT_ADDR"
)
if "&choice"=="MDP_CGC_CONFIG"
(
  per.view hwioreg.per "MDP,MDP_CGC_CONFIG"
)
if "&choice"=="MDP_SYNC_CONFIG"
(
  per.view hwioreg.per "MDP,MDP_SYNC_CONFIG"
)
if "&choice"=="MDP_SYNC_STATUS"
(
  per.view hwioreg.per "MDP,MDP_SYNC_STATUS"
)
if "&choice"=="MDP_SST_REFRESH_COUNT"
(
  per.view hwioreg.per "MDP,MDP_SST_REFRESH_COUNT"
)
if "&choice"=="MDP_SCRIPT_STATUS"
(
  per.view hwioreg.per "MDP,MDP_SCRIPT_STATUS"
)
if "&choice"=="MDP_INTR_ENABLE"
(
  per.view hwioreg.per "MDP,MDP_INTR_ENABLE"
)
if "&choice"=="MDP_INTR_STATUS"
(
  per.view hwioreg.per "MDP,MDP_INTR_STATUS"
)
if "&choice"=="MDP_INTR_CLEAR"
(
  per.view hwioreg.per "MDP,MDP_INTR_CLEAR"
)
if "&choice"=="MDP_TEST_MISR_RESET"
(
  per.view hwioreg.per "MDP,MDP_TEST_MISR_RESET"
)
if "&choice"=="MDP_TEST_EXPORT_MISR"
(
  per.view hwioreg.per "MDP,MDP_TEST_EXPORT_MISR"
)
if "&choice"=="MDP_TEST_MISR_CURR_VAL"
(
  per.view hwioreg.per "MDP,MDP_TEST_MISR_CURR_VAL"
)
if "&choice"=="MDP_INIT_SST_RD_PTR"
(
  per.view hwioreg.per "MDP,MDP_INIT_SST_RD_PTR"
)
if "&choice"=="MDP_ADDRESS_14"
(
  per.view hwioreg.per "MDP,MDP_ADDRESS_14"
)
if "&choice"=="MDP_MAX_SST_RD_PTR"
(
  per.view hwioreg.per "MDP,MDP_MAX_SST_RD_PTR"
)
if "&choice"=="MDP_ADDRESS_15"
(
  per.view hwioreg.per "MDP,MDP_ADDRESS_15"
)
if "&choice"=="MDP_DEBUG_BUS_VALUE"
(
  per.view hwioreg.per "MDP,MDP_DEBUG_BUS_VALUE"
)
if "&choice"=="UXMC_PSRAM_CRE_CFG"
(
  per.view hwioreg.per "MISC_REGS,UXMC_PSRAM_CRE_CFG"
)
if "&choice"=="UXMC_CALIB_CFG"
(
  per.view hwioreg.per "MISC_REGS,UXMC_CALIB_CFG"
)
if "&choice"=="UXMC_CALIB_STATUS"
(
  per.view hwioreg.per "MISC_REGS,UXMC_CALIB_STATUS"
)
if "&choice"=="UXMC_CORE_ID"
(
  per.view hwioreg.per "MISC_REGS,UXMC_CORE_ID"
)
if "&choice"=="MOD_ERAM_DATA"
(
  per.view hwioreg.per "MOD_ERAM,MOD_ERAM_DATA"
)
if "&choice"=="MOD_ERAM_DATA_CTL"
(
  per.view hwioreg.per "MOD_ERAM,MOD_ERAM_DATA_CTL"
)
if "&choice"=="MOD_ERAM_RESERVED_BITS"
(
  per.view hwioreg.per "MOD_ERAM,MOD_ERAM_RESERVED_BITS"
)
if "&choice"=="MOD_TEST_MEM_MODE"
(
  per.view hwioreg.per "MOD_ERAM,MOD_TEST_MEM_MODE"
)
if "&choice"=="MOD_TEST_MEM_SEL"
(
  per.view hwioreg.per "MOD_ERAM,MOD_TEST_MEM_SEL"
)
if "&choice"=="MOD_TEST_MEM_ADDR"
(
  per.view hwioreg.per "MOD_ERAM,MOD_TEST_MEM_ADDR"
)
if "&choice"=="MOD_TEST_MEM_DATA"
(
  per.view hwioreg.per "MOD_ERAM,MOD_TEST_MEM_DATA"
)
if "&choice"=="MOD_TXCX16_SPARE_READ_REG_0"
(
  per.view hwioreg.per "MOD_ERAM,MOD_TXCX16_SPARE_READ_REG_0"
)
if "&choice"=="MOD_TXCX16_SPARE_READ_REG_1"
(
  per.view hwioreg.per "MOD_ERAM,MOD_TXCX16_SPARE_READ_REG_1"
)
if "&choice"=="MODEM_CLK_HALT"
(
  per.view hwioreg.per "MODEM,MODEM_CLK,MODEM_CLK_HALT"
)
if "&choice"=="MODEM_CLK_HALT_2"
(
  per.view hwioreg.per "MODEM,MODEM_CLK,MODEM_CLK_HALT_2"
)
if "&choice"=="MODEM_CLK_RESET"
(
  per.view hwioreg.per "MODEM,MODEM_CLK,MODEM_CLK_RESET"
)
if "&choice"=="MODEM_CLK_RESET_2"
(
  per.view hwioreg.per "MODEM,MODEM_CLK,MODEM_CLK_RESET_2"
)
if "&choice"=="MODEM_CLK_INV"
(
  per.view hwioreg.per "MODEM,MODEM_CLK,MODEM_CLK_INV"
)
if "&choice"=="MODEM_CLK_INV_2"
(
  per.view hwioreg.per "MODEM,MODEM_CLK,MODEM_CLK_INV_2"
)
if "&choice"=="MODEM_RXF_SAMP_REF_CLK_CTL"
(
  per.view hwioreg.per "MODEM,MODEM_CLK,MODEM_RXF_SAMP_REF_CLK_CTL"
)
if "&choice"=="MODEM_IN_N_OUT_CLK_CTL"
(
  per.view hwioreg.per "MODEM,MODEM_CLK,MODEM_IN_N_OUT_CLK_CTL"
)
if "&choice"=="MODEM_MF_CHIPXN_CLK_CTL"
(
  per.view hwioreg.per "MODEM,MODEM_CLK,MODEM_MF_CHIPXN_CLK_CTL"
)
if "&choice"=="MODEM_CHIPXN_CLK_CTL"
(
  per.view hwioreg.per "MODEM,MODEM_CLK,MODEM_CHIPXN_CLK_CTL"
)
if "&choice"=="MODEM_OFFLINE_MNCNTR_M"
(
  per.view hwioreg.per "MODEM,MODEM_CLK,MODEM_OFFLINE_MNCNTR_M"
)
if "&choice"=="MODEM_OFFLINE_MNCNTR_NOT_2D"
(
  per.view hwioreg.per "MODEM,MODEM_CLK,MODEM_OFFLINE_MNCNTR_NOT_2D"
)
if "&choice"=="MODEM_OFFLINE_MNCNTR_NOT_N_M"
(
  per.view hwioreg.per "MODEM,MODEM_CLK,MODEM_OFFLINE_MNCNTR_NOT_N_M"
)
if "&choice"=="MODEM_OFFLINE_CLK_CTL"
(
  per.view hwioreg.per "MODEM,MODEM_CLK,MODEM_OFFLINE_CLK_CTL"
)
if "&choice"=="MODEM_GACC_MNCNTR_M"
(
  per.view hwioreg.per "MODEM,MODEM_CLK,MODEM_GACC_MNCNTR_M"
)
if "&choice"=="MODEM_GACC_MNCNTR_NOT_2D"
(
  per.view hwioreg.per "MODEM,MODEM_CLK,MODEM_GACC_MNCNTR_NOT_2D"
)
if "&choice"=="MODEM_GACC_MNCNTR_NOT_N_M"
(
  per.view hwioreg.per "MODEM,MODEM_CLK,MODEM_GACC_MNCNTR_NOT_N_M"
)
if "&choice"=="MODEM_GACC_CLK_CTL"
(
  per.view hwioreg.per "MODEM,MODEM_CLK,MODEM_GACC_CLK_CTL"
)
if "&choice"=="MODEM_GPS_CLK_CTL"
(
  per.view hwioreg.per "MODEM,MODEM_CLK,MODEM_GPS_CLK_CTL"
)
if "&choice"=="MODEM_GPS_MNCNTR_M"
(
  per.view hwioreg.per "MODEM,MODEM_CLK,MODEM_GPS_MNCNTR_M"
)
if "&choice"=="MODEM_GPS_MNCNTR_NOT_2D"
(
  per.view hwioreg.per "MODEM,MODEM_CLK,MODEM_GPS_MNCNTR_NOT_2D"
)
if "&choice"=="MODEM_GPS_MNCNTR_NOT_N_M"
(
  per.view hwioreg.per "MODEM,MODEM_CLK,MODEM_GPS_MNCNTR_NOT_N_M"
)
if "&choice"=="MODEM_F9_CLK_CTL"
(
  per.view hwioreg.per "MODEM,MODEM_CLK,MODEM_F9_CLK_CTL"
)
if "&choice"=="MODEM_EDGE_CLK_CTL"
(
  per.view hwioreg.per "MODEM,MODEM_CLK,MODEM_EDGE_CLK_CTL"
)
if "&choice"=="MODEM_EDGE_MNCNTR_M"
(
  per.view hwioreg.per "MODEM,MODEM_CLK,MODEM_EDGE_MNCNTR_M"
)
if "&choice"=="MODEM_EDGE_MNCNTR_NOT_2D"
(
  per.view hwioreg.per "MODEM,MODEM_CLK,MODEM_EDGE_MNCNTR_NOT_2D"
)
if "&choice"=="MODEM_EDGE_MNCNTR_NOT_N_M"
(
  per.view hwioreg.per "MODEM,MODEM_CLK,MODEM_EDGE_MNCNTR_NOT_N_M"
)
if "&choice"=="MODEM_WCDMA_CHIPXN_MNCTNR_UPDATE"
(
  per.view hwioreg.per "MODEM,MODEM_CLK,MODEM_WCDMA_CHIPXN_MNCTNR_UPDATE"
)
if "&choice"=="MODEM_WEB_CLK_CTL"
(
  per.view hwioreg.per "MODEM,MODEM_CLK,MODEM_WEB_CLK_CTL"
)
if "&choice"=="MODEM_CHIPXN_CLK_MISC_CTL"
(
  per.view hwioreg.per "MODEM,MODEM_CLK,MODEM_CHIPXN_CLK_MISC_CTL"
)
if "&choice"=="MODEM_CLK_MISC_CTL"
(
  per.view hwioreg.per "MODEM,MODEM_CLK,MODEM_CLK_MISC_CTL"
)
if "&choice"=="MODEM_CLK_MISC_CTL_2"
(
  per.view hwioreg.per "MODEM,MODEM_CLK,MODEM_CLK_MISC_CTL_2"
)
if "&choice"=="MODEM_CLK_MDSP_FS_CTL"
(
  per.view hwioreg.per "MODEM,MODEM_CLK,MODEM_CLK_MDSP_FS_CTL"
)
if "&choice"=="MODEM_CLK_STATUS_RD"
(
  per.view hwioreg.per "MODEM,MODEM_CLK,MODEM_CLK_STATUS_RD"
)
if "&choice"=="MODEM_CLK_STATUS_RD_2"
(
  per.view hwioreg.per "MODEM,MODEM_CLK,MODEM_CLK_STATUS_RD_2"
)
if "&choice"=="MODEM_CLK_TEST"
(
  per.view hwioreg.per "MODEM,MODEM_CLK,MODEM_CLK_TEST"
)
if "&choice"=="MODEM_CLK_TEST_2"
(
  per.view hwioreg.per "MODEM,MODEM_CLK,MODEM_CLK_TEST_2"
)
if "&choice"=="MODEM_CDMA_CHIPXN_MNCNTR_M"
(
  per.view hwioreg.per "MODEM,MODEM_CLK,MODEM_CDMA_CHIPXN_MNCNTR_M"
)
if "&choice"=="MODEM_CDMA_CHIPXN_MNCNTR_NOT_2D"
(
  per.view hwioreg.per "MODEM,MODEM_CLK,MODEM_CDMA_CHIPXN_MNCNTR_NOT_2D"
)
if "&choice"=="MODEM_CDMA_CHIPXN_MNCNTR_NOT_N_M"
(
  per.view hwioreg.per "MODEM,MODEM_CLK,MODEM_CDMA_CHIPXN_MNCNTR_NOT_N_M"
)
if "&choice"=="MODEM_CDMA_CHIPXN_MNCTNR_UPDATE"
(
  per.view hwioreg.per "MODEM,MODEM_CLK,MODEM_CDMA_CHIPXN_MNCTNR_UPDATE"
)
if "&choice"=="MODEM_WCDMA_CHIPXN_MNCNTR_M"
(
  per.view hwioreg.per "MODEM,MODEM_CLK,MODEM_WCDMA_CHIPXN_MNCNTR_M"
)
if "&choice"=="MODEM_WCDMA_CHIPXN_MNCNTR_NOT_2D"
(
  per.view hwioreg.per "MODEM,MODEM_CLK,MODEM_WCDMA_CHIPXN_MNCNTR_NOT_2D"
)
if "&choice"=="MODEM_WCDMA_CHIPXN_MNCNTR_NOT_N_M"
(
  per.view hwioreg.per "MODEM,MODEM_CLK,MODEM_WCDMA_CHIPXN_MNCNTR_NOT_N_M"
)
if "&choice"=="MODEM_GPS_MNCNTR_UPDATE"
(
  per.view hwioreg.per "MODEM,MODEM_CLK,MODEM_GPS_MNCNTR_UPDATE"
)
if "&choice"=="MDSP_MNCNTR_MD"
(
  per.view hwioreg.per "MODEM,MODEM_CLK,MDSP_MNCNTR_MD"
)
if "&choice"=="MDSP_MNCNTR_NS"
(
  per.view hwioreg.per "MODEM,MODEM_CLK,MDSP_MNCNTR_NS"
)
if "&choice"=="MDSP_ACTIVE_MD_RD"
(
  per.view hwioreg.per "MODEM,MODEM_CLK,MDSP_ACTIVE_MD_RD"
)
if "&choice"=="MDSP_ACTIVE_NS_RD"
(
  per.view hwioreg.per "MODEM,MODEM_CLK,MDSP_ACTIVE_NS_RD"
)
if "&choice"=="MDSP_CLK_SWITCH"
(
  per.view hwioreg.per "MODEM,MODEM_CLK,MDSP_CLK_SWITCH"
)
if "&choice"=="MODEM_CLK_DYN_SW_BYPASS"
(
  per.view hwioreg.per "MODEM,MODEM_CLK,MODEM_CLK_DYN_SW_BYPASS"
)
if "&choice"=="MODEM_CLK_DYN_SW_SPARE_READ_REG0"
(
  per.view hwioreg.per "MODEM,MODEM_CLK,MODEM_CLK_DYN_SW_SPARE_READ_REG0"
)
if "&choice"=="MODEM_CDXO_CTL"
(
  per.view hwioreg.per "MODEM,MODEM_CLK,MODEM_CDXO_CTL"
)
if "&choice"=="MODEM_CDXO_Y_CUT_CNTR_CTL"
(
  per.view hwioreg.per "MODEM,MODEM_CLK,MODEM_CDXO_Y_CUT_CNTR_CTL"
)
if "&choice"=="MODEM_CDXO_AT_CUT_CNTR"
(
  per.view hwioreg.per "MODEM,MODEM_CLK,MODEM_CDXO_AT_CUT_CNTR"
)
if "&choice"=="MODEM_CLK_SSBI_CLK_CTL"
(
  per.view hwioreg.per "MODEM,MODEM_CLK,MODEM_CLK_SSBI_CLK_CTL"
)
if "&choice"=="MODEM_EDGE_SWC_CNT"
(
  per.view hwioreg.per "MODEM,MODEM_CLK,MODEM_EDGE_SWC_CNT"
)
if "&choice"=="MODEM_SBI0_CLK_EN"
(
  per.view hwioreg.per "MODEM,MODEM_SBI,MODEM_SBI0_CLK_EN"
)
if "&choice"=="MODEM_SBI1_CLK_EN"
(
  per.view hwioreg.per "MODEM,MODEM_SBI,MODEM_SBI1_CLK_EN"
)
if "&choice"=="MODEM_SBI0_CGC_HW_EN"
(
  per.view hwioreg.per "MODEM,MODEM_SBI,MODEM_SBI0_CGC_HW_EN"
)
if "&choice"=="MODEM_SBI1_CGC_HW_EN"
(
  per.view hwioreg.per "MODEM,MODEM_SBI,MODEM_SBI1_CGC_HW_EN"
)
if "&choice"=="MODEM_SBI0_CLK_CTL"
(
  per.view hwioreg.per "MODEM,MODEM_SBI,MODEM_SBI0_CLK_CTL"
)
if "&choice"=="MODEM_SBI1_CLK_CTL"
(
  per.view hwioreg.per "MODEM,MODEM_SBI,MODEM_SBI1_CLK_CTL"
)
if "&choice"=="MODEM_SBI0_CTL"
(
  per.view hwioreg.per "MODEM,MODEM_SBI,MODEM_SBI0_CTL"
)
if "&choice"=="MODEM_SBI1_CTL"
(
  per.view hwioreg.per "MODEM,MODEM_SBI,MODEM_SBI1_CTL"
)
if "&choice"=="MODEM_SBI0_BYPASS_WR"
(
  per.view hwioreg.per "MODEM,MODEM_SBI,MODEM_SBI0_BYPASS_WR"
)
if "&choice"=="MODEM_SBI1_BYPASS_WR"
(
  per.view hwioreg.per "MODEM,MODEM_SBI,MODEM_SBI1_BYPASS_WR"
)
if "&choice"=="MODEM_SBI0_WR"
(
  per.view hwioreg.per "MODEM,MODEM_SBI,MODEM_SBI0_WR"
)
if "&choice"=="MODEM_SBI1_WR"
(
  per.view hwioreg.per "MODEM,MODEM_SBI,MODEM_SBI1_WR"
)
if "&choice"=="MODEM_SBI0_START_CTL"
(
  per.view hwioreg.per "MODEM,MODEM_SBI,MODEM_SBI0_START_CTL"
)
if "&choice"=="MODEM_SBI1_START_CTL"
(
  per.view hwioreg.per "MODEM,MODEM_SBI,MODEM_SBI1_START_CTL"
)
if "&choice"=="MODEM_SBI0_SECOND_IDCODE"
(
  per.view hwioreg.per "MODEM,MODEM_SBI,MODEM_SBI0_SECOND_IDCODE"
)
if "&choice"=="MODEM_SBI1_SECOND_IDCODE"
(
  per.view hwioreg.per "MODEM,MODEM_SBI,MODEM_SBI1_SECOND_IDCODE"
)
if "&choice"=="MODEM_SBI0_STATUS"
(
  per.view hwioreg.per "MODEM,MODEM_SBI,MODEM_SBI0_STATUS"
)
if "&choice"=="MODEM_SBI1_STATUS"
(
  per.view hwioreg.per "MODEM,MODEM_SBI,MODEM_SBI1_STATUS"
)
if "&choice"=="MODEM_SBI0_BYPASS_RD"
(
  per.view hwioreg.per "MODEM,MODEM_SBI,MODEM_SBI0_BYPASS_RD"
)
if "&choice"=="MODEM_SBI1_BYPASS_RD"
(
  per.view hwioreg.per "MODEM,MODEM_SBI,MODEM_SBI1_BYPASS_RD"
)
if "&choice"=="MODEM_SBI0_RD"
(
  per.view hwioreg.per "MODEM,MODEM_SBI,MODEM_SBI0_RD"
)
if "&choice"=="MODEM_SBI1_RD"
(
  per.view hwioreg.per "MODEM,MODEM_SBI,MODEM_SBI1_RD"
)
if "&choice"=="MODEM_SBI0_RD1"
(
  per.view hwioreg.per "MODEM,MODEM_SBI,MODEM_SBI0_RD1"
)
if "&choice"=="MODEM_SBI1_RD1"
(
  per.view hwioreg.per "MODEM,MODEM_SBI,MODEM_SBI1_RD1"
)
if "&choice"=="MODEM_SBI0_RD2"
(
  per.view hwioreg.per "MODEM,MODEM_SBI,MODEM_SBI0_RD2"
)
if "&choice"=="MODEM_SBI1_RD2"
(
  per.view hwioreg.per "MODEM,MODEM_SBI,MODEM_SBI1_RD2"
)
if "&choice"=="MODEM_SSBI0_CLK_EN"
(
  per.view hwioreg.per "MODEM,MODEM_SBI,MODEM_SSBI0_CLK_EN"
)
if "&choice"=="MODEM_SSBI1_CLK_EN"
(
  per.view hwioreg.per "MODEM,MODEM_SBI,MODEM_SSBI1_CLK_EN"
)
if "&choice"=="MODEM_SSBI2_CLK_EN"
(
  per.view hwioreg.per "MODEM,MODEM_SBI,MODEM_SSBI2_CLK_EN"
)
if "&choice"=="MODEM_SSBI0_CGC_HW_EN"
(
  per.view hwioreg.per "MODEM,MODEM_SBI,MODEM_SSBI0_CGC_HW_EN"
)
if "&choice"=="MODEM_SSBI1_CGC_HW_EN"
(
  per.view hwioreg.per "MODEM,MODEM_SBI,MODEM_SSBI1_CGC_HW_EN"
)
if "&choice"=="MODEM_SSBI2_CGC_HW_EN"
(
  per.view hwioreg.per "MODEM,MODEM_SBI,MODEM_SSBI2_CGC_HW_EN"
)
if "&choice"=="MODEM_SSBI0_CTL"
(
  per.view hwioreg.per "MODEM,MODEM_SBI,MODEM_SSBI0_CTL"
)
if "&choice"=="MODEM_SSBI1_CTL"
(
  per.view hwioreg.per "MODEM,MODEM_SBI,MODEM_SSBI1_CTL"
)
if "&choice"=="MODEM_SSBI2_CTL"
(
  per.view hwioreg.per "MODEM,MODEM_SBI,MODEM_SSBI2_CTL"
)
if "&choice"=="MODEM_SSBI0_RESET"
(
  per.view hwioreg.per "MODEM,MODEM_SBI,MODEM_SSBI0_RESET"
)
if "&choice"=="MODEM_SSBI1_RESET"
(
  per.view hwioreg.per "MODEM,MODEM_SBI,MODEM_SSBI1_RESET"
)
if "&choice"=="MODEM_SSBI2_RESET"
(
  per.view hwioreg.per "MODEM,MODEM_SBI,MODEM_SSBI2_RESET"
)
if "&choice"=="MODEM_SSBI0_CMD"
(
  per.view hwioreg.per "MODEM,MODEM_SBI,MODEM_SSBI0_CMD"
)
if "&choice"=="MODEM_SSBI1_CMD"
(
  per.view hwioreg.per "MODEM,MODEM_SBI,MODEM_SSBI1_CMD"
)
if "&choice"=="MODEM_SSBI2_CMD"
(
  per.view hwioreg.per "MODEM,MODEM_SBI,MODEM_SSBI2_CMD"
)
if "&choice"=="MODEM_SSBI0_BYPASS"
(
  per.view hwioreg.per "MODEM,MODEM_SBI,MODEM_SSBI0_BYPASS"
)
if "&choice"=="MODEM_SSBI1_BYPASS"
(
  per.view hwioreg.per "MODEM,MODEM_SBI,MODEM_SSBI1_BYPASS"
)
if "&choice"=="MODEM_SSBI2_BYPASS"
(
  per.view hwioreg.per "MODEM,MODEM_SBI,MODEM_SSBI2_BYPASS"
)
if "&choice"=="MODEM_SSBI0_PRIORITIES"
(
  per.view hwioreg.per "MODEM,MODEM_SBI,MODEM_SSBI0_PRIORITIES"
)
if "&choice"=="MODEM_SSBI1_PRIORITIES"
(
  per.view hwioreg.per "MODEM,MODEM_SBI,MODEM_SSBI1_PRIORITIES"
)
if "&choice"=="MODEM_SSBI2_PRIORITIES"
(
  per.view hwioreg.per "MODEM,MODEM_SBI,MODEM_SSBI2_PRIORITIES"
)
if "&choice"=="MODEM_SSBI0_RD"
(
  per.view hwioreg.per "MODEM,MODEM_SBI,MODEM_SSBI0_RD"
)
if "&choice"=="MODEM_SSBI1_RD"
(
  per.view hwioreg.per "MODEM,MODEM_SBI,MODEM_SSBI1_RD"
)
if "&choice"=="MODEM_SSBI2_RD"
(
  per.view hwioreg.per "MODEM,MODEM_SBI,MODEM_SSBI2_RD"
)
if "&choice"=="MODEM_SSBI0_STATUS"
(
  per.view hwioreg.per "MODEM,MODEM_SBI,MODEM_SSBI0_STATUS"
)
if "&choice"=="MODEM_SSBI1_STATUS"
(
  per.view hwioreg.per "MODEM,MODEM_SBI,MODEM_SSBI1_STATUS"
)
if "&choice"=="MODEM_SSBI2_STATUS"
(
  per.view hwioreg.per "MODEM,MODEM_SBI,MODEM_SSBI2_STATUS"
)
if "&choice"=="MODEM_SBI_PIN_CFG"
(
  per.view hwioreg.per "MODEM,MODEM_SBI,MODEM_SBI_PIN_CFG"
)
if "&choice"=="MODEM_SBI_INOUT_CONFIG"
(
  per.view hwioreg.per "MODEM,MODEM_SBI,MODEM_SBI_INOUT_CONFIG"
)
if "&choice"=="MODEM_SBI_RXF_AGC_CONFIG"
(
  per.view hwioreg.per "MODEM,MODEM_SBI,MODEM_SBI_RXF_AGC_CONFIG"
)
if "&choice"=="MODEM_SBI_INTR_MASK"
(
  per.view hwioreg.per "MODEM,MODEM_SBI,MODEM_SBI_INTR_MASK"
)
if "&choice"=="MODEM_SBI_INTR_STATUS"
(
  per.view hwioreg.per "MODEM,MODEM_SBI,MODEM_SBI_INTR_STATUS"
)
if "&choice"=="MODEM_SBI_BUGFIX_DISABLE"
(
  per.view hwioreg.per "MODEM,MODEM_SBI,MODEM_SBI_BUGFIX_DISABLE"
)
if "&choice"=="MODEM_SBI_EXT_SSBI_CLK_FORCE_ON"
(
  per.view hwioreg.per "MODEM,MODEM_SBI,MODEM_SBI_EXT_SSBI_CLK_FORCE_ON"
)
if "&choice"=="MODEM_SBI_EXT_SSBI_CLK_DLY"
(
  per.view hwioreg.per "MODEM,MODEM_SBI,MODEM_SBI_EXT_SSBI_CLK_DLY"
)
if "&choice"=="MODEM_HW_REV_RD"
(
  per.view hwioreg.per "MODEM,MODEM_WEB,MODEM_HW_REV_RD"
)
if "&choice"=="MODEM_MISC_CFG0"
(
  per.view hwioreg.per "MODEM,MODEM_WEB,MODEM_MISC_CFG0"
)
if "&choice"=="MODEM_MISC_CFG1"
(
  per.view hwioreg.per "MODEM,MODEM_WEB,MODEM_MISC_CFG1"
)
if "&choice"=="MODEM_MISC_CFG2"
(
  per.view hwioreg.per "MODEM,MODEM_WEB,MODEM_MISC_CFG2"
)
if "&choice"=="MODEM_TX_DAC_SLEEP"
(
  per.view hwioreg.per "MODEM,MODEM_WEB,MODEM_TX_DAC_SLEEP"
)
if "&choice"=="MODEM_DBG_BUS_OUT_GATING"
(
  per.view hwioreg.per "MODEM,MODEM_WEB,MODEM_DBG_BUS_OUT_GATING"
)
if "&choice"=="MODEM_WEB_SPARE_READ_REG0"
(
  per.view hwioreg.per "MODEM,MODEM_WEB,MODEM_WEB_SPARE_READ_REG0"
)
if "&choice"=="MODEM_GENERIC_CTL_REG"
(
  per.view hwioreg.per "MODEM,MODEM_WEB,MODEM_GENERIC_CTL_REG"
)
if "&choice"=="MODEM_BRIDGE_TIMEOUT_CFG"
(
  per.view hwioreg.per "MODEM,MODEM_WEB,MODEM_BRIDGE_TIMEOUT_CFG"
)
if "&choice"=="MODEM_PA_ON_STATUS"
(
  per.view hwioreg.per "MODEM,MODEM_WEB,MODEM_PA_ON_STATUS"
)
if "&choice"=="MODEM_PA_ON_CTL"
(
  per.view hwioreg.per "MODEM,MODEM_WEB,MODEM_PA_ON_CTL"
)
if "&choice"=="MODEM_PA_ON_PROTECTION"
(
  per.view hwioreg.per "MODEM,MODEM_WEB,MODEM_PA_ON_PROTECTION"
)
if "&choice"=="MDM_SEC_DOMAIN_CFG"
(
  per.view hwioreg.per "MODEM,MODEM_WEB,MDM_SEC_DOMAIN_CFG"
)
if "&choice"=="MODEM_WEB_DBG_BUS_SEL"
(
  per.view hwioreg.per "MODEM,MODEM_WEB,MODEM_WEB_DBG_BUS_SEL"
)
if "&choice"=="MODEM_OUTPORT_OVERRIDE0"
(
  per.view hwioreg.per "MODEM,MODEM_WEB,MODEM_OUTPORT_OVERRIDE0"
)
if "&choice"=="MODEM_OUTPORT_OVERRIDE1"
(
  per.view hwioreg.per "MODEM,MODEM_WEB,MODEM_OUTPORT_OVERRIDE1"
)
if "&choice"=="MODEM_OUTPORT_OVERRIDE2"
(
  per.view hwioreg.per "MODEM,MODEM_WEB,MODEM_OUTPORT_OVERRIDE2"
)
if "&choice"=="MODEM_OUTPORT_OVERRIDE3"
(
  per.view hwioreg.per "MODEM,MODEM_WEB,MODEM_OUTPORT_OVERRIDE3"
)
if "&choice"=="MODEM_OUTPORT_OVERRIDE4"
(
  per.view hwioreg.per "MODEM,MODEM_WEB,MODEM_OUTPORT_OVERRIDE4"
)
if "&choice"=="MODEM_OUTPORT_OVERRIDE5"
(
  per.view hwioreg.per "MODEM,MODEM_WEB,MODEM_OUTPORT_OVERRIDE5"
)
if "&choice"=="MODEM_OUTPORT_OVERRIDE_EN"
(
  per.view hwioreg.per "MODEM,MODEM_WEB,MODEM_OUTPORT_OVERRIDE_EN"
)
if "&choice"=="MODEM_INPORT_RD_DATA0"
(
  per.view hwioreg.per "MODEM,MODEM_WEB,MODEM_INPORT_RD_DATA0"
)
if "&choice"=="MODEM_INPORT_RD_DATA1"
(
  per.view hwioreg.per "MODEM,MODEM_WEB,MODEM_INPORT_RD_DATA1"
)
if "&choice"=="MODEM_INPORT_RD_DATA2"
(
  per.view hwioreg.per "MODEM,MODEM_WEB,MODEM_INPORT_RD_DATA2"
)
if "&choice"=="AGC_CARRIER_FREQ_ERR"
(
  per.view hwioreg.per "MODEM,MODEM_WEB,AGC_CARRIER_FREQ_ERR"
)
if "&choice"=="AGC_FREQ_COMB_CTL"
(
  per.view hwioreg.per "MODEM,MODEM_WEB,AGC_FREQ_COMB_CTL"
)
if "&choice"=="CHIP_MODE"
(
  per.view hwioreg.per "PERIPH,PERIPH_HCLK,CHIP_MODE"
)
if "&choice"=="WEB_MISC_WR"
(
  per.view hwioreg.per "PERIPH,PERIPH_HCLK,WEB_MISC_WR"
)
if "&choice"=="EBI1_PAD_PULL_0"
(
  per.view hwioreg.per "PERIPH,PERIPH_HCLK,EBI1_PAD_PULL_0"
)
if "&choice"=="EBI1_PAD_PULL_1"
(
  per.view hwioreg.per "PERIPH,PERIPH_HCLK,EBI1_PAD_PULL_1"
)
if "&choice"=="EBI2_PAD_PULL_0"
(
  per.view hwioreg.per "PERIPH,PERIPH_HCLK,EBI2_PAD_PULL_0"
)
if "&choice"=="EBI2_PAD_PULL_1"
(
  per.view hwioreg.per "PERIPH,PERIPH_HCLK,EBI2_PAD_PULL_1"
)
if "&choice"=="D2D_PAD_PULL_0"
(
  per.view hwioreg.per "PERIPH,PERIPH_HCLK,D2D_PAD_PULL_0"
)
if "&choice"=="D2D_PAD_PULL_1"
(
  per.view hwioreg.per "PERIPH,PERIPH_HCLK,D2D_PAD_PULL_1"
)
if "&choice"=="D2D_PAD_HDRIVE_MSEL_0"
(
  per.view hwioreg.per "PERIPH,PERIPH_HCLK,D2D_PAD_HDRIVE_MSEL_0"
)
if "&choice"=="D2D_PAD_HDRIVE_MSEL_1"
(
  per.view hwioreg.per "PERIPH,PERIPH_HCLK,D2D_PAD_HDRIVE_MSEL_1"
)
if "&choice"=="PAD_HDRIVE_MSEL"
(
  per.view hwioreg.per "PERIPH,PERIPH_HCLK,PAD_HDRIVE_MSEL"
)
if "&choice"=="EBI1_PAD_HDRIVE_MSEL_0"
(
  per.view hwioreg.per "PERIPH,PERIPH_HCLK,EBI1_PAD_HDRIVE_MSEL_0"
)
if "&choice"=="EBI1_PAD_HDRIVE_MSEL_1"
(
  per.view hwioreg.per "PERIPH,PERIPH_HCLK,EBI1_PAD_HDRIVE_MSEL_1"
)
if "&choice"=="EBI2_PAD_HDRIVE_MSEL_0"
(
  per.view hwioreg.per "PERIPH,PERIPH_HCLK,EBI2_PAD_HDRIVE_MSEL_0"
)
if "&choice"=="GPIO_PAD_HDRIVE_MSEL_0"
(
  per.view hwioreg.per "PERIPH,PERIPH_HCLK,GPIO_PAD_HDRIVE_MSEL_0"
)
if "&choice"=="GPIO_PAD_HDRIVE_MSEL_1"
(
  per.view hwioreg.per "PERIPH,PERIPH_HCLK,GPIO_PAD_HDRIVE_MSEL_1"
)
if "&choice"=="GPIO_PAD_HDRIVE_MSEL_2"
(
  per.view hwioreg.per "PERIPH,PERIPH_HCLK,GPIO_PAD_HDRIVE_MSEL_2"
)
if "&choice"=="GPIO_PAD_HDRIVE_MSEL_3"
(
  per.view hwioreg.per "PERIPH,PERIPH_HCLK,GPIO_PAD_HDRIVE_MSEL_3"
)
if "&choice"=="GPIO_PAD_HDRIVE_MSEL_4"
(
  per.view hwioreg.per "PERIPH,PERIPH_HCLK,GPIO_PAD_HDRIVE_MSEL_4"
)
if "&choice"=="GPIO_PAD_HDRIVE_MSEL_5"
(
  per.view hwioreg.per "PERIPH,PERIPH_HCLK,GPIO_PAD_HDRIVE_MSEL_5"
)
if "&choice"=="GPIO_PAD_HDRIVE_MSEL_6"
(
  per.view hwioreg.per "PERIPH,PERIPH_HCLK,GPIO_PAD_HDRIVE_MSEL_6"
)
if "&choice"=="GPIO_PAD_HDRIVE_MSEL_7"
(
  per.view hwioreg.per "PERIPH,PERIPH_HCLK,GPIO_PAD_HDRIVE_MSEL_7"
)
if "&choice"=="PMIC_CONTROL"
(
  per.view hwioreg.per "PERIPH,PERIPH_HCLK,PMIC_CONTROL"
)
if "&choice"=="ANALOG_TEST_SEL"
(
  per.view hwioreg.per "PERIPH,PERIPH_HCLK,ANALOG_TEST_SEL"
)
if "&choice"=="ADIE_TEST_CONTROL"
(
  per.view hwioreg.per "PERIPH,PERIPH_HCLK,ADIE_TEST_CONTROL"
)
if "&choice"=="TXDAC_TEST_CONTROL"
(
  per.view hwioreg.per "PERIPH,PERIPH_HCLK,TXDAC_TEST_CONTROL"
)
if "&choice"=="HW_REVISION_NUMBER"
(
  per.view hwioreg.per "PERIPH,PERIPH_HCLK,HW_REVISION_NUMBER"
)
if "&choice"=="CHIP_FEATURE_ID"
(
  per.view hwioreg.per "PERIPH,PERIPH_HCLK,CHIP_FEATURE_ID"
)
if "&choice"=="USB_GPIO_TEST"
(
  per.view hwioreg.per "PERIPH,PERIPH_HCLK,USB_GPIO_TEST"
)
if "&choice"=="SSBI_GPIO_TEST"
(
  per.view hwioreg.per "PERIPH,PERIPH_HCLK,SSBI_GPIO_TEST"
)
if "&choice"=="USB_PIN_CONFIG"
(
  per.view hwioreg.per "PERIPH,PERIPH_HCLK,USB_PIN_CONFIG"
)
if "&choice"=="USB_PIN_SEL"
(
  per.view hwioreg.per "PERIPH,PERIPH_HCLK,USB_PIN_SEL"
)
if "&choice"=="TEST_BUS_EN"
(
  per.view hwioreg.per "PERIPH,PERIPH_HCLK,TEST_BUS_EN"
)
if "&choice"=="PMBLK_CONFIG"
(
  per.view hwioreg.per "PERIPH,PERIPH_HCLK,PMBLK_CONFIG"
)
if "&choice"=="PMBLK_CNT0"
(
  per.view hwioreg.per "PERIPH,PERIPH_HCLK,PMBLK_CNT0"
)
if "&choice"=="PMBLK_CNT1"
(
  per.view hwioreg.per "PERIPH,PERIPH_HCLK,PMBLK_CNT1"
)
if "&choice"=="PMBLK_CNT2"
(
  per.view hwioreg.per "PERIPH,PERIPH_HCLK,PMBLK_CNT2"
)
if "&choice"=="PMBLK_CNT3"
(
  per.view hwioreg.per "PERIPH,PERIPH_HCLK,PMBLK_CNT3"
)
if "&choice"=="PMBLK_CNT4"
(
  per.view hwioreg.per "PERIPH,PERIPH_HCLK,PMBLK_CNT4"
)
if "&choice"=="TIME_TICK_CTL"
(
  per.view hwioreg.per "PERIPH,PERIPH_XO4,TIME_TICK_CTL"
)
if "&choice"=="TIME_TICK_INT_MSB"
(
  per.view hwioreg.per "PERIPH,PERIPH_XO4,TIME_TICK_INT_MSB"
)
if "&choice"=="I2C_WRITE_DATA"
(
  per.view hwioreg.per "PERPH,PERPH_WEB_I2C,I2C_WRITE_DATA"
)
if "&choice"=="I2C_CLK_CTL"
(
  per.view hwioreg.per "PERPH,PERPH_WEB_I2C,I2C_CLK_CTL"
)
if "&choice"=="I2C_STATUS"
(
  per.view hwioreg.per "PERPH,PERPH_WEB_I2C,I2C_STATUS"
)
if "&choice"=="I2C_READ_DATA"
(
  per.view hwioreg.per "PERPH,PERPH_WEB_I2C,I2C_READ_DATA"
)
if "&choice"=="I2C_INTERFACE_SELECT"
(
  per.view hwioreg.per "PERPH,PERPH_WEB_I2C,I2C_INTERFACE_SELECT"
)
if "&choice"=="TCXO_PDM_CTL"
(
  per.view hwioreg.per "PERPH,PERPH_WEB_XO4,TCXO_PDM_CTL"
)
if "&choice"=="PDM0_CTL"
(
  per.view hwioreg.per "PERPH,PERPH_WEB_XO4,PDM0_CTL"
)
if "&choice"=="PDM1_CTL"
(
  per.view hwioreg.per "PERPH,PERPH_WEB_XO4,PDM1_CTL"
)
if "&choice"=="GP_MN_CLK_MDIV"
(
  per.view hwioreg.per "PERPH,PERPH_WEB_XO4,GP_MN_CLK_MDIV"
)
if "&choice"=="GP_MN_CLK_NDIV"
(
  per.view hwioreg.per "PERPH,PERPH_WEB_XO4,GP_MN_CLK_NDIV"
)
if "&choice"=="GP_MN_CLK_DUTY"
(
  per.view hwioreg.per "PERPH,PERPH_WEB_XO4,GP_MN_CLK_DUTY"
)
if "&choice"=="WEB_TCXO4_TEST"
(
  per.view hwioreg.per "PERPH,PERPH_WEB_XO4,WEB_TCXO4_TEST"
)
if "&choice"=="QLIC_MTI_CTL"
(
  per.view hwioreg.per "QLIC,QLIC_MTI_CTL"
)
if "&choice"=="QLIC_FERAM0_WORD0"
(
  per.view hwioreg.per "QLIC,QLIC_FERAM0_WORD0"
)
if "&choice"=="QLIC_FERAM0_WORD1"
(
  per.view hwioreg.per "QLIC,QLIC_FERAM0_WORD1"
)
if "&choice"=="QLIC_FERAM1_WORD0"
(
  per.view hwioreg.per "QLIC,QLIC_FERAM1_WORD0"
)
if "&choice"=="QLIC_FERAM1_WORD1"
(
  per.view hwioreg.per "QLIC,QLIC_FERAM1_WORD1"
)
if "&choice"=="QLIC_OMGRAM_WORD0"
(
  per.view hwioreg.per "QLIC,QLIC_OMGRAM_WORD0"
)
if "&choice"=="QLIC_OMGRAM_WORD1"
(
  per.view hwioreg.per "QLIC,QLIC_OMGRAM_WORD1"
)
if "&choice"=="QLIC_SECRAM_WORD0"
(
  per.view hwioreg.per "QLIC,QLIC_SECRAM_WORD0"
)
if "&choice"=="QLIC_SECRAM_WORD1"
(
  per.view hwioreg.per "QLIC,QLIC_SECRAM_WORD1"
)
if "&choice"=="QLIC_COMBRAM0_WORD0"
(
  per.view hwioreg.per "QLIC,QLIC_COMBRAM0_WORD0"
)
if "&choice"=="QLIC_COMBRAM0_WORD1"
(
  per.view hwioreg.per "QLIC,QLIC_COMBRAM0_WORD1"
)
if "&choice"=="QLIC_COMBRAM0_WORD2"
(
  per.view hwioreg.per "QLIC,QLIC_COMBRAM0_WORD2"
)
if "&choice"=="QLIC_COMBRAM1_WORD0"
(
  per.view hwioreg.per "QLIC,QLIC_COMBRAM1_WORD0"
)
if "&choice"=="QLIC_COMBRAM1_WORD1"
(
  per.view hwioreg.per "QLIC,QLIC_COMBRAM1_WORD1"
)
if "&choice"=="QLIC_COMBRAM1_WORD2"
(
  per.view hwioreg.per "QLIC,QLIC_COMBRAM1_WORD2"
)
if "&choice"=="QLIC_CGC_TASK_STATE_ARM"
(
  per.view hwioreg.per "QLIC,QLIC_CGC_TASK_STATE_ARM"
)
if "&choice"=="QLIC_TESTBUS_ARM"
(
  per.view hwioreg.per "QLIC,QLIC_TESTBUS_ARM"
)
if "&choice"=="QMEMBIST_CLK_ENA"
(
  per.view hwioreg.per "QMEMBIST,QMEMBIST_CLK_ENA"
)
if "&choice"=="QMEMBIST_IO_CFG"
(
  per.view hwioreg.per "QMEMBIST,QMEMBIST_IO_CFG"
)
if "&choice"=="QMEMBIST_RESET"
(
  per.view hwioreg.per "QMEMBIST,QMEMBIST_RESET"
)
if "&choice"=="QMEMBIST_FA_SEQUENCER_SEL"
(
  per.view hwioreg.per "QMEMBIST,QMEMBIST_FA_SEQUENCER_SEL"
)
if "&choice"=="QMEMBIST_EMBEDDED_ALG_CFG"
(
  per.view hwioreg.per "QMEMBIST,QMEMBIST_EMBEDDED_ALG_CFG"
)
if "&choice"=="QMEMBIST_USR_CMD_DESTINATION"
(
  per.view hwioreg.per "QMEMBIST,QMEMBIST_USR_CMD_DESTINATION"
)
if "&choice"=="QMEMBIST_USR_CMD_CFG"
(
  per.view hwioreg.per "QMEMBIST,QMEMBIST_USR_CMD_CFG"
)
if "&choice"=="QMEMBIST_TEST_TRIGGER"
(
  per.view hwioreg.per "QMEMBIST,QMEMBIST_TEST_TRIGGER"
)
if "&choice"=="QMEMBIST_TEST_STATUS"
(
  per.view hwioreg.per "QMEMBIST,QMEMBIST_TEST_STATUS"
)
if "&choice"=="QMEMBIST_TESTED0"
(
  per.view hwioreg.per "QMEMBIST,QMEMBIST_TESTED0"
)
if "&choice"=="QMEMBIST_TESTED1"
(
  per.view hwioreg.per "QMEMBIST,QMEMBIST_TESTED1"
)
if "&choice"=="QMEMBIST_TESTED2"
(
  per.view hwioreg.per "QMEMBIST,QMEMBIST_TESTED2"
)
if "&choice"=="QMEMBIST_TESTED3"
(
  per.view hwioreg.per "QMEMBIST,QMEMBIST_TESTED3"
)
if "&choice"=="QMEMBIST_FAILED0"
(
  per.view hwioreg.per "QMEMBIST,QMEMBIST_FAILED0"
)
if "&choice"=="QMEMBIST_FAILED1"
(
  per.view hwioreg.per "QMEMBIST,QMEMBIST_FAILED1"
)
if "&choice"=="QMEMBIST_FAILED2"
(
  per.view hwioreg.per "QMEMBIST,QMEMBIST_FAILED2"
)
if "&choice"=="QMEMBIST_FAILED3"
(
  per.view hwioreg.per "QMEMBIST,QMEMBIST_FAILED3"
)
if "&choice"=="QMEMBIST_RAM_FAIL_MAP"
(
  per.view hwioreg.per "QMEMBIST,QMEMBIST_RAM_FAIL_MAP"
)
if "&choice"=="QMEMBIST_CLKOFF0"
(
  per.view hwioreg.per "QMEMBIST,QMEMBIST_CLKOFF0"
)
if "&choice"=="RXA2D_GPR_A1"
(
  per.view hwioreg.per "RXADC_WRAPPER,RXA2D_GPR_A1"
)
if "&choice"=="RXA2D_DDO"
(
  per.view hwioreg.per "RXADC_WRAPPER,RXA2D_DDO"
)
if "&choice"=="RXA2D_EN"
(
  per.view hwioreg.per "RXADC_WRAPPER,RXA2D_EN"
)
if "&choice"=="RXA2D_CONF"
(
  per.view hwioreg.per "RXADC_WRAPPER,RXA2D_CONF"
)
if "&choice"=="RXA2D_CLK"
(
  per.view hwioreg.per "RXADC_WRAPPER,RXA2D_CLK"
)
if "&choice"=="RXA2D_CLK_HDRV"
(
  per.view hwioreg.per "RXADC_WRAPPER,RXA2D_CLK_HDRV"
)
if "&choice"=="RXA2D_CM1"
(
  per.view hwioreg.per "RXADC_WRAPPER,RXA2D_CM1"
)
if "&choice"=="RXA2D_BOOST"
(
  per.view hwioreg.per "RXADC_WRAPPER,RXA2D_BOOST"
)
if "&choice"=="RXA2D_I1"
(
  per.view hwioreg.per "RXADC_WRAPPER,RXA2D_I1"
)
if "&choice"=="RXA2D_I2"
(
  per.view hwioreg.per "RXADC_WRAPPER,RXA2D_I2"
)
if "&choice"=="RXA2D_I3"
(
  per.view hwioreg.per "RXADC_WRAPPER,RXA2D_I3"
)
if "&choice"=="RXA2D_TMUX"
(
  per.view hwioreg.per "RXADC_WRAPPER,RXA2D_TMUX"
)
if "&choice"=="RXA2D_CMP"
(
  per.view hwioreg.per "RXADC_WRAPPER,RXA2D_CMP"
)
if "&choice"=="RXA2D_AAF"
(
  per.view hwioreg.per "RXADC_WRAPPER,RXA2D_AAF"
)
if "&choice"=="RX_AGC0_RESET"
(
  per.view hwioreg.per "RXF,RXF_AGC,RX_AGC0_RESET"
)
if "&choice"=="RX_AGC1_RESET"
(
  per.view hwioreg.per "RXF,RXF_AGC,RX_AGC1_RESET"
)
if "&choice"=="RX_AGC0_MODE_SEL"
(
  per.view hwioreg.per "RXF,RXF_AGC,RX_AGC0_MODE_SEL"
)
if "&choice"=="RX_AGC1_MODE_SEL"
(
  per.view hwioreg.per "RXF,RXF_AGC,RX_AGC1_MODE_SEL"
)
if "&choice"=="RX_AGC0_LGLUT_LVAL"
(
  per.view hwioreg.per "RXF,RXF_AGC,RX_AGC0_LGLUT_LVAL"
)
if "&choice"=="RX_AGC1_LGLUT_LVAL"
(
  per.view hwioreg.per "RXF,RXF_AGC,RX_AGC1_LGLUT_LVAL"
)
if "&choice"=="RX_AGC0_LGLUT_HVAL"
(
  per.view hwioreg.per "RXF,RXF_AGC,RX_AGC0_LGLUT_HVAL"
)
if "&choice"=="RX_AGC1_LGLUT_HVAL"
(
  per.view hwioreg.per "RXF,RXF_AGC,RX_AGC1_LGLUT_HVAL"
)
if "&choice"=="RX_AGC0_GAIN_CTL"
(
  per.view hwioreg.per "RXF,RXF_AGC,RX_AGC0_GAIN_CTL"
)
if "&choice"=="RX_AGC1_GAIN_CTL"
(
  per.view hwioreg.per "RXF,RXF_AGC,RX_AGC1_GAIN_CTL"
)
if "&choice"=="RX_AGC0_LNA_CTL"
(
  per.view hwioreg.per "RXF,RXF_AGC,RX_AGC0_LNA_CTL"
)
if "&choice"=="RX_AGC1_LNA_CTL"
(
  per.view hwioreg.per "RXF,RXF_AGC,RX_AGC1_LNA_CTL"
)
if "&choice"=="RX_AGC0_LNA_DATA"
(
  per.view hwioreg.per "RXF,RXF_AGC,RX_AGC0_LNA_DATA"
)
if "&choice"=="RX_AGC1_LNA_DATA"
(
  per.view hwioreg.per "RXF,RXF_AGC,RX_AGC1_LNA_DATA"
)
if "&choice"=="RX_AGC0_VALUE_WR"
(
  per.view hwioreg.per "RXF,RXF_AGC,RX_AGC0_VALUE_WR"
)
if "&choice"=="RX_AGC1_VALUE_WR"
(
  per.view hwioreg.per "RXF,RXF_AGC,RX_AGC1_VALUE_WR"
)
if "&choice"=="RX_AGC0_LNA_FILT_WR"
(
  per.view hwioreg.per "RXF,RXF_AGC,RX_AGC0_LNA_FILT_WR"
)
if "&choice"=="RX_AGC1_LNA_FILT_WR"
(
  per.view hwioreg.per "RXF,RXF_AGC,RX_AGC1_LNA_FILT_WR"
)
if "&choice"=="RX_AGC0_DC_GAIN"
(
  per.view hwioreg.per "RXF,RXF_AGC,RX_AGC0_DC_GAIN"
)
if "&choice"=="RX_AGC1_DC_GAIN"
(
  per.view hwioreg.per "RXF,RXF_AGC,RX_AGC1_DC_GAIN"
)
if "&choice"=="RX_AGC0_VALUE_1_MIN"
(
  per.view hwioreg.per "RXF,RXF_AGC,RX_AGC0_VALUE_1_MIN"
)
if "&choice"=="RX_AGC0_VALUE_2_MIN"
(
  per.view hwioreg.per "RXF,RXF_AGC,RX_AGC0_VALUE_2_MIN"
)
if "&choice"=="RX_AGC0_VALUE_3_MIN"
(
  per.view hwioreg.per "RXF,RXF_AGC,RX_AGC0_VALUE_3_MIN"
)
if "&choice"=="RX_AGC0_VALUE_4_MIN"
(
  per.view hwioreg.per "RXF,RXF_AGC,RX_AGC0_VALUE_4_MIN"
)
if "&choice"=="RX_AGC1_VALUE_1_MIN"
(
  per.view hwioreg.per "RXF,RXF_AGC,RX_AGC1_VALUE_1_MIN"
)
if "&choice"=="RX_AGC1_VALUE_2_MIN"
(
  per.view hwioreg.per "RXF,RXF_AGC,RX_AGC1_VALUE_2_MIN"
)
if "&choice"=="RX_AGC1_VALUE_3_MIN"
(
  per.view hwioreg.per "RXF,RXF_AGC,RX_AGC1_VALUE_3_MIN"
)
if "&choice"=="RX_AGC1_VALUE_4_MIN"
(
  per.view hwioreg.per "RXF,RXF_AGC,RX_AGC1_VALUE_4_MIN"
)
if "&choice"=="RX_AGC0_VALUE_MAX"
(
  per.view hwioreg.per "RXF,RXF_AGC,RX_AGC0_VALUE_MAX"
)
if "&choice"=="RX_AGC1_VALUE_MAX"
(
  per.view hwioreg.per "RXF,RXF_AGC,RX_AGC1_VALUE_MAX"
)
if "&choice"=="RX_AGC0_IM_LEVEL1"
(
  per.view hwioreg.per "RXF,RXF_AGC,RX_AGC0_IM_LEVEL1"
)
if "&choice"=="RX_AGC0_IM_LEVEL2"
(
  per.view hwioreg.per "RXF,RXF_AGC,RX_AGC0_IM_LEVEL2"
)
if "&choice"=="RX_AGC0_IM_LEVEL3"
(
  per.view hwioreg.per "RXF,RXF_AGC,RX_AGC0_IM_LEVEL3"
)
if "&choice"=="RX_AGC0_IM_LEVEL4"
(
  per.view hwioreg.per "RXF,RXF_AGC,RX_AGC0_IM_LEVEL4"
)
if "&choice"=="RX_AGC1_IM_LEVEL1"
(
  per.view hwioreg.per "RXF,RXF_AGC,RX_AGC1_IM_LEVEL1"
)
if "&choice"=="RX_AGC1_IM_LEVEL2"
(
  per.view hwioreg.per "RXF,RXF_AGC,RX_AGC1_IM_LEVEL2"
)
if "&choice"=="RX_AGC1_IM_LEVEL3"
(
  per.view hwioreg.per "RXF,RXF_AGC,RX_AGC1_IM_LEVEL3"
)
if "&choice"=="RX_AGC1_IM_LEVEL4"
(
  per.view hwioreg.per "RXF,RXF_AGC,RX_AGC1_IM_LEVEL4"
)
if "&choice"=="RX_AGC0_LNA_1_FALL"
(
  per.view hwioreg.per "RXF,RXF_AGC,RX_AGC0_LNA_1_FALL"
)
if "&choice"=="RX_AGC0_LNA_2_FALL"
(
  per.view hwioreg.per "RXF,RXF_AGC,RX_AGC0_LNA_2_FALL"
)
if "&choice"=="RX_AGC0_LNA_3_FALL"
(
  per.view hwioreg.per "RXF,RXF_AGC,RX_AGC0_LNA_3_FALL"
)
if "&choice"=="RX_AGC0_LNA_4_FALL"
(
  per.view hwioreg.per "RXF,RXF_AGC,RX_AGC0_LNA_4_FALL"
)
if "&choice"=="RX_AGC1_LNA_1_FALL"
(
  per.view hwioreg.per "RXF,RXF_AGC,RX_AGC1_LNA_1_FALL"
)
if "&choice"=="RX_AGC1_LNA_2_FALL"
(
  per.view hwioreg.per "RXF,RXF_AGC,RX_AGC1_LNA_2_FALL"
)
if "&choice"=="RX_AGC1_LNA_3_FALL"
(
  per.view hwioreg.per "RXF,RXF_AGC,RX_AGC1_LNA_3_FALL"
)
if "&choice"=="RX_AGC1_LNA_4_FALL"
(
  per.view hwioreg.per "RXF,RXF_AGC,RX_AGC1_LNA_4_FALL"
)
if "&choice"=="RX_AGC0_LNA_1_RISE"
(
  per.view hwioreg.per "RXF,RXF_AGC,RX_AGC0_LNA_1_RISE"
)
if "&choice"=="RX_AGC0_LNA_2_RISE"
(
  per.view hwioreg.per "RXF,RXF_AGC,RX_AGC0_LNA_2_RISE"
)
if "&choice"=="RX_AGC0_LNA_3_RISE"
(
  per.view hwioreg.per "RXF,RXF_AGC,RX_AGC0_LNA_3_RISE"
)
if "&choice"=="RX_AGC0_LNA_4_RISE"
(
  per.view hwioreg.per "RXF,RXF_AGC,RX_AGC0_LNA_4_RISE"
)
if "&choice"=="RX_AGC1_LNA_1_RISE"
(
  per.view hwioreg.per "RXF,RXF_AGC,RX_AGC1_LNA_1_RISE"
)
if "&choice"=="RX_AGC1_LNA_2_RISE"
(
  per.view hwioreg.per "RXF,RXF_AGC,RX_AGC1_LNA_2_RISE"
)
if "&choice"=="RX_AGC1_LNA_3_RISE"
(
  per.view hwioreg.per "RXF,RXF_AGC,RX_AGC1_LNA_3_RISE"
)
if "&choice"=="RX_AGC1_LNA_4_RISE"
(
  per.view hwioreg.per "RXF,RXF_AGC,RX_AGC1_LNA_4_RISE"
)
if "&choice"=="RX_AGC0_LNA_1_OFFSET"
(
  per.view hwioreg.per "RXF,RXF_AGC,RX_AGC0_LNA_1_OFFSET"
)
if "&choice"=="RX_AGC0_LNA_2_OFFSET"
(
  per.view hwioreg.per "RXF,RXF_AGC,RX_AGC0_LNA_2_OFFSET"
)
if "&choice"=="RX_AGC0_LNA_3_OFFSET"
(
  per.view hwioreg.per "RXF,RXF_AGC,RX_AGC0_LNA_3_OFFSET"
)
if "&choice"=="RX_AGC0_LNA_4_OFFSET"
(
  per.view hwioreg.per "RXF,RXF_AGC,RX_AGC0_LNA_4_OFFSET"
)
if "&choice"=="RX_AGC1_LNA_1_OFFSET"
(
  per.view hwioreg.per "RXF,RXF_AGC,RX_AGC1_LNA_1_OFFSET"
)
if "&choice"=="RX_AGC1_LNA_2_OFFSET"
(
  per.view hwioreg.per "RXF,RXF_AGC,RX_AGC1_LNA_2_OFFSET"
)
if "&choice"=="RX_AGC1_LNA_3_OFFSET"
(
  per.view hwioreg.per "RXF,RXF_AGC,RX_AGC1_LNA_3_OFFSET"
)
if "&choice"=="RX_AGC1_LNA_4_OFFSET"
(
  per.view hwioreg.per "RXF,RXF_AGC,RX_AGC1_LNA_4_OFFSET"
)
if "&choice"=="RX_AGC0_LNA_BP_TIMER_0"
(
  per.view hwioreg.per "RXF,RXF_AGC,RX_AGC0_LNA_BP_TIMER_0"
)
if "&choice"=="RX_AGC0_LNA_BP_TIMER_1"
(
  per.view hwioreg.per "RXF,RXF_AGC,RX_AGC0_LNA_BP_TIMER_1"
)
if "&choice"=="RX_AGC0_LNA_BP_TIMER_2"
(
  per.view hwioreg.per "RXF,RXF_AGC,RX_AGC0_LNA_BP_TIMER_2"
)
if "&choice"=="RX_AGC0_LNA_BP_TIMER_3"
(
  per.view hwioreg.per "RXF,RXF_AGC,RX_AGC0_LNA_BP_TIMER_3"
)
if "&choice"=="RX_AGC1_LNA_BP_TIMER_0"
(
  per.view hwioreg.per "RXF,RXF_AGC,RX_AGC1_LNA_BP_TIMER_0"
)
if "&choice"=="RX_AGC1_LNA_BP_TIMER_1"
(
  per.view hwioreg.per "RXF,RXF_AGC,RX_AGC1_LNA_BP_TIMER_1"
)
if "&choice"=="RX_AGC1_LNA_BP_TIMER_2"
(
  per.view hwioreg.per "RXF,RXF_AGC,RX_AGC1_LNA_BP_TIMER_2"
)
if "&choice"=="RX_AGC1_LNA_BP_TIMER_3"
(
  per.view hwioreg.per "RXF,RXF_AGC,RX_AGC1_LNA_BP_TIMER_3"
)
if "&choice"=="RX_AGC0_LNA_NBP_TIMER_0"
(
  per.view hwioreg.per "RXF,RXF_AGC,RX_AGC0_LNA_NBP_TIMER_0"
)
if "&choice"=="RX_AGC0_LNA_NBP_TIMER_1"
(
  per.view hwioreg.per "RXF,RXF_AGC,RX_AGC0_LNA_NBP_TIMER_1"
)
if "&choice"=="RX_AGC0_LNA_NBP_TIMER_2"
(
  per.view hwioreg.per "RXF,RXF_AGC,RX_AGC0_LNA_NBP_TIMER_2"
)
if "&choice"=="RX_AGC0_LNA_NBP_TIMER_3"
(
  per.view hwioreg.per "RXF,RXF_AGC,RX_AGC0_LNA_NBP_TIMER_3"
)
if "&choice"=="RX_AGC1_LNA_NBP_TIMER_0"
(
  per.view hwioreg.per "RXF,RXF_AGC,RX_AGC1_LNA_NBP_TIMER_0"
)
if "&choice"=="RX_AGC1_LNA_NBP_TIMER_1"
(
  per.view hwioreg.per "RXF,RXF_AGC,RX_AGC1_LNA_NBP_TIMER_1"
)
if "&choice"=="RX_AGC1_LNA_NBP_TIMER_2"
(
  per.view hwioreg.per "RXF,RXF_AGC,RX_AGC1_LNA_NBP_TIMER_2"
)
if "&choice"=="RX_AGC1_LNA_NBP_TIMER_3"
(
  per.view hwioreg.per "RXF,RXF_AGC,RX_AGC1_LNA_NBP_TIMER_3"
)
if "&choice"=="RX_AGC0_LNA_RANGE_DELAY"
(
  per.view hwioreg.per "RXF,RXF_AGC,RX_AGC0_LNA_RANGE_DELAY"
)
if "&choice"=="RX_AGC1_LNA_RANGE_DELAY"
(
  per.view hwioreg.per "RXF,RXF_AGC,RX_AGC1_LNA_RANGE_DELAY"
)
if "&choice"=="RX_AGC0_SBI_CTL"
(
  per.view hwioreg.per "RXF,RXF_AGC,RX_AGC0_SBI_CTL"
)
if "&choice"=="RX_AGC1_SBI_CTL"
(
  per.view hwioreg.per "RXF,RXF_AGC,RX_AGC1_SBI_CTL"
)
if "&choice"=="RX_AGC0_SBI_ID"
(
  per.view hwioreg.per "RXF,RXF_AGC,RX_AGC0_SBI_ID"
)
if "&choice"=="RX_AGC1_SBI_ID"
(
  per.view hwioreg.per "RXF,RXF_AGC,RX_AGC1_SBI_ID"
)
if "&choice"=="RX_AGC0_SBI_ADDR"
(
  per.view hwioreg.per "RXF,RXF_AGC,RX_AGC0_SBI_ADDR"
)
if "&choice"=="RX_AGC1_SBI_ADDR"
(
  per.view hwioreg.per "RXF,RXF_AGC,RX_AGC1_SBI_ADDR"
)
if "&choice"=="RX_AGC0_SBI_DATA0"
(
  per.view hwioreg.per "RXF,RXF_AGC,RX_AGC0_SBI_DATA0"
)
if "&choice"=="RX_AGC1_SBI_DATA0"
(
  per.view hwioreg.per "RXF,RXF_AGC,RX_AGC1_SBI_DATA0"
)
if "&choice"=="RX_AGC0_SBI_DATA1"
(
  per.view hwioreg.per "RXF,RXF_AGC,RX_AGC0_SBI_DATA1"
)
if "&choice"=="RX_AGC1_SBI_DATA1"
(
  per.view hwioreg.per "RXF,RXF_AGC,RX_AGC1_SBI_DATA1"
)
if "&choice"=="RX_AGC0_VREF_DELAY_TIMER"
(
  per.view hwioreg.per "RXF,RXF_AGC,RX_AGC0_VREF_DELAY_TIMER"
)
if "&choice"=="RX_AGC1_VREF_DELAY_TIMER"
(
  per.view hwioreg.per "RXF,RXF_AGC,RX_AGC1_VREF_DELAY_TIMER"
)
if "&choice"=="RX_AGC0_VREF_VAL"
(
  per.view hwioreg.per "RXF,RXF_AGC,RX_AGC0_VREF_VAL"
)
if "&choice"=="RX_AGC1_VREF_VAL"
(
  per.view hwioreg.per "RXF,RXF_AGC,RX_AGC1_VREF_VAL"
)
if "&choice"=="RX_AGC0_TEST_CTL"
(
  per.view hwioreg.per "RXF,RXF_AGC,RX_AGC0_TEST_CTL"
)
if "&choice"=="RX_AGC1_TEST_CTL"
(
  per.view hwioreg.per "RXF,RXF_AGC,RX_AGC1_TEST_CTL"
)
if "&choice"=="RX_AGC0_1X_VALUE_RD"
(
  per.view hwioreg.per "RXF,RXF_AGC,RX_AGC0_1X_VALUE_RD"
)
if "&choice"=="RX_AGC1_1X_VALUE_RD"
(
  per.view hwioreg.per "RXF,RXF_AGC,RX_AGC1_1X_VALUE_RD"
)
if "&choice"=="RX_AGC0_HDR_VALUE_RD"
(
  per.view hwioreg.per "RXF,RXF_AGC,RX_AGC0_HDR_VALUE_RD"
)
if "&choice"=="RX_AGC1_HDR_VALUE_RD"
(
  per.view hwioreg.per "RXF,RXF_AGC,RX_AGC1_HDR_VALUE_RD"
)
if "&choice"=="RX_AGC0_1X_VGA_GAIN_RD"
(
  per.view hwioreg.per "RXF,RXF_AGC,RX_AGC0_1X_VGA_GAIN_RD"
)
if "&choice"=="RX_AGC1_1X_VGA_GAIN_RD"
(
  per.view hwioreg.per "RXF,RXF_AGC,RX_AGC1_1X_VGA_GAIN_RD"
)
if "&choice"=="RX_AGC0_HDR_VGA_GAIN_RD"
(
  per.view hwioreg.per "RXF,RXF_AGC,RX_AGC0_HDR_VGA_GAIN_RD"
)
if "&choice"=="RX_AGC1_HDR_VGA_GAIN_RD"
(
  per.view hwioreg.per "RXF,RXF_AGC,RX_AGC1_HDR_VGA_GAIN_RD"
)
if "&choice"=="RX_AGC0_LNA_FILT_RD"
(
  per.view hwioreg.per "RXF,RXF_AGC,RX_AGC0_LNA_FILT_RD"
)
if "&choice"=="RX_AGC1_LNA_FILT_RD"
(
  per.view hwioreg.per "RXF,RXF_AGC,RX_AGC1_LNA_FILT_RD"
)
if "&choice"=="RX_AGC0_LNA_RANGE_RD"
(
  per.view hwioreg.per "RXF,RXF_AGC,RX_AGC0_LNA_RANGE_RD"
)
if "&choice"=="RXF_SRC0_RESET"
(
  per.view hwioreg.per "RXF,RXF_SRC_RF,RXF_SRC0_RESET"
)
if "&choice"=="RXF_SRC1_RESET"
(
  per.view hwioreg.per "RXF,RXF_SRC_RF,RXF_SRC1_RESET"
)
if "&choice"=="RXF_SRC0_CTL"
(
  per.view hwioreg.per "RXF,RXF_SRC_RF,RXF_SRC0_CTL"
)
if "&choice"=="RXF_SRC1_CTL"
(
  per.view hwioreg.per "RXF,RXF_SRC_RF,RXF_SRC1_CTL"
)
if "&choice"=="RXF_SRC0_PHASE_DEL"
(
  per.view hwioreg.per "RXF,RXF_SRC_RF,RXF_SRC0_PHASE_DEL"
)
if "&choice"=="RXF_SRC1_PHASE_DEL"
(
  per.view hwioreg.per "RXF,RXF_SRC_RF,RXF_SRC1_PHASE_DEL"
)
if "&choice"=="RXF_SRC0_LNA_S0_PHASE_OFFSET"
(
  per.view hwioreg.per "RXF,RXF_SRC_RF,RXF_SRC0_LNA_S0_PHASE_OFFSET"
)
if "&choice"=="RXF_SRC1_LNA_S0_PHASE_OFFSET"
(
  per.view hwioreg.per "RXF,RXF_SRC_RF,RXF_SRC1_LNA_S0_PHASE_OFFSET"
)
if "&choice"=="RXF_SRC0_LNA_S1_PHASE_OFFSET"
(
  per.view hwioreg.per "RXF,RXF_SRC_RF,RXF_SRC0_LNA_S1_PHASE_OFFSET"
)
if "&choice"=="RXF_SRC1_LNA_S1_PHASE_OFFSET"
(
  per.view hwioreg.per "RXF,RXF_SRC_RF,RXF_SRC1_LNA_S1_PHASE_OFFSET"
)
if "&choice"=="RXF_SRC0_LNA_S2_PHASE_OFFSET"
(
  per.view hwioreg.per "RXF,RXF_SRC_RF,RXF_SRC0_LNA_S2_PHASE_OFFSET"
)
if "&choice"=="RXF_SRC1_LNA_S2_PHASE_OFFSET"
(
  per.view hwioreg.per "RXF,RXF_SRC_RF,RXF_SRC1_LNA_S2_PHASE_OFFSET"
)
if "&choice"=="RXF_SRC0_LNA_S3_PHASE_OFFSET"
(
  per.view hwioreg.per "RXF,RXF_SRC_RF,RXF_SRC0_LNA_S3_PHASE_OFFSET"
)
if "&choice"=="RXF_SRC1_LNA_S3_PHASE_OFFSET"
(
  per.view hwioreg.per "RXF,RXF_SRC_RF,RXF_SRC1_LNA_S3_PHASE_OFFSET"
)
if "&choice"=="RXF_SRC0_LNA_S4_PHASE_OFFSET"
(
  per.view hwioreg.per "RXF,RXF_SRC_RF,RXF_SRC0_LNA_S4_PHASE_OFFSET"
)
if "&choice"=="RXF_SRC1_LNA_S4_PHASE_OFFSET"
(
  per.view hwioreg.per "RXF,RXF_SRC_RF,RXF_SRC1_LNA_S4_PHASE_OFFSET"
)
if "&choice"=="RXF_SRC0_BBF_NOTCH0_PARAMS"
(
  per.view hwioreg.per "RXF,RXF_SRC_RF,RXF_SRC0_BBF_NOTCH0_PARAMS"
)
if "&choice"=="RXF_SRC1_BBF_NOTCH0_PARAMS"
(
  per.view hwioreg.per "RXF,RXF_SRC_RF,RXF_SRC1_BBF_NOTCH0_PARAMS"
)
if "&choice"=="RXF_SRC0_BBF_NOTCH1_PARAMS"
(
  per.view hwioreg.per "RXF,RXF_SRC_RF,RXF_SRC0_BBF_NOTCH1_PARAMS"
)
if "&choice"=="RXF_SRC1_BBF_NOTCH1_PARAMS"
(
  per.view hwioreg.per "RXF,RXF_SRC_RF,RXF_SRC1_BBF_NOTCH1_PARAMS"
)
if "&choice"=="RXF_SRC0_BBF_NOTCH2_PARAMS"
(
  per.view hwioreg.per "RXF,RXF_SRC_RF,RXF_SRC0_BBF_NOTCH2_PARAMS"
)
if "&choice"=="RXF_SRC1_BBF_NOTCH2_PARAMS"
(
  per.view hwioreg.per "RXF,RXF_SRC_RF,RXF_SRC1_BBF_NOTCH2_PARAMS"
)
if "&choice"=="RXF_SRC0_MIS_COMP_A_COEFF"
(
  per.view hwioreg.per "RXF,RXF_SRC_RF,RXF_SRC0_MIS_COMP_A_COEFF"
)
if "&choice"=="RXF_SRC1_MIS_COMP_A_COEFF"
(
  per.view hwioreg.per "RXF,RXF_SRC_RF,RXF_SRC1_MIS_COMP_A_COEFF"
)
if "&choice"=="RXF_SRC0_MIS_COMP_B_COEFF"
(
  per.view hwioreg.per "RXF,RXF_SRC_RF,RXF_SRC0_MIS_COMP_B_COEFF"
)
if "&choice"=="RXF_SRC1_MIS_COMP_B_COEFF"
(
  per.view hwioreg.per "RXF,RXF_SRC_RF,RXF_SRC1_MIS_COMP_B_COEFF"
)
if "&choice"=="RXF_SRC0_RESAMP_PHASE_MAP0"
(
  per.view hwioreg.per "RXF,RXF_SRC_RF,RXF_SRC0_RESAMP_PHASE_MAP0"
)
if "&choice"=="RXF_SRC1_RESAMP_PHASE_MAP0"
(
  per.view hwioreg.per "RXF,RXF_SRC_RF,RXF_SRC1_RESAMP_PHASE_MAP0"
)
if "&choice"=="RXF_SRC0_RESAMP_PHASE_MAP1"
(
  per.view hwioreg.per "RXF,RXF_SRC_RF,RXF_SRC0_RESAMP_PHASE_MAP1"
)
if "&choice"=="RXF_SRC1_RESAMP_PHASE_MAP1"
(
  per.view hwioreg.per "RXF,RXF_SRC_RF,RXF_SRC1_RESAMP_PHASE_MAP1"
)
if "&choice"=="RXF_SRC0_RESAMP_PHASE_MAP2"
(
  per.view hwioreg.per "RXF,RXF_SRC_RF,RXF_SRC0_RESAMP_PHASE_MAP2"
)
if "&choice"=="RXF_SRC1_RESAMP_PHASE_MAP2"
(
  per.view hwioreg.per "RXF,RXF_SRC_RF,RXF_SRC1_RESAMP_PHASE_MAP2"
)
if "&choice"=="RXF_SRC0_RESAMP_PHASE_MAP3"
(
  per.view hwioreg.per "RXF,RXF_SRC_RF,RXF_SRC0_RESAMP_PHASE_MAP3"
)
if "&choice"=="RXF_SRC1_RESAMP_PHASE_MAP3"
(
  per.view hwioreg.per "RXF,RXF_SRC_RF,RXF_SRC1_RESAMP_PHASE_MAP3"
)
if "&choice"=="RXF_SRC0_RESAMP_END_CNT"
(
  per.view hwioreg.per "RXF,RXF_SRC_RF,RXF_SRC0_RESAMP_END_CNT"
)
if "&choice"=="RXF_SRC1_RESAMP_END_CNT"
(
  per.view hwioreg.per "RXF,RXF_SRC_RF,RXF_SRC1_RESAMP_END_CNT"
)
if "&choice"=="RXF_SRC0_DVGA_PARAMS"
(
  per.view hwioreg.per "RXF,RXF_SRC_RF,RXF_SRC0_DVGA_PARAMS"
)
if "&choice"=="RXF_SRC1_DVGA_PARAMS"
(
  per.view hwioreg.per "RXF,RXF_SRC_RF,RXF_SRC1_DVGA_PARAMS"
)
if "&choice"=="RXF_SRC0_TEST_BUS_SEL"
(
  per.view hwioreg.per "RXF,RXF_SRC_RF,RXF_SRC0_TEST_BUS_SEL"
)
if "&choice"=="RXF_SRC1_TEST_BUS_SEL"
(
  per.view hwioreg.per "RXF,RXF_SRC_RF,RXF_SRC1_TEST_BUS_SEL"
)
if "&choice"=="RXF_SRC0_CXN_CLK_STATUS"
(
  per.view hwioreg.per "RXF,RXF_SRC_RF,RXF_SRC0_CXN_CLK_STATUS"
)
if "&choice"=="RXF_SRC0_BBF_COEF0"
(
  per.view hwioreg.per "RXF,RXF_SRC_RS,RXF_SRC0_BBF_COEF0"
)
if "&choice"=="RXF_SRC1_BBF_COEF0"
(
  per.view hwioreg.per "RXF,RXF_SRC_RS,RXF_SRC1_BBF_COEF0"
)
if "&choice"=="RXF_SRC0_BBF_COEF1"
(
  per.view hwioreg.per "RXF,RXF_SRC_RS,RXF_SRC0_BBF_COEF1"
)
if "&choice"=="RXF_SRC1_BBF_COEF1"
(
  per.view hwioreg.per "RXF,RXF_SRC_RS,RXF_SRC1_BBF_COEF1"
)
if "&choice"=="RXF_SRC0_BBF_COEF_NOTCH0"
(
  per.view hwioreg.per "RXF,RXF_SRC_RS,RXF_SRC0_BBF_COEF_NOTCH0"
)
if "&choice"=="RXF_SRC1_BBF_COEF_NOTCH0"
(
  per.view hwioreg.per "RXF,RXF_SRC_RS,RXF_SRC1_BBF_COEF_NOTCH0"
)
if "&choice"=="RXF_SRC0_BBF_COEF_NOTCH1"
(
  per.view hwioreg.per "RXF,RXF_SRC_RS,RXF_SRC0_BBF_COEF_NOTCH1"
)
if "&choice"=="RXF_SRC1_BBF_COEF_NOTCH1"
(
  per.view hwioreg.per "RXF,RXF_SRC_RS,RXF_SRC1_BBF_COEF_NOTCH1"
)
if "&choice"=="RXF_SRC0_BBF_COEF_NOTCH2"
(
  per.view hwioreg.per "RXF,RXF_SRC_RS,RXF_SRC0_BBF_COEF_NOTCH2"
)
if "&choice"=="RXF_SRC1_BBF_COEF_NOTCH2"
(
  per.view hwioreg.per "RXF,RXF_SRC_RS,RXF_SRC1_BBF_COEF_NOTCH2"
)
if "&choice"=="RXF_SRC0_OFFSET_CTL"
(
  per.view hwioreg.per "RXF,RXF_SRC_RS,RXF_SRC0_OFFSET_CTL"
)
if "&choice"=="RXF_SRC1_OFFSET_CTL"
(
  per.view hwioreg.per "RXF,RXF_SRC_RS,RXF_SRC1_OFFSET_CTL"
)
if "&choice"=="RXF_SRC0_DACC_CTL"
(
  per.view hwioreg.per "RXF,RXF_SRC_RS,RXF_SRC0_DACC_CTL"
)
if "&choice"=="RXF_SRC1_DACC_CTL"
(
  per.view hwioreg.per "RXF,RXF_SRC_RS,RXF_SRC1_DACC_CTL"
)
if "&choice"=="RXF_SRC0_FG_IOFFSET"
(
  per.view hwioreg.per "RXF,RXF_SRC_RS,RXF_SRC0_FG_IOFFSET"
)
if "&choice"=="RXF_SRC1_FG_IOFFSET"
(
  per.view hwioreg.per "RXF,RXF_SRC_RS,RXF_SRC1_FG_IOFFSET"
)
if "&choice"=="RXF_SRC0_FG_QOFFSET"
(
  per.view hwioreg.per "RXF,RXF_SRC_RS,RXF_SRC0_FG_QOFFSET"
)
if "&choice"=="RXF_SRC1_FG_QOFFSET"
(
  per.view hwioreg.per "RXF,RXF_SRC_RS,RXF_SRC1_FG_QOFFSET"
)
if "&choice"=="RXF_SRC0_DC_IOFFSET_ADJ"
(
  per.view hwioreg.per "RXF,RXF_SRC_RS,RXF_SRC0_DC_IOFFSET_ADJ"
)
if "&choice"=="RXF_SRC1_DC_IOFFSET_ADJ"
(
  per.view hwioreg.per "RXF,RXF_SRC_RS,RXF_SRC1_DC_IOFFSET_ADJ"
)
if "&choice"=="RXF_SRC0_DC_QOFFSET_ADJ"
(
  per.view hwioreg.per "RXF,RXF_SRC_RS,RXF_SRC0_DC_QOFFSET_ADJ"
)
if "&choice"=="RXF_SRC1_DC_QOFFSET_ADJ"
(
  per.view hwioreg.per "RXF,RXF_SRC_RS,RXF_SRC1_DC_QOFFSET_ADJ"
)
if "&choice"=="RXF_SRC0_DACC_ACQ_TIMER"
(
  per.view hwioreg.per "RXF,RXF_SRC_RS,RXF_SRC0_DACC_ACQ_TIMER"
)
if "&choice"=="RXF_SRC1_DACC_ACQ_TIMER"
(
  per.view hwioreg.per "RXF,RXF_SRC_RS,RXF_SRC1_DACC_ACQ_TIMER"
)
if "&choice"=="RXF_SRC0_DACC_TRC_TIMER"
(
  per.view hwioreg.per "RXF,RXF_SRC_RS,RXF_SRC0_DACC_TRC_TIMER"
)
if "&choice"=="RXF_SRC1_DACC_TRC_TIMER"
(
  per.view hwioreg.per "RXF,RXF_SRC_RS,RXF_SRC1_DACC_TRC_TIMER"
)
if "&choice"=="RXF_SRC0_DACC_CLR_TIMER"
(
  per.view hwioreg.per "RXF,RXF_SRC_RS,RXF_SRC0_DACC_CLR_TIMER"
)
if "&choice"=="RXF_SRC1_DACC_CLR_TIMER"
(
  per.view hwioreg.per "RXF,RXF_SRC_RS,RXF_SRC1_DACC_CLR_TIMER"
)
if "&choice"=="RXF_SRC0_DACC_EST_THRESH"
(
  per.view hwioreg.per "RXF,RXF_SRC_RS,RXF_SRC0_DACC_EST_THRESH"
)
if "&choice"=="RXF_SRC1_DACC_EST_THRESH"
(
  per.view hwioreg.per "RXF,RXF_SRC_RS,RXF_SRC1_DACC_EST_THRESH"
)
if "&choice"=="RXF_SRC0_DACC_EST_IOFFSET"
(
  per.view hwioreg.per "RXF,RXF_SRC_RS,RXF_SRC0_DACC_EST_IOFFSET"
)
if "&choice"=="RXF_SRC1_DACC_EST_IOFFSET"
(
  per.view hwioreg.per "RXF,RXF_SRC_RS,RXF_SRC1_DACC_EST_IOFFSET"
)
if "&choice"=="RXF_SRC0_DACC_EST_QOFFSET"
(
  per.view hwioreg.per "RXF,RXF_SRC_RS,RXF_SRC0_DACC_EST_QOFFSET"
)
if "&choice"=="RXF_SRC1_DACC_EST_QOFFSET"
(
  per.view hwioreg.per "RXF,RXF_SRC_RS,RXF_SRC1_DACC_EST_QOFFSET"
)
if "&choice"=="RXF_SRC0_DACC_IACCUM0"
(
  per.view hwioreg.per "RXF,RXF_SRC_RS,RXF_SRC0_DACC_IACCUM0"
)
if "&choice"=="RXF_SRC1_DACC_IACCUM0"
(
  per.view hwioreg.per "RXF,RXF_SRC_RS,RXF_SRC1_DACC_IACCUM0"
)
if "&choice"=="RXF_SRC0_DACC_IACCUM1"
(
  per.view hwioreg.per "RXF,RXF_SRC_RS,RXF_SRC0_DACC_IACCUM1"
)
if "&choice"=="RXF_SRC1_DACC_IACCUM1"
(
  per.view hwioreg.per "RXF,RXF_SRC_RS,RXF_SRC1_DACC_IACCUM1"
)
if "&choice"=="RXF_SRC0_DACC_IACCUM2"
(
  per.view hwioreg.per "RXF,RXF_SRC_RS,RXF_SRC0_DACC_IACCUM2"
)
if "&choice"=="RXF_SRC1_DACC_IACCUM2"
(
  per.view hwioreg.per "RXF,RXF_SRC_RS,RXF_SRC1_DACC_IACCUM2"
)
if "&choice"=="RXF_SRC0_DACC_IACCUM3"
(
  per.view hwioreg.per "RXF,RXF_SRC_RS,RXF_SRC0_DACC_IACCUM3"
)
if "&choice"=="RXF_SRC1_DACC_IACCUM3"
(
  per.view hwioreg.per "RXF,RXF_SRC_RS,RXF_SRC1_DACC_IACCUM3"
)
if "&choice"=="RXF_SRC0_DACC_IACCUM4"
(
  per.view hwioreg.per "RXF,RXF_SRC_RS,RXF_SRC0_DACC_IACCUM4"
)
if "&choice"=="RXF_SRC1_DACC_IACCUM4"
(
  per.view hwioreg.per "RXF,RXF_SRC_RS,RXF_SRC1_DACC_IACCUM4"
)
if "&choice"=="RXF_SRC0_DACC_QACCUM0"
(
  per.view hwioreg.per "RXF,RXF_SRC_RS,RXF_SRC0_DACC_QACCUM0"
)
if "&choice"=="RXF_SRC1_DACC_QACCUM0"
(
  per.view hwioreg.per "RXF,RXF_SRC_RS,RXF_SRC1_DACC_QACCUM0"
)
if "&choice"=="RXF_SRC0_DACC_QACCUM1"
(
  per.view hwioreg.per "RXF,RXF_SRC_RS,RXF_SRC0_DACC_QACCUM1"
)
if "&choice"=="RXF_SRC1_DACC_QACCUM1"
(
  per.view hwioreg.per "RXF,RXF_SRC_RS,RXF_SRC1_DACC_QACCUM1"
)
if "&choice"=="RXF_SRC0_DACC_QACCUM2"
(
  per.view hwioreg.per "RXF,RXF_SRC_RS,RXF_SRC0_DACC_QACCUM2"
)
if "&choice"=="RXF_SRC1_DACC_QACCUM2"
(
  per.view hwioreg.per "RXF,RXF_SRC_RS,RXF_SRC1_DACC_QACCUM2"
)
if "&choice"=="RXF_SRC0_DACC_QACCUM3"
(
  per.view hwioreg.per "RXF,RXF_SRC_RS,RXF_SRC0_DACC_QACCUM3"
)
if "&choice"=="RXF_SRC1_DACC_QACCUM3"
(
  per.view hwioreg.per "RXF,RXF_SRC_RS,RXF_SRC1_DACC_QACCUM3"
)
if "&choice"=="RXF_SRC0_DACC_QACCUM4"
(
  per.view hwioreg.per "RXF,RXF_SRC_RS,RXF_SRC0_DACC_QACCUM4"
)
if "&choice"=="RXF_SRC1_DACC_QACCUM4"
(
  per.view hwioreg.per "RXF,RXF_SRC_RS,RXF_SRC1_DACC_QACCUM4"
)
if "&choice"=="RXF_SRC0_MICRO_DACC_UPDATE"
(
  per.view hwioreg.per "RXF,RXF_SRC_RS,RXF_SRC0_MICRO_DACC_UPDATE"
)
if "&choice"=="RXF_SRC1_MICRO_DACC_UPDATE"
(
  per.view hwioreg.per "RXF,RXF_SRC_RS,RXF_SRC1_MICRO_DACC_UPDATE"
)
if "&choice"=="RXF_SRC0_DACC_SSBI_INFO"
(
  per.view hwioreg.per "RXF,RXF_SRC_RS,RXF_SRC0_DACC_SSBI_INFO"
)
if "&choice"=="RXF_SRC1_DACC_SSBI_INFO"
(
  per.view hwioreg.per "RXF,RXF_SRC_RS,RXF_SRC1_DACC_SSBI_INFO"
)
if "&choice"=="RXF_SRC0_DACC_GAIN_MULT"
(
  per.view hwioreg.per "RXF,RXF_SRC_RS,RXF_SRC0_DACC_GAIN_MULT"
)
if "&choice"=="RXF_SRC1_DACC_GAIN_MULT"
(
  per.view hwioreg.per "RXF,RXF_SRC_RS,RXF_SRC1_DACC_GAIN_MULT"
)
if "&choice"=="RXF_SRC0_NOTCH_CFG"
(
  per.view hwioreg.per "RXF,RXF_SRC_RS,RXF_SRC0_NOTCH_CFG"
)
if "&choice"=="RXF_SRC1_NOTCH_CFG"
(
  per.view hwioreg.per "RXF,RXF_SRC_RS,RXF_SRC1_NOTCH_CFG"
)
if "&choice"=="RXF_SRC0_MICRO_SYNC_CMD"
(
  per.view hwioreg.per "RXF,RXF_SRC_RS,RXF_SRC0_MICRO_SYNC_CMD"
)
if "&choice"=="RXF_SRC1_MICRO_SYNC_CMD"
(
  per.view hwioreg.per "RXF,RXF_SRC_RS,RXF_SRC1_MICRO_SYNC_CMD"
)
if "&choice"=="RXF_SRC0_ARM_IRQ_STATUS"
(
  per.view hwioreg.per "RXF,RXF_SRC_RS,RXF_SRC0_ARM_IRQ_STATUS"
)
if "&choice"=="MCI_POWER"
(
  per.view hwioreg.per "SDCC,MCI_POWER"
)
if "&choice"=="MCI_CLK"
(
  per.view hwioreg.per "SDCC,MCI_CLK"
)
if "&choice"=="MCI_ARGUMENT"
(
  per.view hwioreg.per "SDCC,MCI_ARGUMENT"
)
if "&choice"=="MCI_CMD"
(
  per.view hwioreg.per "SDCC,MCI_CMD"
)
if "&choice"=="MCI_RESP_CMD"
(
  per.view hwioreg.per "SDCC,MCI_RESP_CMD"
)
if "&choice"=="MCI_RESP0"
(
  per.view hwioreg.per "SDCC,MCI_RESP0"
)
if "&choice"=="MCI_RESP1"
(
  per.view hwioreg.per "SDCC,MCI_RESP1"
)
if "&choice"=="MCI_RESP2"
(
  per.view hwioreg.per "SDCC,MCI_RESP2"
)
if "&choice"=="MCI_RESP3"
(
  per.view hwioreg.per "SDCC,MCI_RESP3"
)
if "&choice"=="MCI_DATA_TIMER"
(
  per.view hwioreg.per "SDCC,MCI_DATA_TIMER"
)
if "&choice"=="MCI_DATA_LENGTH"
(
  per.view hwioreg.per "SDCC,MCI_DATA_LENGTH"
)
if "&choice"=="MCI_DATA_CTL"
(
  per.view hwioreg.per "SDCC,MCI_DATA_CTL"
)
if "&choice"=="MCI_DATA_COUNT"
(
  per.view hwioreg.per "SDCC,MCI_DATA_COUNT"
)
if "&choice"=="MCI_STATUS"
(
  per.view hwioreg.per "SDCC,MCI_STATUS"
)
if "&choice"=="MCI_CLEAR"
(
  per.view hwioreg.per "SDCC,MCI_CLEAR"
)
if "&choice"=="MCI_INT_MASK0"
(
  per.view hwioreg.per "SDCC,MCI_INT_MASK0"
)
if "&choice"=="MCI_INT_MASK1"
(
  per.view hwioreg.per "SDCC,MCI_INT_MASK1"
)
if "&choice"=="MCI_FIFO_COUNT"
(
  per.view hwioreg.per "SDCC,MCI_FIFO_COUNT"
)
if "&choice"=="MCI_FIFO"
(
  per.view hwioreg.per "SDCC,MCI_FIFO"
)
if "&choice"=="MCI_ABORT"
(
  per.view hwioreg.per "SDCC,MCI_ABORT"
)
if "&choice"=="MCI_START_ADDR"
(
  per.view hwioreg.per "SDCC,MCI_START_ADDR"
)
if "&choice"=="MCI_DMA_CONFIG"
(
  per.view hwioreg.per "SDCC,MCI_DMA_CONFIG"
)
if "&choice"=="MCI_TESTBUS_CONFIG"
(
  per.view hwioreg.per "SDCC,MCI_TESTBUS_CONFIG"
)
if "&choice"=="MCI_TEST_CTL"
(
  per.view hwioreg.per "SDCC,MCI_TEST_CTL"
)
if "&choice"=="MCI_TEST_INPUT"
(
  per.view hwioreg.per "SDCC,MCI_TEST_INPUT"
)
if "&choice"=="MCI_TEST_OUT"
(
  per.view hwioreg.per "SDCC,MCI_TEST_OUT"
)
if "&choice"=="MCI_PERPH_ID0"
(
  per.view hwioreg.per "SDCC,MCI_PERPH_ID0"
)
if "&choice"=="MCI_PERPH_ID1"
(
  per.view hwioreg.per "SDCC,MCI_PERPH_ID1"
)
if "&choice"=="MCI_PERPH_ID2"
(
  per.view hwioreg.per "SDCC,MCI_PERPH_ID2"
)
if "&choice"=="MCI_PERPH_ID3"
(
  per.view hwioreg.per "SDCC,MCI_PERPH_ID3"
)
if "&choice"=="MCI_PCELL_ID0"
(
  per.view hwioreg.per "SDCC,MCI_PCELL_ID0"
)
if "&choice"=="MCI_PCELL_ID1"
(
  per.view hwioreg.per "SDCC,MCI_PCELL_ID1"
)
if "&choice"=="MCI_PCELL_ID2"
(
  per.view hwioreg.per "SDCC,MCI_PCELL_ID2"
)
if "&choice"=="MCI_PCELL_ID3"
(
  per.view hwioreg.per "SDCC,MCI_PCELL_ID3"
)
if "&choice"=="SDRAM_OPT_CFG"
(
  per.view hwioreg.per "SDRAM_REGS,SDRAM_OPT_CFG"
)
if "&choice"=="SDRAM_RFRSH_CFG"
(
  per.view hwioreg.per "SDRAM_REGS,SDRAM_RFRSH_CFG"
)
if "&choice"=="SDRAM_DEV_PARAM_CFG1"
(
  per.view hwioreg.per "SDRAM_REGS,SDRAM_DEV_PARAM_CFG1"
)
if "&choice"=="SDRAM_DEV_PARAM_CFG2"
(
  per.view hwioreg.per "SDRAM_REGS,SDRAM_DEV_PARAM_CFG2"
)
if "&choice"=="SDRAM_DEV_PARAM_CFG3"
(
  per.view hwioreg.per "SDRAM_REGS,SDRAM_DEV_PARAM_CFG3"
)
if "&choice"=="SDRAM_CTRL_CFG"
(
  per.view hwioreg.per "SDRAM_REGS,SDRAM_CTRL_CFG"
)
if "&choice"=="SDRAM_DEV_INIT_CFG"
(
  per.view hwioreg.per "SDRAM_REGS,SDRAM_DEV_INIT_CFG"
)
if "&choice"=="SDRAM_COL_ROW_SIZE_CFG"
(
  per.view hwioreg.per "SDRAM_REGS,SDRAM_COL_ROW_SIZE_CFG"
)
if "&choice"=="SDRAM_HW_DEV_INIT_CFG"
(
  per.view hwioreg.per "SDRAM_REGS,SDRAM_HW_DEV_INIT_CFG"
)
if "&choice"=="SDRAM_CDCM_CFG"
(
  per.view hwioreg.per "SDRAM_REGS,SDRAM_CDCM_CFG"
)
if "&choice"=="SDRAM_CDCM_INTERNAL1"
(
  per.view hwioreg.per "SDRAM_REGS,SDRAM_CDCM_INTERNAL1"
)
if "&choice"=="SDRAM_CDC0_CFG"
(
  per.view hwioreg.per "SDRAM_REGS,SDRAM_CDC0_CFG"
)
if "&choice"=="SDRAM_CDC1_CFG"
(
  per.view hwioreg.per "SDRAM_REGS,SDRAM_CDC1_CFG"
)
if "&choice"=="SDRAM_CDCM_STATUS"
(
  per.view hwioreg.per "SDRAM_REGS,SDRAM_CDCM_STATUS"
)
if "&choice"=="SDRAM_CLOCK_VOLTAGE_SWITCH_CFG"
(
  per.view hwioreg.per "SDRAM_REGS,SDRAM_CLOCK_VOLTAGE_SWITCH_CFG"
)
if "&choice"=="SDRAM_CLK_PWR_DOWN_CFG"
(
  per.view hwioreg.per "SDRAM_REGS,SDRAM_CLK_PWR_DOWN_CFG"
)
if "&choice"=="SDRAM_PERF_MON_CFG"
(
  per.view hwioreg.per "SDRAM_REGS,SDRAM_PERF_MON_CFG"
)
if "&choice"=="SDRAM_PERF_CNTR0_CFG"
(
  per.view hwioreg.per "SDRAM_REGS,SDRAM_PERF_CNTR0_CFG"
)
if "&choice"=="SDRAM_PERF_CNTR1_CFG"
(
  per.view hwioreg.per "SDRAM_REGS,SDRAM_PERF_CNTR1_CFG"
)
if "&choice"=="SDRAM_PERF_CNTR2_CFG"
(
  per.view hwioreg.per "SDRAM_REGS,SDRAM_PERF_CNTR2_CFG"
)
if "&choice"=="SDRAM_PERF_CNTR0_OUT"
(
  per.view hwioreg.per "SDRAM_REGS,SDRAM_PERF_CNTR0_OUT"
)
if "&choice"=="SDRAM_PERF_CNTR1_OUT"
(
  per.view hwioreg.per "SDRAM_REGS,SDRAM_PERF_CNTR1_OUT"
)
if "&choice"=="SDRAM_PERF_CNTR2_OUT"
(
  per.view hwioreg.per "SDRAM_REGS,SDRAM_PERF_CNTR2_OUT"
)
if "&choice"=="SDRAM_PERF_CNTR_STATUS"
(
  per.view hwioreg.per "SDRAM_REGS,SDRAM_PERF_CNTR_STATUS"
)
if "&choice"=="SDRAM_TEST_BUS_CFG"
(
  per.view hwioreg.per "SDRAM_REGS,SDRAM_TEST_BUS_CFG"
)
if "&choice"=="SDRAM_MISR_CTRL"
(
  per.view hwioreg.per "SDRAM_REGS,SDRAM_MISR_CTRL"
)
if "&choice"=="SDRAM_MISR_OUT0"
(
  per.view hwioreg.per "SDRAM_REGS,SDRAM_MISR_OUT0"
)
if "&choice"=="SDRAM_MISR_OUT1"
(
  per.view hwioreg.per "SDRAM_REGS,SDRAM_MISR_OUT1"
)
if "&choice"=="SDRAM_FPGA_CONTROLLER_CFG1"
(
  per.view hwioreg.per "SDRAM_REGS,SDRAM_FPGA_CONTROLLER_CFG1"
)
if "&choice"=="SDRAM_FPGA_CONTROLLER_CFG2"
(
  per.view hwioreg.per "SDRAM_REGS,SDRAM_FPGA_CONTROLLER_CFG2"
)
if "&choice"=="SDRAM_FPGA_CONTROLLER_CFG3"
(
  per.view hwioreg.per "SDRAM_REGS,SDRAM_FPGA_CONTROLLER_CFG3"
)
if "&choice"=="SDRAM_FPGA_CONTROLLER_CFG4"
(
  per.view hwioreg.per "SDRAM_REGS,SDRAM_FPGA_CONTROLLER_CFG4"
)
if "&choice"=="SDRAM_FPGA_CONTROLLER_CFG5"
(
  per.view hwioreg.per "SDRAM_REGS,SDRAM_FPGA_CONTROLLER_CFG5"
)
if "&choice"=="SLEEP0_RTC_ARM"
(
  per.view hwioreg.per "SLEEP_CTL,SLEEP0_RTC_ARM"
)
if "&choice"=="SLEEP1_RTC_ARM"
(
  per.view hwioreg.per "SLEEP_CTL,SLEEP1_RTC_ARM"
)
if "&choice"=="SLEEP2_RTC_ARM"
(
  per.view hwioreg.per "SLEEP_CTL,SLEEP2_RTC_ARM"
)
if "&choice"=="SLEEP0_MICRO_START"
(
  per.view hwioreg.per "SLEEP_CTL,SLEEP0_MICRO_START"
)
if "&choice"=="SLEEP1_MICRO_START"
(
  per.view hwioreg.per "SLEEP_CTL,SLEEP1_MICRO_START"
)
if "&choice"=="SLEEP2_MICRO_START"
(
  per.view hwioreg.per "SLEEP_CTL,SLEEP2_MICRO_START"
)
if "&choice"=="SLEEP0_FINE_TIME"
(
  per.view hwioreg.per "SLEEP_CTL,SLEEP0_FINE_TIME"
)
if "&choice"=="SLEEP1_FINE_TIME"
(
  per.view hwioreg.per "SLEEP_CTL,SLEEP1_FINE_TIME"
)
if "&choice"=="SLEEP2_FINE_TIME"
(
  per.view hwioreg.per "SLEEP_CTL,SLEEP2_FINE_TIME"
)
if "&choice"=="SLEEP0_COARSE_TIME"
(
  per.view hwioreg.per "SLEEP_CTL,SLEEP0_COARSE_TIME"
)
if "&choice"=="SLEEP1_COARSE_TIME"
(
  per.view hwioreg.per "SLEEP_CTL,SLEEP1_COARSE_TIME"
)
if "&choice"=="SLEEP2_COARSE_TIME"
(
  per.view hwioreg.per "SLEEP_CTL,SLEEP2_COARSE_TIME"
)
if "&choice"=="SLEEP0_COARSE_TIME_LATCH"
(
  per.view hwioreg.per "SLEEP_CTL,SLEEP0_COARSE_TIME_LATCH"
)
if "&choice"=="SLEEP1_COARSE_TIME_LATCH"
(
  per.view hwioreg.per "SLEEP_CTL,SLEEP1_COARSE_TIME_LATCH"
)
if "&choice"=="SLEEP2_COARSE_TIME_LATCH"
(
  per.view hwioreg.per "SLEEP_CTL,SLEEP2_COARSE_TIME_LATCH"
)
if "&choice"=="SLEEP0_WAKEUP_TIME"
(
  per.view hwioreg.per "SLEEP_CTL,SLEEP0_WAKEUP_TIME"
)
if "&choice"=="SLEEP1_WAKEUP_TIME"
(
  per.view hwioreg.per "SLEEP_CTL,SLEEP1_WAKEUP_TIME"
)
if "&choice"=="SLEEP2_WAKEUP_TIME"
(
  per.view hwioreg.per "SLEEP_CTL,SLEEP2_WAKEUP_TIME"
)
if "&choice"=="SLEEP0_WAKEUP_TIME_LATCH"
(
  per.view hwioreg.per "SLEEP_CTL,SLEEP0_WAKEUP_TIME_LATCH"
)
if "&choice"=="SLEEP1_WAKEUP_TIME_LATCH"
(
  per.view hwioreg.per "SLEEP_CTL,SLEEP1_WAKEUP_TIME_LATCH"
)
if "&choice"=="SLEEP2_WAKEUP_TIME_LATCH"
(
  per.view hwioreg.per "SLEEP_CTL,SLEEP2_WAKEUP_TIME_LATCH"
)
if "&choice"=="SLEEP0_FINE_COUNT_VAL"
(
  per.view hwioreg.per "SLEEP_CTL,SLEEP0_FINE_COUNT_VAL"
)
if "&choice"=="SLEEP1_FINE_COUNT_VAL"
(
  per.view hwioreg.per "SLEEP_CTL,SLEEP1_FINE_COUNT_VAL"
)
if "&choice"=="SLEEP2_FINE_COUNT_VAL"
(
  per.view hwioreg.per "SLEEP_CTL,SLEEP2_FINE_COUNT_VAL"
)
if "&choice"=="SLEEP0_COARSE_COUNT_VAL"
(
  per.view hwioreg.per "SLEEP_CTL,SLEEP0_COARSE_COUNT_VAL"
)
if "&choice"=="SLEEP1_COARSE_COUNT_VAL"
(
  per.view hwioreg.per "SLEEP_CTL,SLEEP1_COARSE_COUNT_VAL"
)
if "&choice"=="SLEEP2_COARSE_COUNT_VAL"
(
  per.view hwioreg.per "SLEEP_CTL,SLEEP2_COARSE_COUNT_VAL"
)
if "&choice"=="SLEEP0_STATUS"
(
  per.view hwioreg.per "SLEEP_CTL,SLEEP0_STATUS"
)
if "&choice"=="SLEEP1_STATUS"
(
  per.view hwioreg.per "SLEEP_CTL,SLEEP1_STATUS"
)
if "&choice"=="SLEEP2_STATUS"
(
  per.view hwioreg.per "SLEEP_CTL,SLEEP2_STATUS"
)
if "&choice"=="SLEEP0_MODEM_STATUS_ENABLE"
(
  per.view hwioreg.per "SLEEP_CTL,SLEEP0_MODEM_STATUS_ENABLE"
)
if "&choice"=="SLEEP1_MODEM_STATUS_ENABLE"
(
  per.view hwioreg.per "SLEEP_CTL,SLEEP1_MODEM_STATUS_ENABLE"
)
if "&choice"=="SLEEP2_MODEM_STATUS_ENABLE"
(
  per.view hwioreg.per "SLEEP_CTL,SLEEP2_MODEM_STATUS_ENABLE"
)
if "&choice"=="SLEEP0_INT_EN"
(
  per.view hwioreg.per "SLEEP_CTL,SLEEP0_INT_EN"
)
if "&choice"=="SLEEP1_INT_EN"
(
  per.view hwioreg.per "SLEEP_CTL,SLEEP1_INT_EN"
)
if "&choice"=="SLEEP2_INT_EN"
(
  per.view hwioreg.per "SLEEP_CTL,SLEEP2_INT_EN"
)
if "&choice"=="FEE_SLEEP_XTAL_COUNT"
(
  per.view hwioreg.per "SLEEP_CTL,FEE_SLEEP_XTAL_COUNT"
)
if "&choice"=="FEE_SLEEP_XTAL_FREQ_ERR"
(
  per.view hwioreg.per "SLEEP_CTL,FEE_SLEEP_XTAL_FREQ_ERR"
)
if "&choice"=="SSBI_WRAPPER_SSBI_CTL"
(
  per.view hwioreg.per "SSBI,SSBI_WRAPPER_SSBI_CTL"
)
if "&choice"=="SSBI_WRAPPER_SSBI_RESET"
(
  per.view hwioreg.per "SSBI,SSBI_WRAPPER_SSBI_RESET"
)
if "&choice"=="SSBI_WRAPPER_SSBI_CMD"
(
  per.view hwioreg.per "SSBI,SSBI_WRAPPER_SSBI_CMD"
)
if "&choice"=="SSBI_WRAPPER_SSBI_BYPASS"
(
  per.view hwioreg.per "SSBI,SSBI_WRAPPER_SSBI_BYPASS"
)
if "&choice"=="SSBI_WRAPPER_SSBI_RD"
(
  per.view hwioreg.per "SSBI,SSBI_WRAPPER_SSBI_RD"
)
if "&choice"=="SSBI_WRAPPER_SSBI_STATUS"
(
  per.view hwioreg.per "SSBI,SSBI_WRAPPER_SSBI_STATUS"
)
if "&choice"=="SSBI_WRAPPER_SSBI_PRIORITIES"
(
  per.view hwioreg.per "SSBI,SSBI_WRAPPER_SSBI_PRIORITIES"
)
if "&choice"=="SSBI_WRAPPER_SSBI_INTR_MASK"
(
  per.view hwioreg.per "SSBI,SSBI_WRAPPER_SSBI_INTR_MASK"
)
if "&choice"=="SSBI_WRAPPER_SSBI_INTR_CLEAR"
(
  per.view hwioreg.per "SSBI,SSBI_WRAPPER_SSBI_INTR_CLEAR"
)
if "&choice"=="SSBI_WRAPPER_SSBI_INTR_STATUS"
(
  per.view hwioreg.per "SSBI,SSBI_WRAPPER_SSBI_INTR_STATUS"
)
if "&choice"=="VD_RESET"
(
  per.view hwioreg.per "SVD,VD_RESET"
)
if "&choice"=="VD_MODE"
(
  per.view hwioreg.per "SVD,VD_MODE"
)
if "&choice"=="VD_POLY2IJ"
(
  per.view hwioreg.per "SVD,VD_POLY2IJ"
)
if "&choice"=="VD_POLY3IJ"
(
  per.view hwioreg.per "SVD,VD_POLY3IJ"
)
if "&choice"=="VD_POLY3K"
(
  per.view hwioreg.per "SVD,VD_POLY3K"
)
if "&choice"=="VD_POLY4IJ"
(
  per.view hwioreg.per "SVD,VD_POLY4IJ"
)
if "&choice"=="VD_POLY4KL"
(
  per.view hwioreg.per "SVD,VD_POLY4KL"
)
if "&choice"=="VD_TESTCON"
(
  per.view hwioreg.per "SVD,VD_TESTCON"
)
if "&choice"=="VD_TESTOUT"
(
  per.view hwioreg.per "SVD,VD_TESTOUT"
)
if "&choice"=="VD_TEST_MEM_SEL"
(
  per.view hwioreg.per "SVD,VD_TEST_MEM_SEL"
)
if "&choice"=="VD_TEST_MEM_ADDR"
(
  per.view hwioreg.per "SVD,VD_TEST_MEM_ADDR"
)
if "&choice"=="VD_TEST_MEM_WRITE"
(
  per.view hwioreg.per "SVD,VD_TEST_MEM_WRITE"
)
if "&choice"=="VD_TEST_MEM_READ0"
(
  per.view hwioreg.per "SVD,VD_TEST_MEM_READ0"
)
if "&choice"=="VD_TEST_MEM_READ1"
(
  per.view hwioreg.per "SVD,VD_TEST_MEM_READ1"
)
if "&choice"=="VD_TEST_MEM_DIN"
(
  per.view hwioreg.per "SVD,VD_TEST_MEM_DIN"
)
if "&choice"=="VD_HW_CLK_CTL"
(
  per.view hwioreg.per "SVD,VD_HW_CLK_CTL"
)
if "&choice"=="VD_MICRO_CLK_CTL"
(
  per.view hwioreg.per "SVD,VD_MICRO_CLK_CTL"
)
if "&choice"=="VD_CLK_STATUS"
(
  per.view hwioreg.per "SVD,VD_CLK_STATUS"
)
if "&choice"=="VD_SPARE_READ_REG0"
(
  per.view hwioreg.per "SVD,VD_SPARE_READ_REG0"
)
if "&choice"=="SYS_MPU_ENABLE"
(
  per.view hwioreg.per "SYS_MPU,SYS_MPU_ENABLE"
)
if "&choice"=="SYS_MPU_ERR_STATS"
(
  per.view hwioreg.per "SYS_MPU,SYS_MPU_ERR_STATS"
)
if "&choice"=="SYS_MPU_DEF_PART_PERM0"
(
  per.view hwioreg.per "SYS_MPU,SYS_MPU_DEF_PART_PERM0"
)
if "&choice"=="SYS_MPU_PART_START_ADDR0"
(
  per.view hwioreg.per "SYS_MPU,SYS_MPU_PART_START_ADDR0"
)
if "&choice"=="SYS_MPU_PART_START_ADDR1"
(
  per.view hwioreg.per "SYS_MPU,SYS_MPU_PART_START_ADDR1"
)
if "&choice"=="SYS_MPU_PART_START_ADDR2"
(
  per.view hwioreg.per "SYS_MPU,SYS_MPU_PART_START_ADDR2"
)
if "&choice"=="SYS_MPU_PART_START_ADDR3"
(
  per.view hwioreg.per "SYS_MPU,SYS_MPU_PART_START_ADDR3"
)
if "&choice"=="SYS_MPU_PART_END_ADDR0"
(
  per.view hwioreg.per "SYS_MPU,SYS_MPU_PART_END_ADDR0"
)
if "&choice"=="SYS_MPU_PART_END_ADDR1"
(
  per.view hwioreg.per "SYS_MPU,SYS_MPU_PART_END_ADDR1"
)
if "&choice"=="SYS_MPU_PART_END_ADDR2"
(
  per.view hwioreg.per "SYS_MPU,SYS_MPU_PART_END_ADDR2"
)
if "&choice"=="SYS_MPU_PART_END_ADDR3"
(
  per.view hwioreg.per "SYS_MPU,SYS_MPU_PART_END_ADDR3"
)
if "&choice"=="SYS_MPU_PART_PERM00"
(
  per.view hwioreg.per "SYS_MPU,SYS_MPU_PART_PERM00"
)
if "&choice"=="TD_ENERGY_METRIC"
(
  per.view hwioreg.per "TD,TD_ENERGY_METRIC"
)
if "&choice"=="TD_STATUS"
(
  per.view hwioreg.per "TD,TD_STATUS"
)
if "&choice"=="TD_TEST_MEM_SEL"
(
  per.view hwioreg.per "TD,TD_TEST_MEM_SEL"
)
if "&choice"=="TD_TEST_MEM_ADDR"
(
  per.view hwioreg.per "TD,TD_TEST_MEM_ADDR"
)
if "&choice"=="TD_TEST_MEM_WRITE"
(
  per.view hwioreg.per "TD,TD_TEST_MEM_WRITE"
)
if "&choice"=="TD_TEST_MEM_READ0"
(
  per.view hwioreg.per "TD,TD_TEST_MEM_READ0"
)
if "&choice"=="TD_TEST_MEM_READ1"
(
  per.view hwioreg.per "TD,TD_TEST_MEM_READ1"
)
if "&choice"=="TD_TEST_MEM_READ2"
(
  per.view hwioreg.per "TD,TD_TEST_MEM_READ2"
)
if "&choice"=="TD_TEST_MEM_DIN"
(
  per.view hwioreg.per "TD,TD_TEST_MEM_DIN"
)
if "&choice"=="HDR_DDI_CTL"
(
  per.view hwioreg.per "TD,HDR_DDI_CTL"
)
if "&choice"=="HDR_DDI_HOST"
(
  per.view hwioreg.per "TD,HDR_DDI_HOST"
)
if "&choice"=="TD_HW_CLK_CTL"
(
  per.view hwioreg.per "TD,TD_HW_CLK_CTL"
)
if "&choice"=="TD_MICRO_CLK_CTL"
(
  per.view hwioreg.per "TD,TD_MICRO_CLK_CTL"
)
if "&choice"=="TD_CLK_STATUS"
(
  per.view hwioreg.per "TD,TD_CLK_STATUS"
)
if "&choice"=="TD_MISC_CTL"
(
  per.view hwioreg.per "TD,TD_MISC_CTL"
)
if "&choice"=="TD_ONE_FIFTH_TAIL_PATTERN"
(
  per.view hwioreg.per "TD,TD_ONE_FIFTH_TAIL_PATTERN"
)
if "&choice"=="TD_TAIL_CFG"
(
  per.view hwioreg.per "TD,TD_TAIL_CFG"
)
if "&choice"=="TD_MODE_CTL"
(
  per.view hwioreg.per "TD,TD_MODE_CTL"
)
if "&choice"=="UART_DM_MR1"
(
  per.view hwioreg.per "TOP_UART,UART_DM_MR1"
)
if "&choice"=="UART_DM_MR2"
(
  per.view hwioreg.per "TOP_UART,UART_DM_MR2"
)
if "&choice"=="UART_DM_CSR"
(
  per.view hwioreg.per "TOP_UART,UART_DM_CSR"
)
if "&choice"=="UART_DM_TF"
(
  per.view hwioreg.per "TOP_UART,UART_DM_TF"
)
if "&choice"=="UART_DM_TF_2"
(
  per.view hwioreg.per "TOP_UART,UART_DM_TF_2"
)
if "&choice"=="UART_DM_TF_3"
(
  per.view hwioreg.per "TOP_UART,UART_DM_TF_3"
)
if "&choice"=="UART_DM_TF_4"
(
  per.view hwioreg.per "TOP_UART,UART_DM_TF_4"
)
if "&choice"=="UART_DM_CR"
(
  per.view hwioreg.per "TOP_UART,UART_DM_CR"
)
if "&choice"=="UART_DM_IMR"
(
  per.view hwioreg.per "TOP_UART,UART_DM_IMR"
)
if "&choice"=="UART_DM_IPR"
(
  per.view hwioreg.per "TOP_UART,UART_DM_IPR"
)
if "&choice"=="UART_DM_TFWR"
(
  per.view hwioreg.per "TOP_UART,UART_DM_TFWR"
)
if "&choice"=="UART_DM_RFWR"
(
  per.view hwioreg.per "TOP_UART,UART_DM_RFWR"
)
if "&choice"=="UART_DM_HCR"
(
  per.view hwioreg.per "TOP_UART,UART_DM_HCR"
)
if "&choice"=="UART_DM_DMRX"
(
  per.view hwioreg.per "TOP_UART,UART_DM_DMRX"
)
if "&choice"=="UART_DM_IRDA"
(
  per.view hwioreg.per "TOP_UART,UART_DM_IRDA"
)
if "&choice"=="UART_DM_DMEN"
(
  per.view hwioreg.per "TOP_UART,UART_DM_DMEN"
)
if "&choice"=="UART_DM_NO_CHARS_FOR_TX"
(
  per.view hwioreg.per "TOP_UART,UART_DM_NO_CHARS_FOR_TX"
)
if "&choice"=="UART_DM_BADR"
(
  per.view hwioreg.per "TOP_UART,UART_DM_BADR"
)
if "&choice"=="UART_DM_TESTSL"
(
  per.view hwioreg.per "TOP_UART,UART_DM_TESTSL"
)
if "&choice"=="UART_DM_MISR_MODE"
(
  per.view hwioreg.per "TOP_UART,UART_DM_MISR_MODE"
)
if "&choice"=="UART_DM_MISR_RESET"
(
  per.view hwioreg.per "TOP_UART,UART_DM_MISR_RESET"
)
if "&choice"=="UART_DM_MISR_EXPORT"
(
  per.view hwioreg.per "TOP_UART,UART_DM_MISR_EXPORT"
)
if "&choice"=="UART_DM_MISR_VAL"
(
  per.view hwioreg.per "TOP_UART,UART_DM_MISR_VAL"
)
if "&choice"=="UART_DM_SIM_CFG"
(
  per.view hwioreg.per "TOP_UART,UART_DM_SIM_CFG"
)
if "&choice"=="UART_DM_TEST_WR_ADDR"
(
  per.view hwioreg.per "TOP_UART,UART_DM_TEST_WR_ADDR"
)
if "&choice"=="UART_DM_TEST_WR_DATA"
(
  per.view hwioreg.per "TOP_UART,UART_DM_TEST_WR_DATA"
)
if "&choice"=="UART_DM_TEST_RD_ADDR"
(
  per.view hwioreg.per "TOP_UART,UART_DM_TEST_RD_ADDR"
)
if "&choice"=="UART_DM_SR"
(
  per.view hwioreg.per "TOP_UART,UART_DM_SR"
)
if "&choice"=="UART_DM_RF"
(
  per.view hwioreg.per "TOP_UART,UART_DM_RF"
)
if "&choice"=="UART_DM_RF_2"
(
  per.view hwioreg.per "TOP_UART,UART_DM_RF_2"
)
if "&choice"=="UART_DM_RF_3"
(
  per.view hwioreg.per "TOP_UART,UART_DM_RF_3"
)
if "&choice"=="UART_DM_RF_4"
(
  per.view hwioreg.per "TOP_UART,UART_DM_RF_4"
)
if "&choice"=="UART_DM_MISR"
(
  per.view hwioreg.per "TOP_UART,UART_DM_MISR"
)
if "&choice"=="UART_DM_ISR"
(
  per.view hwioreg.per "TOP_UART,UART_DM_ISR"
)
if "&choice"=="UART_DM_RX_TOTAL_SNAP"
(
  per.view hwioreg.per "TOP_UART,UART_DM_RX_TOTAL_SNAP"
)
if "&choice"=="UART_DM_TXFS"
(
  per.view hwioreg.per "TOP_UART,UART_DM_TXFS"
)
if "&choice"=="UART_DM_RXFS"
(
  per.view hwioreg.per "TOP_UART,UART_DM_RXFS"
)
if "&choice"=="UART_DM_TEST_RD_DATA"
(
  per.view hwioreg.per "TOP_UART,UART_DM_TEST_RD_DATA"
)
if "&choice"=="USB_OTG_HS_ID"
(
  per.view hwioreg.per "USB_OTG_HS,USB_OTG_HS_ID"
)
if "&choice"=="USB_OTG_HS_HWGENERAL"
(
  per.view hwioreg.per "USB_OTG_HS,USB_OTG_HS_HWGENERAL"
)
if "&choice"=="USB_OTG_HS_HWHOST"
(
  per.view hwioreg.per "USB_OTG_HS,USB_OTG_HS_HWHOST"
)
if "&choice"=="USB_OTG_HS_HWDEVICE"
(
  per.view hwioreg.per "USB_OTG_HS,USB_OTG_HS_HWDEVICE"
)
if "&choice"=="USB_OTG_HS_HWTXBUF"
(
  per.view hwioreg.per "USB_OTG_HS,USB_OTG_HS_HWTXBUF"
)
if "&choice"=="USB_OTG_HS_HWRXBUF"
(
  per.view hwioreg.per "USB_OTG_HS,USB_OTG_HS_HWRXBUF"
)
if "&choice"=="USB_OTG_HS_GPTIMER0LD"
(
  per.view hwioreg.per "USB_OTG_HS,USB_OTG_HS_GPTIMER0LD"
)
if "&choice"=="USB_OTG_HS_GPTIMER0CTRL"
(
  per.view hwioreg.per "USB_OTG_HS,USB_OTG_HS_GPTIMER0CTRL"
)
if "&choice"=="USB_OTG_HS_GPTIMER1LD"
(
  per.view hwioreg.per "USB_OTG_HS,USB_OTG_HS_GPTIMER1LD"
)
if "&choice"=="USB_OTG_HS_GPTIMER1CTRL"
(
  per.view hwioreg.per "USB_OTG_HS,USB_OTG_HS_GPTIMER1CTRL"
)
if "&choice"=="USB_OTG_HS_AHB_BURST"
(
  per.view hwioreg.per "USB_OTG_HS,USB_OTG_HS_AHB_BURST"
)
if "&choice"=="USB_OTG_HS_XTOR_STS"
(
  per.view hwioreg.per "USB_OTG_HS,USB_OTG_HS_XTOR_STS"
)
if "&choice"=="USB_OTG_HS_AHB_MODE"
(
  per.view hwioreg.per "USB_OTG_HS,USB_OTG_HS_AHB_MODE"
)
if "&choice"=="USB_OTG_HS_GEN_CONFIG"
(
  per.view hwioreg.per "USB_OTG_HS,USB_OTG_HS_GEN_CONFIG"
)
if "&choice"=="USB_OTG_HS_CAPLENGTH"
(
  per.view hwioreg.per "USB_OTG_HS,USB_OTG_HS_CAPLENGTH"
)
if "&choice"=="USB_OTG_HS_HCIVERSION"
(
  per.view hwioreg.per "USB_OTG_HS,USB_OTG_HS_HCIVERSION"
)
if "&choice"=="USB_OTG_HS_HCSPARAMS"
(
  per.view hwioreg.per "USB_OTG_HS,USB_OTG_HS_HCSPARAMS"
)
if "&choice"=="USB_OTG_HS_HCCPARAMS"
(
  per.view hwioreg.per "USB_OTG_HS,USB_OTG_HS_HCCPARAMS"
)
if "&choice"=="USB_OTG_HS_DCIVERSION"
(
  per.view hwioreg.per "USB_OTG_HS,USB_OTG_HS_DCIVERSION"
)
if "&choice"=="USB_OTG_HS_DCCPARAMS"
(
  per.view hwioreg.per "USB_OTG_HS,USB_OTG_HS_DCCPARAMS"
)
if "&choice"=="USB_OTG_HS_USBCMD"
(
  per.view hwioreg.per "USB_OTG_HS,USB_OTG_HS_USBCMD"
)
if "&choice"=="USB_OTG_HS_USBSTS"
(
  per.view hwioreg.per "USB_OTG_HS,USB_OTG_HS_USBSTS"
)
if "&choice"=="USB_OTG_HS_USBINTR"
(
  per.view hwioreg.per "USB_OTG_HS,USB_OTG_HS_USBINTR"
)
if "&choice"=="USB_OTG_HS_FRINDEX"
(
  per.view hwioreg.per "USB_OTG_HS,USB_OTG_HS_FRINDEX"
)
if "&choice"=="USB_OTG_HS_PERIODICLISTBASE"
(
  per.view hwioreg.per "USB_OTG_HS,USB_OTG_HS_PERIODICLISTBASE"
)
if "&choice"=="USB_OTG_HS_DEVICEADDR"
(
  per.view hwioreg.per "USB_OTG_HS,USB_OTG_HS_DEVICEADDR"
)
if "&choice"=="USB_OTG_HS_ASYNCLISTADDR"
(
  per.view hwioreg.per "USB_OTG_HS,USB_OTG_HS_ASYNCLISTADDR"
)
if "&choice"=="USB_OTG_HS_ENDPOINTLISTADDR"
(
  per.view hwioreg.per "USB_OTG_HS,USB_OTG_HS_ENDPOINTLISTADDR"
)
if "&choice"=="USB_OTG_HS_TTCTRL"
(
  per.view hwioreg.per "USB_OTG_HS,USB_OTG_HS_TTCTRL"
)
if "&choice"=="USB_OTG_HS_BURSTSIZE"
(
  per.view hwioreg.per "USB_OTG_HS,USB_OTG_HS_BURSTSIZE"
)
if "&choice"=="USB_OTG_HS_TXFILLTUNING"
(
  per.view hwioreg.per "USB_OTG_HS,USB_OTG_HS_TXFILLTUNING"
)
if "&choice"=="USB_OTG_HS_ULPI_VIEWPORT"
(
  per.view hwioreg.per "USB_OTG_HS,USB_OTG_HS_ULPI_VIEWPORT"
)
if "&choice"=="USB_OTG_HS_ENDPTNAK"
(
  per.view hwioreg.per "USB_OTG_HS,USB_OTG_HS_ENDPTNAK"
)
if "&choice"=="USB_OTG_HS_ENDPTNAKEN"
(
  per.view hwioreg.per "USB_OTG_HS,USB_OTG_HS_ENDPTNAKEN"
)
if "&choice"=="USB_OTG_HS_PORTSC"
(
  per.view hwioreg.per "USB_OTG_HS,USB_OTG_HS_PORTSC"
)
if "&choice"=="USB_OTG_HS_OTGSC"
(
  per.view hwioreg.per "USB_OTG_HS,USB_OTG_HS_OTGSC"
)
if "&choice"=="USB_OTG_HS_USBMODE"
(
  per.view hwioreg.per "USB_OTG_HS,USB_OTG_HS_USBMODE"
)
if "&choice"=="USB_OTG_HS_ENPDTSETUPSTAT"
(
  per.view hwioreg.per "USB_OTG_HS,USB_OTG_HS_ENPDTSETUPSTAT"
)
if "&choice"=="USB_OTG_HS_ENDPTPRIME"
(
  per.view hwioreg.per "USB_OTG_HS,USB_OTG_HS_ENDPTPRIME"
)
if "&choice"=="USB_OTG_HS_ENDPTFLUSH"
(
  per.view hwioreg.per "USB_OTG_HS,USB_OTG_HS_ENDPTFLUSH"
)
if "&choice"=="USB_OTG_HS_ENDPTSTAT"
(
  per.view hwioreg.per "USB_OTG_HS,USB_OTG_HS_ENDPTSTAT"
)
if "&choice"=="USB_OTG_HS_ENDPTCOMPLETE"
(
  per.view hwioreg.per "USB_OTG_HS,USB_OTG_HS_ENDPTCOMPLETE"
)
if "&choice"=="USB_OTG_HS_ENDPTCTRL0"
(
  per.view hwioreg.per "USB_OTG_HS,USB_OTG_HS_ENDPTCTRL0"
)
if "&choice"=="USB_OTG_HS_ENDPTCTRL1"
(
  per.view hwioreg.per "USB_OTG_HS,USB_OTG_HS_ENDPTCTRL1"
)
if "&choice"=="SLEEP_XTAL_TIMER_0_COUNT"
(
  per.view hwioreg.per "WDOG_SLP,SLEEP_XTAL_TIMER_0_COUNT"
)
if "&choice"=="SLEEP_XTAL_TIMER_1_COUNT"
(
  per.view hwioreg.per "WDOG_SLP,SLEEP_XTAL_TIMER_1_COUNT"
)
if "&choice"=="SLEEP_XTAL_TIMETICK_COUNT"
(
  per.view hwioreg.per "WDOG_SLP,SLEEP_XTAL_TIMETICK_COUNT"
)
if "&choice"=="WDOG_STATUS"
(
  per.view hwioreg.per "WDOG_SLP,WDOG_STATUS"
)
if "&choice"=="SLEEP_XTAL_TIMER_0_ENABLE"
(
  per.view hwioreg.per "WDOG_SLP,SLEEP_XTAL_TIMER_0_ENABLE"
)
if "&choice"=="SLEEP_XTAL_TIMER_1_ENABLE"
(
  per.view hwioreg.per "WDOG_SLP,SLEEP_XTAL_TIMER_1_ENABLE"
)
if "&choice"=="SLEEP_XTAL_TIMER_0_MATCH_VAL"
(
  per.view hwioreg.per "WDOG_SLP,SLEEP_XTAL_TIMER_0_MATCH_VAL"
)
if "&choice"=="SLEEP_XTAL_TIMER_1_MATCH_VAL"
(
  per.view hwioreg.per "WDOG_SLP,SLEEP_XTAL_TIMER_1_MATCH_VAL"
)
if "&choice"=="SLEEP_XTAL_TIMETICK_MATCH_VAL_STATUS"
(
  per.view hwioreg.per "WDOG_SLP,SLEEP_XTAL_TIMETICK_MATCH_VAL_STATUS"
)
if "&choice"=="SLEEP_XTAL_TIMETICK_MATCH_VAL"
(
  per.view hwioreg.per "WDOG_SLP,SLEEP_XTAL_TIMETICK_MATCH_VAL"
)
if "&choice"=="WDOG_EXPIRED_WIDTH"
(
  per.view hwioreg.per "WDOG_SLP,WDOG_EXPIRED_WIDTH"
)
if "&choice"=="WDOG_TEST_LOAD_STATUS"
(
  per.view hwioreg.per "WDOG_SLP,WDOG_TEST_LOAD_STATUS"
)
if "&choice"=="WDOG_TEST"
(
  per.view hwioreg.per "WDOG_SLP,WDOG_TEST"
)
if "&choice"=="ADSP_RAMA_BASE"
(
  per.view hwioreg.per "ADSP,ADSP_RAMA_BASE"
)
if "&choice"=="ADSP_RAMB_BASE"
(
  per.view hwioreg.per "ADSP,ADSP_RAMB_BASE"
)
if "&choice"=="ADSP_RAMC_BASE"
(
  per.view hwioreg.per "ADSP,ADSP_RAMC_BASE"
)
if "&choice"=="ADSP_RAMI_BASE"
(
  per.view hwioreg.per "ADSP,ADSP_RAMI_BASE"
)
if "&choice"=="ADSP_CTL"
(
  per.view hwioreg.per "ADSP,ADSP_CTL"
)
if "&choice"=="ADSP_CLK_GATE_CTL"
(
  per.view hwioreg.per "ADSP,ADSP_CLK_GATE_CTL"
)
if "&choice"=="ADSP_CLK_STATUS"
(
  per.view hwioreg.per "ADSP,ADSP_CLK_STATUS"
)
if "&choice"=="ADSP_DBG_CTRL"
(
  per.view hwioreg.per "ADSP,ADSP_DBG_CTRL"
)
if "&choice"=="ADSP_PC_DBG"
(
  per.view hwioreg.per "ADSP,ADSP_PC_DBG"
)
if "&choice"=="ADSP_INT_MASK_DBG"
(
  per.view hwioreg.per "ADSP,ADSP_INT_MASK_DBG"
)
if "&choice"=="ADSP_INT_MASK2_DBG"
(
  per.view hwioreg.per "ADSP,ADSP_INT_MASK2_DBG"
)
if "&choice"=="ADSP_MEM_ACC_CTRL"
(
  per.view hwioreg.per "ADSP,ADSP_MEM_ACC_CTRL"
)
if "&choice"=="BOOT_ROM_CLOCK_ENABLE"
(
  per.view hwioreg.per "AHB,BOOT_ROM_CLOCK_ENABLE"
)
if "&choice"=="PAUSE_TIMER"
(
  per.view hwioreg.per "AHB,PAUSE_TIMER"
)
if "&choice"=="PAUSE_TIMER_CTL"
(
  per.view hwioreg.per "AHB,PAUSE_TIMER_CTL"
)
if "&choice"=="BPM_TRIGGER"
(
  per.view hwioreg.per "AHB,BPM_TRIGGER"
)
if "&choice"=="BPM_HSEL_SEL"
(
  per.view hwioreg.per "AHB,BPM_HSEL_SEL"
)
if "&choice"=="EBI1_CS0_CS1_SWAP"
(
  per.view hwioreg.per "AHB,EBI1_CS0_CS1_SWAP"
)
if "&choice"=="MSM_BRIDGE_CFG"
(
  per.view hwioreg.per "AHB,MSM_BRIDGE_CFG"
)
if "&choice"=="AHB_TEST_BUS_CTL"
(
  per.view hwioreg.per "AHB,AHB_TEST_BUS_CTL"
)
if "&choice"=="AHB_TEST_BUS"
(
  per.view hwioreg.per "AHB,AHB_TEST_BUS"
)
if "&choice"=="BOOT_FROM_ROM_STATUS"
(
  per.view hwioreg.per "AHB,BOOT_FROM_ROM_STATUS"
)
if "&choice"=="AHB_APP_BUS_PRIORITY"
(
  per.view hwioreg.per "AHB,AHB_APP_BUS_PRIORITY"
)
if "&choice"=="AHB_BUS_REQUEST"
(
  per.view hwioreg.per "AHB,AHB_BUS_REQUEST"
)
if "&choice"=="AHB_BUS_MASTERS"
(
  per.view hwioreg.per "AHB,AHB_BUS_MASTERS"
)
if "&choice"=="AHB_SYS_BUS_PRIORITY"
(
  per.view hwioreg.per "AHB,AHB_SYS_BUS_PRIORITY"
)
if "&choice"=="AHB_SYS_DUMMY0"
(
  per.view hwioreg.per "AHB,AHB_SYS_DUMMY0"
)
if "&choice"=="AHB_SYS_DUMMY1"
(
  per.view hwioreg.per "AHB,AHB_SYS_DUMMY1"
)
if "&choice"=="AHB_SYS_DUMMY2"
(
  per.view hwioreg.per "AHB,AHB_SYS_DUMMY2"
)
if "&choice"=="SYS_FINE_TABLE0"
(
  per.view hwioreg.per "AHB,SYS_FINE_TABLE0"
)
if "&choice"=="SYS_FINE_TABLE1"
(
  per.view hwioreg.per "AHB,SYS_FINE_TABLE1"
)
if "&choice"=="SYS_FINE_TABLE2"
(
  per.view hwioreg.per "AHB,SYS_FINE_TABLE2"
)
if "&choice"=="SYS_FINE_TABLE3"
(
  per.view hwioreg.per "AHB,SYS_FINE_TABLE3"
)
if "&choice"=="SYS_FINE_TABLE4"
(
  per.view hwioreg.per "AHB,SYS_FINE_TABLE4"
)
if "&choice"=="SYS_FINE_TABLE5"
(
  per.view hwioreg.per "AHB,SYS_FINE_TABLE5"
)
if "&choice"=="SYS_FINE_TABLE6"
(
  per.view hwioreg.per "AHB,SYS_FINE_TABLE6"
)
if "&choice"=="SYS_FINE_TABLE7"
(
  per.view hwioreg.per "AHB,SYS_FINE_TABLE7"
)
if "&choice"=="SYS_COARSE_TABLE0"
(
  per.view hwioreg.per "AHB,SYS_COARSE_TABLE0"
)
if "&choice"=="SYS_COARSE_TABLE1"
(
  per.view hwioreg.per "AHB,SYS_COARSE_TABLE1"
)
if "&choice"=="SYS_COARSE_TABLE2"
(
  per.view hwioreg.per "AHB,SYS_COARSE_TABLE2"
)
if "&choice"=="SYS_COARSE_TABLE3"
(
  per.view hwioreg.per "AHB,SYS_COARSE_TABLE3"
)
if "&choice"=="SYS_COARSE_TABLE4"
(
  per.view hwioreg.per "AHB,SYS_COARSE_TABLE4"
)
if "&choice"=="SYS_COARSE_TABLE5"
(
  per.view hwioreg.per "AHB,SYS_COARSE_TABLE5"
)
if "&choice"=="SYS_COARSE_TABLE6"
(
  per.view hwioreg.per "AHB,SYS_COARSE_TABLE6"
)
if "&choice"=="SYS_COARSE_TABLE7"
(
  per.view hwioreg.per "AHB,SYS_COARSE_TABLE7"
)
if "&choice"=="APP_FINE_TABLE0"
(
  per.view hwioreg.per "AHB,APP_FINE_TABLE0"
)
if "&choice"=="APP_FINE_TABLE1"
(
  per.view hwioreg.per "AHB,APP_FINE_TABLE1"
)
if "&choice"=="APP_FINE_TABLE2"
(
  per.view hwioreg.per "AHB,APP_FINE_TABLE2"
)
if "&choice"=="APP_FINE_TABLE3"
(
  per.view hwioreg.per "AHB,APP_FINE_TABLE3"
)
if "&choice"=="APP_FINE_TABLE4"
(
  per.view hwioreg.per "AHB,APP_FINE_TABLE4"
)
if "&choice"=="APP_FINE_TABLE5"
(
  per.view hwioreg.per "AHB,APP_FINE_TABLE5"
)
if "&choice"=="APP_FINE_TABLE6"
(
  per.view hwioreg.per "AHB,APP_FINE_TABLE6"
)
if "&choice"=="APP_FINE_TABLE7"
(
  per.view hwioreg.per "AHB,APP_FINE_TABLE7"
)
if "&choice"=="APP_COARSE_TABLE0"
(
  per.view hwioreg.per "AHB,APP_COARSE_TABLE0"
)
if "&choice"=="APP_COARSE_TABLE1"
(
  per.view hwioreg.per "AHB,APP_COARSE_TABLE1"
)
if "&choice"=="APP_COARSE_TABLE2"
(
  per.view hwioreg.per "AHB,APP_COARSE_TABLE2"
)
if "&choice"=="APP_COARSE_TABLE3"
(
  per.view hwioreg.per "AHB,APP_COARSE_TABLE3"
)
if "&choice"=="APP_COARSE_TABLE4"
(
  per.view hwioreg.per "AHB,APP_COARSE_TABLE4"
)
if "&choice"=="APP_COARSE_TABLE5"
(
  per.view hwioreg.per "AHB,APP_COARSE_TABLE5"
)
if "&choice"=="APP_COARSE_TABLE6"
(
  per.view hwioreg.per "AHB,APP_COARSE_TABLE6"
)
if "&choice"=="APP_COARSE_TABLE7"
(
  per.view hwioreg.per "AHB,APP_COARSE_TABLE7"
)
if "&choice"=="GT_SLOT_SIZE"
(
  per.view hwioreg.per "AHB,GT_SLOT_SIZE"
)
if "&choice"=="APP_MPU_ENABLE"
(
  per.view hwioreg.per "APP_MPU,APP_MPU_ENABLE"
)
if "&choice"=="APP_MPU_ERR_STATS"
(
  per.view hwioreg.per "APP_MPU,APP_MPU_ERR_STATS"
)
if "&choice"=="APP_MPU_DEF_PART_PERM0"
(
  per.view hwioreg.per "APP_MPU,APP_MPU_DEF_PART_PERM0"
)
if "&choice"=="APP_MPU_PART_START_ADDR0"
(
  per.view hwioreg.per "APP_MPU,APP_MPU_PART_START_ADDR0"
)
if "&choice"=="APP_MPU_PART_START_ADDR1"
(
  per.view hwioreg.per "APP_MPU,APP_MPU_PART_START_ADDR1"
)
if "&choice"=="APP_MPU_PART_START_ADDR2"
(
  per.view hwioreg.per "APP_MPU,APP_MPU_PART_START_ADDR2"
)
if "&choice"=="APP_MPU_PART_START_ADDR3"
(
  per.view hwioreg.per "APP_MPU,APP_MPU_PART_START_ADDR3"
)
if "&choice"=="APP_MPU_PART_END_ADDR0"
(
  per.view hwioreg.per "APP_MPU,APP_MPU_PART_END_ADDR0"
)
if "&choice"=="APP_MPU_PART_END_ADDR1"
(
  per.view hwioreg.per "APP_MPU,APP_MPU_PART_END_ADDR1"
)
if "&choice"=="APP_MPU_PART_END_ADDR2"
(
  per.view hwioreg.per "APP_MPU,APP_MPU_PART_END_ADDR2"
)
if "&choice"=="APP_MPU_PART_END_ADDR3"
(
  per.view hwioreg.per "APP_MPU,APP_MPU_PART_END_ADDR3"
)
if "&choice"=="APP_MPU_PART_PERM00"
(
  per.view hwioreg.per "APP_MPU,APP_MPU_PART_PERM00"
)
if "&choice"=="CHIP_ARM9_TEST_MEM_ADDR"
(
  per.view hwioreg.per "ARM9_MTI,CHIP_ARM9_TEST_MEM_ADDR"
)
if "&choice"=="CHIP_ARM9_TEST_MEM_WRITE"
(
  per.view hwioreg.per "ARM9_MTI,CHIP_ARM9_TEST_MEM_WRITE"
)
if "&choice"=="CHIP_ARM9_TEST_MEM_SEL"
(
  per.view hwioreg.per "ARM9_MTI,CHIP_ARM9_TEST_MEM_SEL"
)
if "&choice"=="CHIP_ARM9_TEST_MEM_READ0"
(
  per.view hwioreg.per "ARM9_MTI,CHIP_ARM9_TEST_MEM_READ0"
)
if "&choice"=="CHIP_ARM9_TEST_MEM_WRITE_NON_INCR"
(
  per.view hwioreg.per "ARM9_MTI,CHIP_ARM9_TEST_MEM_WRITE_NON_INCR"
)
if "&choice"=="CHIP_ARM9_TEST_MEM_READ0_NON_INCR"
(
  per.view hwioreg.per "ARM9_MTI,CHIP_ARM9_TEST_MEM_READ0_NON_INCR"
)
if "&choice"=="ARM9_11_MEM_ACC_CTRL"
(
  per.view hwioreg.per "ARM9_MTI,ARM9_11_MEM_ACC_CTRL"
)
if "&choice"=="AUX_CODEC_CTL"
(
  per.view hwioreg.per "AUDIO,AUX_CODEC_CTL"
)
if "&choice"=="PCM_PATH_CTL"
(
  per.view hwioreg.per "AUDIO,PCM_PATH_CTL"
)
if "&choice"=="AUX_CODEC_CTL_OUT"
(
  per.view hwioreg.per "AUDIO,AUX_CODEC_CTL_OUT"
)
if "&choice"=="WB_CODEC_TEST_CTL"
(
  per.view hwioreg.per "AUDIO,WB_CODEC_TEST_CTL"
)
if "&choice"=="WB_CODEC_FIFO_WR_REG"
(
  per.view hwioreg.per "AUDIO,WB_CODEC_FIFO_WR_REG"
)
if "&choice"=="WB_CODEC_FIFO_RD_REG"
(
  per.view hwioreg.per "AUDIO,WB_CODEC_FIFO_RD_REG"
)
if "&choice"=="WB_MISSED_ACKS_CNT"
(
  per.view hwioreg.per "AUDIO,WB_MISSED_ACKS_CNT"
)
if "&choice"=="WB_CODEC_CMD_REG"
(
  per.view hwioreg.per "AUDIO,WB_CODEC_CMD_REG"
)
if "&choice"=="WB_CODEC_SEL_ADSP"
(
  per.view hwioreg.per "AUDIO,WB_CODEC_SEL_ADSP"
)
if "&choice"=="BPM_CFG"
(
  per.view hwioreg.per "BPM,BPM_CFG"
)
if "&choice"=="BPM_CMD"
(
  per.view hwioreg.per "BPM,BPM_CMD"
)
if "&choice"=="BPM_MSTR_CFG"
(
  per.view hwioreg.per "BPM,BPM_MSTR_CFG"
)
if "&choice"=="BPM_TIMER"
(
  per.view hwioreg.per "BPM,BPM_TIMER"
)
if "&choice"=="BPM_CYC_CFG"
(
  per.view hwioreg.per "BPM,BPM_CYC_CFG"
)
if "&choice"=="BPM_CYC_OUT"
(
  per.view hwioreg.per "BPM,BPM_CYC_OUT"
)
if "&choice"=="BPM_C0_CFG0"
(
  per.view hwioreg.per "BPM,BPM_C0_CFG0"
)
if "&choice"=="BPM_C1_CFG0"
(
  per.view hwioreg.per "BPM,BPM_C1_CFG0"
)
if "&choice"=="BPM_C2_CFG0"
(
  per.view hwioreg.per "BPM,BPM_C2_CFG0"
)
if "&choice"=="BPM_C3_CFG0"
(
  per.view hwioreg.per "BPM,BPM_C3_CFG0"
)
if "&choice"=="BPM_C0_CFG1"
(
  per.view hwioreg.per "BPM,BPM_C0_CFG1"
)
if "&choice"=="BPM_C1_CFG1"
(
  per.view hwioreg.per "BPM,BPM_C1_CFG1"
)
if "&choice"=="BPM_C2_CFG1"
(
  per.view hwioreg.per "BPM,BPM_C2_CFG1"
)
if "&choice"=="BPM_C3_CFG1"
(
  per.view hwioreg.per "BPM,BPM_C3_CFG1"
)
if "&choice"=="BPM_C0_CFG2"
(
  per.view hwioreg.per "BPM,BPM_C0_CFG2"
)
if "&choice"=="BPM_C1_CFG2"
(
  per.view hwioreg.per "BPM,BPM_C1_CFG2"
)
if "&choice"=="BPM_C2_CFG2"
(
  per.view hwioreg.per "BPM,BPM_C2_CFG2"
)
if "&choice"=="BPM_C3_CFG2"
(
  per.view hwioreg.per "BPM,BPM_C3_CFG2"
)
if "&choice"=="BPM_C0_CFG3"
(
  per.view hwioreg.per "BPM,BPM_C0_CFG3"
)
if "&choice"=="BPM_C1_CFG3"
(
  per.view hwioreg.per "BPM,BPM_C1_CFG3"
)
if "&choice"=="BPM_C2_CFG3"
(
  per.view hwioreg.per "BPM,BPM_C2_CFG3"
)
if "&choice"=="BPM_C3_CFG3"
(
  per.view hwioreg.per "BPM,BPM_C3_CFG3"
)
if "&choice"=="BPM_C0_CFG4"
(
  per.view hwioreg.per "BPM,BPM_C0_CFG4"
)
if "&choice"=="BPM_C1_CFG4"
(
  per.view hwioreg.per "BPM,BPM_C1_CFG4"
)
if "&choice"=="BPM_C2_CFG4"
(
  per.view hwioreg.per "BPM,BPM_C2_CFG4"
)
if "&choice"=="BPM_C3_CFG4"
(
  per.view hwioreg.per "BPM,BPM_C3_CFG4"
)
if "&choice"=="BPM_C0_CFG5"
(
  per.view hwioreg.per "BPM,BPM_C0_CFG5"
)
if "&choice"=="BPM_C1_CFG5"
(
  per.view hwioreg.per "BPM,BPM_C1_CFG5"
)
if "&choice"=="BPM_C2_CFG5"
(
  per.view hwioreg.per "BPM,BPM_C2_CFG5"
)
if "&choice"=="BPM_C3_CFG5"
(
  per.view hwioreg.per "BPM,BPM_C3_CFG5"
)
if "&choice"=="BPM_C0_CFG6"
(
  per.view hwioreg.per "BPM,BPM_C0_CFG6"
)
if "&choice"=="BPM_C1_CFG6"
(
  per.view hwioreg.per "BPM,BPM_C1_CFG6"
)
if "&choice"=="BPM_C2_CFG6"
(
  per.view hwioreg.per "BPM,BPM_C2_CFG6"
)
if "&choice"=="BPM_C3_CFG6"
(
  per.view hwioreg.per "BPM,BPM_C3_CFG6"
)
if "&choice"=="BPM_C0_OUT"
(
  per.view hwioreg.per "BPM,BPM_C0_OUT"
)
if "&choice"=="BPM_C1_OUT"
(
  per.view hwioreg.per "BPM,BPM_C1_OUT"
)
if "&choice"=="BPM_C2_OUT"
(
  per.view hwioreg.per "BPM,BPM_C2_OUT"
)
if "&choice"=="BPM_C3_OUT"
(
  per.view hwioreg.per "BPM,BPM_C3_OUT"
)
if "&choice"=="BPM_DBG_CFG"
(
  per.view hwioreg.per "BPM,BPM_DBG_CFG"
)
if "&choice"=="CDMA_RTC_SYNC"
(
  per.view hwioreg.per "CDMA,CDMA_RTC,CDMA_RTC_SYNC"
)
if "&choice"=="RTC_CNT_1X"
(
  per.view hwioreg.per "CDMA,CDMA_RTC,RTC_CNT_1X"
)
if "&choice"=="RTC_SLEEP"
(
  per.view hwioreg.per "CDMA,CDMA_RTC,RTC_SLEEP"
)
if "&choice"=="RTC_OFFSET"
(
  per.view hwioreg.per "CDMA,CDMA_RTC,RTC_OFFSET"
)
if "&choice"=="RTC_LOAD"
(
  per.view hwioreg.per "CDMA,CDMA_RTC,RTC_LOAD"
)
if "&choice"=="RTC_CTL"
(
  per.view hwioreg.per "CDMA,CDMA_RTC,RTC_CTL"
)
if "&choice"=="RTC_GP_COMPARE1"
(
  per.view hwioreg.per "CDMA,CDMA_RTC,RTC_GP_COMPARE1"
)
if "&choice"=="RTC_GP_COMPARE2"
(
  per.view hwioreg.per "CDMA,CDMA_RTC,RTC_GP_COMPARE2"
)
if "&choice"=="RTC_DIFF_1XHDR"
(
  per.view hwioreg.per "CDMA,CDMA_RTC,RTC_DIFF_1XHDR"
)
if "&choice"=="RTC_INT_ENABLE"
(
  per.view hwioreg.per "CDMA,CDMA_RTC,RTC_INT_ENABLE"
)
if "&choice"=="RTC_INT_CLEAR"
(
  per.view hwioreg.per "CDMA,CDMA_RTC,RTC_INT_CLEAR"
)
if "&choice"=="RTC_INT_STATUS"
(
  per.view hwioreg.per "CDMA,CDMA_RTC,RTC_INT_STATUS"
)
if "&choice"=="RTC_INT_SELECT"
(
  per.view hwioreg.per "CDMA,CDMA_RTC,RTC_INT_SELECT"
)
if "&choice"=="RTC_TTRANS_CTL_1XHDR"
(
  per.view hwioreg.per "CDMA,CDMA_RTC,RTC_TTRANS_CTL_1XHDR"
)
if "&choice"=="RTC_DUMP_STATUS_1XHDR"
(
  per.view hwioreg.per "CDMA,CDMA_RTC,RTC_DUMP_STATUS_1XHDR"
)
if "&choice"=="RTC_TTRANS_TRIG_1X"
(
  per.view hwioreg.per "CDMA,CDMA_RTC,RTC_TTRANS_TRIG_1X"
)
if "&choice"=="RTC_TTRANS_TRIG_HDR"
(
  per.view hwioreg.per "CDMA,CDMA_RTC,RTC_TTRANS_TRIG_HDR"
)
if "&choice"=="RTC_DUMP_1X"
(
  per.view hwioreg.per "CDMA,CDMA_RTC,RTC_DUMP_1X"
)
if "&choice"=="RTC_DUMP_HDR"
(
  per.view hwioreg.per "CDMA,CDMA_RTC,RTC_DUMP_HDR"
)
if "&choice"=="CDMA_SAMPSRV_0_CTL"
(
  per.view hwioreg.per "CDMA,CDMA_SAMPSRV,CDMA_SAMPSRV_0_CTL"
)
if "&choice"=="CDMA_SAMPSRV_1_CTL"
(
  per.view hwioreg.per "CDMA,CDMA_SAMPSRV,CDMA_SAMPSRV_1_CTL"
)
if "&choice"=="CDMA_SAMPSRV_0_MODE"
(
  per.view hwioreg.per "CDMA,CDMA_SAMPSRV,CDMA_SAMPSRV_0_MODE"
)
if "&choice"=="CDMA_SAMPSRV_1_MODE"
(
  per.view hwioreg.per "CDMA,CDMA_SAMPSRV,CDMA_SAMPSRV_1_MODE"
)
if "&choice"=="CDMA_SAMPSRV_TEST_RAM_WE_CTL"
(
  per.view hwioreg.per "CDMA,CDMA_SAMPSRV,CDMA_SAMPSRV_TEST_RAM_WE_CTL"
)
if "&choice"=="CDMA_SAMPSRV_TEST_RAM_ADDR"
(
  per.view hwioreg.per "CDMA,CDMA_SAMPSRV,CDMA_SAMPSRV_TEST_RAM_ADDR"
)
if "&choice"=="CDMA_SAMPSRV_TEST_RAM_DATA"
(
  per.view hwioreg.per "CDMA,CDMA_SAMPSRV,CDMA_SAMPSRV_TEST_RAM_DATA"
)
if "&choice"=="CDMA_SAMPSRV_0_LATEST_RTC"
(
  per.view hwioreg.per "CDMA,CDMA_SAMPSRV,CDMA_SAMPSRV_0_LATEST_RTC"
)
if "&choice"=="CDMA_SAMPSRV_1_LATEST_RTC"
(
  per.view hwioreg.per "CDMA,CDMA_SAMPSRV,CDMA_SAMPSRV_1_LATEST_RTC"
)
if "&choice"=="CDMA_PNSRV_ROM_BIST_MODE"
(
  per.view hwioreg.per "CDMA,CDMA_SAMPSRV,CDMA_PNSRV_ROM_BIST_MODE"
)
if "&choice"=="CDMA_PNSRV_ROM_BIST_STATUS"
(
  per.view hwioreg.per "CDMA,CDMA_SAMPSRV,CDMA_PNSRV_ROM_BIST_STATUS"
)
if "&choice"=="CDMA_PNSRV_TEST_MODE"
(
  per.view hwioreg.per "CDMA,CDMA_SAMPSRV,CDMA_PNSRV_TEST_MODE"
)
if "&choice"=="CDMA_PNSRV_TEST_EXPORT_MISR"
(
  per.view hwioreg.per "CDMA,CDMA_SAMPSRV,CDMA_PNSRV_TEST_EXPORT_MISR"
)
if "&choice"=="CDMA_PNSRV_TEST_MISR_CURR_VAL"
(
  per.view hwioreg.per "CDMA,CDMA_SAMPSRV,CDMA_PNSRV_TEST_MISR_CURR_VAL"
)
if "&choice"=="CDMA_SAMPSRV_CLK_DISABLE"
(
  per.view hwioreg.per "CDMA,CDMA_SAMPSRV,CDMA_SAMPSRV_CLK_DISABLE"
)
if "&choice"=="CDMA_SAMPSRV_CLK_STATUS"
(
  per.view hwioreg.per "CDMA,CDMA_SAMPSRV,CDMA_SAMPSRV_CLK_STATUS"
)
if "&choice"=="CDMA_SAMPSRV_CTL_SEL"
(
  per.view hwioreg.per "CDMA,CDMA_SAMPSRV,CDMA_SAMPSRV_CTL_SEL"
)
if "&choice"=="MOD_MODE"
(
  per.view hwioreg.per "CDMA,CDMA_TX,MOD_MODE"
)
if "&choice"=="I_PN_STATE_0"
(
  per.view hwioreg.per "CDMA,CDMA_TX,I_PN_STATE_0"
)
if "&choice"=="I_PN_STATE_1"
(
  per.view hwioreg.per "CDMA,CDMA_TX,I_PN_STATE_1"
)
if "&choice"=="Q_PN_STATE_0"
(
  per.view hwioreg.per "CDMA,CDMA_TX,Q_PN_STATE_0"
)
if "&choice"=="Q_PN_STATE_1"
(
  per.view hwioreg.per "CDMA,CDMA_TX,Q_PN_STATE_1"
)
if "&choice"=="U_PN_STATE_0"
(
  per.view hwioreg.per "CDMA,CDMA_TX,U_PN_STATE_0"
)
if "&choice"=="U_PN_STATE_1"
(
  per.view hwioreg.per "CDMA,CDMA_TX,U_PN_STATE_1"
)
if "&choice"=="U_PN_STATE_2"
(
  per.view hwioreg.per "CDMA,CDMA_TX,U_PN_STATE_2"
)
if "&choice"=="U_PN_STATE_3"
(
  per.view hwioreg.per "CDMA,CDMA_TX,U_PN_STATE_3"
)
if "&choice"=="U_PN_STATE_4"
(
  per.view hwioreg.per "CDMA,CDMA_TX,U_PN_STATE_4"
)
if "&choice"=="U_PN_STATE_5"
(
  per.view hwioreg.per "CDMA,CDMA_TX,U_PN_STATE_5"
)
if "&choice"=="U_PN_MASK_0"
(
  per.view hwioreg.per "CDMA,CDMA_TX,U_PN_MASK_0"
)
if "&choice"=="U_PN_MASK_1"
(
  per.view hwioreg.per "CDMA,CDMA_TX,U_PN_MASK_1"
)
if "&choice"=="U_PN_MASK_2"
(
  per.view hwioreg.per "CDMA,CDMA_TX,U_PN_MASK_2"
)
if "&choice"=="U_PN_MASK_3"
(
  per.view hwioreg.per "CDMA,CDMA_TX,U_PN_MASK_3"
)
if "&choice"=="U_PN_MASK_4"
(
  per.view hwioreg.per "CDMA,CDMA_TX,U_PN_MASK_4"
)
if "&choice"=="U_PN_MASK_5"
(
  per.view hwioreg.per "CDMA,CDMA_TX,U_PN_MASK_5"
)
if "&choice"=="FRAME_OFF"
(
  per.view hwioreg.per "CDMA,CDMA_TX,FRAME_OFF"
)
if "&choice"=="MOD_STMR_MODIFIER_0"
(
  per.view hwioreg.per "CDMA,CDMA_TX,MOD_STMR_MODIFIER_0"
)
if "&choice"=="MOD_STMR_MODIFIER_1"
(
  per.view hwioreg.per "CDMA,CDMA_TX,MOD_STMR_MODIFIER_1"
)
if "&choice"=="TX_PCG_INT_ENABLE"
(
  per.view hwioreg.per "CDMA,CDMA_TX,TX_PCG_INT_ENABLE"
)
if "&choice"=="TX_PCG_INT_STATUS"
(
  per.view hwioreg.per "CDMA,CDMA_TX,TX_PCG_INT_STATUS"
)
if "&choice"=="MOD_TX_TIME_RD"
(
  per.view hwioreg.per "CDMA,CDMA_TX,MOD_TX_TIME_RD"
)
if "&choice"=="MOD_CH1_TIMING_CTL"
(
  per.view hwioreg.per "CDMA,CDMA_TX,MOD_CH1_TIMING_CTL"
)
if "&choice"=="MOD_CH2_TIMING_CTL"
(
  per.view hwioreg.per "CDMA,CDMA_TX,MOD_CH2_TIMING_CTL"
)
if "&choice"=="MOD_CH3_TIMING_CTL"
(
  per.view hwioreg.per "CDMA,CDMA_TX,MOD_CH3_TIMING_CTL"
)
if "&choice"=="MOD_WCOVER_SEL"
(
  per.view hwioreg.per "CDMA,CDMA_TX,MOD_WCOVER_SEL"
)
if "&choice"=="MOD_CH1_ENC_CTL"
(
  per.view hwioreg.per "CDMA,CDMA_TX,MOD_CH1_ENC_CTL"
)
if "&choice"=="MOD_CH1_CRC_POLY"
(
  per.view hwioreg.per "CDMA,CDMA_TX,MOD_CH1_CRC_POLY"
)
if "&choice"=="MOD_CH1_PUNCT_PATN_1"
(
  per.view hwioreg.per "CDMA,CDMA_TX,MOD_CH1_PUNCT_PATN_1"
)
if "&choice"=="MOD_CH1_PUNCT_PATN_0"
(
  per.view hwioreg.per "CDMA,CDMA_TX,MOD_CH1_PUNCT_PATN_0"
)
if "&choice"=="MOD_CH2_ENC_CTL_0"
(
  per.view hwioreg.per "CDMA,CDMA_TX,MOD_CH2_ENC_CTL_0"
)
if "&choice"=="MOD_CH2_ENC_CTL_1"
(
  per.view hwioreg.per "CDMA,CDMA_TX,MOD_CH2_ENC_CTL_1"
)
if "&choice"=="MOD_CH2_CRC_POLY"
(
  per.view hwioreg.per "CDMA,CDMA_TX,MOD_CH2_CRC_POLY"
)
if "&choice"=="MOD_CH2_PUNCT_PATN_1"
(
  per.view hwioreg.per "CDMA,CDMA_TX,MOD_CH2_PUNCT_PATN_1"
)
if "&choice"=="MOD_CH2_PUNCT_PATN_0"
(
  per.view hwioreg.per "CDMA,CDMA_TX,MOD_CH2_PUNCT_PATN_0"
)
if "&choice"=="MOD_CH3_ENC_CTL_0"
(
  per.view hwioreg.per "CDMA,CDMA_TX,MOD_CH3_ENC_CTL_0"
)
if "&choice"=="MOD_CH3_ENC_CTL_1"
(
  per.view hwioreg.per "CDMA,CDMA_TX,MOD_CH3_ENC_CTL_1"
)
if "&choice"=="MOD_CH3_CRC_POLY"
(
  per.view hwioreg.per "CDMA,CDMA_TX,MOD_CH3_CRC_POLY"
)
if "&choice"=="MOD_CH3_PUNCT_PATN_1"
(
  per.view hwioreg.per "CDMA,CDMA_TX,MOD_CH3_PUNCT_PATN_1"
)
if "&choice"=="MOD_CH3_PUNCT_PATN_0"
(
  per.view hwioreg.per "CDMA,CDMA_TX,MOD_CH3_PUNCT_PATN_0"
)
if "&choice"=="MOD_SCH_LTU_CTL"
(
  per.view hwioreg.per "CDMA,CDMA_TX,MOD_SCH_LTU_CTL"
)
if "&choice"=="MOD_MISC_CTL"
(
  per.view hwioreg.per "CDMA,CDMA_TX,MOD_MISC_CTL"
)
if "&choice"=="MOD_ROTATOR_MAP"
(
  per.view hwioreg.per "CDMA,CDMA_TX,MOD_ROTATOR_MAP"
)
if "&choice"=="MOD_WSYM_STATE"
(
  per.view hwioreg.per "CDMA,CDMA_TX,MOD_WSYM_STATE"
)
if "&choice"=="TX_VERY_EARLY_FRAME_CTL"
(
  per.view hwioreg.per "CDMA,CDMA_TX,TX_VERY_EARLY_FRAME_CTL"
)
if "&choice"=="TX_2_EARLY_PCG_CTL"
(
  per.view hwioreg.per "CDMA,CDMA_TX,TX_2_EARLY_PCG_CTL"
)
if "&choice"=="MOD_PICH_PCBIT_DATA"
(
  per.view hwioreg.per "CDMA,CDMA_TX,MOD_PICH_PCBIT_DATA"
)
if "&choice"=="MOD_PICH_PCBIT_MASK"
(
  per.view hwioreg.per "CDMA,CDMA_TX,MOD_PICH_PCBIT_MASK"
)
if "&choice"=="MOD_STATUS"
(
  per.view hwioreg.per "CDMA,CDMA_TX,MOD_STATUS"
)
if "&choice"=="MASK_DATA"
(
  per.view hwioreg.per "CDMA,CDMA_TX,MASK_DATA"
)
if "&choice"=="PA_PUNCT_FRAME_DIS"
(
  per.view hwioreg.per "CDMA,CDMA_TX,PA_PUNCT_FRAME_DIS"
)
if "&choice"=="PA_WARMUP"
(
  per.view hwioreg.per "CDMA,CDMA_TX,PA_WARMUP"
)
if "&choice"=="TX_WARMUP"
(
  per.view hwioreg.per "CDMA,CDMA_TX,TX_WARMUP"
)
if "&choice"=="MOD_TEST_CTL"
(
  per.view hwioreg.per "CDMA,CDMA_TX,MOD_TEST_CTL"
)
if "&choice"=="TX_I_CLK"
(
  per.view hwioreg.per "CDMA,CDMA_TX,TX_I_CLK"
)
if "&choice"=="MOD_CLK_CTL"
(
  per.view hwioreg.per "CDMA,CDMA_TX,MOD_CLK_CTL"
)
if "&choice"=="TX_DATA_TEST"
(
  per.view hwioreg.per "CDMA,CDMA_TX,TX_DATA_TEST"
)
if "&choice"=="TX_Q_DATA_TEST"
(
  per.view hwioreg.per "CDMA,CDMA_TX,TX_Q_DATA_TEST"
)
if "&choice"=="MOD_TEST_POINT_SEL"
(
  per.view hwioreg.per "CDMA,CDMA_TX,MOD_TEST_POINT_SEL"
)
if "&choice"=="MOD_TEST_MODE"
(
  per.view hwioreg.per "CDMA,CDMA_TX,MOD_TEST_MODE"
)
if "&choice"=="MOD_TEST_EXPORT_MISR"
(
  per.view hwioreg.per "CDMA,CDMA_TX,MOD_TEST_EXPORT_MISR"
)
if "&choice"=="MOD_TEST_MISR_EN"
(
  per.view hwioreg.per "CDMA,CDMA_TX,MOD_TEST_MISR_EN"
)
if "&choice"=="MOD_TEST_MISR_CTL"
(
  per.view hwioreg.per "CDMA,CDMA_TX,MOD_TEST_MISR_CTL"
)
if "&choice"=="MOD_TEST_MISR_DLY"
(
  per.view hwioreg.per "CDMA,CDMA_TX,MOD_TEST_MISR_DLY"
)
if "&choice"=="MOD_TEST_CURR_MISR_VAL"
(
  per.view hwioreg.per "CDMA,CDMA_TX,MOD_TEST_CURR_MISR_VAL"
)
if "&choice"=="MOD_PDCH_TIMING_CTL"
(
  per.view hwioreg.per "CDMA,CDMA_TX,MOD_PDCH_TIMING_CTL"
)
if "&choice"=="MOD_PDCH_CTL"
(
  per.view hwioreg.per "CDMA,CDMA_TX,MOD_PDCH_CTL"
)
if "&choice"=="MOD_PDCCH_CTL"
(
  per.view hwioreg.per "CDMA,CDMA_TX,MOD_PDCCH_CTL"
)
if "&choice"=="MOD_SPICH_CTL"
(
  per.view hwioreg.per "CDMA,CDMA_TX,MOD_SPICH_CTL"
)
if "&choice"=="MOD_VAR_GAIN_SHIFT_DLY"
(
  per.view hwioreg.per "CDMA,CDMA_TX,MOD_VAR_GAIN_SHIFT_DLY"
)
if "&choice"=="REVMOD_PN_LONG_STATE_0"
(
  per.view hwioreg.per "CDMA,CDMA_TX,REVMOD_PN_LONG_STATE_0"
)
if "&choice"=="REVMOD_PN_I_LONG_MASK_0"
(
  per.view hwioreg.per "CDMA,CDMA_TX,REVMOD_PN_I_LONG_MASK_0"
)
if "&choice"=="REVMOD_PN_I_LONG_MASK_1"
(
  per.view hwioreg.per "CDMA,CDMA_TX,REVMOD_PN_I_LONG_MASK_1"
)
if "&choice"=="REVMOD_PN_I_LONG_MASK_2"
(
  per.view hwioreg.per "CDMA,CDMA_TX,REVMOD_PN_I_LONG_MASK_2"
)
if "&choice"=="REVMOD_PN_Q_LONG_MASK_0"
(
  per.view hwioreg.per "CDMA,CDMA_TX,REVMOD_PN_Q_LONG_MASK_0"
)
if "&choice"=="REVMOD_PN_Q_LONG_MASK_1"
(
  per.view hwioreg.per "CDMA,CDMA_TX,REVMOD_PN_Q_LONG_MASK_1"
)
if "&choice"=="REVMOD_PN_Q_LONG_MASK_2"
(
  per.view hwioreg.per "CDMA,CDMA_TX,REVMOD_PN_Q_LONG_MASK_2"
)
if "&choice"=="REVMOD_PN_CTL"
(
  per.view hwioreg.per "CDMA,CDMA_TX,REVMOD_PN_CTL"
)
if "&choice"=="REVMOD_FRAME_OFFSET"
(
  per.view hwioreg.per "CDMA,CDMA_TX,REVMOD_FRAME_OFFSET"
)
if "&choice"=="REVMOD_TIME_STAMP_CTL"
(
  per.view hwioreg.per "CDMA,CDMA_TX,REVMOD_TIME_STAMP_CTL"
)
if "&choice"=="REVMOD_TIME_STAMP"
(
  per.view hwioreg.per "CDMA,CDMA_TX,REVMOD_TIME_STAMP"
)
if "&choice"=="REVMOD_TIME_STAMP2"
(
  per.view hwioreg.per "CDMA,CDMA_TX,REVMOD_TIME_STAMP2"
)
if "&choice"=="REVMOD_FRM_CNT_OFFSET"
(
  per.view hwioreg.per "CDMA,CDMA_TX,REVMOD_FRM_CNT_OFFSET"
)
if "&choice"=="REVMOD_FRM_CNT_OFFSET_CTL"
(
  per.view hwioreg.per "CDMA,CDMA_TX,REVMOD_FRM_CNT_OFFSET_CTL"
)
if "&choice"=="REVMOD_TX_TIME_RD"
(
  per.view hwioreg.per "CDMA,CDMA_TX,REVMOD_TX_TIME_RD"
)
if "&choice"=="REVMOD_FRAME_INT_OFFSET"
(
  per.view hwioreg.per "CDMA,CDMA_TX,REVMOD_FRAME_INT_OFFSET"
)
if "&choice"=="REVMOD_ENC_RATE"
(
  per.view hwioreg.per "CDMA,CDMA_TX,REVMOD_ENC_RATE"
)
if "&choice"=="REVMOD_EDI_CONTROL"
(
  per.view hwioreg.per "CDMA,CDMA_TX,REVMOD_EDI_CONTROL"
)
if "&choice"=="REVMOD_TENC_CTL"
(
  per.view hwioreg.per "CDMA,CDMA_TX,REVMOD_TENC_CTL"
)
if "&choice"=="REVMOD_TENC_STATUS"
(
  per.view hwioreg.per "CDMA,CDMA_TX,REVMOD_TENC_STATUS"
)
if "&choice"=="REVMOD_INBUF_STATUS"
(
  per.view hwioreg.per "CDMA,CDMA_TX,REVMOD_INBUF_STATUS"
)
if "&choice"=="REVMOD_OUTBUF_STATUS"
(
  per.view hwioreg.per "CDMA,CDMA_TX,REVMOD_OUTBUF_STATUS"
)
if "&choice"=="REVMOD_RRI_REQUEST"
(
  per.view hwioreg.per "CDMA,CDMA_TX,REVMOD_RRI_REQUEST"
)
if "&choice"=="REVMOD_MOD_CTL"
(
  per.view hwioreg.per "CDMA,CDMA_TX,REVMOD_MOD_CTL"
)
if "&choice"=="REVMOD_ENC_MODE"
(
  per.view hwioreg.per "CDMA,CDMA_TX,REVMOD_ENC_MODE"
)
if "&choice"=="REVMOD_PA_CTL"
(
  per.view hwioreg.per "CDMA,CDMA_TX,REVMOD_PA_CTL"
)
if "&choice"=="REVMOD_PA_WARMUP"
(
  per.view hwioreg.per "CDMA,CDMA_TX,REVMOD_PA_WARMUP"
)
if "&choice"=="REVMOD_TX_WARMUP"
(
  per.view hwioreg.per "CDMA,CDMA_TX,REVMOD_TX_WARMUP"
)
if "&choice"=="TX_AGC_CTL"
(
  per.view hwioreg.per "CDMA,CDMA_TX,TX_AGC_CTL"
)
if "&choice"=="TX_AGC_CTL2"
(
  per.view hwioreg.per "CDMA,CDMA_TX,TX_AGC_CTL2"
)
if "&choice"=="AGC_TEST_CTL"
(
  per.view hwioreg.per "CDMA,CDMA_TX,AGC_TEST_CTL"
)
if "&choice"=="AGC_TX_MASK_DATA_SEL"
(
  per.view hwioreg.per "CDMA,CDMA_TX,AGC_TX_MASK_DATA_SEL"
)
if "&choice"=="AGC_TX_RCCCH_FRAME_DELAY"
(
  per.view hwioreg.per "CDMA,CDMA_TX,AGC_TX_RCCCH_FRAME_DELAY"
)
if "&choice"=="PA_R_MAP"
(
  per.view hwioreg.per "CDMA,CDMA_TX,PA_R_MAP"
)
if "&choice"=="PA_R_TIMER"
(
  per.view hwioreg.per "CDMA,CDMA_TX,PA_R_TIMER"
)
if "&choice"=="PA_R1_FALL"
(
  per.view hwioreg.per "CDMA,CDMA_TX,PA_R1_FALL"
)
if "&choice"=="PA_R1_RISE"
(
  per.view hwioreg.per "CDMA,CDMA_TX,PA_R1_RISE"
)
if "&choice"=="PA_R2_FALL"
(
  per.view hwioreg.per "CDMA,CDMA_TX,PA_R2_FALL"
)
if "&choice"=="PA_R2_RISE"
(
  per.view hwioreg.per "CDMA,CDMA_TX,PA_R2_RISE"
)
if "&choice"=="PA_R3_FALL"
(
  per.view hwioreg.per "CDMA,CDMA_TX,PA_R3_FALL"
)
if "&choice"=="PA_R3_RISE"
(
  per.view hwioreg.per "CDMA,CDMA_TX,PA_R3_RISE"
)
if "&choice"=="PA_S0_OFFSET"
(
  per.view hwioreg.per "CDMA,CDMA_TX,PA_S0_OFFSET"
)
if "&choice"=="PA_S1_OFFSET"
(
  per.view hwioreg.per "CDMA,CDMA_TX,PA_S1_OFFSET"
)
if "&choice"=="PA_S2_OFFSET"
(
  per.view hwioreg.per "CDMA,CDMA_TX,PA_S2_OFFSET"
)
if "&choice"=="PA_S3_OFFSET"
(
  per.view hwioreg.per "CDMA,CDMA_TX,PA_S3_OFFSET"
)
if "&choice"=="PA_WARMUP_TIMER"
(
  per.view hwioreg.per "CDMA,CDMA_TX,PA_WARMUP_TIMER"
)
if "&choice"=="RAS_RAM_DATA"
(
  per.view hwioreg.per "CDMA,CDMA_TX,RAS_RAM_DATA"
)
if "&choice"=="SUBPCG_PA_WARMUP_DELAY"
(
  per.view hwioreg.per "CDMA,CDMA_TX,SUBPCG_PA_WARMUP_DELAY"
)
if "&choice"=="TX_ALIGN_DELAY"
(
  per.view hwioreg.per "CDMA,CDMA_TX,TX_ALIGN_DELAY"
)
if "&choice"=="TX_ATTEN_LIMIT_WR"
(
  per.view hwioreg.per "CDMA,CDMA_TX,TX_ATTEN_LIMIT_WR"
)
if "&choice"=="TX_GAIN_ADJ_WR"
(
  per.view hwioreg.per "CDMA,CDMA_TX,TX_GAIN_ADJ_WR"
)
if "&choice"=="TX_GAIN_LIMIT_WR"
(
  per.view hwioreg.per "CDMA,CDMA_TX,TX_GAIN_LIMIT_WR"
)
if "&choice"=="TX_OPEN_LOOP_WR"
(
  per.view hwioreg.per "CDMA,CDMA_TX,TX_OPEN_LOOP_WR"
)
if "&choice"=="TX_PDM_DELAY_VAL"
(
  per.view hwioreg.per "CDMA,CDMA_TX,TX_PDM_DELAY_VAL"
)
if "&choice"=="VERY_EARLY_FRAME_DELAY_REG"
(
  per.view hwioreg.per "CDMA,CDMA_TX,VERY_EARLY_FRAME_DELAY_REG"
)
if "&choice"=="TX_AGC_TEST_POINT_SEL"
(
  per.view hwioreg.per "CDMA,CDMA_TX,TX_AGC_TEST_POINT_SEL"
)
if "&choice"=="TX_PA_RD"
(
  per.view hwioreg.per "CDMA,CDMA_TX,TX_PA_RD"
)
if "&choice"=="RATCHET_BIT_DIS"
(
  per.view hwioreg.per "CDMA,CDMA_TX,RATCHET_BIT_DIS"
)
if "&choice"=="TX_AGC_ADJ_RD"
(
  per.view hwioreg.per "CDMA,CDMA_TX,TX_AGC_ADJ_RD"
)
if "&choice"=="TX_GAIN_ADJ_RD"
(
  per.view hwioreg.per "CDMA,CDMA_TX,TX_GAIN_ADJ_RD"
)
if "&choice"=="TX_GAIN_CTL_RD"
(
  per.view hwioreg.per "CDMA,CDMA_TX,TX_GAIN_CTL_RD"
)
if "&choice"=="TX_OPEN_LOOP_RD"
(
  per.view hwioreg.per "CDMA,CDMA_TX,TX_OPEN_LOOP_RD"
)
if "&choice"=="MOD_PA_ON_CTL"
(
  per.view hwioreg.per "CDMA,CDMA_TX,MOD_PA_ON_CTL"
)
if "&choice"=="MOD_TX_AGC_ADJ_CTL"
(
  per.view hwioreg.per "CDMA,CDMA_TX,MOD_TX_AGC_ADJ_CTL"
)
if "&choice"=="MOD_TX_AGC_ADJ"
(
  per.view hwioreg.per "CDMA,CDMA_TX,MOD_TX_AGC_ADJ"
)
if "&choice"=="MOD_TX_AGC_ODRIVE_DLY"
(
  per.view hwioreg.per "CDMA,CDMA_TX,MOD_TX_AGC_ODRIVE_DLY"
)
if "&choice"=="MOD_HW_CLK_CTL"
(
  per.view hwioreg.per "CDMA,CDMA_TX,MOD_HW_CLK_CTL"
)
if "&choice"=="MOD_MICRO_CLK_CTL"
(
  per.view hwioreg.per "CDMA,CDMA_TX,MOD_MICRO_CLK_CTL"
)
if "&choice"=="MOD_CLK_STATUS"
(
  per.view hwioreg.per "CDMA,CDMA_TX,MOD_CLK_STATUS"
)
if "&choice"=="MOD_TX_SLOT_INT_STATUS"
(
  per.view hwioreg.per "CDMA,CDMA_TX,MOD_TX_SLOT_INT_STATUS"
)
if "&choice"=="MOD_TX_SLOT_INT_EN"
(
  per.view hwioreg.per "CDMA,CDMA_TX,MOD_TX_SLOT_INT_EN"
)
if "&choice"=="MOD_TX_FR_INT_STATUS"
(
  per.view hwioreg.per "CDMA,CDMA_TX,MOD_TX_FR_INT_STATUS"
)
if "&choice"=="MOD_TX_FR_INT_EN"
(
  per.view hwioreg.per "CDMA,CDMA_TX,MOD_TX_FR_INT_EN"
)
if "&choice"=="MOD_TXCX8_SPARE_READ_REG_0"
(
  per.view hwioreg.per "CDMA,CDMA_TX,MOD_TXCX8_SPARE_READ_REG_0"
)
if "&choice"=="MOD_TXCX8_SPARE_READ_REG_1"
(
  per.view hwioreg.per "CDMA,CDMA_TX,MOD_TXCX8_SPARE_READ_REG_1"
)
if "&choice"=="MOD_TXCX8_SPARE_READ_REG_2"
(
  per.view hwioreg.per "CDMA,CDMA_TX,MOD_TXCX8_SPARE_READ_REG_2"
)
if "&choice"=="MOD_TXCX8_SPARE_READ_REG_3"
(
  per.view hwioreg.per "CDMA,CDMA_TX,MOD_TXCX8_SPARE_READ_REG_3"
)
if "&choice"=="NAND_FLASH_CMD"
(
  per.view hwioreg.per "CHIP_BASE_BASE,NAND_FLASH_CMD"
)
if "&choice"=="NAND_ADDR0"
(
  per.view hwioreg.per "CHIP_BASE_BASE,NAND_ADDR0"
)
if "&choice"=="NAND_ADDR1"
(
  per.view hwioreg.per "CHIP_BASE_BASE,NAND_ADDR1"
)
if "&choice"=="NAND_FLASH_CHIP_SELECT"
(
  per.view hwioreg.per "CHIP_BASE_BASE,NAND_FLASH_CHIP_SELECT"
)
if "&choice"=="NANDC_EXEC_CMD"
(
  per.view hwioreg.per "CHIP_BASE_BASE,NANDC_EXEC_CMD"
)
if "&choice"=="NAND_FLASH_STATUS"
(
  per.view hwioreg.per "CHIP_BASE_BASE,NAND_FLASH_STATUS"
)
if "&choice"=="NANDC_BUFFER_STATUS"
(
  per.view hwioreg.per "CHIP_BASE_BASE,NANDC_BUFFER_STATUS"
)
if "&choice"=="NAND_DEV0_CFG0"
(
  per.view hwioreg.per "CHIP_BASE_BASE,NAND_DEV0_CFG0"
)
if "&choice"=="NAND_DEV1_CFG0"
(
  per.view hwioreg.per "CHIP_BASE_BASE,NAND_DEV1_CFG0"
)
if "&choice"=="NAND_DEV0_CFG1"
(
  per.view hwioreg.per "CHIP_BASE_BASE,NAND_DEV0_CFG1"
)
if "&choice"=="NAND_DEV1_CFG1"
(
  per.view hwioreg.per "CHIP_BASE_BASE,NAND_DEV1_CFG1"
)
if "&choice"=="NAND_FLASH_READ_ID"
(
  per.view hwioreg.per "CHIP_BASE_BASE,NAND_FLASH_READ_ID"
)
if "&choice"=="NAND_FLASH_READ_STATUS"
(
  per.view hwioreg.per "CHIP_BASE_BASE,NAND_FLASH_READ_STATUS"
)
if "&choice"=="NAND_CONTROLLER_CFG"
(
  per.view hwioreg.per "CHIP_BASE_BASE,NAND_CONTROLLER_CFG"
)
if "&choice"=="NAND_FLASH_CONFIG_DATA"
(
  per.view hwioreg.per "CHIP_BASE_BASE,NAND_FLASH_CONFIG_DATA"
)
if "&choice"=="NAND_FLASH_CONFIG"
(
  per.view hwioreg.per "CHIP_BASE_BASE,NAND_FLASH_CONFIG"
)
if "&choice"=="NAND_FLASH_CONFIG_MODE"
(
  per.view hwioreg.per "CHIP_BASE_BASE,NAND_FLASH_CONFIG_MODE"
)
if "&choice"=="NAND_FLASH_CONFIG_STATUS"
(
  per.view hwioreg.per "CHIP_BASE_BASE,NAND_FLASH_CONFIG_STATUS"
)
if "&choice"=="FLASH_MACRO1_REG"
(
  per.view hwioreg.per "CHIP_BASE_BASE,FLASH_MACRO1_REG"
)
if "&choice"=="FLASH_XFR_STEP1"
(
  per.view hwioreg.per "CHIP_BASE_BASE,FLASH_XFR_STEP1"
)
if "&choice"=="FLASH_XFR_STEP2"
(
  per.view hwioreg.per "CHIP_BASE_BASE,FLASH_XFR_STEP2"
)
if "&choice"=="FLASH_XFR_STEP3"
(
  per.view hwioreg.per "CHIP_BASE_BASE,FLASH_XFR_STEP3"
)
if "&choice"=="FLASH_XFR_STEP4"
(
  per.view hwioreg.per "CHIP_BASE_BASE,FLASH_XFR_STEP4"
)
if "&choice"=="FLASH_XFR_STEP5"
(
  per.view hwioreg.per "CHIP_BASE_BASE,FLASH_XFR_STEP5"
)
if "&choice"=="FLASH_XFR_STEP6"
(
  per.view hwioreg.per "CHIP_BASE_BASE,FLASH_XFR_STEP6"
)
if "&choice"=="FLASH_XFR_STEP7"
(
  per.view hwioreg.per "CHIP_BASE_BASE,FLASH_XFR_STEP7"
)
if "&choice"=="NAND_CTLR_DEBUG_BUS_CFG"
(
  per.view hwioreg.per "CHIP_BASE_BASE,NAND_CTLR_DEBUG_BUS_CFG"
)
if "&choice"=="FLASH_DEV_CMD0"
(
  per.view hwioreg.per "CHIP_BASE_BASE,FLASH_DEV_CMD0"
)
if "&choice"=="FLASH_DEV_CMD1"
(
  per.view hwioreg.per "CHIP_BASE_BASE,FLASH_DEV_CMD1"
)
if "&choice"=="FLASH_DEV_CMD2"
(
  per.view hwioreg.per "CHIP_BASE_BASE,FLASH_DEV_CMD2"
)
if "&choice"=="FLASH_DEV_CMD_VLD"
(
  per.view hwioreg.per "CHIP_BASE_BASE,FLASH_DEV_CMD_VLD"
)
if "&choice"=="EBI2_MISR_SIG_REG"
(
  per.view hwioreg.per "CHIP_BASE_BASE,EBI2_MISR_SIG_REG"
)
if "&choice"=="NAND_ADDR2"
(
  per.view hwioreg.per "CHIP_BASE_BASE,NAND_ADDR2"
)
if "&choice"=="NAND_ADDR3"
(
  per.view hwioreg.per "CHIP_BASE_BASE,NAND_ADDR3"
)
if "&choice"=="NAND_ADDR4"
(
  per.view hwioreg.per "CHIP_BASE_BASE,NAND_ADDR4"
)
if "&choice"=="NAND_ADDR5"
(
  per.view hwioreg.per "CHIP_BASE_BASE,NAND_ADDR5"
)
if "&choice"=="FLASH_DEV_CMD3"
(
  per.view hwioreg.per "CHIP_BASE_BASE,FLASH_DEV_CMD3"
)
if "&choice"=="FLASH_DEV_CMD4"
(
  per.view hwioreg.per "CHIP_BASE_BASE,FLASH_DEV_CMD4"
)
if "&choice"=="FLASH_DEV_CMD5"
(
  per.view hwioreg.per "CHIP_BASE_BASE,FLASH_DEV_CMD5"
)
if "&choice"=="FLASH_DEV_CMD6"
(
  per.view hwioreg.per "CHIP_BASE_BASE,FLASH_DEV_CMD6"
)
if "&choice"=="FLASH_BURST_CFG"
(
  per.view hwioreg.per "CHIP_BASE_BASE,FLASH_BURST_CFG"
)
if "&choice"=="EBI2_ECC_BUF_CFG"
(
  per.view hwioreg.per "CHIP_BASE_BASE,EBI2_ECC_BUF_CFG"
)
if "&choice"=="NAND_FLASH_BIT_STREAM"
(
  per.view hwioreg.per "CHIP_BASE_BASE,NAND_FLASH_BIT_STREAM"
)
if "&choice"=="FLASH_BUFF0_ACC"
(
  per.view hwioreg.per "CHIP_BASE_BASE,FLASH_BUFF0_ACC"
)
if "&choice"=="ARM_MOD_REG"
(
  per.view hwioreg.per "CLK,ARM_MOD_REG"
)
if "&choice"=="ARM_CFG_REG"
(
  per.view hwioreg.per "CLK,ARM_CFG_REG"
)
if "&choice"=="ARM_CLK_EN_REG"
(
  per.view hwioreg.per "CLK,ARM_CLK_EN_REG"
)
if "&choice"=="ARM_CLK_INV_REG"
(
  per.view hwioreg.per "CLK,ARM_CLK_INV_REG"
)
if "&choice"=="ADSP_MND0_REG"
(
  per.view hwioreg.per "CLK,ADSP_MND0_REG"
)
if "&choice"=="ADSP_MND1_REG"
(
  per.view hwioreg.per "CLK,ADSP_MND1_REG"
)
if "&choice"=="ADSP_CFG_REG"
(
  per.view hwioreg.per "CLK,ADSP_CFG_REG"
)
if "&choice"=="ADSP_CLK_CTL_REG"
(
  per.view hwioreg.per "CLK,ADSP_CLK_CTL_REG"
)
if "&choice"=="ADSP_MODE_REG"
(
  per.view hwioreg.per "CLK,ADSP_MODE_REG"
)
if "&choice"=="ADSP_FS_CTL_REG"
(
  per.view hwioreg.per "CLK,ADSP_FS_CTL_REG"
)
if "&choice"=="ECODEC_MN_REG"
(
  per.view hwioreg.per "CLK,ECODEC_MN_REG"
)
if "&choice"=="ECODEC_CD_REG"
(
  per.view hwioreg.per "CLK,ECODEC_CD_REG"
)
if "&choice"=="GSBI0_MN_REG"
(
  per.view hwioreg.per "CLK,GSBI0_MN_REG"
)
if "&choice"=="GSBI0_CD_REG"
(
  per.view hwioreg.per "CLK,GSBI0_CD_REG"
)
if "&choice"=="GSBI1_MN_REG"
(
  per.view hwioreg.per "CLK,GSBI1_MN_REG"
)
if "&choice"=="GSBI1_CD_REG"
(
  per.view hwioreg.per "CLK,GSBI1_CD_REG"
)
if "&choice"=="GSBI2_MN_REG"
(
  per.view hwioreg.per "CLK,GSBI2_MN_REG"
)
if "&choice"=="GSBI2_CD_REG"
(
  per.view hwioreg.per "CLK,GSBI2_CD_REG"
)
if "&choice"=="I2S_MN_REG"
(
  per.view hwioreg.per "CLK,I2S_MN_REG"
)
if "&choice"=="I2S_CD_REG"
(
  per.view hwioreg.per "CLK,I2S_CD_REG"
)
if "&choice"=="ICODEC_RX_MN_REG"
(
  per.view hwioreg.per "CLK,ICODEC_RX_MN_REG"
)
if "&choice"=="ICODEC_RX_CD_REG"
(
  per.view hwioreg.per "CLK,ICODEC_RX_CD_REG"
)
if "&choice"=="ICODEC_TX_MN_REG"
(
  per.view hwioreg.per "CLK,ICODEC_TX_MN_REG"
)
if "&choice"=="ICODEC_TX_CD_REG"
(
  per.view hwioreg.per "CLK,ICODEC_TX_CD_REG"
)
if "&choice"=="SDCC_MN_REG"
(
  per.view hwioreg.per "CLK,SDCC_MN_REG"
)
if "&choice"=="SDCC_CD_REG"
(
  per.view hwioreg.per "CLK,SDCC_CD_REG"
)
if "&choice"=="MISC_CFG_REG"
(
  per.view hwioreg.per "CLK,MISC_CFG_REG"
)
if "&choice"=="UART_DM_MN_REG"
(
  per.view hwioreg.per "CLK,UART_DM_MN_REG"
)
if "&choice"=="UART_DM_CD_REG"
(
  per.view hwioreg.per "CLK,UART_DM_CD_REG"
)
if "&choice"=="USB_MN_REG"
(
  per.view hwioreg.per "CLK,USB_MN_REG"
)
if "&choice"=="USB_CD_REG"
(
  per.view hwioreg.per "CLK,USB_CD_REG"
)
if "&choice"=="CAMCLK_MN_REG"
(
  per.view hwioreg.per "CLK,CAMCLK_MN_REG"
)
if "&choice"=="CAMCLK_CD_REG"
(
  per.view hwioreg.per "CLK,CAMCLK_CD_REG"
)
if "&choice"=="VIDEO_VFE_MN_REG"
(
  per.view hwioreg.per "CLK,VIDEO_VFE_MN_REG"
)
if "&choice"=="VIDEO_VFE_CD_REG"
(
  per.view hwioreg.per "CLK,VIDEO_VFE_CD_REG"
)
if "&choice"=="CLK_OFF_A"
(
  per.view hwioreg.per "CLK,CLK_OFF_A"
)
if "&choice"=="CLK_OFF_B"
(
  per.view hwioreg.per "CLK,CLK_OFF_B"
)
if "&choice"=="DBG_CFG_REG"
(
  per.view hwioreg.per "CLK,DBG_CFG_REG"
)
if "&choice"=="SW_RESET_ALL_REG"
(
  per.view hwioreg.per "CLK,SW_RESET_ALL_REG"
)
if "&choice"=="RESET_STATUS_REG"
(
  per.view hwioreg.per "CLK,RESET_STATUS_REG"
)
if "&choice"=="SW_RESET_REG"
(
  per.view hwioreg.per "CLK,SW_RESET_REG"
)
if "&choice"=="PLL_TESTPAD_CFG_REG"
(
  per.view hwioreg.per "CLK,PLL_TESTPAD_CFG_REG"
)
if "&choice"=="PLL_MODE_REG"
(
  per.view hwioreg.per "CLK,PLL_MODE_REG"
)
if "&choice"=="PLL_L_VAL_REG"
(
  per.view hwioreg.per "CLK,PLL_L_VAL_REG"
)
if "&choice"=="PLL_M_VAL_REG"
(
  per.view hwioreg.per "CLK,PLL_M_VAL_REG"
)
if "&choice"=="PLL_N_VAL_REG"
(
  per.view hwioreg.per "CLK,PLL_N_VAL_REG"
)
if "&choice"=="PLL_CONFIG_REG"
(
  per.view hwioreg.per "CLK,PLL_CONFIG_REG"
)
if "&choice"=="PLL_TEST_CTL_REG"
(
  per.view hwioreg.per "CLK,PLL_TEST_CTL_REG"
)
if "&choice"=="PLL_STATUS_REG"
(
  per.view hwioreg.per "CLK,PLL_STATUS_REG"
)
if "&choice"=="UXMC_DEBUG_BUS_CTRL"
(
  per.view hwioreg.per "DEBUG_REGS,UXMC_DEBUG_BUS_CTRL"
)
if "&choice"=="DECOB_RESET"
(
  per.view hwioreg.per "DECOB,DECOB_RESET"
)
if "&choice"=="DECOB_BURST_IF_ACCESS"
(
  per.view hwioreg.per "DECOB,DECOB_BURST_IF_ACCESS"
)
if "&choice"=="DECOB_LONG_BUFFER_ADDR"
(
  per.view hwioreg.per "DECOB,DECOB_LONG_BUFFER_ADDR"
)
if "&choice"=="DECOB_LONG_BUFFER_DATA"
(
  per.view hwioreg.per "DECOB,DECOB_LONG_BUFFER_DATA"
)
if "&choice"=="DECOB_SHORT_BUFFER_ADDR"
(
  per.view hwioreg.per "DECOB,DECOB_SHORT_BUFFER_ADDR"
)
if "&choice"=="DECOB_SHORT_BUFFER_DATA"
(
  per.view hwioreg.per "DECOB,DECOB_SHORT_BUFFER_DATA"
)
if "&choice"=="DECOB_LONG_BUFFER_HUNT_CHAR"
(
  per.view hwioreg.per "DECOB,DECOB_LONG_BUFFER_HUNT_CHAR"
)
if "&choice"=="DECOB_LONG_BUFFER_DEBUG_WR_ADDR"
(
  per.view hwioreg.per "DECOB,DECOB_LONG_BUFFER_DEBUG_WR_ADDR"
)
if "&choice"=="DECOB_LONG_BUFFER_DEBUG_RD_ADDR"
(
  per.view hwioreg.per "DECOB,DECOB_LONG_BUFFER_DEBUG_RD_ADDR"
)
if "&choice"=="DECOB_PDCCH_0_DATA_RD0"
(
  per.view hwioreg.per "DECOB,DECOB_PDCCH_0_DATA_RD0"
)
if "&choice"=="DECOB_PDCCH_0_DATA_RD1"
(
  per.view hwioreg.per "DECOB,DECOB_PDCCH_0_DATA_RD1"
)
if "&choice"=="DECOB_PDCCH_0_DATA_RD2"
(
  per.view hwioreg.per "DECOB,DECOB_PDCCH_0_DATA_RD2"
)
if "&choice"=="DECOB_PDCCH_1_DATA_RD0"
(
  per.view hwioreg.per "DECOB,DECOB_PDCCH_1_DATA_RD0"
)
if "&choice"=="DECOB_PDCCH_1_DATA_RD1"
(
  per.view hwioreg.per "DECOB,DECOB_PDCCH_1_DATA_RD1"
)
if "&choice"=="DECOB_PDCCH_1_DATA_RD2"
(
  per.view hwioreg.per "DECOB,DECOB_PDCCH_1_DATA_RD2"
)
if "&choice"=="DECOB_PDCCH_0_STATUS_RD0"
(
  per.view hwioreg.per "DECOB,DECOB_PDCCH_0_STATUS_RD0"
)
if "&choice"=="DECOB_PDCCH_0_STATUS_RD1"
(
  per.view hwioreg.per "DECOB,DECOB_PDCCH_0_STATUS_RD1"
)
if "&choice"=="DECOB_PDCCH_0_STATUS_RD2"
(
  per.view hwioreg.per "DECOB,DECOB_PDCCH_0_STATUS_RD2"
)
if "&choice"=="DECOB_PDCCH_1_STATUS_RD0"
(
  per.view hwioreg.per "DECOB,DECOB_PDCCH_1_STATUS_RD0"
)
if "&choice"=="DECOB_PDCCH_1_STATUS_RD1"
(
  per.view hwioreg.per "DECOB,DECOB_PDCCH_1_STATUS_RD1"
)
if "&choice"=="DECOB_PDCCH_1_STATUS_RD2"
(
  per.view hwioreg.per "DECOB,DECOB_PDCCH_1_STATUS_RD2"
)
if "&choice"=="DECOB_GCH_0_DATA_RD"
(
  per.view hwioreg.per "DECOB,DECOB_GCH_0_DATA_RD"
)
if "&choice"=="DECOB_GCH_1_DATA_RD"
(
  per.view hwioreg.per "DECOB,DECOB_GCH_1_DATA_RD"
)
if "&choice"=="DECOB_GCH_0_STATUS_RD"
(
  per.view hwioreg.per "DECOB,DECOB_GCH_0_STATUS_RD"
)
if "&choice"=="DECOB_GCH_1_STATUS_RD"
(
  per.view hwioreg.per "DECOB,DECOB_GCH_1_STATUS_RD"
)
if "&choice"=="DECOB_TEST_CTL"
(
  per.view hwioreg.per "DECOB,DECOB_TEST_CTL"
)
if "&choice"=="DECOB_HW_CLK_CTL"
(
  per.view hwioreg.per "DECOB,DECOB_HW_CLK_CTL"
)
if "&choice"=="DECOB_MICRO_CLK_CTL"
(
  per.view hwioreg.per "DECOB,DECOB_MICRO_CLK_CTL"
)
if "&choice"=="DECOB_CLK_STATUS"
(
  per.view hwioreg.per "DECOB,DECOB_CLK_STATUS"
)
if "&choice"=="DECOB_CLK_SPARE_READ_REG0"
(
  per.view hwioreg.per "DECOB,DECOB_CLK_SPARE_READ_REG0"
)
if "&choice"=="DINT_RESET"
(
  per.view hwioreg.per "DEINT,DINT_RESET"
)
if "&choice"=="DINT_CFG"
(
  per.view hwioreg.per "DEINT,DINT_CFG"
)
if "&choice"=="DINT_CH0_CFG"
(
  per.view hwioreg.per "DEINT,DINT_CH0_CFG"
)
if "&choice"=="DINT_CH1_CFG"
(
  per.view hwioreg.per "DEINT,DINT_CH1_CFG"
)
if "&choice"=="DINT_CH2_CFG"
(
  per.view hwioreg.per "DEINT,DINT_CH2_CFG"
)
if "&choice"=="DINT_CH3_CFG"
(
  per.view hwioreg.per "DEINT,DINT_CH3_CFG"
)
if "&choice"=="TD_BLOCK_SIZE"
(
  per.view hwioreg.per "DEINT,TD_BLOCK_SIZE"
)
if "&choice"=="TD_INTLV_CFG_LO"
(
  per.view hwioreg.per "DEINT,TD_INTLV_CFG_LO"
)
if "&choice"=="TD_INTLV_CFG_HI"
(
  per.view hwioreg.per "DEINT,TD_INTLV_CFG_HI"
)
if "&choice"=="TD_INTLV_SIZE_LO"
(
  per.view hwioreg.per "DEINT,TD_INTLV_SIZE_LO"
)
if "&choice"=="TD_INTLV_SIZE_HI"
(
  per.view hwioreg.per "DEINT,TD_INTLV_SIZE_HI"
)
if "&choice"=="TD_PUNCT_LO"
(
  per.view hwioreg.per "DEINT,TD_PUNCT_LO"
)
if "&choice"=="TD_PUNCT_HI"
(
  per.view hwioreg.per "DEINT,TD_PUNCT_HI"
)
if "&choice"=="TD_PARAMS_LO"
(
  per.view hwioreg.per "DEINT,TD_PARAMS_LO"
)
if "&choice"=="TD_PARAMS_HI"
(
  per.view hwioreg.per "DEINT,TD_PARAMS_HI"
)
if "&choice"=="DINT_PKT_OFFSET"
(
  per.view hwioreg.per "DEINT,DINT_PKT_OFFSET"
)
if "&choice"=="DINT_PKT_CFG"
(
  per.view hwioreg.per "DEINT,DINT_PKT_CFG"
)
if "&choice"=="DINT_TASK_OFFSET"
(
  per.view hwioreg.per "DEINT,DINT_TASK_OFFSET"
)
if "&choice"=="DINT_TASK_LIST"
(
  per.view hwioreg.per "DEINT,DINT_TASK_LIST"
)
if "&choice"=="TST_SYNC_DINT"
(
  per.view hwioreg.per "DEINT,TST_SYNC_DINT"
)
if "&choice"=="TST_CH0_SYMS"
(
  per.view hwioreg.per "DEINT,TST_CH0_SYMS"
)
if "&choice"=="TST_CH1_SYMS"
(
  per.view hwioreg.per "DEINT,TST_CH1_SYMS"
)
if "&choice"=="TST_CH2_SYMS"
(
  per.view hwioreg.per "DEINT,TST_CH2_SYMS"
)
if "&choice"=="TST_SEQ_PROC_PHASE"
(
  per.view hwioreg.per "DEINT,TST_SEQ_PROC_PHASE"
)
if "&choice"=="TST_SEL_DINT"
(
  per.view hwioreg.per "DEINT,TST_SEL_DINT"
)
if "&choice"=="DINT_OTD_CFG"
(
  per.view hwioreg.per "DEINT,DINT_OTD_CFG"
)
if "&choice"=="TD_MIN_LLR_THRESH"
(
  per.view hwioreg.per "DEINT,TD_MIN_LLR_THRESH"
)
if "&choice"=="TD_INTLV_LEN_X2"
(
  per.view hwioreg.per "DEINT,TD_INTLV_LEN_X2"
)
if "&choice"=="TD_INTLV_LEN_X4"
(
  per.view hwioreg.per "DEINT,TD_INTLV_LEN_X4"
)
if "&choice"=="TD_INTLV_LEN_X8"
(
  per.view hwioreg.per "DEINT,TD_INTLV_LEN_X8"
)
if "&choice"=="TD_NUM_SLWIN_X2"
(
  per.view hwioreg.per "DEINT,TD_NUM_SLWIN_X2"
)
if "&choice"=="TD_NUM_SLWIN_X4"
(
  per.view hwioreg.per "DEINT,TD_NUM_SLWIN_X4"
)
if "&choice"=="TD_NUM_SLWIN_X8"
(
  per.view hwioreg.per "DEINT,TD_NUM_SLWIN_X8"
)
if "&choice"=="DINT_GCH_CFG0"
(
  per.view hwioreg.per "DEINT,DINT_GCH_CFG0"
)
if "&choice"=="DINT_GCH_CFG1"
(
  per.view hwioreg.per "DEINT,DINT_GCH_CFG1"
)
if "&choice"=="DINT_GCH_CFG2"
(
  per.view hwioreg.per "DEINT,DINT_GCH_CFG2"
)
if "&choice"=="DINT_GCH_CFG3"
(
  per.view hwioreg.per "DEINT,DINT_GCH_CFG3"
)
if "&choice"=="DINT_PDCCH_CFG"
(
  per.view hwioreg.per "DEINT,DINT_PDCCH_CFG"
)
if "&choice"=="DINT_PDCCH_HYP0_CFG0"
(
  per.view hwioreg.per "DEINT,DINT_PDCCH_HYP0_CFG0"
)
if "&choice"=="DINT_PDCCH_HYP1_CFG0"
(
  per.view hwioreg.per "DEINT,DINT_PDCCH_HYP1_CFG0"
)
if "&choice"=="DINT_PDCCH_HYP2_CFG0"
(
  per.view hwioreg.per "DEINT,DINT_PDCCH_HYP2_CFG0"
)
if "&choice"=="DINT_PDCCH_HYP0_CFG1"
(
  per.view hwioreg.per "DEINT,DINT_PDCCH_HYP0_CFG1"
)
if "&choice"=="DINT_PDCCH_HYP1_CFG1"
(
  per.view hwioreg.per "DEINT,DINT_PDCCH_HYP1_CFG1"
)
if "&choice"=="DINT_PDCCH_HYP2_CFG1"
(
  per.view hwioreg.per "DEINT,DINT_PDCCH_HYP2_CFG1"
)
if "&choice"=="DINT_TEST_MEM_SEL"
(
  per.view hwioreg.per "DEINT,DINT_TEST_MEM_SEL"
)
if "&choice"=="DINT_TEST_MEM_ADDR"
(
  per.view hwioreg.per "DEINT,DINT_TEST_MEM_ADDR"
)
if "&choice"=="DINT_TEST_MEM_WRITE"
(
  per.view hwioreg.per "DEINT,DINT_TEST_MEM_WRITE"
)
if "&choice"=="DINT_TEST_MEM_READ0"
(
  per.view hwioreg.per "DEINT,DINT_TEST_MEM_READ0"
)
if "&choice"=="TST_PDCCH_TASK"
(
  per.view hwioreg.per "DEINT,TST_PDCCH_TASK"
)
if "&choice"=="TST_SYS_TIME"
(
  per.view hwioreg.per "DEINT,TST_SYS_TIME"
)
if "&choice"=="DEINT_DBG_BUS_CTL"
(
  per.view hwioreg.per "DEINT,DEINT_DBG_BUS_CTL"
)
if "&choice"=="DEINT_CLK_SPARE_READ_REG0"
(
  per.view hwioreg.per "DEINT,DEINT_CLK_SPARE_READ_REG0"
)
if "&choice"=="DEINT_CLK_SPARE_READ_REG1"
(
  per.view hwioreg.per "DEINT,DEINT_CLK_SPARE_READ_REG1"
)
if "&choice"=="DEINT_HW_CLK_CTL"
(
  per.view hwioreg.per "DEINT,DEINT_HW_CLK_CTL"
)
if "&choice"=="DEINT_MICRO_CLK_CTL"
(
  per.view hwioreg.per "DEINT,DEINT_MICRO_CLK_CTL"
)
if "&choice"=="DEINT_CLK_STATUS"
(
  per.view hwioreg.per "DEINT,DEINT_CLK_STATUS"
)
if "&choice"=="DEC_DONE_INT_STATUS"
(
  per.view hwioreg.per "DEINT,DEC_DONE_INT_STATUS"
)
if "&choice"=="DEINT_TASK_STATUS"
(
  per.view hwioreg.per "DEINT,DEINT_TASK_STATUS"
)
if "&choice"=="DEINT_FRMHYP_STATUS"
(
  per.view hwioreg.per "DEINT,DEINT_FRMHYP_STATUS"
)
if "&choice"=="DINT_VD_RD_ADDR"
(
  per.view hwioreg.per "DEINT,DINT_VD_RD_ADDR"
)
if "&choice"=="DINT_TD_WR_ADDR"
(
  per.view hwioreg.per "DEINT,DINT_TD_WR_ADDR"
)
if "&choice"=="DEM1X_F0_PILOT_IMMED"
(
  per.view hwioreg.per "DEMOD,DEMOD_1X_OFFLINE,DEM1X_F0_PILOT_IMMED"
)
if "&choice"=="DEM1X_F1_PILOT_IMMED"
(
  per.view hwioreg.per "DEMOD,DEMOD_1X_OFFLINE,DEM1X_F1_PILOT_IMMED"
)
if "&choice"=="DEM1X_F2_PILOT_IMMED"
(
  per.view hwioreg.per "DEMOD,DEMOD_1X_OFFLINE,DEM1X_F2_PILOT_IMMED"
)
if "&choice"=="DEM1X_F3_PILOT_IMMED"
(
  per.view hwioreg.per "DEMOD,DEMOD_1X_OFFLINE,DEM1X_F3_PILOT_IMMED"
)
if "&choice"=="DEM1X_F4_PILOT_IMMED"
(
  per.view hwioreg.per "DEMOD,DEMOD_1X_OFFLINE,DEM1X_F4_PILOT_IMMED"
)
if "&choice"=="DEM1X_F5_PILOT_IMMED"
(
  per.view hwioreg.per "DEMOD,DEMOD_1X_OFFLINE,DEM1X_F5_PILOT_IMMED"
)
if "&choice"=="DEM1X_F6_PILOT_IMMED"
(
  per.view hwioreg.per "DEMOD,DEMOD_1X_OFFLINE,DEM1X_F6_PILOT_IMMED"
)
if "&choice"=="DEM1X_F7_PILOT_IMMED"
(
  per.view hwioreg.per "DEMOD,DEMOD_1X_OFFLINE,DEM1X_F7_PILOT_IMMED"
)
if "&choice"=="DEM1X_F0_DIVERSITY_IMMED"
(
  per.view hwioreg.per "DEMOD,DEMOD_1X_OFFLINE,DEM1X_F0_DIVERSITY_IMMED"
)
if "&choice"=="DEM1X_F1_DIVERSITY_IMMED"
(
  per.view hwioreg.per "DEMOD,DEMOD_1X_OFFLINE,DEM1X_F1_DIVERSITY_IMMED"
)
if "&choice"=="DEM1X_F2_DIVERSITY_IMMED"
(
  per.view hwioreg.per "DEMOD,DEMOD_1X_OFFLINE,DEM1X_F2_DIVERSITY_IMMED"
)
if "&choice"=="DEM1X_F3_DIVERSITY_IMMED"
(
  per.view hwioreg.per "DEMOD,DEMOD_1X_OFFLINE,DEM1X_F3_DIVERSITY_IMMED"
)
if "&choice"=="DEM1X_F4_DIVERSITY_IMMED"
(
  per.view hwioreg.per "DEMOD,DEMOD_1X_OFFLINE,DEM1X_F4_DIVERSITY_IMMED"
)
if "&choice"=="DEM1X_F5_DIVERSITY_IMMED"
(
  per.view hwioreg.per "DEMOD,DEMOD_1X_OFFLINE,DEM1X_F5_DIVERSITY_IMMED"
)
if "&choice"=="DEM1X_F6_DIVERSITY_IMMED"
(
  per.view hwioreg.per "DEMOD,DEMOD_1X_OFFLINE,DEM1X_F6_DIVERSITY_IMMED"
)
if "&choice"=="DEM1X_F7_DIVERSITY_IMMED"
(
  per.view hwioreg.per "DEMOD,DEMOD_1X_OFFLINE,DEM1X_F7_DIVERSITY_IMMED"
)
if "&choice"=="DEM1X_F0_WALSH_ACC0_IMMED"
(
  per.view hwioreg.per "DEMOD,DEMOD_1X_OFFLINE,DEM1X_F0_WALSH_ACC0_IMMED"
)
if "&choice"=="DEM1X_F0_WALSH_ACC1_IMMED"
(
  per.view hwioreg.per "DEMOD,DEMOD_1X_OFFLINE,DEM1X_F0_WALSH_ACC1_IMMED"
)
if "&choice"=="DEM1X_F0_WALSH_ACC2_IMMED"
(
  per.view hwioreg.per "DEMOD,DEMOD_1X_OFFLINE,DEM1X_F0_WALSH_ACC2_IMMED"
)
if "&choice"=="DEM1X_F0_WALSH_ACC3_IMMED"
(
  per.view hwioreg.per "DEMOD,DEMOD_1X_OFFLINE,DEM1X_F0_WALSH_ACC3_IMMED"
)
if "&choice"=="DEM1X_F0_WALSH_ACC4_IMMED"
(
  per.view hwioreg.per "DEMOD,DEMOD_1X_OFFLINE,DEM1X_F0_WALSH_ACC4_IMMED"
)
if "&choice"=="DEM1X_F0_WALSH_ACC5_IMMED"
(
  per.view hwioreg.per "DEMOD,DEMOD_1X_OFFLINE,DEM1X_F0_WALSH_ACC5_IMMED"
)
if "&choice"=="DEM1X_F0_WALSH_ACC6_IMMED"
(
  per.view hwioreg.per "DEMOD,DEMOD_1X_OFFLINE,DEM1X_F0_WALSH_ACC6_IMMED"
)
if "&choice"=="DEM1X_F0_WALSH_ACC7_IMMED"
(
  per.view hwioreg.per "DEMOD,DEMOD_1X_OFFLINE,DEM1X_F0_WALSH_ACC7_IMMED"
)
if "&choice"=="DEM1X_F0_WALSH_ACC8_IMMED"
(
  per.view hwioreg.per "DEMOD,DEMOD_1X_OFFLINE,DEM1X_F0_WALSH_ACC8_IMMED"
)
if "&choice"=="DEM1X_F0_WALSH_ACC9_IMMED"
(
  per.view hwioreg.per "DEMOD,DEMOD_1X_OFFLINE,DEM1X_F0_WALSH_ACC9_IMMED"
)
if "&choice"=="DEM1X_F0_WALSH_ACC10_IMMED"
(
  per.view hwioreg.per "DEMOD,DEMOD_1X_OFFLINE,DEM1X_F0_WALSH_ACC10_IMMED"
)
if "&choice"=="DEM1X_F0_WALSH_ACC11_IMMED"
(
  per.view hwioreg.per "DEMOD,DEMOD_1X_OFFLINE,DEM1X_F0_WALSH_ACC11_IMMED"
)
if "&choice"=="DEM1X_F0_WALSH_ACC12_IMMED"
(
  per.view hwioreg.per "DEMOD,DEMOD_1X_OFFLINE,DEM1X_F0_WALSH_ACC12_IMMED"
)
if "&choice"=="DEM1X_F0_WALSH_ACC13_IMMED"
(
  per.view hwioreg.per "DEMOD,DEMOD_1X_OFFLINE,DEM1X_F0_WALSH_ACC13_IMMED"
)
if "&choice"=="DEM1X_F1_WALSH_ACC0_IMMED"
(
  per.view hwioreg.per "DEMOD,DEMOD_1X_OFFLINE,DEM1X_F1_WALSH_ACC0_IMMED"
)
if "&choice"=="DEM1X_F1_WALSH_ACC1_IMMED"
(
  per.view hwioreg.per "DEMOD,DEMOD_1X_OFFLINE,DEM1X_F1_WALSH_ACC1_IMMED"
)
if "&choice"=="DEM1X_F1_WALSH_ACC2_IMMED"
(
  per.view hwioreg.per "DEMOD,DEMOD_1X_OFFLINE,DEM1X_F1_WALSH_ACC2_IMMED"
)
if "&choice"=="DEM1X_F1_WALSH_ACC3_IMMED"
(
  per.view hwioreg.per "DEMOD,DEMOD_1X_OFFLINE,DEM1X_F1_WALSH_ACC3_IMMED"
)
if "&choice"=="DEM1X_F1_WALSH_ACC4_IMMED"
(
  per.view hwioreg.per "DEMOD,DEMOD_1X_OFFLINE,DEM1X_F1_WALSH_ACC4_IMMED"
)
if "&choice"=="DEM1X_F1_WALSH_ACC5_IMMED"
(
  per.view hwioreg.per "DEMOD,DEMOD_1X_OFFLINE,DEM1X_F1_WALSH_ACC5_IMMED"
)
if "&choice"=="DEM1X_F1_WALSH_ACC6_IMMED"
(
  per.view hwioreg.per "DEMOD,DEMOD_1X_OFFLINE,DEM1X_F1_WALSH_ACC6_IMMED"
)
if "&choice"=="DEM1X_F1_WALSH_ACC7_IMMED"
(
  per.view hwioreg.per "DEMOD,DEMOD_1X_OFFLINE,DEM1X_F1_WALSH_ACC7_IMMED"
)
if "&choice"=="DEM1X_F1_WALSH_ACC8_IMMED"
(
  per.view hwioreg.per "DEMOD,DEMOD_1X_OFFLINE,DEM1X_F1_WALSH_ACC8_IMMED"
)
if "&choice"=="DEM1X_F1_WALSH_ACC9_IMMED"
(
  per.view hwioreg.per "DEMOD,DEMOD_1X_OFFLINE,DEM1X_F1_WALSH_ACC9_IMMED"
)
if "&choice"=="DEM1X_F1_WALSH_ACC10_IMMED"
(
  per.view hwioreg.per "DEMOD,DEMOD_1X_OFFLINE,DEM1X_F1_WALSH_ACC10_IMMED"
)
if "&choice"=="DEM1X_F1_WALSH_ACC11_IMMED"
(
  per.view hwioreg.per "DEMOD,DEMOD_1X_OFFLINE,DEM1X_F1_WALSH_ACC11_IMMED"
)
if "&choice"=="DEM1X_F1_WALSH_ACC12_IMMED"
(
  per.view hwioreg.per "DEMOD,DEMOD_1X_OFFLINE,DEM1X_F1_WALSH_ACC12_IMMED"
)
if "&choice"=="DEM1X_F1_WALSH_ACC13_IMMED"
(
  per.view hwioreg.per "DEMOD,DEMOD_1X_OFFLINE,DEM1X_F1_WALSH_ACC13_IMMED"
)
if "&choice"=="DEM1X_F2_WALSH_ACC0_IMMED"
(
  per.view hwioreg.per "DEMOD,DEMOD_1X_OFFLINE,DEM1X_F2_WALSH_ACC0_IMMED"
)
if "&choice"=="DEM1X_F2_WALSH_ACC1_IMMED"
(
  per.view hwioreg.per "DEMOD,DEMOD_1X_OFFLINE,DEM1X_F2_WALSH_ACC1_IMMED"
)
if "&choice"=="DEM1X_F2_WALSH_ACC2_IMMED"
(
  per.view hwioreg.per "DEMOD,DEMOD_1X_OFFLINE,DEM1X_F2_WALSH_ACC2_IMMED"
)
if "&choice"=="DEM1X_F2_WALSH_ACC3_IMMED"
(
  per.view hwioreg.per "DEMOD,DEMOD_1X_OFFLINE,DEM1X_F2_WALSH_ACC3_IMMED"
)
if "&choice"=="DEM1X_F2_WALSH_ACC4_IMMED"
(
  per.view hwioreg.per "DEMOD,DEMOD_1X_OFFLINE,DEM1X_F2_WALSH_ACC4_IMMED"
)
if "&choice"=="DEM1X_F2_WALSH_ACC5_IMMED"
(
  per.view hwioreg.per "DEMOD,DEMOD_1X_OFFLINE,DEM1X_F2_WALSH_ACC5_IMMED"
)
if "&choice"=="DEM1X_F2_WALSH_ACC6_IMMED"
(
  per.view hwioreg.per "DEMOD,DEMOD_1X_OFFLINE,DEM1X_F2_WALSH_ACC6_IMMED"
)
if "&choice"=="DEM1X_F2_WALSH_ACC7_IMMED"
(
  per.view hwioreg.per "DEMOD,DEMOD_1X_OFFLINE,DEM1X_F2_WALSH_ACC7_IMMED"
)
if "&choice"=="DEM1X_F2_WALSH_ACC8_IMMED"
(
  per.view hwioreg.per "DEMOD,DEMOD_1X_OFFLINE,DEM1X_F2_WALSH_ACC8_IMMED"
)
if "&choice"=="DEM1X_F2_WALSH_ACC9_IMMED"
(
  per.view hwioreg.per "DEMOD,DEMOD_1X_OFFLINE,DEM1X_F2_WALSH_ACC9_IMMED"
)
if "&choice"=="DEM1X_F2_WALSH_ACC10_IMMED"
(
  per.view hwioreg.per "DEMOD,DEMOD_1X_OFFLINE,DEM1X_F2_WALSH_ACC10_IMMED"
)
if "&choice"=="DEM1X_F2_WALSH_ACC11_IMMED"
(
  per.view hwioreg.per "DEMOD,DEMOD_1X_OFFLINE,DEM1X_F2_WALSH_ACC11_IMMED"
)
if "&choice"=="DEM1X_F2_WALSH_ACC12_IMMED"
(
  per.view hwioreg.per "DEMOD,DEMOD_1X_OFFLINE,DEM1X_F2_WALSH_ACC12_IMMED"
)
if "&choice"=="DEM1X_F2_WALSH_ACC13_IMMED"
(
  per.view hwioreg.per "DEMOD,DEMOD_1X_OFFLINE,DEM1X_F2_WALSH_ACC13_IMMED"
)
if "&choice"=="DEM1X_F3_WALSH_ACC0_IMMED"
(
  per.view hwioreg.per "DEMOD,DEMOD_1X_OFFLINE,DEM1X_F3_WALSH_ACC0_IMMED"
)
if "&choice"=="DEM1X_F3_WALSH_ACC1_IMMED"
(
  per.view hwioreg.per "DEMOD,DEMOD_1X_OFFLINE,DEM1X_F3_WALSH_ACC1_IMMED"
)
if "&choice"=="DEM1X_F3_WALSH_ACC2_IMMED"
(
  per.view hwioreg.per "DEMOD,DEMOD_1X_OFFLINE,DEM1X_F3_WALSH_ACC2_IMMED"
)
if "&choice"=="DEM1X_F3_WALSH_ACC3_IMMED"
(
  per.view hwioreg.per "DEMOD,DEMOD_1X_OFFLINE,DEM1X_F3_WALSH_ACC3_IMMED"
)
if "&choice"=="DEM1X_F3_WALSH_ACC4_IMMED"
(
  per.view hwioreg.per "DEMOD,DEMOD_1X_OFFLINE,DEM1X_F3_WALSH_ACC4_IMMED"
)
if "&choice"=="DEM1X_F3_WALSH_ACC5_IMMED"
(
  per.view hwioreg.per "DEMOD,DEMOD_1X_OFFLINE,DEM1X_F3_WALSH_ACC5_IMMED"
)
if "&choice"=="DEM1X_F3_WALSH_ACC6_IMMED"
(
  per.view hwioreg.per "DEMOD,DEMOD_1X_OFFLINE,DEM1X_F3_WALSH_ACC6_IMMED"
)
if "&choice"=="DEM1X_F3_WALSH_ACC7_IMMED"
(
  per.view hwioreg.per "DEMOD,DEMOD_1X_OFFLINE,DEM1X_F3_WALSH_ACC7_IMMED"
)
if "&choice"=="DEM1X_F3_WALSH_ACC8_IMMED"
(
  per.view hwioreg.per "DEMOD,DEMOD_1X_OFFLINE,DEM1X_F3_WALSH_ACC8_IMMED"
)
if "&choice"=="DEM1X_F3_WALSH_ACC9_IMMED"
(
  per.view hwioreg.per "DEMOD,DEMOD_1X_OFFLINE,DEM1X_F3_WALSH_ACC9_IMMED"
)
if "&choice"=="DEM1X_F3_WALSH_ACC10_IMMED"
(
  per.view hwioreg.per "DEMOD,DEMOD_1X_OFFLINE,DEM1X_F3_WALSH_ACC10_IMMED"
)
if "&choice"=="DEM1X_F3_WALSH_ACC11_IMMED"
(
  per.view hwioreg.per "DEMOD,DEMOD_1X_OFFLINE,DEM1X_F3_WALSH_ACC11_IMMED"
)
if "&choice"=="DEM1X_F3_WALSH_ACC12_IMMED"
(
  per.view hwioreg.per "DEMOD,DEMOD_1X_OFFLINE,DEM1X_F3_WALSH_ACC12_IMMED"
)
if "&choice"=="DEM1X_F3_WALSH_ACC13_IMMED"
(
  per.view hwioreg.per "DEMOD,DEMOD_1X_OFFLINE,DEM1X_F3_WALSH_ACC13_IMMED"
)
if "&choice"=="DEM1X_F4_WALSH_ACC0_IMMED"
(
  per.view hwioreg.per "DEMOD,DEMOD_1X_OFFLINE,DEM1X_F4_WALSH_ACC0_IMMED"
)
if "&choice"=="DEM1X_F4_WALSH_ACC1_IMMED"
(
  per.view hwioreg.per "DEMOD,DEMOD_1X_OFFLINE,DEM1X_F4_WALSH_ACC1_IMMED"
)
if "&choice"=="DEM1X_F4_WALSH_ACC2_IMMED"
(
  per.view hwioreg.per "DEMOD,DEMOD_1X_OFFLINE,DEM1X_F4_WALSH_ACC2_IMMED"
)
if "&choice"=="DEM1X_F4_WALSH_ACC3_IMMED"
(
  per.view hwioreg.per "DEMOD,DEMOD_1X_OFFLINE,DEM1X_F4_WALSH_ACC3_IMMED"
)
if "&choice"=="DEM1X_F4_WALSH_ACC4_IMMED"
(
  per.view hwioreg.per "DEMOD,DEMOD_1X_OFFLINE,DEM1X_F4_WALSH_ACC4_IMMED"
)
if "&choice"=="DEM1X_F4_WALSH_ACC5_IMMED"
(
  per.view hwioreg.per "DEMOD,DEMOD_1X_OFFLINE,DEM1X_F4_WALSH_ACC5_IMMED"
)
if "&choice"=="DEM1X_F4_WALSH_ACC6_IMMED"
(
  per.view hwioreg.per "DEMOD,DEMOD_1X_OFFLINE,DEM1X_F4_WALSH_ACC6_IMMED"
)
if "&choice"=="DEM1X_F4_WALSH_ACC7_IMMED"
(
  per.view hwioreg.per "DEMOD,DEMOD_1X_OFFLINE,DEM1X_F4_WALSH_ACC7_IMMED"
)
if "&choice"=="DEM1X_F4_WALSH_ACC8_IMMED"
(
  per.view hwioreg.per "DEMOD,DEMOD_1X_OFFLINE,DEM1X_F4_WALSH_ACC8_IMMED"
)
if "&choice"=="DEM1X_F4_WALSH_ACC9_IMMED"
(
  per.view hwioreg.per "DEMOD,DEMOD_1X_OFFLINE,DEM1X_F4_WALSH_ACC9_IMMED"
)
if "&choice"=="DEM1X_F4_WALSH_ACC10_IMMED"
(
  per.view hwioreg.per "DEMOD,DEMOD_1X_OFFLINE,DEM1X_F4_WALSH_ACC10_IMMED"
)
if "&choice"=="DEM1X_F4_WALSH_ACC11_IMMED"
(
  per.view hwioreg.per "DEMOD,DEMOD_1X_OFFLINE,DEM1X_F4_WALSH_ACC11_IMMED"
)
if "&choice"=="DEM1X_F4_WALSH_ACC12_IMMED"
(
  per.view hwioreg.per "DEMOD,DEMOD_1X_OFFLINE,DEM1X_F4_WALSH_ACC12_IMMED"
)
if "&choice"=="DEM1X_F4_WALSH_ACC13_IMMED"
(
  per.view hwioreg.per "DEMOD,DEMOD_1X_OFFLINE,DEM1X_F4_WALSH_ACC13_IMMED"
)
if "&choice"=="DEM1X_F5_WALSH_ACC0_IMMED"
(
  per.view hwioreg.per "DEMOD,DEMOD_1X_OFFLINE,DEM1X_F5_WALSH_ACC0_IMMED"
)
if "&choice"=="DEM1X_F5_WALSH_ACC1_IMMED"
(
  per.view hwioreg.per "DEMOD,DEMOD_1X_OFFLINE,DEM1X_F5_WALSH_ACC1_IMMED"
)
if "&choice"=="DEM1X_F5_WALSH_ACC2_IMMED"
(
  per.view hwioreg.per "DEMOD,DEMOD_1X_OFFLINE,DEM1X_F5_WALSH_ACC2_IMMED"
)
if "&choice"=="DEM1X_F5_WALSH_ACC3_IMMED"
(
  per.view hwioreg.per "DEMOD,DEMOD_1X_OFFLINE,DEM1X_F5_WALSH_ACC3_IMMED"
)
if "&choice"=="DEM1X_F5_WALSH_ACC4_IMMED"
(
  per.view hwioreg.per "DEMOD,DEMOD_1X_OFFLINE,DEM1X_F5_WALSH_ACC4_IMMED"
)
if "&choice"=="DEM1X_F5_WALSH_ACC5_IMMED"
(
  per.view hwioreg.per "DEMOD,DEMOD_1X_OFFLINE,DEM1X_F5_WALSH_ACC5_IMMED"
)
if "&choice"=="DEM1X_F5_WALSH_ACC6_IMMED"
(
  per.view hwioreg.per "DEMOD,DEMOD_1X_OFFLINE,DEM1X_F5_WALSH_ACC6_IMMED"
)
if "&choice"=="DEM1X_F5_WALSH_ACC7_IMMED"
(
  per.view hwioreg.per "DEMOD,DEMOD_1X_OFFLINE,DEM1X_F5_WALSH_ACC7_IMMED"
)
if "&choice"=="DEM1X_F5_WALSH_ACC8_IMMED"
(
  per.view hwioreg.per "DEMOD,DEMOD_1X_OFFLINE,DEM1X_F5_WALSH_ACC8_IMMED"
)
if "&choice"=="DEM1X_F5_WALSH_ACC9_IMMED"
(
  per.view hwioreg.per "DEMOD,DEMOD_1X_OFFLINE,DEM1X_F5_WALSH_ACC9_IMMED"
)
if "&choice"=="DEM1X_F5_WALSH_ACC10_IMMED"
(
  per.view hwioreg.per "DEMOD,DEMOD_1X_OFFLINE,DEM1X_F5_WALSH_ACC10_IMMED"
)
if "&choice"=="DEM1X_F5_WALSH_ACC11_IMMED"
(
  per.view hwioreg.per "DEMOD,DEMOD_1X_OFFLINE,DEM1X_F5_WALSH_ACC11_IMMED"
)
if "&choice"=="DEM1X_F5_WALSH_ACC12_IMMED"
(
  per.view hwioreg.per "DEMOD,DEMOD_1X_OFFLINE,DEM1X_F5_WALSH_ACC12_IMMED"
)
if "&choice"=="DEM1X_F5_WALSH_ACC13_IMMED"
(
  per.view hwioreg.per "DEMOD,DEMOD_1X_OFFLINE,DEM1X_F5_WALSH_ACC13_IMMED"
)
if "&choice"=="DEM1X_F6_WALSH_ACC0_IMMED"
(
  per.view hwioreg.per "DEMOD,DEMOD_1X_OFFLINE,DEM1X_F6_WALSH_ACC0_IMMED"
)
if "&choice"=="DEM1X_F6_WALSH_ACC1_IMMED"
(
  per.view hwioreg.per "DEMOD,DEMOD_1X_OFFLINE,DEM1X_F6_WALSH_ACC1_IMMED"
)
if "&choice"=="DEM1X_F6_WALSH_ACC2_IMMED"
(
  per.view hwioreg.per "DEMOD,DEMOD_1X_OFFLINE,DEM1X_F6_WALSH_ACC2_IMMED"
)
if "&choice"=="DEM1X_F6_WALSH_ACC3_IMMED"
(
  per.view hwioreg.per "DEMOD,DEMOD_1X_OFFLINE,DEM1X_F6_WALSH_ACC3_IMMED"
)
if "&choice"=="DEM1X_F6_WALSH_ACC4_IMMED"
(
  per.view hwioreg.per "DEMOD,DEMOD_1X_OFFLINE,DEM1X_F6_WALSH_ACC4_IMMED"
)
if "&choice"=="DEM1X_F6_WALSH_ACC5_IMMED"
(
  per.view hwioreg.per "DEMOD,DEMOD_1X_OFFLINE,DEM1X_F6_WALSH_ACC5_IMMED"
)
if "&choice"=="DEM1X_F6_WALSH_ACC6_IMMED"
(
  per.view hwioreg.per "DEMOD,DEMOD_1X_OFFLINE,DEM1X_F6_WALSH_ACC6_IMMED"
)
if "&choice"=="DEM1X_F6_WALSH_ACC7_IMMED"
(
  per.view hwioreg.per "DEMOD,DEMOD_1X_OFFLINE,DEM1X_F6_WALSH_ACC7_IMMED"
)
if "&choice"=="DEM1X_F6_WALSH_ACC8_IMMED"
(
  per.view hwioreg.per "DEMOD,DEMOD_1X_OFFLINE,DEM1X_F6_WALSH_ACC8_IMMED"
)
if "&choice"=="DEM1X_F6_WALSH_ACC9_IMMED"
(
  per.view hwioreg.per "DEMOD,DEMOD_1X_OFFLINE,DEM1X_F6_WALSH_ACC9_IMMED"
)
if "&choice"=="DEM1X_F6_WALSH_ACC10_IMMED"
(
  per.view hwioreg.per "DEMOD,DEMOD_1X_OFFLINE,DEM1X_F6_WALSH_ACC10_IMMED"
)
if "&choice"=="DEM1X_F6_WALSH_ACC11_IMMED"
(
  per.view hwioreg.per "DEMOD,DEMOD_1X_OFFLINE,DEM1X_F6_WALSH_ACC11_IMMED"
)
if "&choice"=="DEM1X_F6_WALSH_ACC12_IMMED"
(
  per.view hwioreg.per "DEMOD,DEMOD_1X_OFFLINE,DEM1X_F6_WALSH_ACC12_IMMED"
)
if "&choice"=="DEM1X_F6_WALSH_ACC13_IMMED"
(
  per.view hwioreg.per "DEMOD,DEMOD_1X_OFFLINE,DEM1X_F6_WALSH_ACC13_IMMED"
)
if "&choice"=="DEM1X_F7_WALSH_ACC0_IMMED"
(
  per.view hwioreg.per "DEMOD,DEMOD_1X_OFFLINE,DEM1X_F7_WALSH_ACC0_IMMED"
)
if "&choice"=="DEM1X_F7_WALSH_ACC1_IMMED"
(
  per.view hwioreg.per "DEMOD,DEMOD_1X_OFFLINE,DEM1X_F7_WALSH_ACC1_IMMED"
)
if "&choice"=="DEM1X_F7_WALSH_ACC2_IMMED"
(
  per.view hwioreg.per "DEMOD,DEMOD_1X_OFFLINE,DEM1X_F7_WALSH_ACC2_IMMED"
)
if "&choice"=="DEM1X_F7_WALSH_ACC3_IMMED"
(
  per.view hwioreg.per "DEMOD,DEMOD_1X_OFFLINE,DEM1X_F7_WALSH_ACC3_IMMED"
)
if "&choice"=="DEM1X_F7_WALSH_ACC4_IMMED"
(
  per.view hwioreg.per "DEMOD,DEMOD_1X_OFFLINE,DEM1X_F7_WALSH_ACC4_IMMED"
)
if "&choice"=="DEM1X_F7_WALSH_ACC5_IMMED"
(
  per.view hwioreg.per "DEMOD,DEMOD_1X_OFFLINE,DEM1X_F7_WALSH_ACC5_IMMED"
)
if "&choice"=="DEM1X_F7_WALSH_ACC6_IMMED"
(
  per.view hwioreg.per "DEMOD,DEMOD_1X_OFFLINE,DEM1X_F7_WALSH_ACC6_IMMED"
)
if "&choice"=="DEM1X_F7_WALSH_ACC7_IMMED"
(
  per.view hwioreg.per "DEMOD,DEMOD_1X_OFFLINE,DEM1X_F7_WALSH_ACC7_IMMED"
)
if "&choice"=="DEM1X_F7_WALSH_ACC8_IMMED"
(
  per.view hwioreg.per "DEMOD,DEMOD_1X_OFFLINE,DEM1X_F7_WALSH_ACC8_IMMED"
)
if "&choice"=="DEM1X_F7_WALSH_ACC9_IMMED"
(
  per.view hwioreg.per "DEMOD,DEMOD_1X_OFFLINE,DEM1X_F7_WALSH_ACC9_IMMED"
)
if "&choice"=="DEM1X_F7_WALSH_ACC10_IMMED"
(
  per.view hwioreg.per "DEMOD,DEMOD_1X_OFFLINE,DEM1X_F7_WALSH_ACC10_IMMED"
)
if "&choice"=="DEM1X_F7_WALSH_ACC11_IMMED"
(
  per.view hwioreg.per "DEMOD,DEMOD_1X_OFFLINE,DEM1X_F7_WALSH_ACC11_IMMED"
)
if "&choice"=="DEM1X_F7_WALSH_ACC12_IMMED"
(
  per.view hwioreg.per "DEMOD,DEMOD_1X_OFFLINE,DEM1X_F7_WALSH_ACC12_IMMED"
)
if "&choice"=="DEM1X_F7_WALSH_ACC13_IMMED"
(
  per.view hwioreg.per "DEMOD,DEMOD_1X_OFFLINE,DEM1X_F7_WALSH_ACC13_IMMED"
)
if "&choice"=="DEM1X_F0_WALSH_ACC0_FRAME"
(
  per.view hwioreg.per "DEMOD,DEMOD_1X_OFFLINE,DEM1X_F0_WALSH_ACC0_FRAME"
)
if "&choice"=="DEM1X_F0_WALSH_ACC1_FRAME"
(
  per.view hwioreg.per "DEMOD,DEMOD_1X_OFFLINE,DEM1X_F0_WALSH_ACC1_FRAME"
)
if "&choice"=="DEM1X_F0_WALSH_ACC2_FRAME"
(
  per.view hwioreg.per "DEMOD,DEMOD_1X_OFFLINE,DEM1X_F0_WALSH_ACC2_FRAME"
)
if "&choice"=="DEM1X_F0_WALSH_ACC3_FRAME"
(
  per.view hwioreg.per "DEMOD,DEMOD_1X_OFFLINE,DEM1X_F0_WALSH_ACC3_FRAME"
)
if "&choice"=="DEM1X_F0_WALSH_ACC4_FRAME"
(
  per.view hwioreg.per "DEMOD,DEMOD_1X_OFFLINE,DEM1X_F0_WALSH_ACC4_FRAME"
)
if "&choice"=="DEM1X_F0_WALSH_ACC5_FRAME"
(
  per.view hwioreg.per "DEMOD,DEMOD_1X_OFFLINE,DEM1X_F0_WALSH_ACC5_FRAME"
)
if "&choice"=="DEM1X_F0_WALSH_ACC6_FRAME"
(
  per.view hwioreg.per "DEMOD,DEMOD_1X_OFFLINE,DEM1X_F0_WALSH_ACC6_FRAME"
)
if "&choice"=="DEM1X_F0_WALSH_ACC7_FRAME"
(
  per.view hwioreg.per "DEMOD,DEMOD_1X_OFFLINE,DEM1X_F0_WALSH_ACC7_FRAME"
)
if "&choice"=="DEM1X_F0_WALSH_ACC8_FRAME"
(
  per.view hwioreg.per "DEMOD,DEMOD_1X_OFFLINE,DEM1X_F0_WALSH_ACC8_FRAME"
)
if "&choice"=="DEM1X_F0_WALSH_ACC9_FRAME"
(
  per.view hwioreg.per "DEMOD,DEMOD_1X_OFFLINE,DEM1X_F0_WALSH_ACC9_FRAME"
)
if "&choice"=="DEM1X_F0_WALSH_ACC10_FRAME"
(
  per.view hwioreg.per "DEMOD,DEMOD_1X_OFFLINE,DEM1X_F0_WALSH_ACC10_FRAME"
)
if "&choice"=="DEM1X_F0_WALSH_ACC11_FRAME"
(
  per.view hwioreg.per "DEMOD,DEMOD_1X_OFFLINE,DEM1X_F0_WALSH_ACC11_FRAME"
)
if "&choice"=="DEM1X_F0_WALSH_ACC12_FRAME"
(
  per.view hwioreg.per "DEMOD,DEMOD_1X_OFFLINE,DEM1X_F0_WALSH_ACC12_FRAME"
)
if "&choice"=="DEM1X_F0_WALSH_ACC13_FRAME"
(
  per.view hwioreg.per "DEMOD,DEMOD_1X_OFFLINE,DEM1X_F0_WALSH_ACC13_FRAME"
)
if "&choice"=="DEM1X_F1_WALSH_ACC0_FRAME"
(
  per.view hwioreg.per "DEMOD,DEMOD_1X_OFFLINE,DEM1X_F1_WALSH_ACC0_FRAME"
)
if "&choice"=="DEM1X_F1_WALSH_ACC1_FRAME"
(
  per.view hwioreg.per "DEMOD,DEMOD_1X_OFFLINE,DEM1X_F1_WALSH_ACC1_FRAME"
)
if "&choice"=="DEM1X_F1_WALSH_ACC2_FRAME"
(
  per.view hwioreg.per "DEMOD,DEMOD_1X_OFFLINE,DEM1X_F1_WALSH_ACC2_FRAME"
)
if "&choice"=="DEM1X_F1_WALSH_ACC3_FRAME"
(
  per.view hwioreg.per "DEMOD,DEMOD_1X_OFFLINE,DEM1X_F1_WALSH_ACC3_FRAME"
)
if "&choice"=="DEM1X_F1_WALSH_ACC4_FRAME"
(
  per.view hwioreg.per "DEMOD,DEMOD_1X_OFFLINE,DEM1X_F1_WALSH_ACC4_FRAME"
)
if "&choice"=="DEM1X_F1_WALSH_ACC5_FRAME"
(
  per.view hwioreg.per "DEMOD,DEMOD_1X_OFFLINE,DEM1X_F1_WALSH_ACC5_FRAME"
)
if "&choice"=="DEM1X_F1_WALSH_ACC6_FRAME"
(
  per.view hwioreg.per "DEMOD,DEMOD_1X_OFFLINE,DEM1X_F1_WALSH_ACC6_FRAME"
)
if "&choice"=="DEM1X_F1_WALSH_ACC7_FRAME"
(
  per.view hwioreg.per "DEMOD,DEMOD_1X_OFFLINE,DEM1X_F1_WALSH_ACC7_FRAME"
)
if "&choice"=="DEM1X_F1_WALSH_ACC8_FRAME"
(
  per.view hwioreg.per "DEMOD,DEMOD_1X_OFFLINE,DEM1X_F1_WALSH_ACC8_FRAME"
)
if "&choice"=="DEM1X_F1_WALSH_ACC9_FRAME"
(
  per.view hwioreg.per "DEMOD,DEMOD_1X_OFFLINE,DEM1X_F1_WALSH_ACC9_FRAME"
)
if "&choice"=="DEM1X_F1_WALSH_ACC10_FRAME"
(
  per.view hwioreg.per "DEMOD,DEMOD_1X_OFFLINE,DEM1X_F1_WALSH_ACC10_FRAME"
)
if "&choice"=="DEM1X_F1_WALSH_ACC11_FRAME"
(
  per.view hwioreg.per "DEMOD,DEMOD_1X_OFFLINE,DEM1X_F1_WALSH_ACC11_FRAME"
)
if "&choice"=="DEM1X_F1_WALSH_ACC12_FRAME"
(
  per.view hwioreg.per "DEMOD,DEMOD_1X_OFFLINE,DEM1X_F1_WALSH_ACC12_FRAME"
)
if "&choice"=="DEM1X_F1_WALSH_ACC13_FRAME"
(
  per.view hwioreg.per "DEMOD,DEMOD_1X_OFFLINE,DEM1X_F1_WALSH_ACC13_FRAME"
)
if "&choice"=="DEM1X_F2_WALSH_ACC0_FRAME"
(
  per.view hwioreg.per "DEMOD,DEMOD_1X_OFFLINE,DEM1X_F2_WALSH_ACC0_FRAME"
)
if "&choice"=="DEM1X_F2_WALSH_ACC1_FRAME"
(
  per.view hwioreg.per "DEMOD,DEMOD_1X_OFFLINE,DEM1X_F2_WALSH_ACC1_FRAME"
)
if "&choice"=="DEM1X_F2_WALSH_ACC2_FRAME"
(
  per.view hwioreg.per "DEMOD,DEMOD_1X_OFFLINE,DEM1X_F2_WALSH_ACC2_FRAME"
)
if "&choice"=="DEM1X_F2_WALSH_ACC3_FRAME"
(
  per.view hwioreg.per "DEMOD,DEMOD_1X_OFFLINE,DEM1X_F2_WALSH_ACC3_FRAME"
)
if "&choice"=="DEM1X_F2_WALSH_ACC4_FRAME"
(
  per.view hwioreg.per "DEMOD,DEMOD_1X_OFFLINE,DEM1X_F2_WALSH_ACC4_FRAME"
)
if "&choice"=="DEM1X_F2_WALSH_ACC5_FRAME"
(
  per.view hwioreg.per "DEMOD,DEMOD_1X_OFFLINE,DEM1X_F2_WALSH_ACC5_FRAME"
)
if "&choice"=="DEM1X_F2_WALSH_ACC6_FRAME"
(
  per.view hwioreg.per "DEMOD,DEMOD_1X_OFFLINE,DEM1X_F2_WALSH_ACC6_FRAME"
)
if "&choice"=="DEM1X_F2_WALSH_ACC7_FRAME"
(
  per.view hwioreg.per "DEMOD,DEMOD_1X_OFFLINE,DEM1X_F2_WALSH_ACC7_FRAME"
)
if "&choice"=="DEM1X_F2_WALSH_ACC8_FRAME"
(
  per.view hwioreg.per "DEMOD,DEMOD_1X_OFFLINE,DEM1X_F2_WALSH_ACC8_FRAME"
)
if "&choice"=="DEM1X_F2_WALSH_ACC9_FRAME"
(
  per.view hwioreg.per "DEMOD,DEMOD_1X_OFFLINE,DEM1X_F2_WALSH_ACC9_FRAME"
)
if "&choice"=="DEM1X_F2_WALSH_ACC10_FRAME"
(
  per.view hwioreg.per "DEMOD,DEMOD_1X_OFFLINE,DEM1X_F2_WALSH_ACC10_FRAME"
)
if "&choice"=="DEM1X_F2_WALSH_ACC11_FRAME"
(
  per.view hwioreg.per "DEMOD,DEMOD_1X_OFFLINE,DEM1X_F2_WALSH_ACC11_FRAME"
)
if "&choice"=="DEM1X_F2_WALSH_ACC12_FRAME"
(
  per.view hwioreg.per "DEMOD,DEMOD_1X_OFFLINE,DEM1X_F2_WALSH_ACC12_FRAME"
)
if "&choice"=="DEM1X_F2_WALSH_ACC13_FRAME"
(
  per.view hwioreg.per "DEMOD,DEMOD_1X_OFFLINE,DEM1X_F2_WALSH_ACC13_FRAME"
)
if "&choice"=="DEM1X_F3_WALSH_ACC0_FRAME"
(
  per.view hwioreg.per "DEMOD,DEMOD_1X_OFFLINE,DEM1X_F3_WALSH_ACC0_FRAME"
)
if "&choice"=="DEM1X_F3_WALSH_ACC1_FRAME"
(
  per.view hwioreg.per "DEMOD,DEMOD_1X_OFFLINE,DEM1X_F3_WALSH_ACC1_FRAME"
)
if "&choice"=="DEM1X_F3_WALSH_ACC2_FRAME"
(
  per.view hwioreg.per "DEMOD,DEMOD_1X_OFFLINE,DEM1X_F3_WALSH_ACC2_FRAME"
)
if "&choice"=="DEM1X_F3_WALSH_ACC3_FRAME"
(
  per.view hwioreg.per "DEMOD,DEMOD_1X_OFFLINE,DEM1X_F3_WALSH_ACC3_FRAME"
)
if "&choice"=="DEM1X_F3_WALSH_ACC4_FRAME"
(
  per.view hwioreg.per "DEMOD,DEMOD_1X_OFFLINE,DEM1X_F3_WALSH_ACC4_FRAME"
)
if "&choice"=="DEM1X_F3_WALSH_ACC5_FRAME"
(
  per.view hwioreg.per "DEMOD,DEMOD_1X_OFFLINE,DEM1X_F3_WALSH_ACC5_FRAME"
)
if "&choice"=="DEM1X_F3_WALSH_ACC6_FRAME"
(
  per.view hwioreg.per "DEMOD,DEMOD_1X_OFFLINE,DEM1X_F3_WALSH_ACC6_FRAME"
)
if "&choice"=="DEM1X_F3_WALSH_ACC7_FRAME"
(
  per.view hwioreg.per "DEMOD,DEMOD_1X_OFFLINE,DEM1X_F3_WALSH_ACC7_FRAME"
)
if "&choice"=="DEM1X_F3_WALSH_ACC8_FRAME"
(
  per.view hwioreg.per "DEMOD,DEMOD_1X_OFFLINE,DEM1X_F3_WALSH_ACC8_FRAME"
)
if "&choice"=="DEM1X_F3_WALSH_ACC9_FRAME"
(
  per.view hwioreg.per "DEMOD,DEMOD_1X_OFFLINE,DEM1X_F3_WALSH_ACC9_FRAME"
)
if "&choice"=="DEM1X_F3_WALSH_ACC10_FRAME"
(
  per.view hwioreg.per "DEMOD,DEMOD_1X_OFFLINE,DEM1X_F3_WALSH_ACC10_FRAME"
)
if "&choice"=="DEM1X_F3_WALSH_ACC11_FRAME"
(
  per.view hwioreg.per "DEMOD,DEMOD_1X_OFFLINE,DEM1X_F3_WALSH_ACC11_FRAME"
)
if "&choice"=="DEM1X_F3_WALSH_ACC12_FRAME"
(
  per.view hwioreg.per "DEMOD,DEMOD_1X_OFFLINE,DEM1X_F3_WALSH_ACC12_FRAME"
)
if "&choice"=="DEM1X_F3_WALSH_ACC13_FRAME"
(
  per.view hwioreg.per "DEMOD,DEMOD_1X_OFFLINE,DEM1X_F3_WALSH_ACC13_FRAME"
)
if "&choice"=="DEM1X_F4_WALSH_ACC0_FRAME"
(
  per.view hwioreg.per "DEMOD,DEMOD_1X_OFFLINE,DEM1X_F4_WALSH_ACC0_FRAME"
)
if "&choice"=="DEM1X_F4_WALSH_ACC1_FRAME"
(
  per.view hwioreg.per "DEMOD,DEMOD_1X_OFFLINE,DEM1X_F4_WALSH_ACC1_FRAME"
)
if "&choice"=="DEM1X_F4_WALSH_ACC2_FRAME"
(
  per.view hwioreg.per "DEMOD,DEMOD_1X_OFFLINE,DEM1X_F4_WALSH_ACC2_FRAME"
)
if "&choice"=="DEM1X_F4_WALSH_ACC3_FRAME"
(
  per.view hwioreg.per "DEMOD,DEMOD_1X_OFFLINE,DEM1X_F4_WALSH_ACC3_FRAME"
)
if "&choice"=="DEM1X_F4_WALSH_ACC4_FRAME"
(
  per.view hwioreg.per "DEMOD,DEMOD_1X_OFFLINE,DEM1X_F4_WALSH_ACC4_FRAME"
)
if "&choice"=="DEM1X_F4_WALSH_ACC5_FRAME"
(
  per.view hwioreg.per "DEMOD,DEMOD_1X_OFFLINE,DEM1X_F4_WALSH_ACC5_FRAME"
)
if "&choice"=="DEM1X_F4_WALSH_ACC6_FRAME"
(
  per.view hwioreg.per "DEMOD,DEMOD_1X_OFFLINE,DEM1X_F4_WALSH_ACC6_FRAME"
)
if "&choice"=="DEM1X_F4_WALSH_ACC7_FRAME"
(
  per.view hwioreg.per "DEMOD,DEMOD_1X_OFFLINE,DEM1X_F4_WALSH_ACC7_FRAME"
)
if "&choice"=="DEM1X_F4_WALSH_ACC8_FRAME"
(
  per.view hwioreg.per "DEMOD,DEMOD_1X_OFFLINE,DEM1X_F4_WALSH_ACC8_FRAME"
)
if "&choice"=="DEM1X_F4_WALSH_ACC9_FRAME"
(
  per.view hwioreg.per "DEMOD,DEMOD_1X_OFFLINE,DEM1X_F4_WALSH_ACC9_FRAME"
)
if "&choice"=="DEM1X_F4_WALSH_ACC10_FRAME"
(
  per.view hwioreg.per "DEMOD,DEMOD_1X_OFFLINE,DEM1X_F4_WALSH_ACC10_FRAME"
)
if "&choice"=="DEM1X_F4_WALSH_ACC11_FRAME"
(
  per.view hwioreg.per "DEMOD,DEMOD_1X_OFFLINE,DEM1X_F4_WALSH_ACC11_FRAME"
)
if "&choice"=="DEM1X_F4_WALSH_ACC12_FRAME"
(
  per.view hwioreg.per "DEMOD,DEMOD_1X_OFFLINE,DEM1X_F4_WALSH_ACC12_FRAME"
)
if "&choice"=="DEM1X_F4_WALSH_ACC13_FRAME"
(
  per.view hwioreg.per "DEMOD,DEMOD_1X_OFFLINE,DEM1X_F4_WALSH_ACC13_FRAME"
)
if "&choice"=="DEM1X_F5_WALSH_ACC0_FRAME"
(
  per.view hwioreg.per "DEMOD,DEMOD_1X_OFFLINE,DEM1X_F5_WALSH_ACC0_FRAME"
)
if "&choice"=="DEM1X_F5_WALSH_ACC1_FRAME"
(
  per.view hwioreg.per "DEMOD,DEMOD_1X_OFFLINE,DEM1X_F5_WALSH_ACC1_FRAME"
)
if "&choice"=="DEM1X_F5_WALSH_ACC2_FRAME"
(
  per.view hwioreg.per "DEMOD,DEMOD_1X_OFFLINE,DEM1X_F5_WALSH_ACC2_FRAME"
)
if "&choice"=="DEM1X_F5_WALSH_ACC3_FRAME"
(
  per.view hwioreg.per "DEMOD,DEMOD_1X_OFFLINE,DEM1X_F5_WALSH_ACC3_FRAME"
)
if "&choice"=="DEM1X_F5_WALSH_ACC4_FRAME"
(
  per.view hwioreg.per "DEMOD,DEMOD_1X_OFFLINE,DEM1X_F5_WALSH_ACC4_FRAME"
)
if "&choice"=="DEM1X_F5_WALSH_ACC5_FRAME"
(
  per.view hwioreg.per "DEMOD,DEMOD_1X_OFFLINE,DEM1X_F5_WALSH_ACC5_FRAME"
)
if "&choice"=="DEM1X_F5_WALSH_ACC6_FRAME"
(
  per.view hwioreg.per "DEMOD,DEMOD_1X_OFFLINE,DEM1X_F5_WALSH_ACC6_FRAME"
)
if "&choice"=="DEM1X_F5_WALSH_ACC7_FRAME"
(
  per.view hwioreg.per "DEMOD,DEMOD_1X_OFFLINE,DEM1X_F5_WALSH_ACC7_FRAME"
)
if "&choice"=="DEM1X_F5_WALSH_ACC8_FRAME"
(
  per.view hwioreg.per "DEMOD,DEMOD_1X_OFFLINE,DEM1X_F5_WALSH_ACC8_FRAME"
)
if "&choice"=="DEM1X_F5_WALSH_ACC9_FRAME"
(
  per.view hwioreg.per "DEMOD,DEMOD_1X_OFFLINE,DEM1X_F5_WALSH_ACC9_FRAME"
)
if "&choice"=="DEM1X_F5_WALSH_ACC10_FRAME"
(
  per.view hwioreg.per "DEMOD,DEMOD_1X_OFFLINE,DEM1X_F5_WALSH_ACC10_FRAME"
)
if "&choice"=="DEM1X_F5_WALSH_ACC11_FRAME"
(
  per.view hwioreg.per "DEMOD,DEMOD_1X_OFFLINE,DEM1X_F5_WALSH_ACC11_FRAME"
)
if "&choice"=="DEM1X_F5_WALSH_ACC12_FRAME"
(
  per.view hwioreg.per "DEMOD,DEMOD_1X_OFFLINE,DEM1X_F5_WALSH_ACC12_FRAME"
)
if "&choice"=="DEM1X_F5_WALSH_ACC13_FRAME"
(
  per.view hwioreg.per "DEMOD,DEMOD_1X_OFFLINE,DEM1X_F5_WALSH_ACC13_FRAME"
)
if "&choice"=="DEM1X_F6_WALSH_ACC0_FRAME"
(
  per.view hwioreg.per "DEMOD,DEMOD_1X_OFFLINE,DEM1X_F6_WALSH_ACC0_FRAME"
)
if "&choice"=="DEM1X_F6_WALSH_ACC1_FRAME"
(
  per.view hwioreg.per "DEMOD,DEMOD_1X_OFFLINE,DEM1X_F6_WALSH_ACC1_FRAME"
)
if "&choice"=="DEM1X_F6_WALSH_ACC2_FRAME"
(
  per.view hwioreg.per "DEMOD,DEMOD_1X_OFFLINE,DEM1X_F6_WALSH_ACC2_FRAME"
)
if "&choice"=="DEM1X_F6_WALSH_ACC3_FRAME"
(
  per.view hwioreg.per "DEMOD,DEMOD_1X_OFFLINE,DEM1X_F6_WALSH_ACC3_FRAME"
)
if "&choice"=="DEM1X_F6_WALSH_ACC4_FRAME"
(
  per.view hwioreg.per "DEMOD,DEMOD_1X_OFFLINE,DEM1X_F6_WALSH_ACC4_FRAME"
)
if "&choice"=="DEM1X_F6_WALSH_ACC5_FRAME"
(
  per.view hwioreg.per "DEMOD,DEMOD_1X_OFFLINE,DEM1X_F6_WALSH_ACC5_FRAME"
)
if "&choice"=="DEM1X_F6_WALSH_ACC6_FRAME"
(
  per.view hwioreg.per "DEMOD,DEMOD_1X_OFFLINE,DEM1X_F6_WALSH_ACC6_FRAME"
)
if "&choice"=="DEM1X_F6_WALSH_ACC7_FRAME"
(
  per.view hwioreg.per "DEMOD,DEMOD_1X_OFFLINE,DEM1X_F6_WALSH_ACC7_FRAME"
)
if "&choice"=="DEM1X_F6_WALSH_ACC8_FRAME"
(
  per.view hwioreg.per "DEMOD,DEMOD_1X_OFFLINE,DEM1X_F6_WALSH_ACC8_FRAME"
)
if "&choice"=="DEM1X_F6_WALSH_ACC9_FRAME"
(
  per.view hwioreg.per "DEMOD,DEMOD_1X_OFFLINE,DEM1X_F6_WALSH_ACC9_FRAME"
)
if "&choice"=="DEM1X_F6_WALSH_ACC10_FRAME"
(
  per.view hwioreg.per "DEMOD,DEMOD_1X_OFFLINE,DEM1X_F6_WALSH_ACC10_FRAME"
)
if "&choice"=="DEM1X_F6_WALSH_ACC11_FRAME"
(
  per.view hwioreg.per "DEMOD,DEMOD_1X_OFFLINE,DEM1X_F6_WALSH_ACC11_FRAME"
)
if "&choice"=="DEM1X_F6_WALSH_ACC12_FRAME"
(
  per.view hwioreg.per "DEMOD,DEMOD_1X_OFFLINE,DEM1X_F6_WALSH_ACC12_FRAME"
)
if "&choice"=="DEM1X_F6_WALSH_ACC13_FRAME"
(
  per.view hwioreg.per "DEMOD,DEMOD_1X_OFFLINE,DEM1X_F6_WALSH_ACC13_FRAME"
)
if "&choice"=="DEM1X_F7_WALSH_ACC0_FRAME"
(
  per.view hwioreg.per "DEMOD,DEMOD_1X_OFFLINE,DEM1X_F7_WALSH_ACC0_FRAME"
)
if "&choice"=="DEM1X_F7_WALSH_ACC1_FRAME"
(
  per.view hwioreg.per "DEMOD,DEMOD_1X_OFFLINE,DEM1X_F7_WALSH_ACC1_FRAME"
)
if "&choice"=="DEM1X_F7_WALSH_ACC2_FRAME"
(
  per.view hwioreg.per "DEMOD,DEMOD_1X_OFFLINE,DEM1X_F7_WALSH_ACC2_FRAME"
)
if "&choice"=="DEM1X_F7_WALSH_ACC3_FRAME"
(
  per.view hwioreg.per "DEMOD,DEMOD_1X_OFFLINE,DEM1X_F7_WALSH_ACC3_FRAME"
)
if "&choice"=="DEM1X_F7_WALSH_ACC4_FRAME"
(
  per.view hwioreg.per "DEMOD,DEMOD_1X_OFFLINE,DEM1X_F7_WALSH_ACC4_FRAME"
)
if "&choice"=="DEM1X_F7_WALSH_ACC5_FRAME"
(
  per.view hwioreg.per "DEMOD,DEMOD_1X_OFFLINE,DEM1X_F7_WALSH_ACC5_FRAME"
)
if "&choice"=="DEM1X_F7_WALSH_ACC6_FRAME"
(
  per.view hwioreg.per "DEMOD,DEMOD_1X_OFFLINE,DEM1X_F7_WALSH_ACC6_FRAME"
)
if "&choice"=="DEM1X_F7_WALSH_ACC7_FRAME"
(
  per.view hwioreg.per "DEMOD,DEMOD_1X_OFFLINE,DEM1X_F7_WALSH_ACC7_FRAME"
)
if "&choice"=="DEM1X_F7_WALSH_ACC8_FRAME"
(
  per.view hwioreg.per "DEMOD,DEMOD_1X_OFFLINE,DEM1X_F7_WALSH_ACC8_FRAME"
)
if "&choice"=="DEM1X_F7_WALSH_ACC9_FRAME"
(
  per.view hwioreg.per "DEMOD,DEMOD_1X_OFFLINE,DEM1X_F7_WALSH_ACC9_FRAME"
)
if "&choice"=="DEM1X_F7_WALSH_ACC10_FRAME"
(
  per.view hwioreg.per "DEMOD,DEMOD_1X_OFFLINE,DEM1X_F7_WALSH_ACC10_FRAME"
)
if "&choice"=="DEM1X_F7_WALSH_ACC11_FRAME"
(
  per.view hwioreg.per "DEMOD,DEMOD_1X_OFFLINE,DEM1X_F7_WALSH_ACC11_FRAME"
)
if "&choice"=="DEM1X_F7_WALSH_ACC12_FRAME"
(
  per.view hwioreg.per "DEMOD,DEMOD_1X_OFFLINE,DEM1X_F7_WALSH_ACC12_FRAME"
)
if "&choice"=="DEM1X_F7_WALSH_ACC13_FRAME"
(
  per.view hwioreg.per "DEMOD,DEMOD_1X_OFFLINE,DEM1X_F7_WALSH_ACC13_FRAME"
)
if "&choice"=="DEM1X_F0_HW_CH1_IMMED"
(
  per.view hwioreg.per "DEMOD,DEMOD_1X_OFFLINE,DEM1X_F0_HW_CH1_IMMED"
)
if "&choice"=="DEM1X_F1_HW_CH1_IMMED"
(
  per.view hwioreg.per "DEMOD,DEMOD_1X_OFFLINE,DEM1X_F1_HW_CH1_IMMED"
)
if "&choice"=="DEM1X_F2_HW_CH1_IMMED"
(
  per.view hwioreg.per "DEMOD,DEMOD_1X_OFFLINE,DEM1X_F2_HW_CH1_IMMED"
)
if "&choice"=="DEM1X_F3_HW_CH1_IMMED"
(
  per.view hwioreg.per "DEMOD,DEMOD_1X_OFFLINE,DEM1X_F3_HW_CH1_IMMED"
)
if "&choice"=="DEM1X_F4_HW_CH1_IMMED"
(
  per.view hwioreg.per "DEMOD,DEMOD_1X_OFFLINE,DEM1X_F4_HW_CH1_IMMED"
)
if "&choice"=="DEM1X_F5_HW_CH1_IMMED"
(
  per.view hwioreg.per "DEMOD,DEMOD_1X_OFFLINE,DEM1X_F5_HW_CH1_IMMED"
)
if "&choice"=="DEM1X_F6_HW_CH1_IMMED"
(
  per.view hwioreg.per "DEMOD,DEMOD_1X_OFFLINE,DEM1X_F6_HW_CH1_IMMED"
)
if "&choice"=="DEM1X_F7_HW_CH1_IMMED"
(
  per.view hwioreg.per "DEMOD,DEMOD_1X_OFFLINE,DEM1X_F7_HW_CH1_IMMED"
)
if "&choice"=="DEM1X_F0_HW_CH1_FRAME"
(
  per.view hwioreg.per "DEMOD,DEMOD_1X_OFFLINE,DEM1X_F0_HW_CH1_FRAME"
)
if "&choice"=="DEM1X_F1_HW_CH1_FRAME"
(
  per.view hwioreg.per "DEMOD,DEMOD_1X_OFFLINE,DEM1X_F1_HW_CH1_FRAME"
)
if "&choice"=="DEM1X_F2_HW_CH1_FRAME"
(
  per.view hwioreg.per "DEMOD,DEMOD_1X_OFFLINE,DEM1X_F2_HW_CH1_FRAME"
)
if "&choice"=="DEM1X_F3_HW_CH1_FRAME"
(
  per.view hwioreg.per "DEMOD,DEMOD_1X_OFFLINE,DEM1X_F3_HW_CH1_FRAME"
)
if "&choice"=="DEM1X_F4_HW_CH1_FRAME"
(
  per.view hwioreg.per "DEMOD,DEMOD_1X_OFFLINE,DEM1X_F4_HW_CH1_FRAME"
)
if "&choice"=="DEM1X_F5_HW_CH1_FRAME"
(
  per.view hwioreg.per "DEMOD,DEMOD_1X_OFFLINE,DEM1X_F5_HW_CH1_FRAME"
)
if "&choice"=="DEM1X_F6_HW_CH1_FRAME"
(
  per.view hwioreg.per "DEMOD,DEMOD_1X_OFFLINE,DEM1X_F6_HW_CH1_FRAME"
)
if "&choice"=="DEM1X_F7_HW_CH1_FRAME"
(
  per.view hwioreg.per "DEMOD,DEMOD_1X_OFFLINE,DEM1X_F7_HW_CH1_FRAME"
)
if "&choice"=="DEM1X_F0_HW_CH2_IMMED"
(
  per.view hwioreg.per "DEMOD,DEMOD_1X_OFFLINE,DEM1X_F0_HW_CH2_IMMED"
)
if "&choice"=="DEM1X_F1_HW_CH2_IMMED"
(
  per.view hwioreg.per "DEMOD,DEMOD_1X_OFFLINE,DEM1X_F1_HW_CH2_IMMED"
)
if "&choice"=="DEM1X_F2_HW_CH2_IMMED"
(
  per.view hwioreg.per "DEMOD,DEMOD_1X_OFFLINE,DEM1X_F2_HW_CH2_IMMED"
)
if "&choice"=="DEM1X_F3_HW_CH2_IMMED"
(
  per.view hwioreg.per "DEMOD,DEMOD_1X_OFFLINE,DEM1X_F3_HW_CH2_IMMED"
)
if "&choice"=="DEM1X_F4_HW_CH2_IMMED"
(
  per.view hwioreg.per "DEMOD,DEMOD_1X_OFFLINE,DEM1X_F4_HW_CH2_IMMED"
)
if "&choice"=="DEM1X_F5_HW_CH2_IMMED"
(
  per.view hwioreg.per "DEMOD,DEMOD_1X_OFFLINE,DEM1X_F5_HW_CH2_IMMED"
)
if "&choice"=="DEM1X_F6_HW_CH2_IMMED"
(
  per.view hwioreg.per "DEMOD,DEMOD_1X_OFFLINE,DEM1X_F6_HW_CH2_IMMED"
)
if "&choice"=="DEM1X_F7_HW_CH2_IMMED"
(
  per.view hwioreg.per "DEMOD,DEMOD_1X_OFFLINE,DEM1X_F7_HW_CH2_IMMED"
)
if "&choice"=="DEM1X_F0_HW_CH2_FRAME"
(
  per.view hwioreg.per "DEMOD,DEMOD_1X_OFFLINE,DEM1X_F0_HW_CH2_FRAME"
)
if "&choice"=="DEM1X_F1_HW_CH2_FRAME"
(
  per.view hwioreg.per "DEMOD,DEMOD_1X_OFFLINE,DEM1X_F1_HW_CH2_FRAME"
)
if "&choice"=="DEM1X_F2_HW_CH2_FRAME"
(
  per.view hwioreg.per "DEMOD,DEMOD_1X_OFFLINE,DEM1X_F2_HW_CH2_FRAME"
)
if "&choice"=="DEM1X_F3_HW_CH2_FRAME"
(
  per.view hwioreg.per "DEMOD,DEMOD_1X_OFFLINE,DEM1X_F3_HW_CH2_FRAME"
)
if "&choice"=="DEM1X_F4_HW_CH2_FRAME"
(
  per.view hwioreg.per "DEMOD,DEMOD_1X_OFFLINE,DEM1X_F4_HW_CH2_FRAME"
)
if "&choice"=="DEM1X_F5_HW_CH2_FRAME"
(
  per.view hwioreg.per "DEMOD,DEMOD_1X_OFFLINE,DEM1X_F5_HW_CH2_FRAME"
)
if "&choice"=="DEM1X_F6_HW_CH2_FRAME"
(
  per.view hwioreg.per "DEMOD,DEMOD_1X_OFFLINE,DEM1X_F6_HW_CH2_FRAME"
)
if "&choice"=="DEM1X_F7_HW_CH2_FRAME"
(
  per.view hwioreg.per "DEMOD,DEMOD_1X_OFFLINE,DEM1X_F7_HW_CH2_FRAME"
)
if "&choice"=="DEM1X_F0_HW_CH3_IMMED"
(
  per.view hwioreg.per "DEMOD,DEMOD_1X_OFFLINE,DEM1X_F0_HW_CH3_IMMED"
)
if "&choice"=="DEM1X_F1_HW_CH3_IMMED"
(
  per.view hwioreg.per "DEMOD,DEMOD_1X_OFFLINE,DEM1X_F1_HW_CH3_IMMED"
)
if "&choice"=="DEM1X_F2_HW_CH3_IMMED"
(
  per.view hwioreg.per "DEMOD,DEMOD_1X_OFFLINE,DEM1X_F2_HW_CH3_IMMED"
)
if "&choice"=="DEM1X_F3_HW_CH3_IMMED"
(
  per.view hwioreg.per "DEMOD,DEMOD_1X_OFFLINE,DEM1X_F3_HW_CH3_IMMED"
)
if "&choice"=="DEM1X_F4_HW_CH3_IMMED"
(
  per.view hwioreg.per "DEMOD,DEMOD_1X_OFFLINE,DEM1X_F4_HW_CH3_IMMED"
)
if "&choice"=="DEM1X_F5_HW_CH3_IMMED"
(
  per.view hwioreg.per "DEMOD,DEMOD_1X_OFFLINE,DEM1X_F5_HW_CH3_IMMED"
)
if "&choice"=="DEM1X_F6_HW_CH3_IMMED"
(
  per.view hwioreg.per "DEMOD,DEMOD_1X_OFFLINE,DEM1X_F6_HW_CH3_IMMED"
)
if "&choice"=="DEM1X_F7_HW_CH3_IMMED"
(
  per.view hwioreg.per "DEMOD,DEMOD_1X_OFFLINE,DEM1X_F7_HW_CH3_IMMED"
)
if "&choice"=="DEM1X_F0_HW_CH3_FRAME"
(
  per.view hwioreg.per "DEMOD,DEMOD_1X_OFFLINE,DEM1X_F0_HW_CH3_FRAME"
)
if "&choice"=="DEM1X_F1_HW_CH3_FRAME"
(
  per.view hwioreg.per "DEMOD,DEMOD_1X_OFFLINE,DEM1X_F1_HW_CH3_FRAME"
)
if "&choice"=="DEM1X_F2_HW_CH3_FRAME"
(
  per.view hwioreg.per "DEMOD,DEMOD_1X_OFFLINE,DEM1X_F2_HW_CH3_FRAME"
)
if "&choice"=="DEM1X_F3_HW_CH3_FRAME"
(
  per.view hwioreg.per "DEMOD,DEMOD_1X_OFFLINE,DEM1X_F3_HW_CH3_FRAME"
)
if "&choice"=="DEM1X_F4_HW_CH3_FRAME"
(
  per.view hwioreg.per "DEMOD,DEMOD_1X_OFFLINE,DEM1X_F4_HW_CH3_FRAME"
)
if "&choice"=="DEM1X_F5_HW_CH3_FRAME"
(
  per.view hwioreg.per "DEMOD,DEMOD_1X_OFFLINE,DEM1X_F5_HW_CH3_FRAME"
)
if "&choice"=="DEM1X_F6_HW_CH3_FRAME"
(
  per.view hwioreg.per "DEMOD,DEMOD_1X_OFFLINE,DEM1X_F6_HW_CH3_FRAME"
)
if "&choice"=="DEM1X_F7_HW_CH3_FRAME"
(
  per.view hwioreg.per "DEMOD,DEMOD_1X_OFFLINE,DEM1X_F7_HW_CH3_FRAME"
)
if "&choice"=="DEM1X_F0_WALSH_ACC14_IMMED"
(
  per.view hwioreg.per "DEMOD,DEMOD_1X_OFFLINE,DEM1X_F0_WALSH_ACC14_IMMED"
)
if "&choice"=="DEM1X_F0_WALSH_ACC15_IMMED"
(
  per.view hwioreg.per "DEMOD,DEMOD_1X_OFFLINE,DEM1X_F0_WALSH_ACC15_IMMED"
)
if "&choice"=="DEM1X_F0_WALSH_ACC16_IMMED"
(
  per.view hwioreg.per "DEMOD,DEMOD_1X_OFFLINE,DEM1X_F0_WALSH_ACC16_IMMED"
)
if "&choice"=="DEM1X_F0_WALSH_ACC17_IMMED"
(
  per.view hwioreg.per "DEMOD,DEMOD_1X_OFFLINE,DEM1X_F0_WALSH_ACC17_IMMED"
)
if "&choice"=="DEM1X_F0_WALSH_ACC18_IMMED"
(
  per.view hwioreg.per "DEMOD,DEMOD_1X_OFFLINE,DEM1X_F0_WALSH_ACC18_IMMED"
)
if "&choice"=="DEM1X_F0_WALSH_ACC19_IMMED"
(
  per.view hwioreg.per "DEMOD,DEMOD_1X_OFFLINE,DEM1X_F0_WALSH_ACC19_IMMED"
)
if "&choice"=="DEM1X_F0_WALSH_ACC20_IMMED"
(
  per.view hwioreg.per "DEMOD,DEMOD_1X_OFFLINE,DEM1X_F0_WALSH_ACC20_IMMED"
)
if "&choice"=="DEM1X_F0_WALSH_ACC21_IMMED"
(
  per.view hwioreg.per "DEMOD,DEMOD_1X_OFFLINE,DEM1X_F0_WALSH_ACC21_IMMED"
)
if "&choice"=="DEM1X_F1_WALSH_ACC14_IMMED"
(
  per.view hwioreg.per "DEMOD,DEMOD_1X_OFFLINE,DEM1X_F1_WALSH_ACC14_IMMED"
)
if "&choice"=="DEM1X_F1_WALSH_ACC15_IMMED"
(
  per.view hwioreg.per "DEMOD,DEMOD_1X_OFFLINE,DEM1X_F1_WALSH_ACC15_IMMED"
)
if "&choice"=="DEM1X_F1_WALSH_ACC16_IMMED"
(
  per.view hwioreg.per "DEMOD,DEMOD_1X_OFFLINE,DEM1X_F1_WALSH_ACC16_IMMED"
)
if "&choice"=="DEM1X_F1_WALSH_ACC17_IMMED"
(
  per.view hwioreg.per "DEMOD,DEMOD_1X_OFFLINE,DEM1X_F1_WALSH_ACC17_IMMED"
)
if "&choice"=="DEM1X_F1_WALSH_ACC18_IMMED"
(
  per.view hwioreg.per "DEMOD,DEMOD_1X_OFFLINE,DEM1X_F1_WALSH_ACC18_IMMED"
)
if "&choice"=="DEM1X_F1_WALSH_ACC19_IMMED"
(
  per.view hwioreg.per "DEMOD,DEMOD_1X_OFFLINE,DEM1X_F1_WALSH_ACC19_IMMED"
)
if "&choice"=="DEM1X_F1_WALSH_ACC20_IMMED"
(
  per.view hwioreg.per "DEMOD,DEMOD_1X_OFFLINE,DEM1X_F1_WALSH_ACC20_IMMED"
)
if "&choice"=="DEM1X_F1_WALSH_ACC21_IMMED"
(
  per.view hwioreg.per "DEMOD,DEMOD_1X_OFFLINE,DEM1X_F1_WALSH_ACC21_IMMED"
)
if "&choice"=="DEM1X_F2_WALSH_ACC14_IMMED"
(
  per.view hwioreg.per "DEMOD,DEMOD_1X_OFFLINE,DEM1X_F2_WALSH_ACC14_IMMED"
)
if "&choice"=="DEM1X_F2_WALSH_ACC15_IMMED"
(
  per.view hwioreg.per "DEMOD,DEMOD_1X_OFFLINE,DEM1X_F2_WALSH_ACC15_IMMED"
)
if "&choice"=="DEM1X_F2_WALSH_ACC16_IMMED"
(
  per.view hwioreg.per "DEMOD,DEMOD_1X_OFFLINE,DEM1X_F2_WALSH_ACC16_IMMED"
)
if "&choice"=="DEM1X_F2_WALSH_ACC17_IMMED"
(
  per.view hwioreg.per "DEMOD,DEMOD_1X_OFFLINE,DEM1X_F2_WALSH_ACC17_IMMED"
)
if "&choice"=="DEM1X_F2_WALSH_ACC18_IMMED"
(
  per.view hwioreg.per "DEMOD,DEMOD_1X_OFFLINE,DEM1X_F2_WALSH_ACC18_IMMED"
)
if "&choice"=="DEM1X_F2_WALSH_ACC19_IMMED"
(
  per.view hwioreg.per "DEMOD,DEMOD_1X_OFFLINE,DEM1X_F2_WALSH_ACC19_IMMED"
)
if "&choice"=="DEM1X_F2_WALSH_ACC20_IMMED"
(
  per.view hwioreg.per "DEMOD,DEMOD_1X_OFFLINE,DEM1X_F2_WALSH_ACC20_IMMED"
)
if "&choice"=="DEM1X_F2_WALSH_ACC21_IMMED"
(
  per.view hwioreg.per "DEMOD,DEMOD_1X_OFFLINE,DEM1X_F2_WALSH_ACC21_IMMED"
)
if "&choice"=="DEM1X_F3_WALSH_ACC14_IMMED"
(
  per.view hwioreg.per "DEMOD,DEMOD_1X_OFFLINE,DEM1X_F3_WALSH_ACC14_IMMED"
)
if "&choice"=="DEM1X_F3_WALSH_ACC15_IMMED"
(
  per.view hwioreg.per "DEMOD,DEMOD_1X_OFFLINE,DEM1X_F3_WALSH_ACC15_IMMED"
)
if "&choice"=="DEM1X_F3_WALSH_ACC16_IMMED"
(
  per.view hwioreg.per "DEMOD,DEMOD_1X_OFFLINE,DEM1X_F3_WALSH_ACC16_IMMED"
)
if "&choice"=="DEM1X_F3_WALSH_ACC17_IMMED"
(
  per.view hwioreg.per "DEMOD,DEMOD_1X_OFFLINE,DEM1X_F3_WALSH_ACC17_IMMED"
)
if "&choice"=="DEM1X_F3_WALSH_ACC18_IMMED"
(
  per.view hwioreg.per "DEMOD,DEMOD_1X_OFFLINE,DEM1X_F3_WALSH_ACC18_IMMED"
)
if "&choice"=="DEM1X_F3_WALSH_ACC19_IMMED"
(
  per.view hwioreg.per "DEMOD,DEMOD_1X_OFFLINE,DEM1X_F3_WALSH_ACC19_IMMED"
)
if "&choice"=="DEM1X_F3_WALSH_ACC20_IMMED"
(
  per.view hwioreg.per "DEMOD,DEMOD_1X_OFFLINE,DEM1X_F3_WALSH_ACC20_IMMED"
)
if "&choice"=="DEM1X_F3_WALSH_ACC21_IMMED"
(
  per.view hwioreg.per "DEMOD,DEMOD_1X_OFFLINE,DEM1X_F3_WALSH_ACC21_IMMED"
)
if "&choice"=="DEM1X_F4_WALSH_ACC14_IMMED"
(
  per.view hwioreg.per "DEMOD,DEMOD_1X_OFFLINE,DEM1X_F4_WALSH_ACC14_IMMED"
)
if "&choice"=="DEM1X_F4_WALSH_ACC15_IMMED"
(
  per.view hwioreg.per "DEMOD,DEMOD_1X_OFFLINE,DEM1X_F4_WALSH_ACC15_IMMED"
)
if "&choice"=="DEM1X_F4_WALSH_ACC16_IMMED"
(
  per.view hwioreg.per "DEMOD,DEMOD_1X_OFFLINE,DEM1X_F4_WALSH_ACC16_IMMED"
)
if "&choice"=="DEM1X_F4_WALSH_ACC17_IMMED"
(
  per.view hwioreg.per "DEMOD,DEMOD_1X_OFFLINE,DEM1X_F4_WALSH_ACC17_IMMED"
)
if "&choice"=="DEM1X_F4_WALSH_ACC18_IMMED"
(
  per.view hwioreg.per "DEMOD,DEMOD_1X_OFFLINE,DEM1X_F4_WALSH_ACC18_IMMED"
)
if "&choice"=="DEM1X_F4_WALSH_ACC19_IMMED"
(
  per.view hwioreg.per "DEMOD,DEMOD_1X_OFFLINE,DEM1X_F4_WALSH_ACC19_IMMED"
)
if "&choice"=="DEM1X_F4_WALSH_ACC20_IMMED"
(
  per.view hwioreg.per "DEMOD,DEMOD_1X_OFFLINE,DEM1X_F4_WALSH_ACC20_IMMED"
)
if "&choice"=="DEM1X_F4_WALSH_ACC21_IMMED"
(
  per.view hwioreg.per "DEMOD,DEMOD_1X_OFFLINE,DEM1X_F4_WALSH_ACC21_IMMED"
)
if "&choice"=="DEM1X_F5_WALSH_ACC14_IMMED"
(
  per.view hwioreg.per "DEMOD,DEMOD_1X_OFFLINE,DEM1X_F5_WALSH_ACC14_IMMED"
)
if "&choice"=="DEM1X_F5_WALSH_ACC15_IMMED"
(
  per.view hwioreg.per "DEMOD,DEMOD_1X_OFFLINE,DEM1X_F5_WALSH_ACC15_IMMED"
)
if "&choice"=="DEM1X_F5_WALSH_ACC16_IMMED"
(
  per.view hwioreg.per "DEMOD,DEMOD_1X_OFFLINE,DEM1X_F5_WALSH_ACC16_IMMED"
)
if "&choice"=="DEM1X_F5_WALSH_ACC17_IMMED"
(
  per.view hwioreg.per "DEMOD,DEMOD_1X_OFFLINE,DEM1X_F5_WALSH_ACC17_IMMED"
)
if "&choice"=="DEM1X_F5_WALSH_ACC18_IMMED"
(
  per.view hwioreg.per "DEMOD,DEMOD_1X_OFFLINE,DEM1X_F5_WALSH_ACC18_IMMED"
)
if "&choice"=="DEM1X_F5_WALSH_ACC19_IMMED"
(
  per.view hwioreg.per "DEMOD,DEMOD_1X_OFFLINE,DEM1X_F5_WALSH_ACC19_IMMED"
)
if "&choice"=="DEM1X_F5_WALSH_ACC20_IMMED"
(
  per.view hwioreg.per "DEMOD,DEMOD_1X_OFFLINE,DEM1X_F5_WALSH_ACC20_IMMED"
)
if "&choice"=="DEM1X_F5_WALSH_ACC21_IMMED"
(
  per.view hwioreg.per "DEMOD,DEMOD_1X_OFFLINE,DEM1X_F5_WALSH_ACC21_IMMED"
)
if "&choice"=="DEM1X_F6_WALSH_ACC14_IMMED"
(
  per.view hwioreg.per "DEMOD,DEMOD_1X_OFFLINE,DEM1X_F6_WALSH_ACC14_IMMED"
)
if "&choice"=="DEM1X_F6_WALSH_ACC15_IMMED"
(
  per.view hwioreg.per "DEMOD,DEMOD_1X_OFFLINE,DEM1X_F6_WALSH_ACC15_IMMED"
)
if "&choice"=="DEM1X_F6_WALSH_ACC16_IMMED"
(
  per.view hwioreg.per "DEMOD,DEMOD_1X_OFFLINE,DEM1X_F6_WALSH_ACC16_IMMED"
)
if "&choice"=="DEM1X_F6_WALSH_ACC17_IMMED"
(
  per.view hwioreg.per "DEMOD,DEMOD_1X_OFFLINE,DEM1X_F6_WALSH_ACC17_IMMED"
)
if "&choice"=="DEM1X_F6_WALSH_ACC18_IMMED"
(
  per.view hwioreg.per "DEMOD,DEMOD_1X_OFFLINE,DEM1X_F6_WALSH_ACC18_IMMED"
)
if "&choice"=="DEM1X_F6_WALSH_ACC19_IMMED"
(
  per.view hwioreg.per "DEMOD,DEMOD_1X_OFFLINE,DEM1X_F6_WALSH_ACC19_IMMED"
)
if "&choice"=="DEM1X_F6_WALSH_ACC20_IMMED"
(
  per.view hwioreg.per "DEMOD,DEMOD_1X_OFFLINE,DEM1X_F6_WALSH_ACC20_IMMED"
)
if "&choice"=="DEM1X_F6_WALSH_ACC21_IMMED"
(
  per.view hwioreg.per "DEMOD,DEMOD_1X_OFFLINE,DEM1X_F6_WALSH_ACC21_IMMED"
)
if "&choice"=="DEM1X_F7_WALSH_ACC14_IMMED"
(
  per.view hwioreg.per "DEMOD,DEMOD_1X_OFFLINE,DEM1X_F7_WALSH_ACC14_IMMED"
)
if "&choice"=="DEM1X_F7_WALSH_ACC15_IMMED"
(
  per.view hwioreg.per "DEMOD,DEMOD_1X_OFFLINE,DEM1X_F7_WALSH_ACC15_IMMED"
)
if "&choice"=="DEM1X_F7_WALSH_ACC16_IMMED"
(
  per.view hwioreg.per "DEMOD,DEMOD_1X_OFFLINE,DEM1X_F7_WALSH_ACC16_IMMED"
)
if "&choice"=="DEM1X_F7_WALSH_ACC17_IMMED"
(
  per.view hwioreg.per "DEMOD,DEMOD_1X_OFFLINE,DEM1X_F7_WALSH_ACC17_IMMED"
)
if "&choice"=="DEM1X_F7_WALSH_ACC18_IMMED"
(
  per.view hwioreg.per "DEMOD,DEMOD_1X_OFFLINE,DEM1X_F7_WALSH_ACC18_IMMED"
)
if "&choice"=="DEM1X_F7_WALSH_ACC19_IMMED"
(
  per.view hwioreg.per "DEMOD,DEMOD_1X_OFFLINE,DEM1X_F7_WALSH_ACC19_IMMED"
)
if "&choice"=="DEM1X_F7_WALSH_ACC20_IMMED"
(
  per.view hwioreg.per "DEMOD,DEMOD_1X_OFFLINE,DEM1X_F7_WALSH_ACC20_IMMED"
)
if "&choice"=="DEM1X_F7_WALSH_ACC21_IMMED"
(
  per.view hwioreg.per "DEMOD,DEMOD_1X_OFFLINE,DEM1X_F7_WALSH_ACC21_IMMED"
)
if "&choice"=="DEM1X_F0_WALSH_ACC14_FRAME"
(
  per.view hwioreg.per "DEMOD,DEMOD_1X_OFFLINE,DEM1X_F0_WALSH_ACC14_FRAME"
)
if "&choice"=="DEM1X_F0_WALSH_ACC15_FRAME"
(
  per.view hwioreg.per "DEMOD,DEMOD_1X_OFFLINE,DEM1X_F0_WALSH_ACC15_FRAME"
)
if "&choice"=="DEM1X_F0_WALSH_ACC16_FRAME"
(
  per.view hwioreg.per "DEMOD,DEMOD_1X_OFFLINE,DEM1X_F0_WALSH_ACC16_FRAME"
)
if "&choice"=="DEM1X_F0_WALSH_ACC17_FRAME"
(
  per.view hwioreg.per "DEMOD,DEMOD_1X_OFFLINE,DEM1X_F0_WALSH_ACC17_FRAME"
)
if "&choice"=="DEM1X_F0_WALSH_ACC18_FRAME"
(
  per.view hwioreg.per "DEMOD,DEMOD_1X_OFFLINE,DEM1X_F0_WALSH_ACC18_FRAME"
)
if "&choice"=="DEM1X_F0_WALSH_ACC19_FRAME"
(
  per.view hwioreg.per "DEMOD,DEMOD_1X_OFFLINE,DEM1X_F0_WALSH_ACC19_FRAME"
)
if "&choice"=="DEM1X_F0_WALSH_ACC20_FRAME"
(
  per.view hwioreg.per "DEMOD,DEMOD_1X_OFFLINE,DEM1X_F0_WALSH_ACC20_FRAME"
)
if "&choice"=="DEM1X_F0_WALSH_ACC21_FRAME"
(
  per.view hwioreg.per "DEMOD,DEMOD_1X_OFFLINE,DEM1X_F0_WALSH_ACC21_FRAME"
)
if "&choice"=="DEM1X_F1_WALSH_ACC14_FRAME"
(
  per.view hwioreg.per "DEMOD,DEMOD_1X_OFFLINE,DEM1X_F1_WALSH_ACC14_FRAME"
)
if "&choice"=="DEM1X_F1_WALSH_ACC15_FRAME"
(
  per.view hwioreg.per "DEMOD,DEMOD_1X_OFFLINE,DEM1X_F1_WALSH_ACC15_FRAME"
)
if "&choice"=="DEM1X_F1_WALSH_ACC16_FRAME"
(
  per.view hwioreg.per "DEMOD,DEMOD_1X_OFFLINE,DEM1X_F1_WALSH_ACC16_FRAME"
)
if "&choice"=="DEM1X_F1_WALSH_ACC17_FRAME"
(
  per.view hwioreg.per "DEMOD,DEMOD_1X_OFFLINE,DEM1X_F1_WALSH_ACC17_FRAME"
)
if "&choice"=="DEM1X_F1_WALSH_ACC18_FRAME"
(
  per.view hwioreg.per "DEMOD,DEMOD_1X_OFFLINE,DEM1X_F1_WALSH_ACC18_FRAME"
)
if "&choice"=="DEM1X_F1_WALSH_ACC19_FRAME"
(
  per.view hwioreg.per "DEMOD,DEMOD_1X_OFFLINE,DEM1X_F1_WALSH_ACC19_FRAME"
)
if "&choice"=="DEM1X_F1_WALSH_ACC20_FRAME"
(
  per.view hwioreg.per "DEMOD,DEMOD_1X_OFFLINE,DEM1X_F1_WALSH_ACC20_FRAME"
)
if "&choice"=="DEM1X_F1_WALSH_ACC21_FRAME"
(
  per.view hwioreg.per "DEMOD,DEMOD_1X_OFFLINE,DEM1X_F1_WALSH_ACC21_FRAME"
)
if "&choice"=="DEM1X_F2_WALSH_ACC14_FRAME"
(
  per.view hwioreg.per "DEMOD,DEMOD_1X_OFFLINE,DEM1X_F2_WALSH_ACC14_FRAME"
)
if "&choice"=="DEM1X_F2_WALSH_ACC15_FRAME"
(
  per.view hwioreg.per "DEMOD,DEMOD_1X_OFFLINE,DEM1X_F2_WALSH_ACC15_FRAME"
)
if "&choice"=="DEM1X_F2_WALSH_ACC16_FRAME"
(
  per.view hwioreg.per "DEMOD,DEMOD_1X_OFFLINE,DEM1X_F2_WALSH_ACC16_FRAME"
)
if "&choice"=="DEM1X_F2_WALSH_ACC17_FRAME"
(
  per.view hwioreg.per "DEMOD,DEMOD_1X_OFFLINE,DEM1X_F2_WALSH_ACC17_FRAME"
)
if "&choice"=="DEM1X_F2_WALSH_ACC18_FRAME"
(
  per.view hwioreg.per "DEMOD,DEMOD_1X_OFFLINE,DEM1X_F2_WALSH_ACC18_FRAME"
)
if "&choice"=="DEM1X_F2_WALSH_ACC19_FRAME"
(
  per.view hwioreg.per "DEMOD,DEMOD_1X_OFFLINE,DEM1X_F2_WALSH_ACC19_FRAME"
)
if "&choice"=="DEM1X_F2_WALSH_ACC20_FRAME"
(
  per.view hwioreg.per "DEMOD,DEMOD_1X_OFFLINE,DEM1X_F2_WALSH_ACC20_FRAME"
)
if "&choice"=="DEM1X_F2_WALSH_ACC21_FRAME"
(
  per.view hwioreg.per "DEMOD,DEMOD_1X_OFFLINE,DEM1X_F2_WALSH_ACC21_FRAME"
)
if "&choice"=="DEM1X_F3_WALSH_ACC14_FRAME"
(
  per.view hwioreg.per "DEMOD,DEMOD_1X_OFFLINE,DEM1X_F3_WALSH_ACC14_FRAME"
)
if "&choice"=="DEM1X_F3_WALSH_ACC15_FRAME"
(
  per.view hwioreg.per "DEMOD,DEMOD_1X_OFFLINE,DEM1X_F3_WALSH_ACC15_FRAME"
)
if "&choice"=="DEM1X_F3_WALSH_ACC16_FRAME"
(
  per.view hwioreg.per "DEMOD,DEMOD_1X_OFFLINE,DEM1X_F3_WALSH_ACC16_FRAME"
)
if "&choice"=="DEM1X_F3_WALSH_ACC17_FRAME"
(
  per.view hwioreg.per "DEMOD,DEMOD_1X_OFFLINE,DEM1X_F3_WALSH_ACC17_FRAME"
)
if "&choice"=="DEM1X_F3_WALSH_ACC18_FRAME"
(
  per.view hwioreg.per "DEMOD,DEMOD_1X_OFFLINE,DEM1X_F3_WALSH_ACC18_FRAME"
)
if "&choice"=="DEM1X_F3_WALSH_ACC19_FRAME"
(
  per.view hwioreg.per "DEMOD,DEMOD_1X_OFFLINE,DEM1X_F3_WALSH_ACC19_FRAME"
)
if "&choice"=="DEM1X_F3_WALSH_ACC20_FRAME"
(
  per.view hwioreg.per "DEMOD,DEMOD_1X_OFFLINE,DEM1X_F3_WALSH_ACC20_FRAME"
)
if "&choice"=="DEM1X_F3_WALSH_ACC21_FRAME"
(
  per.view hwioreg.per "DEMOD,DEMOD_1X_OFFLINE,DEM1X_F3_WALSH_ACC21_FRAME"
)
if "&choice"=="DEM1X_F4_WALSH_ACC14_FRAME"
(
  per.view hwioreg.per "DEMOD,DEMOD_1X_OFFLINE,DEM1X_F4_WALSH_ACC14_FRAME"
)
if "&choice"=="DEM1X_F4_WALSH_ACC15_FRAME"
(
  per.view hwioreg.per "DEMOD,DEMOD_1X_OFFLINE,DEM1X_F4_WALSH_ACC15_FRAME"
)
if "&choice"=="DEM1X_F4_WALSH_ACC16_FRAME"
(
  per.view hwioreg.per "DEMOD,DEMOD_1X_OFFLINE,DEM1X_F4_WALSH_ACC16_FRAME"
)
if "&choice"=="DEM1X_F4_WALSH_ACC17_FRAME"
(
  per.view hwioreg.per "DEMOD,DEMOD_1X_OFFLINE,DEM1X_F4_WALSH_ACC17_FRAME"
)
if "&choice"=="DEM1X_F4_WALSH_ACC18_FRAME"
(
  per.view hwioreg.per "DEMOD,DEMOD_1X_OFFLINE,DEM1X_F4_WALSH_ACC18_FRAME"
)
if "&choice"=="DEM1X_F4_WALSH_ACC19_FRAME"
(
  per.view hwioreg.per "DEMOD,DEMOD_1X_OFFLINE,DEM1X_F4_WALSH_ACC19_FRAME"
)
if "&choice"=="DEM1X_F4_WALSH_ACC20_FRAME"
(
  per.view hwioreg.per "DEMOD,DEMOD_1X_OFFLINE,DEM1X_F4_WALSH_ACC20_FRAME"
)
if "&choice"=="DEM1X_F4_WALSH_ACC21_FRAME"
(
  per.view hwioreg.per "DEMOD,DEMOD_1X_OFFLINE,DEM1X_F4_WALSH_ACC21_FRAME"
)
if "&choice"=="DEM1X_F5_WALSH_ACC14_FRAME"
(
  per.view hwioreg.per "DEMOD,DEMOD_1X_OFFLINE,DEM1X_F5_WALSH_ACC14_FRAME"
)
if "&choice"=="DEM1X_F5_WALSH_ACC15_FRAME"
(
  per.view hwioreg.per "DEMOD,DEMOD_1X_OFFLINE,DEM1X_F5_WALSH_ACC15_FRAME"
)
if "&choice"=="DEM1X_F5_WALSH_ACC16_FRAME"
(
  per.view hwioreg.per "DEMOD,DEMOD_1X_OFFLINE,DEM1X_F5_WALSH_ACC16_FRAME"
)
if "&choice"=="DEM1X_F5_WALSH_ACC17_FRAME"
(
  per.view hwioreg.per "DEMOD,DEMOD_1X_OFFLINE,DEM1X_F5_WALSH_ACC17_FRAME"
)
if "&choice"=="DEM1X_F5_WALSH_ACC18_FRAME"
(
  per.view hwioreg.per "DEMOD,DEMOD_1X_OFFLINE,DEM1X_F5_WALSH_ACC18_FRAME"
)
if "&choice"=="DEM1X_F5_WALSH_ACC19_FRAME"
(
  per.view hwioreg.per "DEMOD,DEMOD_1X_OFFLINE,DEM1X_F5_WALSH_ACC19_FRAME"
)
if "&choice"=="DEM1X_F5_WALSH_ACC20_FRAME"
(
  per.view hwioreg.per "DEMOD,DEMOD_1X_OFFLINE,DEM1X_F5_WALSH_ACC20_FRAME"
)
if "&choice"=="DEM1X_F5_WALSH_ACC21_FRAME"
(
  per.view hwioreg.per "DEMOD,DEMOD_1X_OFFLINE,DEM1X_F5_WALSH_ACC21_FRAME"
)
if "&choice"=="DEM1X_F6_WALSH_ACC14_FRAME"
(
  per.view hwioreg.per "DEMOD,DEMOD_1X_OFFLINE,DEM1X_F6_WALSH_ACC14_FRAME"
)
if "&choice"=="DEM1X_F6_WALSH_ACC15_FRAME"
(
  per.view hwioreg.per "DEMOD,DEMOD_1X_OFFLINE,DEM1X_F6_WALSH_ACC15_FRAME"
)
if "&choice"=="DEM1X_F6_WALSH_ACC16_FRAME"
(
  per.view hwioreg.per "DEMOD,DEMOD_1X_OFFLINE,DEM1X_F6_WALSH_ACC16_FRAME"
)
if "&choice"=="DEM1X_F6_WALSH_ACC17_FRAME"
(
  per.view hwioreg.per "DEMOD,DEMOD_1X_OFFLINE,DEM1X_F6_WALSH_ACC17_FRAME"
)
if "&choice"=="DEM1X_F6_WALSH_ACC18_FRAME"
(
  per.view hwioreg.per "DEMOD,DEMOD_1X_OFFLINE,DEM1X_F6_WALSH_ACC18_FRAME"
)
if "&choice"=="DEM1X_F6_WALSH_ACC19_FRAME"
(
  per.view hwioreg.per "DEMOD,DEMOD_1X_OFFLINE,DEM1X_F6_WALSH_ACC19_FRAME"
)
if "&choice"=="DEM1X_F6_WALSH_ACC20_FRAME"
(
  per.view hwioreg.per "DEMOD,DEMOD_1X_OFFLINE,DEM1X_F6_WALSH_ACC20_FRAME"
)
if "&choice"=="DEM1X_F6_WALSH_ACC21_FRAME"
(
  per.view hwioreg.per "DEMOD,DEMOD_1X_OFFLINE,DEM1X_F6_WALSH_ACC21_FRAME"
)
if "&choice"=="DEM1X_F7_WALSH_ACC14_FRAME"
(
  per.view hwioreg.per "DEMOD,DEMOD_1X_OFFLINE,DEM1X_F7_WALSH_ACC14_FRAME"
)
if "&choice"=="DEM1X_F7_WALSH_ACC15_FRAME"
(
  per.view hwioreg.per "DEMOD,DEMOD_1X_OFFLINE,DEM1X_F7_WALSH_ACC15_FRAME"
)
if "&choice"=="DEM1X_F7_WALSH_ACC16_FRAME"
(
  per.view hwioreg.per "DEMOD,DEMOD_1X_OFFLINE,DEM1X_F7_WALSH_ACC16_FRAME"
)
if "&choice"=="DEM1X_F7_WALSH_ACC17_FRAME"
(
  per.view hwioreg.per "DEMOD,DEMOD_1X_OFFLINE,DEM1X_F7_WALSH_ACC17_FRAME"
)
if "&choice"=="DEM1X_F7_WALSH_ACC18_FRAME"
(
  per.view hwioreg.per "DEMOD,DEMOD_1X_OFFLINE,DEM1X_F7_WALSH_ACC18_FRAME"
)
if "&choice"=="DEM1X_F7_WALSH_ACC19_FRAME"
(
  per.view hwioreg.per "DEMOD,DEMOD_1X_OFFLINE,DEM1X_F7_WALSH_ACC19_FRAME"
)
if "&choice"=="DEM1X_F7_WALSH_ACC20_FRAME"
(
  per.view hwioreg.per "DEMOD,DEMOD_1X_OFFLINE,DEM1X_F7_WALSH_ACC20_FRAME"
)
if "&choice"=="DEM1X_F7_WALSH_ACC21_FRAME"
(
  per.view hwioreg.per "DEMOD,DEMOD_1X_OFFLINE,DEM1X_F7_WALSH_ACC21_FRAME"
)
if "&choice"=="DEM1X_F0_HW_CH4_IMMED"
(
  per.view hwioreg.per "DEMOD,DEMOD_1X_OFFLINE,DEM1X_F0_HW_CH4_IMMED"
)
if "&choice"=="DEM1X_F1_HW_CH4_IMMED"
(
  per.view hwioreg.per "DEMOD,DEMOD_1X_OFFLINE,DEM1X_F1_HW_CH4_IMMED"
)
if "&choice"=="DEM1X_F2_HW_CH4_IMMED"
(
  per.view hwioreg.per "DEMOD,DEMOD_1X_OFFLINE,DEM1X_F2_HW_CH4_IMMED"
)
if "&choice"=="DEM1X_F3_HW_CH4_IMMED"
(
  per.view hwioreg.per "DEMOD,DEMOD_1X_OFFLINE,DEM1X_F3_HW_CH4_IMMED"
)
if "&choice"=="DEM1X_F4_HW_CH4_IMMED"
(
  per.view hwioreg.per "DEMOD,DEMOD_1X_OFFLINE,DEM1X_F4_HW_CH4_IMMED"
)
if "&choice"=="DEM1X_F5_HW_CH4_IMMED"
(
  per.view hwioreg.per "DEMOD,DEMOD_1X_OFFLINE,DEM1X_F5_HW_CH4_IMMED"
)
if "&choice"=="DEM1X_F6_HW_CH4_IMMED"
(
  per.view hwioreg.per "DEMOD,DEMOD_1X_OFFLINE,DEM1X_F6_HW_CH4_IMMED"
)
if "&choice"=="DEM1X_F7_HW_CH4_IMMED"
(
  per.view hwioreg.per "DEMOD,DEMOD_1X_OFFLINE,DEM1X_F7_HW_CH4_IMMED"
)
if "&choice"=="DEM1X_F0_HW_CH4_FRAME"
(
  per.view hwioreg.per "DEMOD,DEMOD_1X_OFFLINE,DEM1X_F0_HW_CH4_FRAME"
)
if "&choice"=="DEM1X_F1_HW_CH4_FRAME"
(
  per.view hwioreg.per "DEMOD,DEMOD_1X_OFFLINE,DEM1X_F1_HW_CH4_FRAME"
)
if "&choice"=="DEM1X_F2_HW_CH4_FRAME"
(
  per.view hwioreg.per "DEMOD,DEMOD_1X_OFFLINE,DEM1X_F2_HW_CH4_FRAME"
)
if "&choice"=="DEM1X_F3_HW_CH4_FRAME"
(
  per.view hwioreg.per "DEMOD,DEMOD_1X_OFFLINE,DEM1X_F3_HW_CH4_FRAME"
)
if "&choice"=="DEM1X_F4_HW_CH4_FRAME"
(
  per.view hwioreg.per "DEMOD,DEMOD_1X_OFFLINE,DEM1X_F4_HW_CH4_FRAME"
)
if "&choice"=="DEM1X_F5_HW_CH4_FRAME"
(
  per.view hwioreg.per "DEMOD,DEMOD_1X_OFFLINE,DEM1X_F5_HW_CH4_FRAME"
)
if "&choice"=="DEM1X_F6_HW_CH4_FRAME"
(
  per.view hwioreg.per "DEMOD,DEMOD_1X_OFFLINE,DEM1X_F6_HW_CH4_FRAME"
)
if "&choice"=="DEM1X_F7_HW_CH4_FRAME"
(
  per.view hwioreg.per "DEMOD,DEMOD_1X_OFFLINE,DEM1X_F7_HW_CH4_FRAME"
)
if "&choice"=="DEM1X_F0_HW_CH5_IMMED"
(
  per.view hwioreg.per "DEMOD,DEMOD_1X_OFFLINE,DEM1X_F0_HW_CH5_IMMED"
)
if "&choice"=="DEM1X_F1_HW_CH5_IMMED"
(
  per.view hwioreg.per "DEMOD,DEMOD_1X_OFFLINE,DEM1X_F1_HW_CH5_IMMED"
)
if "&choice"=="DEM1X_F2_HW_CH5_IMMED"
(
  per.view hwioreg.per "DEMOD,DEMOD_1X_OFFLINE,DEM1X_F2_HW_CH5_IMMED"
)
if "&choice"=="DEM1X_F3_HW_CH5_IMMED"
(
  per.view hwioreg.per "DEMOD,DEMOD_1X_OFFLINE,DEM1X_F3_HW_CH5_IMMED"
)
if "&choice"=="DEM1X_F4_HW_CH5_IMMED"
(
  per.view hwioreg.per "DEMOD,DEMOD_1X_OFFLINE,DEM1X_F4_HW_CH5_IMMED"
)
if "&choice"=="DEM1X_F5_HW_CH5_IMMED"
(
  per.view hwioreg.per "DEMOD,DEMOD_1X_OFFLINE,DEM1X_F5_HW_CH5_IMMED"
)
if "&choice"=="DEM1X_F6_HW_CH5_IMMED"
(
  per.view hwioreg.per "DEMOD,DEMOD_1X_OFFLINE,DEM1X_F6_HW_CH5_IMMED"
)
if "&choice"=="DEM1X_F7_HW_CH5_IMMED"
(
  per.view hwioreg.per "DEMOD,DEMOD_1X_OFFLINE,DEM1X_F7_HW_CH5_IMMED"
)
if "&choice"=="DEM1X_F0_HW_CH5_FRAME"
(
  per.view hwioreg.per "DEMOD,DEMOD_1X_OFFLINE,DEM1X_F0_HW_CH5_FRAME"
)
if "&choice"=="DEM1X_F1_HW_CH5_FRAME"
(
  per.view hwioreg.per "DEMOD,DEMOD_1X_OFFLINE,DEM1X_F1_HW_CH5_FRAME"
)
if "&choice"=="DEM1X_F2_HW_CH5_FRAME"
(
  per.view hwioreg.per "DEMOD,DEMOD_1X_OFFLINE,DEM1X_F2_HW_CH5_FRAME"
)
if "&choice"=="DEM1X_F3_HW_CH5_FRAME"
(
  per.view hwioreg.per "DEMOD,DEMOD_1X_OFFLINE,DEM1X_F3_HW_CH5_FRAME"
)
if "&choice"=="DEM1X_F4_HW_CH5_FRAME"
(
  per.view hwioreg.per "DEMOD,DEMOD_1X_OFFLINE,DEM1X_F4_HW_CH5_FRAME"
)
if "&choice"=="DEM1X_F5_HW_CH5_FRAME"
(
  per.view hwioreg.per "DEMOD,DEMOD_1X_OFFLINE,DEM1X_F5_HW_CH5_FRAME"
)
if "&choice"=="DEM1X_F6_HW_CH5_FRAME"
(
  per.view hwioreg.per "DEMOD,DEMOD_1X_OFFLINE,DEM1X_F6_HW_CH5_FRAME"
)
if "&choice"=="DEM1X_F7_HW_CH5_FRAME"
(
  per.view hwioreg.per "DEMOD,DEMOD_1X_OFFLINE,DEM1X_F7_HW_CH5_FRAME"
)
if "&choice"=="DEM1X_FFE_TEST"
(
  per.view hwioreg.per "DEMOD,DEMOD_1X_OFFLINE,DEM1X_FFE_TEST"
)
if "&choice"=="DEM1X_FFE_TEST_MODE"
(
  per.view hwioreg.per "DEMOD,DEMOD_1X_OFFLINE,DEM1X_FFE_TEST_MODE"
)
if "&choice"=="DEM1X_FFE_TEST_MISR_RESET"
(
  per.view hwioreg.per "DEMOD,DEMOD_1X_OFFLINE,DEM1X_FFE_TEST_MISR_RESET"
)
if "&choice"=="DEM1X_FFE_TEST_EXPORT_MISR"
(
  per.view hwioreg.per "DEMOD,DEMOD_1X_OFFLINE,DEM1X_FFE_TEST_EXPORT_MISR"
)
if "&choice"=="DEM1X_FFE_TEST_CAPTURED"
(
  per.view hwioreg.per "DEMOD,DEMOD_1X_OFFLINE,DEM1X_FFE_TEST_CAPTURED"
)
if "&choice"=="DEM1X_FFE_TEST_MISR_CURR_VAL"
(
  per.view hwioreg.per "DEMOD,DEMOD_1X_OFFLINE,DEM1X_FFE_TEST_MISR_CURR_VAL"
)
if "&choice"=="DEM1X_FFE_TEST_MISR_CAPT_VAL"
(
  per.view hwioreg.per "DEMOD,DEMOD_1X_OFFLINE,DEM1X_FFE_TEST_MISR_CAPT_VAL"
)
if "&choice"=="DEM1X_TEST_MEM_SEL"
(
  per.view hwioreg.per "DEMOD,DEMOD_1X_OFFLINE,DEM1X_TEST_MEM_SEL"
)
if "&choice"=="DEM1X_TEST_MEM_ADDR"
(
  per.view hwioreg.per "DEMOD,DEMOD_1X_OFFLINE,DEM1X_TEST_MEM_ADDR"
)
if "&choice"=="DEM1X_TEST_MEM_WRITE"
(
  per.view hwioreg.per "DEMOD,DEMOD_1X_OFFLINE,DEM1X_TEST_MEM_WRITE"
)
if "&choice"=="DEM1X_TEST_MEM_READ0"
(
  per.view hwioreg.per "DEMOD,DEMOD_1X_OFFLINE,DEM1X_TEST_MEM_READ0"
)
if "&choice"=="DEM1X_HW_OFFLINE_CLK_CTL"
(
  per.view hwioreg.per "DEMOD,DEMOD_1X_OFFLINE,DEM1X_HW_OFFLINE_CLK_CTL"
)
if "&choice"=="DEM1X_MICRO_OFFLINE_CLK_CTL"
(
  per.view hwioreg.per "DEMOD,DEMOD_1X_OFFLINE,DEM1X_MICRO_OFFLINE_CLK_CTL"
)
if "&choice"=="DEM1X_OFFLINE_CLK_STATUS"
(
  per.view hwioreg.per "DEMOD,DEMOD_1X_OFFLINE,DEM1X_OFFLINE_CLK_STATUS"
)
if "&choice"=="DEM1X_OFFLINE_SPARE_READ_REG0"
(
  per.view hwioreg.per "DEMOD,DEMOD_1X_OFFLINE,DEM1X_OFFLINE_SPARE_READ_REG0"
)
if "&choice"=="DEM1X_OFFLINE_SPARE_READ_REG1"
(
  per.view hwioreg.per "DEMOD,DEMOD_1X_OFFLINE,DEM1X_OFFLINE_SPARE_READ_REG1"
)
if "&choice"=="DEM1X_FFE_CONFIG_SPARE_READ_REG0"
(
  per.view hwioreg.per "DEMOD,DEMOD_1X_OFFLINE,DEM1X_FFE_CONFIG_SPARE_READ_REG0"
)
if "&choice"=="DEM1X_FFE_RESULTS_SPARE_READ_REG0"
(
  per.view hwioreg.per "DEMOD,DEMOD_1X_OFFLINE,DEM1X_FFE_RESULTS_SPARE_READ_REG0"
)
if "&choice"=="DEM1X_FFE_ENGINE_SPARE_READ_REG0"
(
  per.view hwioreg.per "DEMOD,DEMOD_1X_OFFLINE,DEM1X_FFE_ENGINE_SPARE_READ_REG0"
)
if "&choice"=="DEM1X_FFE_ENGINE_SPARE_READ_REG1"
(
  per.view hwioreg.per "DEMOD,DEMOD_1X_OFFLINE,DEM1X_FFE_ENGINE_SPARE_READ_REG1"
)
if "&choice"=="DEM1X_RESET"
(
  per.view hwioreg.per "DEMOD,DEMOD_1X_RXCHIPX8,DEM1X_RESET"
)
if "&choice"=="DEM1X_TRACKING"
(
  per.view hwioreg.per "DEMOD,DEMOD_1X_RXCHIPX8,DEM1X_TRACKING"
)
if "&choice"=="DEM1X_FRAME_OFFSET"
(
  per.view hwioreg.per "DEMOD,DEMOD_1X_RXCHIPX8,DEM1X_FRAME_OFFSET"
)
if "&choice"=="DEM1X_FINGER_MERGE"
(
  per.view hwioreg.per "DEMOD,DEMOD_1X_RXCHIPX8,DEM1X_FINGER_MERGE"
)
if "&choice"=="DEM1X_FINGER0"
(
  per.view hwioreg.per "DEMOD,DEMOD_1X_RXCHIPX8,DEM1X_FINGER0"
)
if "&choice"=="DEM1X_FINGER1"
(
  per.view hwioreg.per "DEMOD,DEMOD_1X_RXCHIPX8,DEM1X_FINGER1"
)
if "&choice"=="DEM1X_FINGER2"
(
  per.view hwioreg.per "DEMOD,DEMOD_1X_RXCHIPX8,DEM1X_FINGER2"
)
if "&choice"=="DEM1X_FINGER3"
(
  per.view hwioreg.per "DEMOD,DEMOD_1X_RXCHIPX8,DEM1X_FINGER3"
)
if "&choice"=="DEM1X_FINGER4"
(
  per.view hwioreg.per "DEMOD,DEMOD_1X_RXCHIPX8,DEM1X_FINGER4"
)
if "&choice"=="DEM1X_FINGER5"
(
  per.view hwioreg.per "DEMOD,DEMOD_1X_RXCHIPX8,DEM1X_FINGER5"
)
if "&choice"=="DEM1X_FINGER6"
(
  per.view hwioreg.per "DEMOD,DEMOD_1X_RXCHIPX8,DEM1X_FINGER6"
)
if "&choice"=="DEM1X_FINGER7"
(
  per.view hwioreg.per "DEMOD,DEMOD_1X_RXCHIPX8,DEM1X_FINGER7"
)
if "&choice"=="DEM1X_COMBINER_TIME_LOAD"
(
  per.view hwioreg.per "DEMOD,DEMOD_1X_RXCHIPX8,DEM1X_COMBINER_TIME_LOAD"
)
if "&choice"=="DEM1X_LC_STATE_LOAD_LO"
(
  per.view hwioreg.per "DEMOD,DEMOD_1X_RXCHIPX8,DEM1X_LC_STATE_LOAD_LO"
)
if "&choice"=="DEM1X_LC_STATE_LOAD_HI"
(
  per.view hwioreg.per "DEMOD,DEMOD_1X_RXCHIPX8,DEM1X_LC_STATE_LOAD_HI"
)
if "&choice"=="DEM1X_COMBINER_TIME"
(
  per.view hwioreg.per "DEMOD,DEMOD_1X_RXCHIPX8,DEM1X_COMBINER_TIME"
)
if "&choice"=="DEM1X_FRAME_COUNT"
(
  per.view hwioreg.per "DEMOD,DEMOD_1X_RXCHIPX8,DEM1X_FRAME_COUNT"
)
if "&choice"=="DEM1X_LC_STATE_LO"
(
  per.view hwioreg.per "DEMOD,DEMOD_1X_RXCHIPX8,DEM1X_LC_STATE_LO"
)
if "&choice"=="DEM1X_LC_STATE_HI"
(
  per.view hwioreg.per "DEMOD,DEMOD_1X_RXCHIPX8,DEM1X_LC_STATE_HI"
)
if "&choice"=="DEM1X_TRAFFIC_REV_PWR_CTL"
(
  per.view hwioreg.per "DEMOD,DEMOD_1X_RXCHIPX8,DEM1X_TRAFFIC_REV_PWR_CTL"
)
if "&choice"=="DEM1X_COMMON_REV_PWR_CTL"
(
  per.view hwioreg.per "DEMOD,DEMOD_1X_RXCHIPX8,DEM1X_COMMON_REV_PWR_CTL"
)
if "&choice"=="DEM1X_COMMON_REV_PWR_CTL2"
(
  per.view hwioreg.per "DEMOD,DEMOD_1X_RXCHIPX8,DEM1X_COMMON_REV_PWR_CTL2"
)
if "&choice"=="DEM1X_FWD_PWR_CTL_IMMED"
(
  per.view hwioreg.per "DEMOD,DEMOD_1X_RXCHIPX8,DEM1X_FWD_PWR_CTL_IMMED"
)
if "&choice"=="DEM1X_FWD_PWR_CTL_FRAME"
(
  per.view hwioreg.per "DEMOD,DEMOD_1X_RXCHIPX8,DEM1X_FWD_PWR_CTL_FRAME"
)
if "&choice"=="DEM1X_FWD_PWR_CTL_TIMING"
(
  per.view hwioreg.per "DEMOD,DEMOD_1X_RXCHIPX8,DEM1X_FWD_PWR_CTL_TIMING"
)
if "&choice"=="DEM1X_BETA_TIMING"
(
  per.view hwioreg.per "DEMOD,DEMOD_1X_RXCHIPX8,DEM1X_BETA_TIMING"
)
if "&choice"=="DEM1X_TIME_INT1_ENABLE"
(
  per.view hwioreg.per "DEMOD,DEMOD_1X_RXCHIPX8,DEM1X_TIME_INT1_ENABLE"
)
if "&choice"=="DEM1X_TIME_INT1_STATUS"
(
  per.view hwioreg.per "DEMOD,DEMOD_1X_RXCHIPX8,DEM1X_TIME_INT1_STATUS"
)
if "&choice"=="DEM1X_TIME_INT1_CLEAR"
(
  per.view hwioreg.per "DEMOD,DEMOD_1X_RXCHIPX8,DEM1X_TIME_INT1_CLEAR"
)
if "&choice"=="DEM1X_TIME_INT2_ENABLE"
(
  per.view hwioreg.per "DEMOD,DEMOD_1X_RXCHIPX8,DEM1X_TIME_INT2_ENABLE"
)
if "&choice"=="DEM1X_TIME_INT2_STATUS"
(
  per.view hwioreg.per "DEMOD,DEMOD_1X_RXCHIPX8,DEM1X_TIME_INT2_STATUS"
)
if "&choice"=="DEM1X_TIME_INT2_CLEAR"
(
  per.view hwioreg.per "DEMOD,DEMOD_1X_RXCHIPX8,DEM1X_TIME_INT2_CLEAR"
)
if "&choice"=="DEM1X_CH0_LC_MASK_LO_IMMED"
(
  per.view hwioreg.per "DEMOD,DEMOD_1X_RXCHIPX8,DEM1X_CH0_LC_MASK_LO_IMMED"
)
if "&choice"=="DEM1X_CH1_LC_MASK_LO_IMMED"
(
  per.view hwioreg.per "DEMOD,DEMOD_1X_RXCHIPX8,DEM1X_CH1_LC_MASK_LO_IMMED"
)
if "&choice"=="DEM1X_CH2_LC_MASK_LO_IMMED"
(
  per.view hwioreg.per "DEMOD,DEMOD_1X_RXCHIPX8,DEM1X_CH2_LC_MASK_LO_IMMED"
)
if "&choice"=="DEM1X_CH3_LC_MASK_LO_IMMED"
(
  per.view hwioreg.per "DEMOD,DEMOD_1X_RXCHIPX8,DEM1X_CH3_LC_MASK_LO_IMMED"
)
if "&choice"=="DEM1X_CH4_LC_MASK_LO_IMMED"
(
  per.view hwioreg.per "DEMOD,DEMOD_1X_RXCHIPX8,DEM1X_CH4_LC_MASK_LO_IMMED"
)
if "&choice"=="DEM1X_CH5_LC_MASK_LO_IMMED"
(
  per.view hwioreg.per "DEMOD,DEMOD_1X_RXCHIPX8,DEM1X_CH5_LC_MASK_LO_IMMED"
)
if "&choice"=="DEM1X_CH6_LC_MASK_LO_IMMED"
(
  per.view hwioreg.per "DEMOD,DEMOD_1X_RXCHIPX8,DEM1X_CH6_LC_MASK_LO_IMMED"
)
if "&choice"=="DEM1X_CH7_LC_MASK_LO_IMMED"
(
  per.view hwioreg.per "DEMOD,DEMOD_1X_RXCHIPX8,DEM1X_CH7_LC_MASK_LO_IMMED"
)
if "&choice"=="DEM1X_CH8_LC_MASK_LO_IMMED"
(
  per.view hwioreg.per "DEMOD,DEMOD_1X_RXCHIPX8,DEM1X_CH8_LC_MASK_LO_IMMED"
)
if "&choice"=="DEM1X_CH0_LC_MASK_HI_IMMED"
(
  per.view hwioreg.per "DEMOD,DEMOD_1X_RXCHIPX8,DEM1X_CH0_LC_MASK_HI_IMMED"
)
if "&choice"=="DEM1X_CH1_LC_MASK_HI_IMMED"
(
  per.view hwioreg.per "DEMOD,DEMOD_1X_RXCHIPX8,DEM1X_CH1_LC_MASK_HI_IMMED"
)
if "&choice"=="DEM1X_CH2_LC_MASK_HI_IMMED"
(
  per.view hwioreg.per "DEMOD,DEMOD_1X_RXCHIPX8,DEM1X_CH2_LC_MASK_HI_IMMED"
)
if "&choice"=="DEM1X_CH3_LC_MASK_HI_IMMED"
(
  per.view hwioreg.per "DEMOD,DEMOD_1X_RXCHIPX8,DEM1X_CH3_LC_MASK_HI_IMMED"
)
if "&choice"=="DEM1X_CH4_LC_MASK_HI_IMMED"
(
  per.view hwioreg.per "DEMOD,DEMOD_1X_RXCHIPX8,DEM1X_CH4_LC_MASK_HI_IMMED"
)
if "&choice"=="DEM1X_CH5_LC_MASK_HI_IMMED"
(
  per.view hwioreg.per "DEMOD,DEMOD_1X_RXCHIPX8,DEM1X_CH5_LC_MASK_HI_IMMED"
)
if "&choice"=="DEM1X_CH6_LC_MASK_HI_IMMED"
(
  per.view hwioreg.per "DEMOD,DEMOD_1X_RXCHIPX8,DEM1X_CH6_LC_MASK_HI_IMMED"
)
if "&choice"=="DEM1X_CH7_LC_MASK_HI_IMMED"
(
  per.view hwioreg.per "DEMOD,DEMOD_1X_RXCHIPX8,DEM1X_CH7_LC_MASK_HI_IMMED"
)
if "&choice"=="DEM1X_CH8_LC_MASK_HI_IMMED"
(
  per.view hwioreg.per "DEMOD,DEMOD_1X_RXCHIPX8,DEM1X_CH8_LC_MASK_HI_IMMED"
)
if "&choice"=="DEM1X_CH0_LC_MASK_LO_SPN_ROLL"
(
  per.view hwioreg.per "DEMOD,DEMOD_1X_RXCHIPX8,DEM1X_CH0_LC_MASK_LO_SPN_ROLL"
)
if "&choice"=="DEM1X_CH1_LC_MASK_LO_SPN_ROLL"
(
  per.view hwioreg.per "DEMOD,DEMOD_1X_RXCHIPX8,DEM1X_CH1_LC_MASK_LO_SPN_ROLL"
)
if "&choice"=="DEM1X_CH2_LC_MASK_LO_SPN_ROLL"
(
  per.view hwioreg.per "DEMOD,DEMOD_1X_RXCHIPX8,DEM1X_CH2_LC_MASK_LO_SPN_ROLL"
)
if "&choice"=="DEM1X_CH3_LC_MASK_LO_SPN_ROLL"
(
  per.view hwioreg.per "DEMOD,DEMOD_1X_RXCHIPX8,DEM1X_CH3_LC_MASK_LO_SPN_ROLL"
)
if "&choice"=="DEM1X_CH4_LC_MASK_LO_SPN_ROLL"
(
  per.view hwioreg.per "DEMOD,DEMOD_1X_RXCHIPX8,DEM1X_CH4_LC_MASK_LO_SPN_ROLL"
)
if "&choice"=="DEM1X_CH5_LC_MASK_LO_SPN_ROLL"
(
  per.view hwioreg.per "DEMOD,DEMOD_1X_RXCHIPX8,DEM1X_CH5_LC_MASK_LO_SPN_ROLL"
)
if "&choice"=="DEM1X_CH6_LC_MASK_LO_SPN_ROLL"
(
  per.view hwioreg.per "DEMOD,DEMOD_1X_RXCHIPX8,DEM1X_CH6_LC_MASK_LO_SPN_ROLL"
)
if "&choice"=="DEM1X_CH7_LC_MASK_LO_SPN_ROLL"
(
  per.view hwioreg.per "DEMOD,DEMOD_1X_RXCHIPX8,DEM1X_CH7_LC_MASK_LO_SPN_ROLL"
)
if "&choice"=="DEM1X_CH8_LC_MASK_LO_SPN_ROLL"
(
  per.view hwioreg.per "DEMOD,DEMOD_1X_RXCHIPX8,DEM1X_CH8_LC_MASK_LO_SPN_ROLL"
)
if "&choice"=="DEM1X_CH0_LC_MASK_HI_SPN_ROLL"
(
  per.view hwioreg.per "DEMOD,DEMOD_1X_RXCHIPX8,DEM1X_CH0_LC_MASK_HI_SPN_ROLL"
)
if "&choice"=="DEM1X_CH1_LC_MASK_HI_SPN_ROLL"
(
  per.view hwioreg.per "DEMOD,DEMOD_1X_RXCHIPX8,DEM1X_CH1_LC_MASK_HI_SPN_ROLL"
)
if "&choice"=="DEM1X_CH2_LC_MASK_HI_SPN_ROLL"
(
  per.view hwioreg.per "DEMOD,DEMOD_1X_RXCHIPX8,DEM1X_CH2_LC_MASK_HI_SPN_ROLL"
)
if "&choice"=="DEM1X_CH3_LC_MASK_HI_SPN_ROLL"
(
  per.view hwioreg.per "DEMOD,DEMOD_1X_RXCHIPX8,DEM1X_CH3_LC_MASK_HI_SPN_ROLL"
)
if "&choice"=="DEM1X_CH4_LC_MASK_HI_SPN_ROLL"
(
  per.view hwioreg.per "DEMOD,DEMOD_1X_RXCHIPX8,DEM1X_CH4_LC_MASK_HI_SPN_ROLL"
)
if "&choice"=="DEM1X_CH5_LC_MASK_HI_SPN_ROLL"
(
  per.view hwioreg.per "DEMOD,DEMOD_1X_RXCHIPX8,DEM1X_CH5_LC_MASK_HI_SPN_ROLL"
)
if "&choice"=="DEM1X_CH6_LC_MASK_HI_SPN_ROLL"
(
  per.view hwioreg.per "DEMOD,DEMOD_1X_RXCHIPX8,DEM1X_CH6_LC_MASK_HI_SPN_ROLL"
)
if "&choice"=="DEM1X_CH7_LC_MASK_HI_SPN_ROLL"
(
  per.view hwioreg.per "DEMOD,DEMOD_1X_RXCHIPX8,DEM1X_CH7_LC_MASK_HI_SPN_ROLL"
)
if "&choice"=="DEM1X_CH8_LC_MASK_HI_SPN_ROLL"
(
  per.view hwioreg.per "DEMOD,DEMOD_1X_RXCHIPX8,DEM1X_CH8_LC_MASK_HI_SPN_ROLL"
)
if "&choice"=="DEM1X_COMBINER_CTL"
(
  per.view hwioreg.per "DEMOD,DEMOD_1X_RXCHIPX8,DEM1X_COMBINER_CTL"
)
if "&choice"=="DEM1X_FW_CH_ENABLE_IMMED"
(
  per.view hwioreg.per "DEMOD,DEMOD_1X_RXCHIPX8,DEM1X_FW_CH_ENABLE_IMMED"
)
if "&choice"=="DEM1X_FW_CH_ENABLE_FRAME"
(
  per.view hwioreg.per "DEMOD,DEMOD_1X_RXCHIPX8,DEM1X_FW_CH_ENABLE_FRAME"
)
if "&choice"=="DEM1X_CHANNEL0_IMMED"
(
  per.view hwioreg.per "DEMOD,DEMOD_1X_RXCHIPX8,DEM1X_CHANNEL0_IMMED"
)
if "&choice"=="DEM1X_CHANNEL0_FRAME"
(
  per.view hwioreg.per "DEMOD,DEMOD_1X_RXCHIPX8,DEM1X_CHANNEL0_FRAME"
)
if "&choice"=="DEM1X_CHANNEL1_IMMED"
(
  per.view hwioreg.per "DEMOD,DEMOD_1X_RXCHIPX8,DEM1X_CHANNEL1_IMMED"
)
if "&choice"=="DEM1X_CHANNEL1_FRAME"
(
  per.view hwioreg.per "DEMOD,DEMOD_1X_RXCHIPX8,DEM1X_CHANNEL1_FRAME"
)
if "&choice"=="DEM1X_CHANNEL2_IMMED"
(
  per.view hwioreg.per "DEMOD,DEMOD_1X_RXCHIPX8,DEM1X_CHANNEL2_IMMED"
)
if "&choice"=="DEM1X_CHANNEL2_FRAME"
(
  per.view hwioreg.per "DEMOD,DEMOD_1X_RXCHIPX8,DEM1X_CHANNEL2_FRAME"
)
if "&choice"=="DEM1X_CHANNEL3_IMMED"
(
  per.view hwioreg.per "DEMOD,DEMOD_1X_RXCHIPX8,DEM1X_CHANNEL3_IMMED"
)
if "&choice"=="DEM1X_CHANNEL3_FRAME"
(
  per.view hwioreg.per "DEMOD,DEMOD_1X_RXCHIPX8,DEM1X_CHANNEL3_FRAME"
)
if "&choice"=="DEM1X_CHANNEL4_IMMED"
(
  per.view hwioreg.per "DEMOD,DEMOD_1X_RXCHIPX8,DEM1X_CHANNEL4_IMMED"
)
if "&choice"=="DEM1X_CHANNEL4_FRAME"
(
  per.view hwioreg.per "DEMOD,DEMOD_1X_RXCHIPX8,DEM1X_CHANNEL4_FRAME"
)
if "&choice"=="DEM1X_CHANNEL5_IMMED"
(
  per.view hwioreg.per "DEMOD,DEMOD_1X_RXCHIPX8,DEM1X_CHANNEL5_IMMED"
)
if "&choice"=="DEM1X_CHANNEL5_FRAME"
(
  per.view hwioreg.per "DEMOD,DEMOD_1X_RXCHIPX8,DEM1X_CHANNEL5_FRAME"
)
if "&choice"=="DEM1X_CHANNEL6_IMMED"
(
  per.view hwioreg.per "DEMOD,DEMOD_1X_RXCHIPX8,DEM1X_CHANNEL6_IMMED"
)
if "&choice"=="DEM1X_CHANNEL6_FRAME"
(
  per.view hwioreg.per "DEMOD,DEMOD_1X_RXCHIPX8,DEM1X_CHANNEL6_FRAME"
)
if "&choice"=="DEM1X_CHANNEL8_IMMED"
(
  per.view hwioreg.per "DEMOD,DEMOD_1X_RXCHIPX8,DEM1X_CHANNEL8_IMMED"
)
if "&choice"=="DEM1X_CHANNEL8_FRAME"
(
  per.view hwioreg.per "DEMOD,DEMOD_1X_RXCHIPX8,DEM1X_CHANNEL8_FRAME"
)
if "&choice"=="DEM1X_ACKCH_FINGER0_IMMED"
(
  per.view hwioreg.per "DEMOD,DEMOD_1X_RXCHIPX8,DEM1X_ACKCH_FINGER0_IMMED"
)
if "&choice"=="DEM1X_ACKCH_FINGER1_IMMED"
(
  per.view hwioreg.per "DEMOD,DEMOD_1X_RXCHIPX8,DEM1X_ACKCH_FINGER1_IMMED"
)
if "&choice"=="DEM1X_ACKCH_FINGER2_IMMED"
(
  per.view hwioreg.per "DEMOD,DEMOD_1X_RXCHIPX8,DEM1X_ACKCH_FINGER2_IMMED"
)
if "&choice"=="DEM1X_ACKCH_FINGER3_IMMED"
(
  per.view hwioreg.per "DEMOD,DEMOD_1X_RXCHIPX8,DEM1X_ACKCH_FINGER3_IMMED"
)
if "&choice"=="DEM1X_ACKCH_FINGER4_IMMED"
(
  per.view hwioreg.per "DEMOD,DEMOD_1X_RXCHIPX8,DEM1X_ACKCH_FINGER4_IMMED"
)
if "&choice"=="DEM1X_ACKCH_FINGER5_IMMED"
(
  per.view hwioreg.per "DEMOD,DEMOD_1X_RXCHIPX8,DEM1X_ACKCH_FINGER5_IMMED"
)
if "&choice"=="DEM1X_ACKCH_FINGER0_FRAME"
(
  per.view hwioreg.per "DEMOD,DEMOD_1X_RXCHIPX8,DEM1X_ACKCH_FINGER0_FRAME"
)
if "&choice"=="DEM1X_ACKCH_FINGER1_FRAME"
(
  per.view hwioreg.per "DEMOD,DEMOD_1X_RXCHIPX8,DEM1X_ACKCH_FINGER1_FRAME"
)
if "&choice"=="DEM1X_ACKCH_FINGER2_FRAME"
(
  per.view hwioreg.per "DEMOD,DEMOD_1X_RXCHIPX8,DEM1X_ACKCH_FINGER2_FRAME"
)
if "&choice"=="DEM1X_ACKCH_FINGER3_FRAME"
(
  per.view hwioreg.per "DEMOD,DEMOD_1X_RXCHIPX8,DEM1X_ACKCH_FINGER3_FRAME"
)
if "&choice"=="DEM1X_ACKCH_FINGER4_FRAME"
(
  per.view hwioreg.per "DEMOD,DEMOD_1X_RXCHIPX8,DEM1X_ACKCH_FINGER4_FRAME"
)
if "&choice"=="DEM1X_ACKCH_FINGER5_FRAME"
(
  per.view hwioreg.per "DEMOD,DEMOD_1X_RXCHIPX8,DEM1X_ACKCH_FINGER5_FRAME"
)
if "&choice"=="DEM1X_RCCH_CTL"
(
  per.view hwioreg.per "DEMOD,DEMOD_1X_RXCHIPX8,DEM1X_RCCH_CTL"
)
if "&choice"=="DEM1X_RCCH_CTL2"
(
  per.view hwioreg.per "DEMOD,DEMOD_1X_RXCHIPX8,DEM1X_RCCH_CTL2"
)
if "&choice"=="DEM1X_SYS_TIME_GP_COMPARE"
(
  per.view hwioreg.per "DEMOD,DEMOD_1X_RXCHIPX8,DEM1X_SYS_TIME_GP_COMPARE"
)
if "&choice"=="DEM1X_OFFLINE"
(
  per.view hwioreg.per "DEMOD,DEMOD_1X_RXCHIPX8,DEM1X_OFFLINE"
)
if "&choice"=="DEM1X_REF_COUNT"
(
  per.view hwioreg.per "DEMOD,DEMOD_1X_RXCHIPX8,DEM1X_REF_COUNT"
)
if "&choice"=="DEM1X_RTC_ADJUST"
(
  per.view hwioreg.per "DEMOD,DEMOD_1X_RXCHIPX8,DEM1X_RTC_ADJUST"
)
if "&choice"=="DEM1X_RTF_CTL_SEL"
(
  per.view hwioreg.per "DEMOD,DEMOD_1X_RXCHIPX8,DEM1X_RTF_CTL_SEL"
)
if "&choice"=="DEM1X_LPN_ADV"
(
  per.view hwioreg.per "DEMOD,DEMOD_1X_RXCHIPX8,DEM1X_LPN_ADV"
)
if "&choice"=="DEM1X_FINGER_MERGE_F8"
(
  per.view hwioreg.per "DEMOD,DEMOD_1X_RXCHIPX8,DEM1X_FINGER_MERGE_F8"
)
if "&choice"=="DEM1X_CX8_TEST_MODE"
(
  per.view hwioreg.per "DEMOD,DEMOD_1X_RXCHIPX8,DEM1X_CX8_TEST_MODE"
)
if "&choice"=="DEM1X_CX8_TEST_MISR_RESET"
(
  per.view hwioreg.per "DEMOD,DEMOD_1X_RXCHIPX8,DEM1X_CX8_TEST_MISR_RESET"
)
if "&choice"=="DEM1X_CX8_TEST_EXPORT_MISR"
(
  per.view hwioreg.per "DEMOD,DEMOD_1X_RXCHIPX8,DEM1X_CX8_TEST_EXPORT_MISR"
)
if "&choice"=="DEM1X_CX8_TEST_CAPTURED"
(
  per.view hwioreg.per "DEMOD,DEMOD_1X_RXCHIPX8,DEM1X_CX8_TEST_CAPTURED"
)
if "&choice"=="DEM1X_CX8_TEST_MISR_CURR_VAL"
(
  per.view hwioreg.per "DEMOD,DEMOD_1X_RXCHIPX8,DEM1X_CX8_TEST_MISR_CURR_VAL"
)
if "&choice"=="DEM1X_CX8_TEST_MISR_CAPT_VAL"
(
  per.view hwioreg.per "DEMOD,DEMOD_1X_RXCHIPX8,DEM1X_CX8_TEST_MISR_CAPT_VAL"
)
if "&choice"=="DEM1X_MICRO_CX8_CLK_CTL"
(
  per.view hwioreg.per "DEMOD,DEMOD_1X_RXCHIPX8,DEM1X_MICRO_CX8_CLK_CTL"
)
if "&choice"=="DEM1X_CX8_CLK_STATUS"
(
  per.view hwioreg.per "DEMOD,DEMOD_1X_RXCHIPX8,DEM1X_CX8_CLK_STATUS"
)
if "&choice"=="DEM1X_RXCX8_SPARE_READ_REG0"
(
  per.view hwioreg.per "DEMOD,DEMOD_1X_RXCHIPX8,DEM1X_RXCX8_SPARE_READ_REG0"
)
if "&choice"=="DEM1X_RXCX8_SPARE_READ_REG1"
(
  per.view hwioreg.per "DEMOD,DEMOD_1X_RXCHIPX8,DEM1X_RXCX8_SPARE_READ_REG1"
)
if "&choice"=="DEM1X_RXCX8_SPARE_READ_REG2"
(
  per.view hwioreg.per "DEMOD,DEMOD_1X_RXCHIPX8,DEM1X_RXCX8_SPARE_READ_REG2"
)
if "&choice"=="DEM1X_RXCX8_SPARE_READ_REG3"
(
  per.view hwioreg.per "DEMOD,DEMOD_1X_RXCHIPX8,DEM1X_RXCX8_SPARE_READ_REG3"
)
if "&choice"=="DEM1X_RXCX8WR_SPARE_READ_REG0"
(
  per.view hwioreg.per "DEMOD,DEMOD_1X_RXCHIPX8,DEM1X_RXCX8WR_SPARE_READ_REG0"
)
if "&choice"=="MDM_HI0_CH0_CMD_PTR_SD0"
(
  per.view hwioreg.per "DMH00,MDM_HI0_CH0_CMD_PTR_SD0"
)
if "&choice"=="MDM_HI0_CH0_CMD_PTR_SD1"
(
  per.view hwioreg.per "DMH00,MDM_HI0_CH0_CMD_PTR_SD1"
)
if "&choice"=="MDM_HI0_CH0_CMD_PTR_SD2"
(
  per.view hwioreg.per "DMH00,MDM_HI0_CH0_CMD_PTR_SD2"
)
if "&choice"=="MDM_HI0_CH0_CMD_PTR_SD3"
(
  per.view hwioreg.per "DMH00,MDM_HI0_CH0_CMD_PTR_SD3"
)
if "&choice"=="MDM_HI0_CH1_CMD_PTR_SD0"
(
  per.view hwioreg.per "DMH00,MDM_HI0_CH1_CMD_PTR_SD0"
)
if "&choice"=="MDM_HI0_CH1_CMD_PTR_SD1"
(
  per.view hwioreg.per "DMH00,MDM_HI0_CH1_CMD_PTR_SD1"
)
if "&choice"=="MDM_HI0_CH1_CMD_PTR_SD2"
(
  per.view hwioreg.per "DMH00,MDM_HI0_CH1_CMD_PTR_SD2"
)
if "&choice"=="MDM_HI0_CH1_CMD_PTR_SD3"
(
  per.view hwioreg.per "DMH00,MDM_HI0_CH1_CMD_PTR_SD3"
)
if "&choice"=="MDM_HI0_CH2_CMD_PTR_SD0"
(
  per.view hwioreg.per "DMH00,MDM_HI0_CH2_CMD_PTR_SD0"
)
if "&choice"=="MDM_HI0_CH2_CMD_PTR_SD1"
(
  per.view hwioreg.per "DMH00,MDM_HI0_CH2_CMD_PTR_SD1"
)
if "&choice"=="MDM_HI0_CH2_CMD_PTR_SD2"
(
  per.view hwioreg.per "DMH00,MDM_HI0_CH2_CMD_PTR_SD2"
)
if "&choice"=="MDM_HI0_CH2_CMD_PTR_SD3"
(
  per.view hwioreg.per "DMH00,MDM_HI0_CH2_CMD_PTR_SD3"
)
if "&choice"=="MDM_HI0_CH3_CMD_PTR_SD0"
(
  per.view hwioreg.per "DMH00,MDM_HI0_CH3_CMD_PTR_SD0"
)
if "&choice"=="MDM_HI0_CH3_CMD_PTR_SD1"
(
  per.view hwioreg.per "DMH00,MDM_HI0_CH3_CMD_PTR_SD1"
)
if "&choice"=="MDM_HI0_CH3_CMD_PTR_SD2"
(
  per.view hwioreg.per "DMH00,MDM_HI0_CH3_CMD_PTR_SD2"
)
if "&choice"=="MDM_HI0_CH3_CMD_PTR_SD3"
(
  per.view hwioreg.per "DMH00,MDM_HI0_CH3_CMD_PTR_SD3"
)
if "&choice"=="MDM_HI0_CH4_CMD_PTR_SD0"
(
  per.view hwioreg.per "DMH00,MDM_HI0_CH4_CMD_PTR_SD0"
)
if "&choice"=="MDM_HI0_CH4_CMD_PTR_SD1"
(
  per.view hwioreg.per "DMH00,MDM_HI0_CH4_CMD_PTR_SD1"
)
if "&choice"=="MDM_HI0_CH4_CMD_PTR_SD2"
(
  per.view hwioreg.per "DMH00,MDM_HI0_CH4_CMD_PTR_SD2"
)
if "&choice"=="MDM_HI0_CH4_CMD_PTR_SD3"
(
  per.view hwioreg.per "DMH00,MDM_HI0_CH4_CMD_PTR_SD3"
)
if "&choice"=="MDM_HI0_CH5_CMD_PTR_SD0"
(
  per.view hwioreg.per "DMH00,MDM_HI0_CH5_CMD_PTR_SD0"
)
if "&choice"=="MDM_HI0_CH5_CMD_PTR_SD1"
(
  per.view hwioreg.per "DMH00,MDM_HI0_CH5_CMD_PTR_SD1"
)
if "&choice"=="MDM_HI0_CH5_CMD_PTR_SD2"
(
  per.view hwioreg.per "DMH00,MDM_HI0_CH5_CMD_PTR_SD2"
)
if "&choice"=="MDM_HI0_CH5_CMD_PTR_SD3"
(
  per.view hwioreg.per "DMH00,MDM_HI0_CH5_CMD_PTR_SD3"
)
if "&choice"=="MDM_HI0_CH6_CMD_PTR_SD0"
(
  per.view hwioreg.per "DMH00,MDM_HI0_CH6_CMD_PTR_SD0"
)
if "&choice"=="MDM_HI0_CH6_CMD_PTR_SD1"
(
  per.view hwioreg.per "DMH00,MDM_HI0_CH6_CMD_PTR_SD1"
)
if "&choice"=="MDM_HI0_CH6_CMD_PTR_SD2"
(
  per.view hwioreg.per "DMH00,MDM_HI0_CH6_CMD_PTR_SD2"
)
if "&choice"=="MDM_HI0_CH6_CMD_PTR_SD3"
(
  per.view hwioreg.per "DMH00,MDM_HI0_CH6_CMD_PTR_SD3"
)
if "&choice"=="MDM_HI0_CH7_CMD_PTR_SD0"
(
  per.view hwioreg.per "DMH00,MDM_HI0_CH7_CMD_PTR_SD0"
)
if "&choice"=="MDM_HI0_CH7_CMD_PTR_SD1"
(
  per.view hwioreg.per "DMH00,MDM_HI0_CH7_CMD_PTR_SD1"
)
if "&choice"=="MDM_HI0_CH7_CMD_PTR_SD2"
(
  per.view hwioreg.per "DMH00,MDM_HI0_CH7_CMD_PTR_SD2"
)
if "&choice"=="MDM_HI0_CH7_CMD_PTR_SD3"
(
  per.view hwioreg.per "DMH00,MDM_HI0_CH7_CMD_PTR_SD3"
)
if "&choice"=="MDM_HI0_CH8_CMD_PTR_SD0"
(
  per.view hwioreg.per "DMH00,MDM_HI0_CH8_CMD_PTR_SD0"
)
if "&choice"=="MDM_HI0_CH8_CMD_PTR_SD1"
(
  per.view hwioreg.per "DMH00,MDM_HI0_CH8_CMD_PTR_SD1"
)
if "&choice"=="MDM_HI0_CH8_CMD_PTR_SD2"
(
  per.view hwioreg.per "DMH00,MDM_HI0_CH8_CMD_PTR_SD2"
)
if "&choice"=="MDM_HI0_CH8_CMD_PTR_SD3"
(
  per.view hwioreg.per "DMH00,MDM_HI0_CH8_CMD_PTR_SD3"
)
if "&choice"=="MDM_HI0_CH9_CMD_PTR_SD0"
(
  per.view hwioreg.per "DMH00,MDM_HI0_CH9_CMD_PTR_SD0"
)
if "&choice"=="MDM_HI0_CH9_CMD_PTR_SD1"
(
  per.view hwioreg.per "DMH00,MDM_HI0_CH9_CMD_PTR_SD1"
)
if "&choice"=="MDM_HI0_CH9_CMD_PTR_SD2"
(
  per.view hwioreg.per "DMH00,MDM_HI0_CH9_CMD_PTR_SD2"
)
if "&choice"=="MDM_HI0_CH9_CMD_PTR_SD3"
(
  per.view hwioreg.per "DMH00,MDM_HI0_CH9_CMD_PTR_SD3"
)
if "&choice"=="MDM_HI0_CH10_CMD_PTR_SD0"
(
  per.view hwioreg.per "DMH00,MDM_HI0_CH10_CMD_PTR_SD0"
)
if "&choice"=="MDM_HI0_CH10_CMD_PTR_SD1"
(
  per.view hwioreg.per "DMH00,MDM_HI0_CH10_CMD_PTR_SD1"
)
if "&choice"=="MDM_HI0_CH10_CMD_PTR_SD2"
(
  per.view hwioreg.per "DMH00,MDM_HI0_CH10_CMD_PTR_SD2"
)
if "&choice"=="MDM_HI0_CH10_CMD_PTR_SD3"
(
  per.view hwioreg.per "DMH00,MDM_HI0_CH10_CMD_PTR_SD3"
)
if "&choice"=="MDM_HI0_CH11_CMD_PTR_SD0"
(
  per.view hwioreg.per "DMH00,MDM_HI0_CH11_CMD_PTR_SD0"
)
if "&choice"=="MDM_HI0_CH11_CMD_PTR_SD1"
(
  per.view hwioreg.per "DMH00,MDM_HI0_CH11_CMD_PTR_SD1"
)
if "&choice"=="MDM_HI0_CH11_CMD_PTR_SD2"
(
  per.view hwioreg.per "DMH00,MDM_HI0_CH11_CMD_PTR_SD2"
)
if "&choice"=="MDM_HI0_CH11_CMD_PTR_SD3"
(
  per.view hwioreg.per "DMH00,MDM_HI0_CH11_CMD_PTR_SD3"
)
if "&choice"=="MDM_HI0_CH12_CMD_PTR_SD0"
(
  per.view hwioreg.per "DMH00,MDM_HI0_CH12_CMD_PTR_SD0"
)
if "&choice"=="MDM_HI0_CH12_CMD_PTR_SD1"
(
  per.view hwioreg.per "DMH00,MDM_HI0_CH12_CMD_PTR_SD1"
)
if "&choice"=="MDM_HI0_CH12_CMD_PTR_SD2"
(
  per.view hwioreg.per "DMH00,MDM_HI0_CH12_CMD_PTR_SD2"
)
if "&choice"=="MDM_HI0_CH12_CMD_PTR_SD3"
(
  per.view hwioreg.per "DMH00,MDM_HI0_CH12_CMD_PTR_SD3"
)
if "&choice"=="MDM_HI0_CH13_CMD_PTR_SD0"
(
  per.view hwioreg.per "DMH00,MDM_HI0_CH13_CMD_PTR_SD0"
)
if "&choice"=="MDM_HI0_CH13_CMD_PTR_SD1"
(
  per.view hwioreg.per "DMH00,MDM_HI0_CH13_CMD_PTR_SD1"
)
if "&choice"=="MDM_HI0_CH13_CMD_PTR_SD2"
(
  per.view hwioreg.per "DMH00,MDM_HI0_CH13_CMD_PTR_SD2"
)
if "&choice"=="MDM_HI0_CH13_CMD_PTR_SD3"
(
  per.view hwioreg.per "DMH00,MDM_HI0_CH13_CMD_PTR_SD3"
)
if "&choice"=="MDM_HI0_CH14_CMD_PTR_SD0"
(
  per.view hwioreg.per "DMH00,MDM_HI0_CH14_CMD_PTR_SD0"
)
if "&choice"=="MDM_HI0_CH14_CMD_PTR_SD1"
(
  per.view hwioreg.per "DMH00,MDM_HI0_CH14_CMD_PTR_SD1"
)
if "&choice"=="MDM_HI0_CH14_CMD_PTR_SD2"
(
  per.view hwioreg.per "DMH00,MDM_HI0_CH14_CMD_PTR_SD2"
)
if "&choice"=="MDM_HI0_CH14_CMD_PTR_SD3"
(
  per.view hwioreg.per "DMH00,MDM_HI0_CH14_CMD_PTR_SD3"
)
if "&choice"=="MDM_HI0_CH15_CMD_PTR_SD0"
(
  per.view hwioreg.per "DMH00,MDM_HI0_CH15_CMD_PTR_SD0"
)
if "&choice"=="MDM_HI0_CH15_CMD_PTR_SD1"
(
  per.view hwioreg.per "DMH00,MDM_HI0_CH15_CMD_PTR_SD1"
)
if "&choice"=="MDM_HI0_CH15_CMD_PTR_SD2"
(
  per.view hwioreg.per "DMH00,MDM_HI0_CH15_CMD_PTR_SD2"
)
if "&choice"=="MDM_HI0_CH15_CMD_PTR_SD3"
(
  per.view hwioreg.per "DMH00,MDM_HI0_CH15_CMD_PTR_SD3"
)
if "&choice"=="MDM_HI0_CH0_RSLT_SD0"
(
  per.view hwioreg.per "DMH00,MDM_HI0_CH0_RSLT_SD0"
)
if "&choice"=="MDM_HI0_CH0_RSLT_SD1"
(
  per.view hwioreg.per "DMH00,MDM_HI0_CH0_RSLT_SD1"
)
if "&choice"=="MDM_HI0_CH0_RSLT_SD2"
(
  per.view hwioreg.per "DMH00,MDM_HI0_CH0_RSLT_SD2"
)
if "&choice"=="MDM_HI0_CH0_RSLT_SD3"
(
  per.view hwioreg.per "DMH00,MDM_HI0_CH0_RSLT_SD3"
)
if "&choice"=="MDM_HI0_CH1_RSLT_SD0"
(
  per.view hwioreg.per "DMH00,MDM_HI0_CH1_RSLT_SD0"
)
if "&choice"=="MDM_HI0_CH1_RSLT_SD1"
(
  per.view hwioreg.per "DMH00,MDM_HI0_CH1_RSLT_SD1"
)
if "&choice"=="MDM_HI0_CH1_RSLT_SD2"
(
  per.view hwioreg.per "DMH00,MDM_HI0_CH1_RSLT_SD2"
)
if "&choice"=="MDM_HI0_CH1_RSLT_SD3"
(
  per.view hwioreg.per "DMH00,MDM_HI0_CH1_RSLT_SD3"
)
if "&choice"=="MDM_HI0_CH2_RSLT_SD0"
(
  per.view hwioreg.per "DMH00,MDM_HI0_CH2_RSLT_SD0"
)
if "&choice"=="MDM_HI0_CH2_RSLT_SD1"
(
  per.view hwioreg.per "DMH00,MDM_HI0_CH2_RSLT_SD1"
)
if "&choice"=="MDM_HI0_CH2_RSLT_SD2"
(
  per.view hwioreg.per "DMH00,MDM_HI0_CH2_RSLT_SD2"
)
if "&choice"=="MDM_HI0_CH2_RSLT_SD3"
(
  per.view hwioreg.per "DMH00,MDM_HI0_CH2_RSLT_SD3"
)
if "&choice"=="MDM_HI0_CH3_RSLT_SD0"
(
  per.view hwioreg.per "DMH00,MDM_HI0_CH3_RSLT_SD0"
)
if "&choice"=="MDM_HI0_CH3_RSLT_SD1"
(
  per.view hwioreg.per "DMH00,MDM_HI0_CH3_RSLT_SD1"
)
if "&choice"=="MDM_HI0_CH3_RSLT_SD2"
(
  per.view hwioreg.per "DMH00,MDM_HI0_CH3_RSLT_SD2"
)
if "&choice"=="MDM_HI0_CH3_RSLT_SD3"
(
  per.view hwioreg.per "DMH00,MDM_HI0_CH3_RSLT_SD3"
)
if "&choice"=="MDM_HI0_CH4_RSLT_SD0"
(
  per.view hwioreg.per "DMH00,MDM_HI0_CH4_RSLT_SD0"
)
if "&choice"=="MDM_HI0_CH4_RSLT_SD1"
(
  per.view hwioreg.per "DMH00,MDM_HI0_CH4_RSLT_SD1"
)
if "&choice"=="MDM_HI0_CH4_RSLT_SD2"
(
  per.view hwioreg.per "DMH00,MDM_HI0_CH4_RSLT_SD2"
)
if "&choice"=="MDM_HI0_CH4_RSLT_SD3"
(
  per.view hwioreg.per "DMH00,MDM_HI0_CH4_RSLT_SD3"
)
if "&choice"=="MDM_HI0_CH5_RSLT_SD0"
(
  per.view hwioreg.per "DMH00,MDM_HI0_CH5_RSLT_SD0"
)
if "&choice"=="MDM_HI0_CH5_RSLT_SD1"
(
  per.view hwioreg.per "DMH00,MDM_HI0_CH5_RSLT_SD1"
)
if "&choice"=="MDM_HI0_CH5_RSLT_SD2"
(
  per.view hwioreg.per "DMH00,MDM_HI0_CH5_RSLT_SD2"
)
if "&choice"=="MDM_HI0_CH5_RSLT_SD3"
(
  per.view hwioreg.per "DMH00,MDM_HI0_CH5_RSLT_SD3"
)
if "&choice"=="MDM_HI0_CH6_RSLT_SD0"
(
  per.view hwioreg.per "DMH00,MDM_HI0_CH6_RSLT_SD0"
)
if "&choice"=="MDM_HI0_CH6_RSLT_SD1"
(
  per.view hwioreg.per "DMH00,MDM_HI0_CH6_RSLT_SD1"
)
if "&choice"=="MDM_HI0_CH6_RSLT_SD2"
(
  per.view hwioreg.per "DMH00,MDM_HI0_CH6_RSLT_SD2"
)
if "&choice"=="MDM_HI0_CH6_RSLT_SD3"
(
  per.view hwioreg.per "DMH00,MDM_HI0_CH6_RSLT_SD3"
)
if "&choice"=="MDM_HI0_CH7_RSLT_SD0"
(
  per.view hwioreg.per "DMH00,MDM_HI0_CH7_RSLT_SD0"
)
if "&choice"=="MDM_HI0_CH7_RSLT_SD1"
(
  per.view hwioreg.per "DMH00,MDM_HI0_CH7_RSLT_SD1"
)
if "&choice"=="MDM_HI0_CH7_RSLT_SD2"
(
  per.view hwioreg.per "DMH00,MDM_HI0_CH7_RSLT_SD2"
)
if "&choice"=="MDM_HI0_CH7_RSLT_SD3"
(
  per.view hwioreg.per "DMH00,MDM_HI0_CH7_RSLT_SD3"
)
if "&choice"=="MDM_HI0_CH8_RSLT_SD0"
(
  per.view hwioreg.per "DMH00,MDM_HI0_CH8_RSLT_SD0"
)
if "&choice"=="MDM_HI0_CH8_RSLT_SD1"
(
  per.view hwioreg.per "DMH00,MDM_HI0_CH8_RSLT_SD1"
)
if "&choice"=="MDM_HI0_CH8_RSLT_SD2"
(
  per.view hwioreg.per "DMH00,MDM_HI0_CH8_RSLT_SD2"
)
if "&choice"=="MDM_HI0_CH8_RSLT_SD3"
(
  per.view hwioreg.per "DMH00,MDM_HI0_CH8_RSLT_SD3"
)
if "&choice"=="MDM_HI0_CH9_RSLT_SD0"
(
  per.view hwioreg.per "DMH00,MDM_HI0_CH9_RSLT_SD0"
)
if "&choice"=="MDM_HI0_CH9_RSLT_SD1"
(
  per.view hwioreg.per "DMH00,MDM_HI0_CH9_RSLT_SD1"
)
if "&choice"=="MDM_HI0_CH9_RSLT_SD2"
(
  per.view hwioreg.per "DMH00,MDM_HI0_CH9_RSLT_SD2"
)
if "&choice"=="MDM_HI0_CH9_RSLT_SD3"
(
  per.view hwioreg.per "DMH00,MDM_HI0_CH9_RSLT_SD3"
)
if "&choice"=="MDM_HI0_CH10_RSLT_SD0"
(
  per.view hwioreg.per "DMH00,MDM_HI0_CH10_RSLT_SD0"
)
if "&choice"=="MDM_HI0_CH10_RSLT_SD1"
(
  per.view hwioreg.per "DMH00,MDM_HI0_CH10_RSLT_SD1"
)
if "&choice"=="MDM_HI0_CH10_RSLT_SD2"
(
  per.view hwioreg.per "DMH00,MDM_HI0_CH10_RSLT_SD2"
)
if "&choice"=="MDM_HI0_CH10_RSLT_SD3"
(
  per.view hwioreg.per "DMH00,MDM_HI0_CH10_RSLT_SD3"
)
if "&choice"=="MDM_HI0_CH11_RSLT_SD0"
(
  per.view hwioreg.per "DMH00,MDM_HI0_CH11_RSLT_SD0"
)
if "&choice"=="MDM_HI0_CH11_RSLT_SD1"
(
  per.view hwioreg.per "DMH00,MDM_HI0_CH11_RSLT_SD1"
)
if "&choice"=="MDM_HI0_CH11_RSLT_SD2"
(
  per.view hwioreg.per "DMH00,MDM_HI0_CH11_RSLT_SD2"
)
if "&choice"=="MDM_HI0_CH11_RSLT_SD3"
(
  per.view hwioreg.per "DMH00,MDM_HI0_CH11_RSLT_SD3"
)
if "&choice"=="MDM_HI0_CH12_RSLT_SD0"
(
  per.view hwioreg.per "DMH00,MDM_HI0_CH12_RSLT_SD0"
)
if "&choice"=="MDM_HI0_CH12_RSLT_SD1"
(
  per.view hwioreg.per "DMH00,MDM_HI0_CH12_RSLT_SD1"
)
if "&choice"=="MDM_HI0_CH12_RSLT_SD2"
(
  per.view hwioreg.per "DMH00,MDM_HI0_CH12_RSLT_SD2"
)
if "&choice"=="MDM_HI0_CH12_RSLT_SD3"
(
  per.view hwioreg.per "DMH00,MDM_HI0_CH12_RSLT_SD3"
)
if "&choice"=="MDM_HI0_CH13_RSLT_SD0"
(
  per.view hwioreg.per "DMH00,MDM_HI0_CH13_RSLT_SD0"
)
if "&choice"=="MDM_HI0_CH13_RSLT_SD1"
(
  per.view hwioreg.per "DMH00,MDM_HI0_CH13_RSLT_SD1"
)
if "&choice"=="MDM_HI0_CH13_RSLT_SD2"
(
  per.view hwioreg.per "DMH00,MDM_HI0_CH13_RSLT_SD2"
)
if "&choice"=="MDM_HI0_CH13_RSLT_SD3"
(
  per.view hwioreg.per "DMH00,MDM_HI0_CH13_RSLT_SD3"
)
if "&choice"=="MDM_HI0_CH14_RSLT_SD0"
(
  per.view hwioreg.per "DMH00,MDM_HI0_CH14_RSLT_SD0"
)
if "&choice"=="MDM_HI0_CH14_RSLT_SD1"
(
  per.view hwioreg.per "DMH00,MDM_HI0_CH14_RSLT_SD1"
)
if "&choice"=="MDM_HI0_CH14_RSLT_SD2"
(
  per.view hwioreg.per "DMH00,MDM_HI0_CH14_RSLT_SD2"
)
if "&choice"=="MDM_HI0_CH14_RSLT_SD3"
(
  per.view hwioreg.per "DMH00,MDM_HI0_CH14_RSLT_SD3"
)
if "&choice"=="MDM_HI0_CH15_RSLT_SD0"
(
  per.view hwioreg.per "DMH00,MDM_HI0_CH15_RSLT_SD0"
)
if "&choice"=="MDM_HI0_CH15_RSLT_SD1"
(
  per.view hwioreg.per "DMH00,MDM_HI0_CH15_RSLT_SD1"
)
if "&choice"=="MDM_HI0_CH15_RSLT_SD2"
(
  per.view hwioreg.per "DMH00,MDM_HI0_CH15_RSLT_SD2"
)
if "&choice"=="MDM_HI0_CH15_RSLT_SD3"
(
  per.view hwioreg.per "DMH00,MDM_HI0_CH15_RSLT_SD3"
)
if "&choice"=="MDM_HI0_CH0_FLUSH_STATE0_SD0"
(
  per.view hwioreg.per "DMH00,MDM_HI0_CH0_FLUSH_STATE0_SD0"
)
if "&choice"=="MDM_HI0_CH0_FLUSH_STATE0_SD1"
(
  per.view hwioreg.per "DMH00,MDM_HI0_CH0_FLUSH_STATE0_SD1"
)
if "&choice"=="MDM_HI0_CH0_FLUSH_STATE0_SD2"
(
  per.view hwioreg.per "DMH00,MDM_HI0_CH0_FLUSH_STATE0_SD2"
)
if "&choice"=="MDM_HI0_CH0_FLUSH_STATE0_SD3"
(
  per.view hwioreg.per "DMH00,MDM_HI0_CH0_FLUSH_STATE0_SD3"
)
if "&choice"=="MDM_HI0_CH1_FLUSH_STATE0_SD0"
(
  per.view hwioreg.per "DMH00,MDM_HI0_CH1_FLUSH_STATE0_SD0"
)
if "&choice"=="MDM_HI0_CH1_FLUSH_STATE0_SD1"
(
  per.view hwioreg.per "DMH00,MDM_HI0_CH1_FLUSH_STATE0_SD1"
)
if "&choice"=="MDM_HI0_CH1_FLUSH_STATE0_SD2"
(
  per.view hwioreg.per "DMH00,MDM_HI0_CH1_FLUSH_STATE0_SD2"
)
if "&choice"=="MDM_HI0_CH1_FLUSH_STATE0_SD3"
(
  per.view hwioreg.per "DMH00,MDM_HI0_CH1_FLUSH_STATE0_SD3"
)
if "&choice"=="MDM_HI0_CH2_FLUSH_STATE0_SD0"
(
  per.view hwioreg.per "DMH00,MDM_HI0_CH2_FLUSH_STATE0_SD0"
)
if "&choice"=="MDM_HI0_CH2_FLUSH_STATE0_SD1"
(
  per.view hwioreg.per "DMH00,MDM_HI0_CH2_FLUSH_STATE0_SD1"
)
if "&choice"=="MDM_HI0_CH2_FLUSH_STATE0_SD2"
(
  per.view hwioreg.per "DMH00,MDM_HI0_CH2_FLUSH_STATE0_SD2"
)
if "&choice"=="MDM_HI0_CH2_FLUSH_STATE0_SD3"
(
  per.view hwioreg.per "DMH00,MDM_HI0_CH2_FLUSH_STATE0_SD3"
)
if "&choice"=="MDM_HI0_CH3_FLUSH_STATE0_SD0"
(
  per.view hwioreg.per "DMH00,MDM_HI0_CH3_FLUSH_STATE0_SD0"
)
if "&choice"=="MDM_HI0_CH3_FLUSH_STATE0_SD1"
(
  per.view hwioreg.per "DMH00,MDM_HI0_CH3_FLUSH_STATE0_SD1"
)
if "&choice"=="MDM_HI0_CH3_FLUSH_STATE0_SD2"
(
  per.view hwioreg.per "DMH00,MDM_HI0_CH3_FLUSH_STATE0_SD2"
)
if "&choice"=="MDM_HI0_CH3_FLUSH_STATE0_SD3"
(
  per.view hwioreg.per "DMH00,MDM_HI0_CH3_FLUSH_STATE0_SD3"
)
if "&choice"=="MDM_HI0_CH4_FLUSH_STATE0_SD0"
(
  per.view hwioreg.per "DMH00,MDM_HI0_CH4_FLUSH_STATE0_SD0"
)
if "&choice"=="MDM_HI0_CH4_FLUSH_STATE0_SD1"
(
  per.view hwioreg.per "DMH00,MDM_HI0_CH4_FLUSH_STATE0_SD1"
)
if "&choice"=="MDM_HI0_CH4_FLUSH_STATE0_SD2"
(
  per.view hwioreg.per "DMH00,MDM_HI0_CH4_FLUSH_STATE0_SD2"
)
if "&choice"=="MDM_HI0_CH4_FLUSH_STATE0_SD3"
(
  per.view hwioreg.per "DMH00,MDM_HI0_CH4_FLUSH_STATE0_SD3"
)
if "&choice"=="MDM_HI0_CH5_FLUSH_STATE0_SD0"
(
  per.view hwioreg.per "DMH00,MDM_HI0_CH5_FLUSH_STATE0_SD0"
)
if "&choice"=="MDM_HI0_CH5_FLUSH_STATE0_SD1"
(
  per.view hwioreg.per "DMH00,MDM_HI0_CH5_FLUSH_STATE0_SD1"
)
if "&choice"=="MDM_HI0_CH5_FLUSH_STATE0_SD2"
(
  per.view hwioreg.per "DMH00,MDM_HI0_CH5_FLUSH_STATE0_SD2"
)
if "&choice"=="MDM_HI0_CH5_FLUSH_STATE0_SD3"
(
  per.view hwioreg.per "DMH00,MDM_HI0_CH5_FLUSH_STATE0_SD3"
)
if "&choice"=="MDM_HI0_CH6_FLUSH_STATE0_SD0"
(
  per.view hwioreg.per "DMH00,MDM_HI0_CH6_FLUSH_STATE0_SD0"
)
if "&choice"=="MDM_HI0_CH6_FLUSH_STATE0_SD1"
(
  per.view hwioreg.per "DMH00,MDM_HI0_CH6_FLUSH_STATE0_SD1"
)
if "&choice"=="MDM_HI0_CH6_FLUSH_STATE0_SD2"
(
  per.view hwioreg.per "DMH00,MDM_HI0_CH6_FLUSH_STATE0_SD2"
)
if "&choice"=="MDM_HI0_CH6_FLUSH_STATE0_SD3"
(
  per.view hwioreg.per "DMH00,MDM_HI0_CH6_FLUSH_STATE0_SD3"
)
if "&choice"=="MDM_HI0_CH7_FLUSH_STATE0_SD0"
(
  per.view hwioreg.per "DMH00,MDM_HI0_CH7_FLUSH_STATE0_SD0"
)
if "&choice"=="MDM_HI0_CH7_FLUSH_STATE0_SD1"
(
  per.view hwioreg.per "DMH00,MDM_HI0_CH7_FLUSH_STATE0_SD1"
)
if "&choice"=="MDM_HI0_CH7_FLUSH_STATE0_SD2"
(
  per.view hwioreg.per "DMH00,MDM_HI0_CH7_FLUSH_STATE0_SD2"
)
if "&choice"=="MDM_HI0_CH7_FLUSH_STATE0_SD3"
(
  per.view hwioreg.per "DMH00,MDM_HI0_CH7_FLUSH_STATE0_SD3"
)
if "&choice"=="MDM_HI0_CH8_FLUSH_STATE0_SD0"
(
  per.view hwioreg.per "DMH00,MDM_HI0_CH8_FLUSH_STATE0_SD0"
)
if "&choice"=="MDM_HI0_CH8_FLUSH_STATE0_SD1"
(
  per.view hwioreg.per "DMH00,MDM_HI0_CH8_FLUSH_STATE0_SD1"
)
if "&choice"=="MDM_HI0_CH8_FLUSH_STATE0_SD2"
(
  per.view hwioreg.per "DMH00,MDM_HI0_CH8_FLUSH_STATE0_SD2"
)
if "&choice"=="MDM_HI0_CH8_FLUSH_STATE0_SD3"
(
  per.view hwioreg.per "DMH00,MDM_HI0_CH8_FLUSH_STATE0_SD3"
)
if "&choice"=="MDM_HI0_CH9_FLUSH_STATE0_SD0"
(
  per.view hwioreg.per "DMH00,MDM_HI0_CH9_FLUSH_STATE0_SD0"
)
if "&choice"=="MDM_HI0_CH9_FLUSH_STATE0_SD1"
(
  per.view hwioreg.per "DMH00,MDM_HI0_CH9_FLUSH_STATE0_SD1"
)
if "&choice"=="MDM_HI0_CH9_FLUSH_STATE0_SD2"
(
  per.view hwioreg.per "DMH00,MDM_HI0_CH9_FLUSH_STATE0_SD2"
)
if "&choice"=="MDM_HI0_CH9_FLUSH_STATE0_SD3"
(
  per.view hwioreg.per "DMH00,MDM_HI0_CH9_FLUSH_STATE0_SD3"
)
if "&choice"=="MDM_HI0_CH10_FLUSH_STATE0_SD0"
(
  per.view hwioreg.per "DMH00,MDM_HI0_CH10_FLUSH_STATE0_SD0"
)
if "&choice"=="MDM_HI0_CH10_FLUSH_STATE0_SD1"
(
  per.view hwioreg.per "DMH00,MDM_HI0_CH10_FLUSH_STATE0_SD1"
)
if "&choice"=="MDM_HI0_CH10_FLUSH_STATE0_SD2"
(
  per.view hwioreg.per "DMH00,MDM_HI0_CH10_FLUSH_STATE0_SD2"
)
if "&choice"=="MDM_HI0_CH10_FLUSH_STATE0_SD3"
(
  per.view hwioreg.per "DMH00,MDM_HI0_CH10_FLUSH_STATE0_SD3"
)
if "&choice"=="MDM_HI0_CH11_FLUSH_STATE0_SD0"
(
  per.view hwioreg.per "DMH00,MDM_HI0_CH11_FLUSH_STATE0_SD0"
)
if "&choice"=="MDM_HI0_CH11_FLUSH_STATE0_SD1"
(
  per.view hwioreg.per "DMH00,MDM_HI0_CH11_FLUSH_STATE0_SD1"
)
if "&choice"=="MDM_HI0_CH11_FLUSH_STATE0_SD2"
(
  per.view hwioreg.per "DMH00,MDM_HI0_CH11_FLUSH_STATE0_SD2"
)
if "&choice"=="MDM_HI0_CH11_FLUSH_STATE0_SD3"
(
  per.view hwioreg.per "DMH00,MDM_HI0_CH11_FLUSH_STATE0_SD3"
)
if "&choice"=="MDM_HI0_CH12_FLUSH_STATE0_SD0"
(
  per.view hwioreg.per "DMH00,MDM_HI0_CH12_FLUSH_STATE0_SD0"
)
if "&choice"=="MDM_HI0_CH12_FLUSH_STATE0_SD1"
(
  per.view hwioreg.per "DMH00,MDM_HI0_CH12_FLUSH_STATE0_SD1"
)
if "&choice"=="MDM_HI0_CH12_FLUSH_STATE0_SD2"
(
  per.view hwioreg.per "DMH00,MDM_HI0_CH12_FLUSH_STATE0_SD2"
)
if "&choice"=="MDM_HI0_CH12_FLUSH_STATE0_SD3"
(
  per.view hwioreg.per "DMH00,MDM_HI0_CH12_FLUSH_STATE0_SD3"
)
if "&choice"=="MDM_HI0_CH13_FLUSH_STATE0_SD0"
(
  per.view hwioreg.per "DMH00,MDM_HI0_CH13_FLUSH_STATE0_SD0"
)
if "&choice"=="MDM_HI0_CH13_FLUSH_STATE0_SD1"
(
  per.view hwioreg.per "DMH00,MDM_HI0_CH13_FLUSH_STATE0_SD1"
)
if "&choice"=="MDM_HI0_CH13_FLUSH_STATE0_SD2"
(
  per.view hwioreg.per "DMH00,MDM_HI0_CH13_FLUSH_STATE0_SD2"
)
if "&choice"=="MDM_HI0_CH13_FLUSH_STATE0_SD3"
(
  per.view hwioreg.per "DMH00,MDM_HI0_CH13_FLUSH_STATE0_SD3"
)
if "&choice"=="MDM_HI0_CH14_FLUSH_STATE0_SD0"
(
  per.view hwioreg.per "DMH00,MDM_HI0_CH14_FLUSH_STATE0_SD0"
)
if "&choice"=="MDM_HI0_CH14_FLUSH_STATE0_SD1"
(
  per.view hwioreg.per "DMH00,MDM_HI0_CH14_FLUSH_STATE0_SD1"
)
if "&choice"=="MDM_HI0_CH14_FLUSH_STATE0_SD2"
(
  per.view hwioreg.per "DMH00,MDM_HI0_CH14_FLUSH_STATE0_SD2"
)
if "&choice"=="MDM_HI0_CH14_FLUSH_STATE0_SD3"
(
  per.view hwioreg.per "DMH00,MDM_HI0_CH14_FLUSH_STATE0_SD3"
)
if "&choice"=="MDM_HI0_CH15_FLUSH_STATE0_SD0"
(
  per.view hwioreg.per "DMH00,MDM_HI0_CH15_FLUSH_STATE0_SD0"
)
if "&choice"=="MDM_HI0_CH15_FLUSH_STATE0_SD1"
(
  per.view hwioreg.per "DMH00,MDM_HI0_CH15_FLUSH_STATE0_SD1"
)
if "&choice"=="MDM_HI0_CH15_FLUSH_STATE0_SD2"
(
  per.view hwioreg.per "DMH00,MDM_HI0_CH15_FLUSH_STATE0_SD2"
)
if "&choice"=="MDM_HI0_CH15_FLUSH_STATE0_SD3"
(
  per.view hwioreg.per "DMH00,MDM_HI0_CH15_FLUSH_STATE0_SD3"
)
if "&choice"=="MDM_HI0_CH0_FLUSH_STATE1_SD0"
(
  per.view hwioreg.per "DMH00,MDM_HI0_CH0_FLUSH_STATE1_SD0"
)
if "&choice"=="MDM_HI0_CH0_FLUSH_STATE1_SD1"
(
  per.view hwioreg.per "DMH00,MDM_HI0_CH0_FLUSH_STATE1_SD1"
)
if "&choice"=="MDM_HI0_CH0_FLUSH_STATE1_SD2"
(
  per.view hwioreg.per "DMH00,MDM_HI0_CH0_FLUSH_STATE1_SD2"
)
if "&choice"=="MDM_HI0_CH0_FLUSH_STATE1_SD3"
(
  per.view hwioreg.per "DMH00,MDM_HI0_CH0_FLUSH_STATE1_SD3"
)
if "&choice"=="MDM_HI0_CH1_FLUSH_STATE1_SD0"
(
  per.view hwioreg.per "DMH00,MDM_HI0_CH1_FLUSH_STATE1_SD0"
)
if "&choice"=="MDM_HI0_CH1_FLUSH_STATE1_SD1"
(
  per.view hwioreg.per "DMH00,MDM_HI0_CH1_FLUSH_STATE1_SD1"
)
if "&choice"=="MDM_HI0_CH1_FLUSH_STATE1_SD2"
(
  per.view hwioreg.per "DMH00,MDM_HI0_CH1_FLUSH_STATE1_SD2"
)
if "&choice"=="MDM_HI0_CH1_FLUSH_STATE1_SD3"
(
  per.view hwioreg.per "DMH00,MDM_HI0_CH1_FLUSH_STATE1_SD3"
)
if "&choice"=="MDM_HI0_CH2_FLUSH_STATE1_SD0"
(
  per.view hwioreg.per "DMH00,MDM_HI0_CH2_FLUSH_STATE1_SD0"
)
if "&choice"=="MDM_HI0_CH2_FLUSH_STATE1_SD1"
(
  per.view hwioreg.per "DMH00,MDM_HI0_CH2_FLUSH_STATE1_SD1"
)
if "&choice"=="MDM_HI0_CH2_FLUSH_STATE1_SD2"
(
  per.view hwioreg.per "DMH00,MDM_HI0_CH2_FLUSH_STATE1_SD2"
)
if "&choice"=="MDM_HI0_CH2_FLUSH_STATE1_SD3"
(
  per.view hwioreg.per "DMH00,MDM_HI0_CH2_FLUSH_STATE1_SD3"
)
if "&choice"=="MDM_HI0_CH3_FLUSH_STATE1_SD0"
(
  per.view hwioreg.per "DMH00,MDM_HI0_CH3_FLUSH_STATE1_SD0"
)
if "&choice"=="MDM_HI0_CH3_FLUSH_STATE1_SD1"
(
  per.view hwioreg.per "DMH00,MDM_HI0_CH3_FLUSH_STATE1_SD1"
)
if "&choice"=="MDM_HI0_CH3_FLUSH_STATE1_SD2"
(
  per.view hwioreg.per "DMH00,MDM_HI0_CH3_FLUSH_STATE1_SD2"
)
if "&choice"=="MDM_HI0_CH3_FLUSH_STATE1_SD3"
(
  per.view hwioreg.per "DMH00,MDM_HI0_CH3_FLUSH_STATE1_SD3"
)
if "&choice"=="MDM_HI0_CH4_FLUSH_STATE1_SD0"
(
  per.view hwioreg.per "DMH00,MDM_HI0_CH4_FLUSH_STATE1_SD0"
)
if "&choice"=="MDM_HI0_CH4_FLUSH_STATE1_SD1"
(
  per.view hwioreg.per "DMH00,MDM_HI0_CH4_FLUSH_STATE1_SD1"
)
if "&choice"=="MDM_HI0_CH4_FLUSH_STATE1_SD2"
(
  per.view hwioreg.per "DMH00,MDM_HI0_CH4_FLUSH_STATE1_SD2"
)
if "&choice"=="MDM_HI0_CH4_FLUSH_STATE1_SD3"
(
  per.view hwioreg.per "DMH00,MDM_HI0_CH4_FLUSH_STATE1_SD3"
)
if "&choice"=="MDM_HI0_CH5_FLUSH_STATE1_SD0"
(
  per.view hwioreg.per "DMH00,MDM_HI0_CH5_FLUSH_STATE1_SD0"
)
if "&choice"=="MDM_HI0_CH5_FLUSH_STATE1_SD1"
(
  per.view hwioreg.per "DMH00,MDM_HI0_CH5_FLUSH_STATE1_SD1"
)
if "&choice"=="MDM_HI0_CH5_FLUSH_STATE1_SD2"
(
  per.view hwioreg.per "DMH00,MDM_HI0_CH5_FLUSH_STATE1_SD2"
)
if "&choice"=="MDM_HI0_CH5_FLUSH_STATE1_SD3"
(
  per.view hwioreg.per "DMH00,MDM_HI0_CH5_FLUSH_STATE1_SD3"
)
if "&choice"=="MDM_HI0_CH6_FLUSH_STATE1_SD0"
(
  per.view hwioreg.per "DMH00,MDM_HI0_CH6_FLUSH_STATE1_SD0"
)
if "&choice"=="MDM_HI0_CH6_FLUSH_STATE1_SD1"
(
  per.view hwioreg.per "DMH00,MDM_HI0_CH6_FLUSH_STATE1_SD1"
)
if "&choice"=="MDM_HI0_CH6_FLUSH_STATE1_SD2"
(
  per.view hwioreg.per "DMH00,MDM_HI0_CH6_FLUSH_STATE1_SD2"
)
if "&choice"=="MDM_HI0_CH6_FLUSH_STATE1_SD3"
(
  per.view hwioreg.per "DMH00,MDM_HI0_CH6_FLUSH_STATE1_SD3"
)
if "&choice"=="MDM_HI0_CH7_FLUSH_STATE1_SD0"
(
  per.view hwioreg.per "DMH00,MDM_HI0_CH7_FLUSH_STATE1_SD0"
)
if "&choice"=="MDM_HI0_CH7_FLUSH_STATE1_SD1"
(
  per.view hwioreg.per "DMH00,MDM_HI0_CH7_FLUSH_STATE1_SD1"
)
if "&choice"=="MDM_HI0_CH7_FLUSH_STATE1_SD2"
(
  per.view hwioreg.per "DMH00,MDM_HI0_CH7_FLUSH_STATE1_SD2"
)
if "&choice"=="MDM_HI0_CH7_FLUSH_STATE1_SD3"
(
  per.view hwioreg.per "DMH00,MDM_HI0_CH7_FLUSH_STATE1_SD3"
)
if "&choice"=="MDM_HI0_CH8_FLUSH_STATE1_SD0"
(
  per.view hwioreg.per "DMH00,MDM_HI0_CH8_FLUSH_STATE1_SD0"
)
if "&choice"=="MDM_HI0_CH8_FLUSH_STATE1_SD1"
(
  per.view hwioreg.per "DMH00,MDM_HI0_CH8_FLUSH_STATE1_SD1"
)
if "&choice"=="MDM_HI0_CH8_FLUSH_STATE1_SD2"
(
  per.view hwioreg.per "DMH00,MDM_HI0_CH8_FLUSH_STATE1_SD2"
)
if "&choice"=="MDM_HI0_CH8_FLUSH_STATE1_SD3"
(
  per.view hwioreg.per "DMH00,MDM_HI0_CH8_FLUSH_STATE1_SD3"
)
if "&choice"=="MDM_HI0_CH9_FLUSH_STATE1_SD0"
(
  per.view hwioreg.per "DMH00,MDM_HI0_CH9_FLUSH_STATE1_SD0"
)
if "&choice"=="MDM_HI0_CH9_FLUSH_STATE1_SD1"
(
  per.view hwioreg.per "DMH00,MDM_HI0_CH9_FLUSH_STATE1_SD1"
)
if "&choice"=="MDM_HI0_CH9_FLUSH_STATE1_SD2"
(
  per.view hwioreg.per "DMH00,MDM_HI0_CH9_FLUSH_STATE1_SD2"
)
if "&choice"=="MDM_HI0_CH9_FLUSH_STATE1_SD3"
(
  per.view hwioreg.per "DMH00,MDM_HI0_CH9_FLUSH_STATE1_SD3"
)
if "&choice"=="MDM_HI0_CH10_FLUSH_STATE1_SD0"
(
  per.view hwioreg.per "DMH00,MDM_HI0_CH10_FLUSH_STATE1_SD0"
)
if "&choice"=="MDM_HI0_CH10_FLUSH_STATE1_SD1"
(
  per.view hwioreg.per "DMH00,MDM_HI0_CH10_FLUSH_STATE1_SD1"
)
if "&choice"=="MDM_HI0_CH10_FLUSH_STATE1_SD2"
(
  per.view hwioreg.per "DMH00,MDM_HI0_CH10_FLUSH_STATE1_SD2"
)
if "&choice"=="MDM_HI0_CH10_FLUSH_STATE1_SD3"
(
  per.view hwioreg.per "DMH00,MDM_HI0_CH10_FLUSH_STATE1_SD3"
)
if "&choice"=="MDM_HI0_CH11_FLUSH_STATE1_SD0"
(
  per.view hwioreg.per "DMH00,MDM_HI0_CH11_FLUSH_STATE1_SD0"
)
if "&choice"=="MDM_HI0_CH11_FLUSH_STATE1_SD1"
(
  per.view hwioreg.per "DMH00,MDM_HI0_CH11_FLUSH_STATE1_SD1"
)
if "&choice"=="MDM_HI0_CH11_FLUSH_STATE1_SD2"
(
  per.view hwioreg.per "DMH00,MDM_HI0_CH11_FLUSH_STATE1_SD2"
)
if "&choice"=="MDM_HI0_CH11_FLUSH_STATE1_SD3"
(
  per.view hwioreg.per "DMH00,MDM_HI0_CH11_FLUSH_STATE1_SD3"
)
if "&choice"=="MDM_HI0_CH12_FLUSH_STATE1_SD0"
(
  per.view hwioreg.per "DMH00,MDM_HI0_CH12_FLUSH_STATE1_SD0"
)
if "&choice"=="MDM_HI0_CH12_FLUSH_STATE1_SD1"
(
  per.view hwioreg.per "DMH00,MDM_HI0_CH12_FLUSH_STATE1_SD1"
)
if "&choice"=="MDM_HI0_CH12_FLUSH_STATE1_SD2"
(
  per.view hwioreg.per "DMH00,MDM_HI0_CH12_FLUSH_STATE1_SD2"
)
if "&choice"=="MDM_HI0_CH12_FLUSH_STATE1_SD3"
(
  per.view hwioreg.per "DMH00,MDM_HI0_CH12_FLUSH_STATE1_SD3"
)
if "&choice"=="MDM_HI0_CH13_FLUSH_STATE1_SD0"
(
  per.view hwioreg.per "DMH00,MDM_HI0_CH13_FLUSH_STATE1_SD0"
)
if "&choice"=="MDM_HI0_CH13_FLUSH_STATE1_SD1"
(
  per.view hwioreg.per "DMH00,MDM_HI0_CH13_FLUSH_STATE1_SD1"
)
if "&choice"=="MDM_HI0_CH13_FLUSH_STATE1_SD2"
(
  per.view hwioreg.per "DMH00,MDM_HI0_CH13_FLUSH_STATE1_SD2"
)
if "&choice"=="MDM_HI0_CH13_FLUSH_STATE1_SD3"
(
  per.view hwioreg.per "DMH00,MDM_HI0_CH13_FLUSH_STATE1_SD3"
)
if "&choice"=="MDM_HI0_CH14_FLUSH_STATE1_SD0"
(
  per.view hwioreg.per "DMH00,MDM_HI0_CH14_FLUSH_STATE1_SD0"
)
if "&choice"=="MDM_HI0_CH14_FLUSH_STATE1_SD1"
(
  per.view hwioreg.per "DMH00,MDM_HI0_CH14_FLUSH_STATE1_SD1"
)
if "&choice"=="MDM_HI0_CH14_FLUSH_STATE1_SD2"
(
  per.view hwioreg.per "DMH00,MDM_HI0_CH14_FLUSH_STATE1_SD2"
)
if "&choice"=="MDM_HI0_CH14_FLUSH_STATE1_SD3"
(
  per.view hwioreg.per "DMH00,MDM_HI0_CH14_FLUSH_STATE1_SD3"
)
if "&choice"=="MDM_HI0_CH15_FLUSH_STATE1_SD0"
(
  per.view hwioreg.per "DMH00,MDM_HI0_CH15_FLUSH_STATE1_SD0"
)
if "&choice"=="MDM_HI0_CH15_FLUSH_STATE1_SD1"
(
  per.view hwioreg.per "DMH00,MDM_HI0_CH15_FLUSH_STATE1_SD1"
)
if "&choice"=="MDM_HI0_CH15_FLUSH_STATE1_SD2"
(
  per.view hwioreg.per "DMH00,MDM_HI0_CH15_FLUSH_STATE1_SD2"
)
if "&choice"=="MDM_HI0_CH15_FLUSH_STATE1_SD3"
(
  per.view hwioreg.per "DMH00,MDM_HI0_CH15_FLUSH_STATE1_SD3"
)
if "&choice"=="MDM_HI0_CH0_FLUSH_STATE2_SD0"
(
  per.view hwioreg.per "DMH00,MDM_HI0_CH0_FLUSH_STATE2_SD0"
)
if "&choice"=="MDM_HI0_CH0_FLUSH_STATE2_SD1"
(
  per.view hwioreg.per "DMH00,MDM_HI0_CH0_FLUSH_STATE2_SD1"
)
if "&choice"=="MDM_HI0_CH0_FLUSH_STATE2_SD2"
(
  per.view hwioreg.per "DMH00,MDM_HI0_CH0_FLUSH_STATE2_SD2"
)
if "&choice"=="MDM_HI0_CH0_FLUSH_STATE2_SD3"
(
  per.view hwioreg.per "DMH00,MDM_HI0_CH0_FLUSH_STATE2_SD3"
)
if "&choice"=="MDM_HI0_CH1_FLUSH_STATE2_SD0"
(
  per.view hwioreg.per "DMH00,MDM_HI0_CH1_FLUSH_STATE2_SD0"
)
if "&choice"=="MDM_HI0_CH1_FLUSH_STATE2_SD1"
(
  per.view hwioreg.per "DMH00,MDM_HI0_CH1_FLUSH_STATE2_SD1"
)
if "&choice"=="MDM_HI0_CH1_FLUSH_STATE2_SD2"
(
  per.view hwioreg.per "DMH00,MDM_HI0_CH1_FLUSH_STATE2_SD2"
)
if "&choice"=="MDM_HI0_CH1_FLUSH_STATE2_SD3"
(
  per.view hwioreg.per "DMH00,MDM_HI0_CH1_FLUSH_STATE2_SD3"
)
if "&choice"=="MDM_HI0_CH2_FLUSH_STATE2_SD0"
(
  per.view hwioreg.per "DMH00,MDM_HI0_CH2_FLUSH_STATE2_SD0"
)
if "&choice"=="MDM_HI0_CH2_FLUSH_STATE2_SD1"
(
  per.view hwioreg.per "DMH00,MDM_HI0_CH2_FLUSH_STATE2_SD1"
)
if "&choice"=="MDM_HI0_CH2_FLUSH_STATE2_SD2"
(
  per.view hwioreg.per "DMH00,MDM_HI0_CH2_FLUSH_STATE2_SD2"
)
if "&choice"=="MDM_HI0_CH2_FLUSH_STATE2_SD3"
(
  per.view hwioreg.per "DMH00,MDM_HI0_CH2_FLUSH_STATE2_SD3"
)
if "&choice"=="MDM_HI0_CH3_FLUSH_STATE2_SD0"
(
  per.view hwioreg.per "DMH00,MDM_HI0_CH3_FLUSH_STATE2_SD0"
)
if "&choice"=="MDM_HI0_CH3_FLUSH_STATE2_SD1"
(
  per.view hwioreg.per "DMH00,MDM_HI0_CH3_FLUSH_STATE2_SD1"
)
if "&choice"=="MDM_HI0_CH3_FLUSH_STATE2_SD2"
(
  per.view hwioreg.per "DMH00,MDM_HI0_CH3_FLUSH_STATE2_SD2"
)
if "&choice"=="MDM_HI0_CH3_FLUSH_STATE2_SD3"
(
  per.view hwioreg.per "DMH00,MDM_HI0_CH3_FLUSH_STATE2_SD3"
)
if "&choice"=="MDM_HI0_CH4_FLUSH_STATE2_SD0"
(
  per.view hwioreg.per "DMH00,MDM_HI0_CH4_FLUSH_STATE2_SD0"
)
if "&choice"=="MDM_HI0_CH4_FLUSH_STATE2_SD1"
(
  per.view hwioreg.per "DMH00,MDM_HI0_CH4_FLUSH_STATE2_SD1"
)
if "&choice"=="MDM_HI0_CH4_FLUSH_STATE2_SD2"
(
  per.view hwioreg.per "DMH00,MDM_HI0_CH4_FLUSH_STATE2_SD2"
)
if "&choice"=="MDM_HI0_CH4_FLUSH_STATE2_SD3"
(
  per.view hwioreg.per "DMH00,MDM_HI0_CH4_FLUSH_STATE2_SD3"
)
if "&choice"=="MDM_HI0_CH5_FLUSH_STATE2_SD0"
(
  per.view hwioreg.per "DMH00,MDM_HI0_CH5_FLUSH_STATE2_SD0"
)
if "&choice"=="MDM_HI0_CH5_FLUSH_STATE2_SD1"
(
  per.view hwioreg.per "DMH00,MDM_HI0_CH5_FLUSH_STATE2_SD1"
)
if "&choice"=="MDM_HI0_CH5_FLUSH_STATE2_SD2"
(
  per.view hwioreg.per "DMH00,MDM_HI0_CH5_FLUSH_STATE2_SD2"
)
if "&choice"=="MDM_HI0_CH5_FLUSH_STATE2_SD3"
(
  per.view hwioreg.per "DMH00,MDM_HI0_CH5_FLUSH_STATE2_SD3"
)
if "&choice"=="MDM_HI0_CH6_FLUSH_STATE2_SD0"
(
  per.view hwioreg.per "DMH00,MDM_HI0_CH6_FLUSH_STATE2_SD0"
)
if "&choice"=="MDM_HI0_CH6_FLUSH_STATE2_SD1"
(
  per.view hwioreg.per "DMH00,MDM_HI0_CH6_FLUSH_STATE2_SD1"
)
if "&choice"=="MDM_HI0_CH6_FLUSH_STATE2_SD2"
(
  per.view hwioreg.per "DMH00,MDM_HI0_CH6_FLUSH_STATE2_SD2"
)
if "&choice"=="MDM_HI0_CH6_FLUSH_STATE2_SD3"
(
  per.view hwioreg.per "DMH00,MDM_HI0_CH6_FLUSH_STATE2_SD3"
)
if "&choice"=="MDM_HI0_CH7_FLUSH_STATE2_SD0"
(
  per.view hwioreg.per "DMH00,MDM_HI0_CH7_FLUSH_STATE2_SD0"
)
if "&choice"=="MDM_HI0_CH7_FLUSH_STATE2_SD1"
(
  per.view hwioreg.per "DMH00,MDM_HI0_CH7_FLUSH_STATE2_SD1"
)
if "&choice"=="MDM_HI0_CH7_FLUSH_STATE2_SD2"
(
  per.view hwioreg.per "DMH00,MDM_HI0_CH7_FLUSH_STATE2_SD2"
)
if "&choice"=="MDM_HI0_CH7_FLUSH_STATE2_SD3"
(
  per.view hwioreg.per "DMH00,MDM_HI0_CH7_FLUSH_STATE2_SD3"
)
if "&choice"=="MDM_HI0_CH8_FLUSH_STATE2_SD0"
(
  per.view hwioreg.per "DMH00,MDM_HI0_CH8_FLUSH_STATE2_SD0"
)
if "&choice"=="MDM_HI0_CH8_FLUSH_STATE2_SD1"
(
  per.view hwioreg.per "DMH00,MDM_HI0_CH8_FLUSH_STATE2_SD1"
)
if "&choice"=="MDM_HI0_CH8_FLUSH_STATE2_SD2"
(
  per.view hwioreg.per "DMH00,MDM_HI0_CH8_FLUSH_STATE2_SD2"
)
if "&choice"=="MDM_HI0_CH8_FLUSH_STATE2_SD3"
(
  per.view hwioreg.per "DMH00,MDM_HI0_CH8_FLUSH_STATE2_SD3"
)
if "&choice"=="MDM_HI0_CH9_FLUSH_STATE2_SD0"
(
  per.view hwioreg.per "DMH00,MDM_HI0_CH9_FLUSH_STATE2_SD0"
)
if "&choice"=="MDM_HI0_CH9_FLUSH_STATE2_SD1"
(
  per.view hwioreg.per "DMH00,MDM_HI0_CH9_FLUSH_STATE2_SD1"
)
if "&choice"=="MDM_HI0_CH9_FLUSH_STATE2_SD2"
(
  per.view hwioreg.per "DMH00,MDM_HI0_CH9_FLUSH_STATE2_SD2"
)
if "&choice"=="MDM_HI0_CH9_FLUSH_STATE2_SD3"
(
  per.view hwioreg.per "DMH00,MDM_HI0_CH9_FLUSH_STATE2_SD3"
)
if "&choice"=="MDM_HI0_CH10_FLUSH_STATE2_SD0"
(
  per.view hwioreg.per "DMH00,MDM_HI0_CH10_FLUSH_STATE2_SD0"
)
if "&choice"=="MDM_HI0_CH10_FLUSH_STATE2_SD1"
(
  per.view hwioreg.per "DMH00,MDM_HI0_CH10_FLUSH_STATE2_SD1"
)
if "&choice"=="MDM_HI0_CH10_FLUSH_STATE2_SD2"
(
  per.view hwioreg.per "DMH00,MDM_HI0_CH10_FLUSH_STATE2_SD2"
)
if "&choice"=="MDM_HI0_CH10_FLUSH_STATE2_SD3"
(
  per.view hwioreg.per "DMH00,MDM_HI0_CH10_FLUSH_STATE2_SD3"
)
if "&choice"=="MDM_HI0_CH11_FLUSH_STATE2_SD0"
(
  per.view hwioreg.per "DMH00,MDM_HI0_CH11_FLUSH_STATE2_SD0"
)
if "&choice"=="MDM_HI0_CH11_FLUSH_STATE2_SD1"
(
  per.view hwioreg.per "DMH00,MDM_HI0_CH11_FLUSH_STATE2_SD1"
)
if "&choice"=="MDM_HI0_CH11_FLUSH_STATE2_SD2"
(
  per.view hwioreg.per "DMH00,MDM_HI0_CH11_FLUSH_STATE2_SD2"
)
if "&choice"=="MDM_HI0_CH11_FLUSH_STATE2_SD3"
(
  per.view hwioreg.per "DMH00,MDM_HI0_CH11_FLUSH_STATE2_SD3"
)
if "&choice"=="MDM_HI0_CH12_FLUSH_STATE2_SD0"
(
  per.view hwioreg.per "DMH00,MDM_HI0_CH12_FLUSH_STATE2_SD0"
)
if "&choice"=="MDM_HI0_CH12_FLUSH_STATE2_SD1"
(
  per.view hwioreg.per "DMH00,MDM_HI0_CH12_FLUSH_STATE2_SD1"
)
if "&choice"=="MDM_HI0_CH12_FLUSH_STATE2_SD2"
(
  per.view hwioreg.per "DMH00,MDM_HI0_CH12_FLUSH_STATE2_SD2"
)
if "&choice"=="MDM_HI0_CH12_FLUSH_STATE2_SD3"
(
  per.view hwioreg.per "DMH00,MDM_HI0_CH12_FLUSH_STATE2_SD3"
)
if "&choice"=="MDM_HI0_CH13_FLUSH_STATE2_SD0"
(
  per.view hwioreg.per "DMH00,MDM_HI0_CH13_FLUSH_STATE2_SD0"
)
if "&choice"=="MDM_HI0_CH13_FLUSH_STATE2_SD1"
(
  per.view hwioreg.per "DMH00,MDM_HI0_CH13_FLUSH_STATE2_SD1"
)
if "&choice"=="MDM_HI0_CH13_FLUSH_STATE2_SD2"
(
  per.view hwioreg.per "DMH00,MDM_HI0_CH13_FLUSH_STATE2_SD2"
)
if "&choice"=="MDM_HI0_CH13_FLUSH_STATE2_SD3"
(
  per.view hwioreg.per "DMH00,MDM_HI0_CH13_FLUSH_STATE2_SD3"
)
if "&choice"=="MDM_HI0_CH14_FLUSH_STATE2_SD0"
(
  per.view hwioreg.per "DMH00,MDM_HI0_CH14_FLUSH_STATE2_SD0"
)
if "&choice"=="MDM_HI0_CH14_FLUSH_STATE2_SD1"
(
  per.view hwioreg.per "DMH00,MDM_HI0_CH14_FLUSH_STATE2_SD1"
)
if "&choice"=="MDM_HI0_CH14_FLUSH_STATE2_SD2"
(
  per.view hwioreg.per "DMH00,MDM_HI0_CH14_FLUSH_STATE2_SD2"
)
if "&choice"=="MDM_HI0_CH14_FLUSH_STATE2_SD3"
(
  per.view hwioreg.per "DMH00,MDM_HI0_CH14_FLUSH_STATE2_SD3"
)
if "&choice"=="MDM_HI0_CH15_FLUSH_STATE2_SD0"
(
  per.view hwioreg.per "DMH00,MDM_HI0_CH15_FLUSH_STATE2_SD0"
)
if "&choice"=="MDM_HI0_CH15_FLUSH_STATE2_SD1"
(
  per.view hwioreg.per "DMH00,MDM_HI0_CH15_FLUSH_STATE2_SD1"
)
if "&choice"=="MDM_HI0_CH15_FLUSH_STATE2_SD2"
(
  per.view hwioreg.per "DMH00,MDM_HI0_CH15_FLUSH_STATE2_SD2"
)
if "&choice"=="MDM_HI0_CH15_FLUSH_STATE2_SD3"
(
  per.view hwioreg.per "DMH00,MDM_HI0_CH15_FLUSH_STATE2_SD3"
)
if "&choice"=="MDM_HI0_CH0_FLUSH_STATE3_SD0"
(
  per.view hwioreg.per "DMH00,MDM_HI0_CH0_FLUSH_STATE3_SD0"
)
if "&choice"=="MDM_HI0_CH0_FLUSH_STATE3_SD1"
(
  per.view hwioreg.per "DMH00,MDM_HI0_CH0_FLUSH_STATE3_SD1"
)
if "&choice"=="MDM_HI0_CH0_FLUSH_STATE3_SD2"
(
  per.view hwioreg.per "DMH00,MDM_HI0_CH0_FLUSH_STATE3_SD2"
)
if "&choice"=="MDM_HI0_CH0_FLUSH_STATE3_SD3"
(
  per.view hwioreg.per "DMH00,MDM_HI0_CH0_FLUSH_STATE3_SD3"
)
if "&choice"=="MDM_HI0_CH1_FLUSH_STATE3_SD0"
(
  per.view hwioreg.per "DMH00,MDM_HI0_CH1_FLUSH_STATE3_SD0"
)
if "&choice"=="MDM_HI0_CH1_FLUSH_STATE3_SD1"
(
  per.view hwioreg.per "DMH00,MDM_HI0_CH1_FLUSH_STATE3_SD1"
)
if "&choice"=="MDM_HI0_CH1_FLUSH_STATE3_SD2"
(
  per.view hwioreg.per "DMH00,MDM_HI0_CH1_FLUSH_STATE3_SD2"
)
if "&choice"=="MDM_HI0_CH1_FLUSH_STATE3_SD3"
(
  per.view hwioreg.per "DMH00,MDM_HI0_CH1_FLUSH_STATE3_SD3"
)
if "&choice"=="MDM_HI0_CH2_FLUSH_STATE3_SD0"
(
  per.view hwioreg.per "DMH00,MDM_HI0_CH2_FLUSH_STATE3_SD0"
)
if "&choice"=="MDM_HI0_CH2_FLUSH_STATE3_SD1"
(
  per.view hwioreg.per "DMH00,MDM_HI0_CH2_FLUSH_STATE3_SD1"
)
if "&choice"=="MDM_HI0_CH2_FLUSH_STATE3_SD2"
(
  per.view hwioreg.per "DMH00,MDM_HI0_CH2_FLUSH_STATE3_SD2"
)
if "&choice"=="MDM_HI0_CH2_FLUSH_STATE3_SD3"
(
  per.view hwioreg.per "DMH00,MDM_HI0_CH2_FLUSH_STATE3_SD3"
)
if "&choice"=="MDM_HI0_CH3_FLUSH_STATE3_SD0"
(
  per.view hwioreg.per "DMH00,MDM_HI0_CH3_FLUSH_STATE3_SD0"
)
if "&choice"=="MDM_HI0_CH3_FLUSH_STATE3_SD1"
(
  per.view hwioreg.per "DMH00,MDM_HI0_CH3_FLUSH_STATE3_SD1"
)
if "&choice"=="MDM_HI0_CH3_FLUSH_STATE3_SD2"
(
  per.view hwioreg.per "DMH00,MDM_HI0_CH3_FLUSH_STATE3_SD2"
)
if "&choice"=="MDM_HI0_CH3_FLUSH_STATE3_SD3"
(
  per.view hwioreg.per "DMH00,MDM_HI0_CH3_FLUSH_STATE3_SD3"
)
if "&choice"=="MDM_HI0_CH4_FLUSH_STATE3_SD0"
(
  per.view hwioreg.per "DMH00,MDM_HI0_CH4_FLUSH_STATE3_SD0"
)
if "&choice"=="MDM_HI0_CH4_FLUSH_STATE3_SD1"
(
  per.view hwioreg.per "DMH00,MDM_HI0_CH4_FLUSH_STATE3_SD1"
)
if "&choice"=="MDM_HI0_CH4_FLUSH_STATE3_SD2"
(
  per.view hwioreg.per "DMH00,MDM_HI0_CH4_FLUSH_STATE3_SD2"
)
if "&choice"=="MDM_HI0_CH4_FLUSH_STATE3_SD3"
(
  per.view hwioreg.per "DMH00,MDM_HI0_CH4_FLUSH_STATE3_SD3"
)
if "&choice"=="MDM_HI0_CH5_FLUSH_STATE3_SD0"
(
  per.view hwioreg.per "DMH00,MDM_HI0_CH5_FLUSH_STATE3_SD0"
)
if "&choice"=="MDM_HI0_CH5_FLUSH_STATE3_SD1"
(
  per.view hwioreg.per "DMH00,MDM_HI0_CH5_FLUSH_STATE3_SD1"
)
if "&choice"=="MDM_HI0_CH5_FLUSH_STATE3_SD2"
(
  per.view hwioreg.per "DMH00,MDM_HI0_CH5_FLUSH_STATE3_SD2"
)
if "&choice"=="MDM_HI0_CH5_FLUSH_STATE3_SD3"
(
  per.view hwioreg.per "DMH00,MDM_HI0_CH5_FLUSH_STATE3_SD3"
)
if "&choice"=="MDM_HI0_CH6_FLUSH_STATE3_SD0"
(
  per.view hwioreg.per "DMH00,MDM_HI0_CH6_FLUSH_STATE3_SD0"
)
if "&choice"=="MDM_HI0_CH6_FLUSH_STATE3_SD1"
(
  per.view hwioreg.per "DMH00,MDM_HI0_CH6_FLUSH_STATE3_SD1"
)
if "&choice"=="MDM_HI0_CH6_FLUSH_STATE3_SD2"
(
  per.view hwioreg.per "DMH00,MDM_HI0_CH6_FLUSH_STATE3_SD2"
)
if "&choice"=="MDM_HI0_CH6_FLUSH_STATE3_SD3"
(
  per.view hwioreg.per "DMH00,MDM_HI0_CH6_FLUSH_STATE3_SD3"
)
if "&choice"=="MDM_HI0_CH7_FLUSH_STATE3_SD0"
(
  per.view hwioreg.per "DMH00,MDM_HI0_CH7_FLUSH_STATE3_SD0"
)
if "&choice"=="MDM_HI0_CH7_FLUSH_STATE3_SD1"
(
  per.view hwioreg.per "DMH00,MDM_HI0_CH7_FLUSH_STATE3_SD1"
)
if "&choice"=="MDM_HI0_CH7_FLUSH_STATE3_SD2"
(
  per.view hwioreg.per "DMH00,MDM_HI0_CH7_FLUSH_STATE3_SD2"
)
if "&choice"=="MDM_HI0_CH7_FLUSH_STATE3_SD3"
(
  per.view hwioreg.per "DMH00,MDM_HI0_CH7_FLUSH_STATE3_SD3"
)
if "&choice"=="MDM_HI0_CH8_FLUSH_STATE3_SD0"
(
  per.view hwioreg.per "DMH00,MDM_HI0_CH8_FLUSH_STATE3_SD0"
)
if "&choice"=="MDM_HI0_CH8_FLUSH_STATE3_SD1"
(
  per.view hwioreg.per "DMH00,MDM_HI0_CH8_FLUSH_STATE3_SD1"
)
if "&choice"=="MDM_HI0_CH8_FLUSH_STATE3_SD2"
(
  per.view hwioreg.per "DMH00,MDM_HI0_CH8_FLUSH_STATE3_SD2"
)
if "&choice"=="MDM_HI0_CH8_FLUSH_STATE3_SD3"
(
  per.view hwioreg.per "DMH00,MDM_HI0_CH8_FLUSH_STATE3_SD3"
)
if "&choice"=="MDM_HI0_CH9_FLUSH_STATE3_SD0"
(
  per.view hwioreg.per "DMH00,MDM_HI0_CH9_FLUSH_STATE3_SD0"
)
if "&choice"=="MDM_HI0_CH9_FLUSH_STATE3_SD1"
(
  per.view hwioreg.per "DMH00,MDM_HI0_CH9_FLUSH_STATE3_SD1"
)
if "&choice"=="MDM_HI0_CH9_FLUSH_STATE3_SD2"
(
  per.view hwioreg.per "DMH00,MDM_HI0_CH9_FLUSH_STATE3_SD2"
)
if "&choice"=="MDM_HI0_CH9_FLUSH_STATE3_SD3"
(
  per.view hwioreg.per "DMH00,MDM_HI0_CH9_FLUSH_STATE3_SD3"
)
if "&choice"=="MDM_HI0_CH10_FLUSH_STATE3_SD0"
(
  per.view hwioreg.per "DMH00,MDM_HI0_CH10_FLUSH_STATE3_SD0"
)
if "&choice"=="MDM_HI0_CH10_FLUSH_STATE3_SD1"
(
  per.view hwioreg.per "DMH00,MDM_HI0_CH10_FLUSH_STATE3_SD1"
)
if "&choice"=="MDM_HI0_CH10_FLUSH_STATE3_SD2"
(
  per.view hwioreg.per "DMH00,MDM_HI0_CH10_FLUSH_STATE3_SD2"
)
if "&choice"=="MDM_HI0_CH10_FLUSH_STATE3_SD3"
(
  per.view hwioreg.per "DMH00,MDM_HI0_CH10_FLUSH_STATE3_SD3"
)
if "&choice"=="MDM_HI0_CH11_FLUSH_STATE3_SD0"
(
  per.view hwioreg.per "DMH00,MDM_HI0_CH11_FLUSH_STATE3_SD0"
)
if "&choice"=="MDM_HI0_CH11_FLUSH_STATE3_SD1"
(
  per.view hwioreg.per "DMH00,MDM_HI0_CH11_FLUSH_STATE3_SD1"
)
if "&choice"=="MDM_HI0_CH11_FLUSH_STATE3_SD2"
(
  per.view hwioreg.per "DMH00,MDM_HI0_CH11_FLUSH_STATE3_SD2"
)
if "&choice"=="MDM_HI0_CH11_FLUSH_STATE3_SD3"
(
  per.view hwioreg.per "DMH00,MDM_HI0_CH11_FLUSH_STATE3_SD3"
)
if "&choice"=="MDM_HI0_CH12_FLUSH_STATE3_SD0"
(
  per.view hwioreg.per "DMH00,MDM_HI0_CH12_FLUSH_STATE3_SD0"
)
if "&choice"=="MDM_HI0_CH12_FLUSH_STATE3_SD1"
(
  per.view hwioreg.per "DMH00,MDM_HI0_CH12_FLUSH_STATE3_SD1"
)
if "&choice"=="MDM_HI0_CH12_FLUSH_STATE3_SD2"
(
  per.view hwioreg.per "DMH00,MDM_HI0_CH12_FLUSH_STATE3_SD2"
)
if "&choice"=="MDM_HI0_CH12_FLUSH_STATE3_SD3"
(
  per.view hwioreg.per "DMH00,MDM_HI0_CH12_FLUSH_STATE3_SD3"
)
if "&choice"=="MDM_HI0_CH13_FLUSH_STATE3_SD0"
(
  per.view hwioreg.per "DMH00,MDM_HI0_CH13_FLUSH_STATE3_SD0"
)
if "&choice"=="MDM_HI0_CH13_FLUSH_STATE3_SD1"
(
  per.view hwioreg.per "DMH00,MDM_HI0_CH13_FLUSH_STATE3_SD1"
)
if "&choice"=="MDM_HI0_CH13_FLUSH_STATE3_SD2"
(
  per.view hwioreg.per "DMH00,MDM_HI0_CH13_FLUSH_STATE3_SD2"
)
if "&choice"=="MDM_HI0_CH13_FLUSH_STATE3_SD3"
(
  per.view hwioreg.per "DMH00,MDM_HI0_CH13_FLUSH_STATE3_SD3"
)
if "&choice"=="MDM_HI0_CH14_FLUSH_STATE3_SD0"
(
  per.view hwioreg.per "DMH00,MDM_HI0_CH14_FLUSH_STATE3_SD0"
)
if "&choice"=="MDM_HI0_CH14_FLUSH_STATE3_SD1"
(
  per.view hwioreg.per "DMH00,MDM_HI0_CH14_FLUSH_STATE3_SD1"
)
if "&choice"=="MDM_HI0_CH14_FLUSH_STATE3_SD2"
(
  per.view hwioreg.per "DMH00,MDM_HI0_CH14_FLUSH_STATE3_SD2"
)
if "&choice"=="MDM_HI0_CH14_FLUSH_STATE3_SD3"
(
  per.view hwioreg.per "DMH00,MDM_HI0_CH14_FLUSH_STATE3_SD3"
)
if "&choice"=="MDM_HI0_CH15_FLUSH_STATE3_SD0"
(
  per.view hwioreg.per "DMH00,MDM_HI0_CH15_FLUSH_STATE3_SD0"
)
if "&choice"=="MDM_HI0_CH15_FLUSH_STATE3_SD1"
(
  per.view hwioreg.per "DMH00,MDM_HI0_CH15_FLUSH_STATE3_SD1"
)
if "&choice"=="MDM_HI0_CH15_FLUSH_STATE3_SD2"
(
  per.view hwioreg.per "DMH00,MDM_HI0_CH15_FLUSH_STATE3_SD2"
)
if "&choice"=="MDM_HI0_CH15_FLUSH_STATE3_SD3"
(
  per.view hwioreg.per "DMH00,MDM_HI0_CH15_FLUSH_STATE3_SD3"
)
if "&choice"=="MDM_HI0_CH0_FLUSH_STATE4_SD0"
(
  per.view hwioreg.per "DMH00,MDM_HI0_CH0_FLUSH_STATE4_SD0"
)
if "&choice"=="MDM_HI0_CH0_FLUSH_STATE4_SD1"
(
  per.view hwioreg.per "DMH00,MDM_HI0_CH0_FLUSH_STATE4_SD1"
)
if "&choice"=="MDM_HI0_CH0_FLUSH_STATE4_SD2"
(
  per.view hwioreg.per "DMH00,MDM_HI0_CH0_FLUSH_STATE4_SD2"
)
if "&choice"=="MDM_HI0_CH0_FLUSH_STATE4_SD3"
(
  per.view hwioreg.per "DMH00,MDM_HI0_CH0_FLUSH_STATE4_SD3"
)
if "&choice"=="MDM_HI0_CH1_FLUSH_STATE4_SD0"
(
  per.view hwioreg.per "DMH00,MDM_HI0_CH1_FLUSH_STATE4_SD0"
)
if "&choice"=="MDM_HI0_CH1_FLUSH_STATE4_SD1"
(
  per.view hwioreg.per "DMH00,MDM_HI0_CH1_FLUSH_STATE4_SD1"
)
if "&choice"=="MDM_HI0_CH1_FLUSH_STATE4_SD2"
(
  per.view hwioreg.per "DMH00,MDM_HI0_CH1_FLUSH_STATE4_SD2"
)
if "&choice"=="MDM_HI0_CH1_FLUSH_STATE4_SD3"
(
  per.view hwioreg.per "DMH00,MDM_HI0_CH1_FLUSH_STATE4_SD3"
)
if "&choice"=="MDM_HI0_CH2_FLUSH_STATE4_SD0"
(
  per.view hwioreg.per "DMH00,MDM_HI0_CH2_FLUSH_STATE4_SD0"
)
if "&choice"=="MDM_HI0_CH2_FLUSH_STATE4_SD1"
(
  per.view hwioreg.per "DMH00,MDM_HI0_CH2_FLUSH_STATE4_SD1"
)
if "&choice"=="MDM_HI0_CH2_FLUSH_STATE4_SD2"
(
  per.view hwioreg.per "DMH00,MDM_HI0_CH2_FLUSH_STATE4_SD2"
)
if "&choice"=="MDM_HI0_CH2_FLUSH_STATE4_SD3"
(
  per.view hwioreg.per "DMH00,MDM_HI0_CH2_FLUSH_STATE4_SD3"
)
if "&choice"=="MDM_HI0_CH3_FLUSH_STATE4_SD0"
(
  per.view hwioreg.per "DMH00,MDM_HI0_CH3_FLUSH_STATE4_SD0"
)
if "&choice"=="MDM_HI0_CH3_FLUSH_STATE4_SD1"
(
  per.view hwioreg.per "DMH00,MDM_HI0_CH3_FLUSH_STATE4_SD1"
)
if "&choice"=="MDM_HI0_CH3_FLUSH_STATE4_SD2"
(
  per.view hwioreg.per "DMH00,MDM_HI0_CH3_FLUSH_STATE4_SD2"
)
if "&choice"=="MDM_HI0_CH3_FLUSH_STATE4_SD3"
(
  per.view hwioreg.per "DMH00,MDM_HI0_CH3_FLUSH_STATE4_SD3"
)
if "&choice"=="MDM_HI0_CH4_FLUSH_STATE4_SD0"
(
  per.view hwioreg.per "DMH00,MDM_HI0_CH4_FLUSH_STATE4_SD0"
)
if "&choice"=="MDM_HI0_CH4_FLUSH_STATE4_SD1"
(
  per.view hwioreg.per "DMH00,MDM_HI0_CH4_FLUSH_STATE4_SD1"
)
if "&choice"=="MDM_HI0_CH4_FLUSH_STATE4_SD2"
(
  per.view hwioreg.per "DMH00,MDM_HI0_CH4_FLUSH_STATE4_SD2"
)
if "&choice"=="MDM_HI0_CH4_FLUSH_STATE4_SD3"
(
  per.view hwioreg.per "DMH00,MDM_HI0_CH4_FLUSH_STATE4_SD3"
)
if "&choice"=="MDM_HI0_CH5_FLUSH_STATE4_SD0"
(
  per.view hwioreg.per "DMH00,MDM_HI0_CH5_FLUSH_STATE4_SD0"
)
if "&choice"=="MDM_HI0_CH5_FLUSH_STATE4_SD1"
(
  per.view hwioreg.per "DMH00,MDM_HI0_CH5_FLUSH_STATE4_SD1"
)
if "&choice"=="MDM_HI0_CH5_FLUSH_STATE4_SD2"
(
  per.view hwioreg.per "DMH00,MDM_HI0_CH5_FLUSH_STATE4_SD2"
)
if "&choice"=="MDM_HI0_CH5_FLUSH_STATE4_SD3"
(
  per.view hwioreg.per "DMH00,MDM_HI0_CH5_FLUSH_STATE4_SD3"
)
if "&choice"=="MDM_HI0_CH6_FLUSH_STATE4_SD0"
(
  per.view hwioreg.per "DMH00,MDM_HI0_CH6_FLUSH_STATE4_SD0"
)
if "&choice"=="MDM_HI0_CH6_FLUSH_STATE4_SD1"
(
  per.view hwioreg.per "DMH00,MDM_HI0_CH6_FLUSH_STATE4_SD1"
)
if "&choice"=="MDM_HI0_CH6_FLUSH_STATE4_SD2"
(
  per.view hwioreg.per "DMH00,MDM_HI0_CH6_FLUSH_STATE4_SD2"
)
if "&choice"=="MDM_HI0_CH6_FLUSH_STATE4_SD3"
(
  per.view hwioreg.per "DMH00,MDM_HI0_CH6_FLUSH_STATE4_SD3"
)
if "&choice"=="MDM_HI0_CH7_FLUSH_STATE4_SD0"
(
  per.view hwioreg.per "DMH00,MDM_HI0_CH7_FLUSH_STATE4_SD0"
)
if "&choice"=="MDM_HI0_CH7_FLUSH_STATE4_SD1"
(
  per.view hwioreg.per "DMH00,MDM_HI0_CH7_FLUSH_STATE4_SD1"
)
if "&choice"=="MDM_HI0_CH7_FLUSH_STATE4_SD2"
(
  per.view hwioreg.per "DMH00,MDM_HI0_CH7_FLUSH_STATE4_SD2"
)
if "&choice"=="MDM_HI0_CH7_FLUSH_STATE4_SD3"
(
  per.view hwioreg.per "DMH00,MDM_HI0_CH7_FLUSH_STATE4_SD3"
)
if "&choice"=="MDM_HI0_CH8_FLUSH_STATE4_SD0"
(
  per.view hwioreg.per "DMH00,MDM_HI0_CH8_FLUSH_STATE4_SD0"
)
if "&choice"=="MDM_HI0_CH8_FLUSH_STATE4_SD1"
(
  per.view hwioreg.per "DMH00,MDM_HI0_CH8_FLUSH_STATE4_SD1"
)
if "&choice"=="MDM_HI0_CH8_FLUSH_STATE4_SD2"
(
  per.view hwioreg.per "DMH00,MDM_HI0_CH8_FLUSH_STATE4_SD2"
)
if "&choice"=="MDM_HI0_CH8_FLUSH_STATE4_SD3"
(
  per.view hwioreg.per "DMH00,MDM_HI0_CH8_FLUSH_STATE4_SD3"
)
if "&choice"=="MDM_HI0_CH9_FLUSH_STATE4_SD0"
(
  per.view hwioreg.per "DMH00,MDM_HI0_CH9_FLUSH_STATE4_SD0"
)
if "&choice"=="MDM_HI0_CH9_FLUSH_STATE4_SD1"
(
  per.view hwioreg.per "DMH00,MDM_HI0_CH9_FLUSH_STATE4_SD1"
)
if "&choice"=="MDM_HI0_CH9_FLUSH_STATE4_SD2"
(
  per.view hwioreg.per "DMH00,MDM_HI0_CH9_FLUSH_STATE4_SD2"
)
if "&choice"=="MDM_HI0_CH9_FLUSH_STATE4_SD3"
(
  per.view hwioreg.per "DMH00,MDM_HI0_CH9_FLUSH_STATE4_SD3"
)
if "&choice"=="MDM_HI0_CH10_FLUSH_STATE4_SD0"
(
  per.view hwioreg.per "DMH00,MDM_HI0_CH10_FLUSH_STATE4_SD0"
)
if "&choice"=="MDM_HI0_CH10_FLUSH_STATE4_SD1"
(
  per.view hwioreg.per "DMH00,MDM_HI0_CH10_FLUSH_STATE4_SD1"
)
if "&choice"=="MDM_HI0_CH10_FLUSH_STATE4_SD2"
(
  per.view hwioreg.per "DMH00,MDM_HI0_CH10_FLUSH_STATE4_SD2"
)
if "&choice"=="MDM_HI0_CH10_FLUSH_STATE4_SD3"
(
  per.view hwioreg.per "DMH00,MDM_HI0_CH10_FLUSH_STATE4_SD3"
)
if "&choice"=="MDM_HI0_CH11_FLUSH_STATE4_SD0"
(
  per.view hwioreg.per "DMH00,MDM_HI0_CH11_FLUSH_STATE4_SD0"
)
if "&choice"=="MDM_HI0_CH11_FLUSH_STATE4_SD1"
(
  per.view hwioreg.per "DMH00,MDM_HI0_CH11_FLUSH_STATE4_SD1"
)
if "&choice"=="MDM_HI0_CH11_FLUSH_STATE4_SD2"
(
  per.view hwioreg.per "DMH00,MDM_HI0_CH11_FLUSH_STATE4_SD2"
)
if "&choice"=="MDM_HI0_CH11_FLUSH_STATE4_SD3"
(
  per.view hwioreg.per "DMH00,MDM_HI0_CH11_FLUSH_STATE4_SD3"
)
if "&choice"=="MDM_HI0_CH12_FLUSH_STATE4_SD0"
(
  per.view hwioreg.per "DMH00,MDM_HI0_CH12_FLUSH_STATE4_SD0"
)
if "&choice"=="MDM_HI0_CH12_FLUSH_STATE4_SD1"
(
  per.view hwioreg.per "DMH00,MDM_HI0_CH12_FLUSH_STATE4_SD1"
)
if "&choice"=="MDM_HI0_CH12_FLUSH_STATE4_SD2"
(
  per.view hwioreg.per "DMH00,MDM_HI0_CH12_FLUSH_STATE4_SD2"
)
if "&choice"=="MDM_HI0_CH12_FLUSH_STATE4_SD3"
(
  per.view hwioreg.per "DMH00,MDM_HI0_CH12_FLUSH_STATE4_SD3"
)
if "&choice"=="MDM_HI0_CH13_FLUSH_STATE4_SD0"
(
  per.view hwioreg.per "DMH00,MDM_HI0_CH13_FLUSH_STATE4_SD0"
)
if "&choice"=="MDM_HI0_CH13_FLUSH_STATE4_SD1"
(
  per.view hwioreg.per "DMH00,MDM_HI0_CH13_FLUSH_STATE4_SD1"
)
if "&choice"=="MDM_HI0_CH13_FLUSH_STATE4_SD2"
(
  per.view hwioreg.per "DMH00,MDM_HI0_CH13_FLUSH_STATE4_SD2"
)
if "&choice"=="MDM_HI0_CH13_FLUSH_STATE4_SD3"
(
  per.view hwioreg.per "DMH00,MDM_HI0_CH13_FLUSH_STATE4_SD3"
)
if "&choice"=="MDM_HI0_CH14_FLUSH_STATE4_SD0"
(
  per.view hwioreg.per "DMH00,MDM_HI0_CH14_FLUSH_STATE4_SD0"
)
if "&choice"=="MDM_HI0_CH14_FLUSH_STATE4_SD1"
(
  per.view hwioreg.per "DMH00,MDM_HI0_CH14_FLUSH_STATE4_SD1"
)
if "&choice"=="MDM_HI0_CH14_FLUSH_STATE4_SD2"
(
  per.view hwioreg.per "DMH00,MDM_HI0_CH14_FLUSH_STATE4_SD2"
)
if "&choice"=="MDM_HI0_CH14_FLUSH_STATE4_SD3"
(
  per.view hwioreg.per "DMH00,MDM_HI0_CH14_FLUSH_STATE4_SD3"
)
if "&choice"=="MDM_HI0_CH15_FLUSH_STATE4_SD0"
(
  per.view hwioreg.per "DMH00,MDM_HI0_CH15_FLUSH_STATE4_SD0"
)
if "&choice"=="MDM_HI0_CH15_FLUSH_STATE4_SD1"
(
  per.view hwioreg.per "DMH00,MDM_HI0_CH15_FLUSH_STATE4_SD1"
)
if "&choice"=="MDM_HI0_CH15_FLUSH_STATE4_SD2"
(
  per.view hwioreg.per "DMH00,MDM_HI0_CH15_FLUSH_STATE4_SD2"
)
if "&choice"=="MDM_HI0_CH15_FLUSH_STATE4_SD3"
(
  per.view hwioreg.per "DMH00,MDM_HI0_CH15_FLUSH_STATE4_SD3"
)
if "&choice"=="MDM_HI0_CH0_FLUSH_STATE5_SD0"
(
  per.view hwioreg.per "DMH00,MDM_HI0_CH0_FLUSH_STATE5_SD0"
)
if "&choice"=="MDM_HI0_CH0_FLUSH_STATE5_SD1"
(
  per.view hwioreg.per "DMH00,MDM_HI0_CH0_FLUSH_STATE5_SD1"
)
if "&choice"=="MDM_HI0_CH0_FLUSH_STATE5_SD2"
(
  per.view hwioreg.per "DMH00,MDM_HI0_CH0_FLUSH_STATE5_SD2"
)
if "&choice"=="MDM_HI0_CH0_FLUSH_STATE5_SD3"
(
  per.view hwioreg.per "DMH00,MDM_HI0_CH0_FLUSH_STATE5_SD3"
)
if "&choice"=="MDM_HI0_CH1_FLUSH_STATE5_SD0"
(
  per.view hwioreg.per "DMH00,MDM_HI0_CH1_FLUSH_STATE5_SD0"
)
if "&choice"=="MDM_HI0_CH1_FLUSH_STATE5_SD1"
(
  per.view hwioreg.per "DMH00,MDM_HI0_CH1_FLUSH_STATE5_SD1"
)
if "&choice"=="MDM_HI0_CH1_FLUSH_STATE5_SD2"
(
  per.view hwioreg.per "DMH00,MDM_HI0_CH1_FLUSH_STATE5_SD2"
)
if "&choice"=="MDM_HI0_CH1_FLUSH_STATE5_SD3"
(
  per.view hwioreg.per "DMH00,MDM_HI0_CH1_FLUSH_STATE5_SD3"
)
if "&choice"=="MDM_HI0_CH2_FLUSH_STATE5_SD0"
(
  per.view hwioreg.per "DMH00,MDM_HI0_CH2_FLUSH_STATE5_SD0"
)
if "&choice"=="MDM_HI0_CH2_FLUSH_STATE5_SD1"
(
  per.view hwioreg.per "DMH00,MDM_HI0_CH2_FLUSH_STATE5_SD1"
)
if "&choice"=="MDM_HI0_CH2_FLUSH_STATE5_SD2"
(
  per.view hwioreg.per "DMH00,MDM_HI0_CH2_FLUSH_STATE5_SD2"
)
if "&choice"=="MDM_HI0_CH2_FLUSH_STATE5_SD3"
(
  per.view hwioreg.per "DMH00,MDM_HI0_CH2_FLUSH_STATE5_SD3"
)
if "&choice"=="MDM_HI0_CH3_FLUSH_STATE5_SD0"
(
  per.view hwioreg.per "DMH00,MDM_HI0_CH3_FLUSH_STATE5_SD0"
)
if "&choice"=="MDM_HI0_CH3_FLUSH_STATE5_SD1"
(
  per.view hwioreg.per "DMH00,MDM_HI0_CH3_FLUSH_STATE5_SD1"
)
if "&choice"=="MDM_HI0_CH3_FLUSH_STATE5_SD2"
(
  per.view hwioreg.per "DMH00,MDM_HI0_CH3_FLUSH_STATE5_SD2"
)
if "&choice"=="MDM_HI0_CH3_FLUSH_STATE5_SD3"
(
  per.view hwioreg.per "DMH00,MDM_HI0_CH3_FLUSH_STATE5_SD3"
)
if "&choice"=="MDM_HI0_CH4_FLUSH_STATE5_SD0"
(
  per.view hwioreg.per "DMH00,MDM_HI0_CH4_FLUSH_STATE5_SD0"
)
if "&choice"=="MDM_HI0_CH4_FLUSH_STATE5_SD1"
(
  per.view hwioreg.per "DMH00,MDM_HI0_CH4_FLUSH_STATE5_SD1"
)
if "&choice"=="MDM_HI0_CH4_FLUSH_STATE5_SD2"
(
  per.view hwioreg.per "DMH00,MDM_HI0_CH4_FLUSH_STATE5_SD2"
)
if "&choice"=="MDM_HI0_CH4_FLUSH_STATE5_SD3"
(
  per.view hwioreg.per "DMH00,MDM_HI0_CH4_FLUSH_STATE5_SD3"
)
if "&choice"=="MDM_HI0_CH5_FLUSH_STATE5_SD0"
(
  per.view hwioreg.per "DMH00,MDM_HI0_CH5_FLUSH_STATE5_SD0"
)
if "&choice"=="MDM_HI0_CH5_FLUSH_STATE5_SD1"
(
  per.view hwioreg.per "DMH00,MDM_HI0_CH5_FLUSH_STATE5_SD1"
)
if "&choice"=="MDM_HI0_CH5_FLUSH_STATE5_SD2"
(
  per.view hwioreg.per "DMH00,MDM_HI0_CH5_FLUSH_STATE5_SD2"
)
if "&choice"=="MDM_HI0_CH5_FLUSH_STATE5_SD3"
(
  per.view hwioreg.per "DMH00,MDM_HI0_CH5_FLUSH_STATE5_SD3"
)
if "&choice"=="MDM_HI0_CH6_FLUSH_STATE5_SD0"
(
  per.view hwioreg.per "DMH00,MDM_HI0_CH6_FLUSH_STATE5_SD0"
)
if "&choice"=="MDM_HI0_CH6_FLUSH_STATE5_SD1"
(
  per.view hwioreg.per "DMH00,MDM_HI0_CH6_FLUSH_STATE5_SD1"
)
if "&choice"=="MDM_HI0_CH6_FLUSH_STATE5_SD2"
(
  per.view hwioreg.per "DMH00,MDM_HI0_CH6_FLUSH_STATE5_SD2"
)
if "&choice"=="MDM_HI0_CH6_FLUSH_STATE5_SD3"
(
  per.view hwioreg.per "DMH00,MDM_HI0_CH6_FLUSH_STATE5_SD3"
)
if "&choice"=="MDM_HI0_CH7_FLUSH_STATE5_SD0"
(
  per.view hwioreg.per "DMH00,MDM_HI0_CH7_FLUSH_STATE5_SD0"
)
if "&choice"=="MDM_HI0_CH7_FLUSH_STATE5_SD1"
(
  per.view hwioreg.per "DMH00,MDM_HI0_CH7_FLUSH_STATE5_SD1"
)
if "&choice"=="MDM_HI0_CH7_FLUSH_STATE5_SD2"
(
  per.view hwioreg.per "DMH00,MDM_HI0_CH7_FLUSH_STATE5_SD2"
)
if "&choice"=="MDM_HI0_CH7_FLUSH_STATE5_SD3"
(
  per.view hwioreg.per "DMH00,MDM_HI0_CH7_FLUSH_STATE5_SD3"
)
if "&choice"=="MDM_HI0_CH8_FLUSH_STATE5_SD0"
(
  per.view hwioreg.per "DMH00,MDM_HI0_CH8_FLUSH_STATE5_SD0"
)
if "&choice"=="MDM_HI0_CH8_FLUSH_STATE5_SD1"
(
  per.view hwioreg.per "DMH00,MDM_HI0_CH8_FLUSH_STATE5_SD1"
)
if "&choice"=="MDM_HI0_CH8_FLUSH_STATE5_SD2"
(
  per.view hwioreg.per "DMH00,MDM_HI0_CH8_FLUSH_STATE5_SD2"
)
if "&choice"=="MDM_HI0_CH8_FLUSH_STATE5_SD3"
(
  per.view hwioreg.per "DMH00,MDM_HI0_CH8_FLUSH_STATE5_SD3"
)
if "&choice"=="MDM_HI0_CH9_FLUSH_STATE5_SD0"
(
  per.view hwioreg.per "DMH00,MDM_HI0_CH9_FLUSH_STATE5_SD0"
)
if "&choice"=="MDM_HI0_CH9_FLUSH_STATE5_SD1"
(
  per.view hwioreg.per "DMH00,MDM_HI0_CH9_FLUSH_STATE5_SD1"
)
if "&choice"=="MDM_HI0_CH9_FLUSH_STATE5_SD2"
(
  per.view hwioreg.per "DMH00,MDM_HI0_CH9_FLUSH_STATE5_SD2"
)
if "&choice"=="MDM_HI0_CH9_FLUSH_STATE5_SD3"
(
  per.view hwioreg.per "DMH00,MDM_HI0_CH9_FLUSH_STATE5_SD3"
)
if "&choice"=="MDM_HI0_CH10_FLUSH_STATE5_SD0"
(
  per.view hwioreg.per "DMH00,MDM_HI0_CH10_FLUSH_STATE5_SD0"
)
if "&choice"=="MDM_HI0_CH10_FLUSH_STATE5_SD1"
(
  per.view hwioreg.per "DMH00,MDM_HI0_CH10_FLUSH_STATE5_SD1"
)
if "&choice"=="MDM_HI0_CH10_FLUSH_STATE5_SD2"
(
  per.view hwioreg.per "DMH00,MDM_HI0_CH10_FLUSH_STATE5_SD2"
)
if "&choice"=="MDM_HI0_CH10_FLUSH_STATE5_SD3"
(
  per.view hwioreg.per "DMH00,MDM_HI0_CH10_FLUSH_STATE5_SD3"
)
if "&choice"=="MDM_HI0_CH11_FLUSH_STATE5_SD0"
(
  per.view hwioreg.per "DMH00,MDM_HI0_CH11_FLUSH_STATE5_SD0"
)
if "&choice"=="MDM_HI0_CH11_FLUSH_STATE5_SD1"
(
  per.view hwioreg.per "DMH00,MDM_HI0_CH11_FLUSH_STATE5_SD1"
)
if "&choice"=="MDM_HI0_CH11_FLUSH_STATE5_SD2"
(
  per.view hwioreg.per "DMH00,MDM_HI0_CH11_FLUSH_STATE5_SD2"
)
if "&choice"=="MDM_HI0_CH11_FLUSH_STATE5_SD3"
(
  per.view hwioreg.per "DMH00,MDM_HI0_CH11_FLUSH_STATE5_SD3"
)
if "&choice"=="MDM_HI0_CH12_FLUSH_STATE5_SD0"
(
  per.view hwioreg.per "DMH00,MDM_HI0_CH12_FLUSH_STATE5_SD0"
)
if "&choice"=="MDM_HI0_CH12_FLUSH_STATE5_SD1"
(
  per.view hwioreg.per "DMH00,MDM_HI0_CH12_FLUSH_STATE5_SD1"
)
if "&choice"=="MDM_HI0_CH12_FLUSH_STATE5_SD2"
(
  per.view hwioreg.per "DMH00,MDM_HI0_CH12_FLUSH_STATE5_SD2"
)
if "&choice"=="MDM_HI0_CH12_FLUSH_STATE5_SD3"
(
  per.view hwioreg.per "DMH00,MDM_HI0_CH12_FLUSH_STATE5_SD3"
)
if "&choice"=="MDM_HI0_CH13_FLUSH_STATE5_SD0"
(
  per.view hwioreg.per "DMH00,MDM_HI0_CH13_FLUSH_STATE5_SD0"
)
if "&choice"=="MDM_HI0_CH13_FLUSH_STATE5_SD1"
(
  per.view hwioreg.per "DMH00,MDM_HI0_CH13_FLUSH_STATE5_SD1"
)
if "&choice"=="MDM_HI0_CH13_FLUSH_STATE5_SD2"
(
  per.view hwioreg.per "DMH00,MDM_HI0_CH13_FLUSH_STATE5_SD2"
)
if "&choice"=="MDM_HI0_CH13_FLUSH_STATE5_SD3"
(
  per.view hwioreg.per "DMH00,MDM_HI0_CH13_FLUSH_STATE5_SD3"
)
if "&choice"=="MDM_HI0_CH14_FLUSH_STATE5_SD0"
(
  per.view hwioreg.per "DMH00,MDM_HI0_CH14_FLUSH_STATE5_SD0"
)
if "&choice"=="MDM_HI0_CH14_FLUSH_STATE5_SD1"
(
  per.view hwioreg.per "DMH00,MDM_HI0_CH14_FLUSH_STATE5_SD1"
)
if "&choice"=="MDM_HI0_CH14_FLUSH_STATE5_SD2"
(
  per.view hwioreg.per "DMH00,MDM_HI0_CH14_FLUSH_STATE5_SD2"
)
if "&choice"=="MDM_HI0_CH14_FLUSH_STATE5_SD3"
(
  per.view hwioreg.per "DMH00,MDM_HI0_CH14_FLUSH_STATE5_SD3"
)
if "&choice"=="MDM_HI0_CH15_FLUSH_STATE5_SD0"
(
  per.view hwioreg.per "DMH00,MDM_HI0_CH15_FLUSH_STATE5_SD0"
)
if "&choice"=="MDM_HI0_CH15_FLUSH_STATE5_SD1"
(
  per.view hwioreg.per "DMH00,MDM_HI0_CH15_FLUSH_STATE5_SD1"
)
if "&choice"=="MDM_HI0_CH15_FLUSH_STATE5_SD2"
(
  per.view hwioreg.per "DMH00,MDM_HI0_CH15_FLUSH_STATE5_SD2"
)
if "&choice"=="MDM_HI0_CH15_FLUSH_STATE5_SD3"
(
  per.view hwioreg.per "DMH00,MDM_HI0_CH15_FLUSH_STATE5_SD3"
)
if "&choice"=="MDM_HI0_SEC_DOMAIN_IRQ_STATUS_SD0"
(
  per.view hwioreg.per "DMH00,MDM_HI0_SEC_DOMAIN_IRQ_STATUS_SD0"
)
if "&choice"=="MDM_HI0_SEC_DOMAIN_IRQ_STATUS_SD1"
(
  per.view hwioreg.per "DMH00,MDM_HI0_SEC_DOMAIN_IRQ_STATUS_SD1"
)
if "&choice"=="MDM_HI0_SEC_DOMAIN_IRQ_STATUS_SD2"
(
  per.view hwioreg.per "DMH00,MDM_HI0_SEC_DOMAIN_IRQ_STATUS_SD2"
)
if "&choice"=="MDM_HI0_SEC_DOMAIN_IRQ_STATUS_SD3"
(
  per.view hwioreg.per "DMH00,MDM_HI0_SEC_DOMAIN_IRQ_STATUS_SD3"
)
if "&choice"=="MDM_HI0_CH0_RSLT_CONF_SD0"
(
  per.view hwioreg.per "DMH00,MDM_HI0_CH0_RSLT_CONF_SD0"
)
if "&choice"=="MDM_HI0_CH0_RSLT_CONF_SD1"
(
  per.view hwioreg.per "DMH00,MDM_HI0_CH0_RSLT_CONF_SD1"
)
if "&choice"=="MDM_HI0_CH0_RSLT_CONF_SD2"
(
  per.view hwioreg.per "DMH00,MDM_HI0_CH0_RSLT_CONF_SD2"
)
if "&choice"=="MDM_HI0_CH0_RSLT_CONF_SD3"
(
  per.view hwioreg.per "DMH00,MDM_HI0_CH0_RSLT_CONF_SD3"
)
if "&choice"=="MDM_HI0_CH1_RSLT_CONF_SD0"
(
  per.view hwioreg.per "DMH00,MDM_HI0_CH1_RSLT_CONF_SD0"
)
if "&choice"=="MDM_HI0_CH1_RSLT_CONF_SD1"
(
  per.view hwioreg.per "DMH00,MDM_HI0_CH1_RSLT_CONF_SD1"
)
if "&choice"=="MDM_HI0_CH1_RSLT_CONF_SD2"
(
  per.view hwioreg.per "DMH00,MDM_HI0_CH1_RSLT_CONF_SD2"
)
if "&choice"=="MDM_HI0_CH1_RSLT_CONF_SD3"
(
  per.view hwioreg.per "DMH00,MDM_HI0_CH1_RSLT_CONF_SD3"
)
if "&choice"=="MDM_HI0_CH2_RSLT_CONF_SD0"
(
  per.view hwioreg.per "DMH00,MDM_HI0_CH2_RSLT_CONF_SD0"
)
if "&choice"=="MDM_HI0_CH2_RSLT_CONF_SD1"
(
  per.view hwioreg.per "DMH00,MDM_HI0_CH2_RSLT_CONF_SD1"
)
if "&choice"=="MDM_HI0_CH2_RSLT_CONF_SD2"
(
  per.view hwioreg.per "DMH00,MDM_HI0_CH2_RSLT_CONF_SD2"
)
if "&choice"=="MDM_HI0_CH2_RSLT_CONF_SD3"
(
  per.view hwioreg.per "DMH00,MDM_HI0_CH2_RSLT_CONF_SD3"
)
if "&choice"=="MDM_HI0_CH3_RSLT_CONF_SD0"
(
  per.view hwioreg.per "DMH00,MDM_HI0_CH3_RSLT_CONF_SD0"
)
if "&choice"=="MDM_HI0_CH3_RSLT_CONF_SD1"
(
  per.view hwioreg.per "DMH00,MDM_HI0_CH3_RSLT_CONF_SD1"
)
if "&choice"=="MDM_HI0_CH3_RSLT_CONF_SD2"
(
  per.view hwioreg.per "DMH00,MDM_HI0_CH3_RSLT_CONF_SD2"
)
if "&choice"=="MDM_HI0_CH3_RSLT_CONF_SD3"
(
  per.view hwioreg.per "DMH00,MDM_HI0_CH3_RSLT_CONF_SD3"
)
if "&choice"=="MDM_HI0_CH4_RSLT_CONF_SD0"
(
  per.view hwioreg.per "DMH00,MDM_HI0_CH4_RSLT_CONF_SD0"
)
if "&choice"=="MDM_HI0_CH4_RSLT_CONF_SD1"
(
  per.view hwioreg.per "DMH00,MDM_HI0_CH4_RSLT_CONF_SD1"
)
if "&choice"=="MDM_HI0_CH4_RSLT_CONF_SD2"
(
  per.view hwioreg.per "DMH00,MDM_HI0_CH4_RSLT_CONF_SD2"
)
if "&choice"=="MDM_HI0_CH4_RSLT_CONF_SD3"
(
  per.view hwioreg.per "DMH00,MDM_HI0_CH4_RSLT_CONF_SD3"
)
if "&choice"=="MDM_HI0_CH5_RSLT_CONF_SD0"
(
  per.view hwioreg.per "DMH00,MDM_HI0_CH5_RSLT_CONF_SD0"
)
if "&choice"=="MDM_HI0_CH5_RSLT_CONF_SD1"
(
  per.view hwioreg.per "DMH00,MDM_HI0_CH5_RSLT_CONF_SD1"
)
if "&choice"=="MDM_HI0_CH5_RSLT_CONF_SD2"
(
  per.view hwioreg.per "DMH00,MDM_HI0_CH5_RSLT_CONF_SD2"
)
if "&choice"=="MDM_HI0_CH5_RSLT_CONF_SD3"
(
  per.view hwioreg.per "DMH00,MDM_HI0_CH5_RSLT_CONF_SD3"
)
if "&choice"=="MDM_HI0_CH6_RSLT_CONF_SD0"
(
  per.view hwioreg.per "DMH00,MDM_HI0_CH6_RSLT_CONF_SD0"
)
if "&choice"=="MDM_HI0_CH6_RSLT_CONF_SD1"
(
  per.view hwioreg.per "DMH00,MDM_HI0_CH6_RSLT_CONF_SD1"
)
if "&choice"=="MDM_HI0_CH6_RSLT_CONF_SD2"
(
  per.view hwioreg.per "DMH00,MDM_HI0_CH6_RSLT_CONF_SD2"
)
if "&choice"=="MDM_HI0_CH6_RSLT_CONF_SD3"
(
  per.view hwioreg.per "DMH00,MDM_HI0_CH6_RSLT_CONF_SD3"
)
if "&choice"=="MDM_HI0_CH7_RSLT_CONF_SD0"
(
  per.view hwioreg.per "DMH00,MDM_HI0_CH7_RSLT_CONF_SD0"
)
if "&choice"=="MDM_HI0_CH7_RSLT_CONF_SD1"
(
  per.view hwioreg.per "DMH00,MDM_HI0_CH7_RSLT_CONF_SD1"
)
if "&choice"=="MDM_HI0_CH7_RSLT_CONF_SD2"
(
  per.view hwioreg.per "DMH00,MDM_HI0_CH7_RSLT_CONF_SD2"
)
if "&choice"=="MDM_HI0_CH7_RSLT_CONF_SD3"
(
  per.view hwioreg.per "DMH00,MDM_HI0_CH7_RSLT_CONF_SD3"
)
if "&choice"=="MDM_HI0_CH8_RSLT_CONF_SD0"
(
  per.view hwioreg.per "DMH00,MDM_HI0_CH8_RSLT_CONF_SD0"
)
if "&choice"=="MDM_HI0_CH8_RSLT_CONF_SD1"
(
  per.view hwioreg.per "DMH00,MDM_HI0_CH8_RSLT_CONF_SD1"
)
if "&choice"=="MDM_HI0_CH8_RSLT_CONF_SD2"
(
  per.view hwioreg.per "DMH00,MDM_HI0_CH8_RSLT_CONF_SD2"
)
if "&choice"=="MDM_HI0_CH8_RSLT_CONF_SD3"
(
  per.view hwioreg.per "DMH00,MDM_HI0_CH8_RSLT_CONF_SD3"
)
if "&choice"=="MDM_HI0_CH9_RSLT_CONF_SD0"
(
  per.view hwioreg.per "DMH00,MDM_HI0_CH9_RSLT_CONF_SD0"
)
if "&choice"=="MDM_HI0_CH9_RSLT_CONF_SD1"
(
  per.view hwioreg.per "DMH00,MDM_HI0_CH9_RSLT_CONF_SD1"
)
if "&choice"=="MDM_HI0_CH9_RSLT_CONF_SD2"
(
  per.view hwioreg.per "DMH00,MDM_HI0_CH9_RSLT_CONF_SD2"
)
if "&choice"=="MDM_HI0_CH9_RSLT_CONF_SD3"
(
  per.view hwioreg.per "DMH00,MDM_HI0_CH9_RSLT_CONF_SD3"
)
if "&choice"=="MDM_HI0_CH10_RSLT_CONF_SD0"
(
  per.view hwioreg.per "DMH00,MDM_HI0_CH10_RSLT_CONF_SD0"
)
if "&choice"=="MDM_HI0_CH10_RSLT_CONF_SD1"
(
  per.view hwioreg.per "DMH00,MDM_HI0_CH10_RSLT_CONF_SD1"
)
if "&choice"=="MDM_HI0_CH10_RSLT_CONF_SD2"
(
  per.view hwioreg.per "DMH00,MDM_HI0_CH10_RSLT_CONF_SD2"
)
if "&choice"=="MDM_HI0_CH10_RSLT_CONF_SD3"
(
  per.view hwioreg.per "DMH00,MDM_HI0_CH10_RSLT_CONF_SD3"
)
if "&choice"=="MDM_HI0_CH11_RSLT_CONF_SD0"
(
  per.view hwioreg.per "DMH00,MDM_HI0_CH11_RSLT_CONF_SD0"
)
if "&choice"=="MDM_HI0_CH11_RSLT_CONF_SD1"
(
  per.view hwioreg.per "DMH00,MDM_HI0_CH11_RSLT_CONF_SD1"
)
if "&choice"=="MDM_HI0_CH11_RSLT_CONF_SD2"
(
  per.view hwioreg.per "DMH00,MDM_HI0_CH11_RSLT_CONF_SD2"
)
if "&choice"=="MDM_HI0_CH11_RSLT_CONF_SD3"
(
  per.view hwioreg.per "DMH00,MDM_HI0_CH11_RSLT_CONF_SD3"
)
if "&choice"=="MDM_HI0_CH12_RSLT_CONF_SD0"
(
  per.view hwioreg.per "DMH00,MDM_HI0_CH12_RSLT_CONF_SD0"
)
if "&choice"=="MDM_HI0_CH12_RSLT_CONF_SD1"
(
  per.view hwioreg.per "DMH00,MDM_HI0_CH12_RSLT_CONF_SD1"
)
if "&choice"=="MDM_HI0_CH12_RSLT_CONF_SD2"
(
  per.view hwioreg.per "DMH00,MDM_HI0_CH12_RSLT_CONF_SD2"
)
if "&choice"=="MDM_HI0_CH12_RSLT_CONF_SD3"
(
  per.view hwioreg.per "DMH00,MDM_HI0_CH12_RSLT_CONF_SD3"
)
if "&choice"=="MDM_HI0_CH13_RSLT_CONF_SD0"
(
  per.view hwioreg.per "DMH00,MDM_HI0_CH13_RSLT_CONF_SD0"
)
if "&choice"=="MDM_HI0_CH13_RSLT_CONF_SD1"
(
  per.view hwioreg.per "DMH00,MDM_HI0_CH13_RSLT_CONF_SD1"
)
if "&choice"=="MDM_HI0_CH13_RSLT_CONF_SD2"
(
  per.view hwioreg.per "DMH00,MDM_HI0_CH13_RSLT_CONF_SD2"
)
if "&choice"=="MDM_HI0_CH13_RSLT_CONF_SD3"
(
  per.view hwioreg.per "DMH00,MDM_HI0_CH13_RSLT_CONF_SD3"
)
if "&choice"=="MDM_HI0_CH14_RSLT_CONF_SD0"
(
  per.view hwioreg.per "DMH00,MDM_HI0_CH14_RSLT_CONF_SD0"
)
if "&choice"=="MDM_HI0_CH14_RSLT_CONF_SD1"
(
  per.view hwioreg.per "DMH00,MDM_HI0_CH14_RSLT_CONF_SD1"
)
if "&choice"=="MDM_HI0_CH14_RSLT_CONF_SD2"
(
  per.view hwioreg.per "DMH00,MDM_HI0_CH14_RSLT_CONF_SD2"
)
if "&choice"=="MDM_HI0_CH14_RSLT_CONF_SD3"
(
  per.view hwioreg.per "DMH00,MDM_HI0_CH14_RSLT_CONF_SD3"
)
if "&choice"=="MDM_HI0_CH15_RSLT_CONF_SD0"
(
  per.view hwioreg.per "DMH00,MDM_HI0_CH15_RSLT_CONF_SD0"
)
if "&choice"=="MDM_HI0_CH15_RSLT_CONF_SD1"
(
  per.view hwioreg.per "DMH00,MDM_HI0_CH15_RSLT_CONF_SD1"
)
if "&choice"=="MDM_HI0_CH15_RSLT_CONF_SD2"
(
  per.view hwioreg.per "DMH00,MDM_HI0_CH15_RSLT_CONF_SD2"
)
if "&choice"=="MDM_HI0_CH15_RSLT_CONF_SD3"
(
  per.view hwioreg.per "DMH00,MDM_HI0_CH15_RSLT_CONF_SD3"
)
if "&choice"=="MDM_HI0_CH0_STATUS_SD0"
(
  per.view hwioreg.per "DMH00,MDM_HI0_CH0_STATUS_SD0"
)
if "&choice"=="MDM_HI0_CH0_STATUS_SD1"
(
  per.view hwioreg.per "DMH00,MDM_HI0_CH0_STATUS_SD1"
)
if "&choice"=="MDM_HI0_CH0_STATUS_SD2"
(
  per.view hwioreg.per "DMH00,MDM_HI0_CH0_STATUS_SD2"
)
if "&choice"=="MDM_HI0_CH0_STATUS_SD3"
(
  per.view hwioreg.per "DMH00,MDM_HI0_CH0_STATUS_SD3"
)
if "&choice"=="MDM_HI0_CH1_STATUS_SD0"
(
  per.view hwioreg.per "DMH00,MDM_HI0_CH1_STATUS_SD0"
)
if "&choice"=="MDM_HI0_CH1_STATUS_SD1"
(
  per.view hwioreg.per "DMH00,MDM_HI0_CH1_STATUS_SD1"
)
if "&choice"=="MDM_HI0_CH1_STATUS_SD2"
(
  per.view hwioreg.per "DMH00,MDM_HI0_CH1_STATUS_SD2"
)
if "&choice"=="MDM_HI0_CH1_STATUS_SD3"
(
  per.view hwioreg.per "DMH00,MDM_HI0_CH1_STATUS_SD3"
)
if "&choice"=="MDM_HI0_CH2_STATUS_SD0"
(
  per.view hwioreg.per "DMH00,MDM_HI0_CH2_STATUS_SD0"
)
if "&choice"=="MDM_HI0_CH2_STATUS_SD1"
(
  per.view hwioreg.per "DMH00,MDM_HI0_CH2_STATUS_SD1"
)
if "&choice"=="MDM_HI0_CH2_STATUS_SD2"
(
  per.view hwioreg.per "DMH00,MDM_HI0_CH2_STATUS_SD2"
)
if "&choice"=="MDM_HI0_CH2_STATUS_SD3"
(
  per.view hwioreg.per "DMH00,MDM_HI0_CH2_STATUS_SD3"
)
if "&choice"=="MDM_HI0_CH3_STATUS_SD0"
(
  per.view hwioreg.per "DMH00,MDM_HI0_CH3_STATUS_SD0"
)
if "&choice"=="MDM_HI0_CH3_STATUS_SD1"
(
  per.view hwioreg.per "DMH00,MDM_HI0_CH3_STATUS_SD1"
)
if "&choice"=="MDM_HI0_CH3_STATUS_SD2"
(
  per.view hwioreg.per "DMH00,MDM_HI0_CH3_STATUS_SD2"
)
if "&choice"=="MDM_HI0_CH3_STATUS_SD3"
(
  per.view hwioreg.per "DMH00,MDM_HI0_CH3_STATUS_SD3"
)
if "&choice"=="MDM_HI0_CH4_STATUS_SD0"
(
  per.view hwioreg.per "DMH00,MDM_HI0_CH4_STATUS_SD0"
)
if "&choice"=="MDM_HI0_CH4_STATUS_SD1"
(
  per.view hwioreg.per "DMH00,MDM_HI0_CH4_STATUS_SD1"
)
if "&choice"=="MDM_HI0_CH4_STATUS_SD2"
(
  per.view hwioreg.per "DMH00,MDM_HI0_CH4_STATUS_SD2"
)
if "&choice"=="MDM_HI0_CH4_STATUS_SD3"
(
  per.view hwioreg.per "DMH00,MDM_HI0_CH4_STATUS_SD3"
)
if "&choice"=="MDM_HI0_CH5_STATUS_SD0"
(
  per.view hwioreg.per "DMH00,MDM_HI0_CH5_STATUS_SD0"
)
if "&choice"=="MDM_HI0_CH5_STATUS_SD1"
(
  per.view hwioreg.per "DMH00,MDM_HI0_CH5_STATUS_SD1"
)
if "&choice"=="MDM_HI0_CH5_STATUS_SD2"
(
  per.view hwioreg.per "DMH00,MDM_HI0_CH5_STATUS_SD2"
)
if "&choice"=="MDM_HI0_CH5_STATUS_SD3"
(
  per.view hwioreg.per "DMH00,MDM_HI0_CH5_STATUS_SD3"
)
if "&choice"=="MDM_HI0_CH6_STATUS_SD0"
(
  per.view hwioreg.per "DMH00,MDM_HI0_CH6_STATUS_SD0"
)
if "&choice"=="MDM_HI0_CH6_STATUS_SD1"
(
  per.view hwioreg.per "DMH00,MDM_HI0_CH6_STATUS_SD1"
)
if "&choice"=="MDM_HI0_CH6_STATUS_SD2"
(
  per.view hwioreg.per "DMH00,MDM_HI0_CH6_STATUS_SD2"
)
if "&choice"=="MDM_HI0_CH6_STATUS_SD3"
(
  per.view hwioreg.per "DMH00,MDM_HI0_CH6_STATUS_SD3"
)
if "&choice"=="MDM_HI0_CH7_STATUS_SD0"
(
  per.view hwioreg.per "DMH00,MDM_HI0_CH7_STATUS_SD0"
)
if "&choice"=="MDM_HI0_CH7_STATUS_SD1"
(
  per.view hwioreg.per "DMH00,MDM_HI0_CH7_STATUS_SD1"
)
if "&choice"=="MDM_HI0_CH7_STATUS_SD2"
(
  per.view hwioreg.per "DMH00,MDM_HI0_CH7_STATUS_SD2"
)
if "&choice"=="MDM_HI0_CH7_STATUS_SD3"
(
  per.view hwioreg.per "DMH00,MDM_HI0_CH7_STATUS_SD3"
)
if "&choice"=="MDM_HI0_CH8_STATUS_SD0"
(
  per.view hwioreg.per "DMH00,MDM_HI0_CH8_STATUS_SD0"
)
if "&choice"=="MDM_HI0_CH8_STATUS_SD1"
(
  per.view hwioreg.per "DMH00,MDM_HI0_CH8_STATUS_SD1"
)
if "&choice"=="MDM_HI0_CH8_STATUS_SD2"
(
  per.view hwioreg.per "DMH00,MDM_HI0_CH8_STATUS_SD2"
)
if "&choice"=="MDM_HI0_CH8_STATUS_SD3"
(
  per.view hwioreg.per "DMH00,MDM_HI0_CH8_STATUS_SD3"
)
if "&choice"=="MDM_HI0_CH9_STATUS_SD0"
(
  per.view hwioreg.per "DMH00,MDM_HI0_CH9_STATUS_SD0"
)
if "&choice"=="MDM_HI0_CH9_STATUS_SD1"
(
  per.view hwioreg.per "DMH00,MDM_HI0_CH9_STATUS_SD1"
)
if "&choice"=="MDM_HI0_CH9_STATUS_SD2"
(
  per.view hwioreg.per "DMH00,MDM_HI0_CH9_STATUS_SD2"
)
if "&choice"=="MDM_HI0_CH9_STATUS_SD3"
(
  per.view hwioreg.per "DMH00,MDM_HI0_CH9_STATUS_SD3"
)
if "&choice"=="MDM_HI0_CH10_STATUS_SD0"
(
  per.view hwioreg.per "DMH00,MDM_HI0_CH10_STATUS_SD0"
)
if "&choice"=="MDM_HI0_CH10_STATUS_SD1"
(
  per.view hwioreg.per "DMH00,MDM_HI0_CH10_STATUS_SD1"
)
if "&choice"=="MDM_HI0_CH10_STATUS_SD2"
(
  per.view hwioreg.per "DMH00,MDM_HI0_CH10_STATUS_SD2"
)
if "&choice"=="MDM_HI0_CH10_STATUS_SD3"
(
  per.view hwioreg.per "DMH00,MDM_HI0_CH10_STATUS_SD3"
)
if "&choice"=="MDM_HI0_CH11_STATUS_SD0"
(
  per.view hwioreg.per "DMH00,MDM_HI0_CH11_STATUS_SD0"
)
if "&choice"=="MDM_HI0_CH11_STATUS_SD1"
(
  per.view hwioreg.per "DMH00,MDM_HI0_CH11_STATUS_SD1"
)
if "&choice"=="MDM_HI0_CH11_STATUS_SD2"
(
  per.view hwioreg.per "DMH00,MDM_HI0_CH11_STATUS_SD2"
)
if "&choice"=="MDM_HI0_CH11_STATUS_SD3"
(
  per.view hwioreg.per "DMH00,MDM_HI0_CH11_STATUS_SD3"
)
if "&choice"=="MDM_HI0_CH12_STATUS_SD0"
(
  per.view hwioreg.per "DMH00,MDM_HI0_CH12_STATUS_SD0"
)
if "&choice"=="MDM_HI0_CH12_STATUS_SD1"
(
  per.view hwioreg.per "DMH00,MDM_HI0_CH12_STATUS_SD1"
)
if "&choice"=="MDM_HI0_CH12_STATUS_SD2"
(
  per.view hwioreg.per "DMH00,MDM_HI0_CH12_STATUS_SD2"
)
if "&choice"=="MDM_HI0_CH12_STATUS_SD3"
(
  per.view hwioreg.per "DMH00,MDM_HI0_CH12_STATUS_SD3"
)
if "&choice"=="MDM_HI0_CH13_STATUS_SD0"
(
  per.view hwioreg.per "DMH00,MDM_HI0_CH13_STATUS_SD0"
)
if "&choice"=="MDM_HI0_CH13_STATUS_SD1"
(
  per.view hwioreg.per "DMH00,MDM_HI0_CH13_STATUS_SD1"
)
if "&choice"=="MDM_HI0_CH13_STATUS_SD2"
(
  per.view hwioreg.per "DMH00,MDM_HI0_CH13_STATUS_SD2"
)
if "&choice"=="MDM_HI0_CH13_STATUS_SD3"
(
  per.view hwioreg.per "DMH00,MDM_HI0_CH13_STATUS_SD3"
)
if "&choice"=="MDM_HI0_CH14_STATUS_SD0"
(
  per.view hwioreg.per "DMH00,MDM_HI0_CH14_STATUS_SD0"
)
if "&choice"=="MDM_HI0_CH14_STATUS_SD1"
(
  per.view hwioreg.per "DMH00,MDM_HI0_CH14_STATUS_SD1"
)
if "&choice"=="MDM_HI0_CH14_STATUS_SD2"
(
  per.view hwioreg.per "DMH00,MDM_HI0_CH14_STATUS_SD2"
)
if "&choice"=="MDM_HI0_CH14_STATUS_SD3"
(
  per.view hwioreg.per "DMH00,MDM_HI0_CH14_STATUS_SD3"
)
if "&choice"=="MDM_HI0_CH15_STATUS_SD0"
(
  per.view hwioreg.per "DMH00,MDM_HI0_CH15_STATUS_SD0"
)
if "&choice"=="MDM_HI0_CH15_STATUS_SD1"
(
  per.view hwioreg.per "DMH00,MDM_HI0_CH15_STATUS_SD1"
)
if "&choice"=="MDM_HI0_CH15_STATUS_SD2"
(
  per.view hwioreg.per "DMH00,MDM_HI0_CH15_STATUS_SD2"
)
if "&choice"=="MDM_HI0_CH15_STATUS_SD3"
(
  per.view hwioreg.per "DMH00,MDM_HI0_CH15_STATUS_SD3"
)
if "&choice"=="MDM_HI0_CH0_CONF"
(
  per.view hwioreg.per "DMH00,MDM_HI0_CH0_CONF"
)
if "&choice"=="MDM_HI0_CH1_CONF"
(
  per.view hwioreg.per "DMH00,MDM_HI0_CH1_CONF"
)
if "&choice"=="MDM_HI0_CH2_CONF"
(
  per.view hwioreg.per "DMH00,MDM_HI0_CH2_CONF"
)
if "&choice"=="MDM_HI0_CH3_CONF"
(
  per.view hwioreg.per "DMH00,MDM_HI0_CH3_CONF"
)
if "&choice"=="MDM_HI0_CH4_CONF"
(
  per.view hwioreg.per "DMH00,MDM_HI0_CH4_CONF"
)
if "&choice"=="MDM_HI0_CH5_CONF"
(
  per.view hwioreg.per "DMH00,MDM_HI0_CH5_CONF"
)
if "&choice"=="MDM_HI0_CH6_CONF"
(
  per.view hwioreg.per "DMH00,MDM_HI0_CH6_CONF"
)
if "&choice"=="MDM_HI0_CH7_CONF"
(
  per.view hwioreg.per "DMH00,MDM_HI0_CH7_CONF"
)
if "&choice"=="MDM_HI0_CH8_CONF"
(
  per.view hwioreg.per "DMH00,MDM_HI0_CH8_CONF"
)
if "&choice"=="MDM_HI0_CH9_CONF"
(
  per.view hwioreg.per "DMH00,MDM_HI0_CH9_CONF"
)
if "&choice"=="MDM_HI0_CH10_CONF"
(
  per.view hwioreg.per "DMH00,MDM_HI0_CH10_CONF"
)
if "&choice"=="MDM_HI0_CH11_CONF"
(
  per.view hwioreg.per "DMH00,MDM_HI0_CH11_CONF"
)
if "&choice"=="MDM_HI0_CH12_CONF"
(
  per.view hwioreg.per "DMH00,MDM_HI0_CH12_CONF"
)
if "&choice"=="MDM_HI0_CH13_CONF"
(
  per.view hwioreg.per "DMH00,MDM_HI0_CH13_CONF"
)
if "&choice"=="MDM_HI0_CH14_CONF"
(
  per.view hwioreg.per "DMH00,MDM_HI0_CH14_CONF"
)
if "&choice"=="MDM_HI0_CH15_CONF"
(
  per.view hwioreg.per "DMH00,MDM_HI0_CH15_CONF"
)
if "&choice"=="MDM_HI0_CH0_DBG_0"
(
  per.view hwioreg.per "DMH00,MDM_HI0_CH0_DBG_0"
)
if "&choice"=="MDM_HI0_CH1_DBG_0"
(
  per.view hwioreg.per "DMH00,MDM_HI0_CH1_DBG_0"
)
if "&choice"=="MDM_HI0_CH2_DBG_0"
(
  per.view hwioreg.per "DMH00,MDM_HI0_CH2_DBG_0"
)
if "&choice"=="MDM_HI0_CH3_DBG_0"
(
  per.view hwioreg.per "DMH00,MDM_HI0_CH3_DBG_0"
)
if "&choice"=="MDM_HI0_CH4_DBG_0"
(
  per.view hwioreg.per "DMH00,MDM_HI0_CH4_DBG_0"
)
if "&choice"=="MDM_HI0_CH5_DBG_0"
(
  per.view hwioreg.per "DMH00,MDM_HI0_CH5_DBG_0"
)
if "&choice"=="MDM_HI0_CH6_DBG_0"
(
  per.view hwioreg.per "DMH00,MDM_HI0_CH6_DBG_0"
)
if "&choice"=="MDM_HI0_CH7_DBG_0"
(
  per.view hwioreg.per "DMH00,MDM_HI0_CH7_DBG_0"
)
if "&choice"=="MDM_HI0_CH8_DBG_0"
(
  per.view hwioreg.per "DMH00,MDM_HI0_CH8_DBG_0"
)
if "&choice"=="MDM_HI0_CH9_DBG_0"
(
  per.view hwioreg.per "DMH00,MDM_HI0_CH9_DBG_0"
)
if "&choice"=="MDM_HI0_CH10_DBG_0"
(
  per.view hwioreg.per "DMH00,MDM_HI0_CH10_DBG_0"
)
if "&choice"=="MDM_HI0_CH11_DBG_0"
(
  per.view hwioreg.per "DMH00,MDM_HI0_CH11_DBG_0"
)
if "&choice"=="MDM_HI0_CH12_DBG_0"
(
  per.view hwioreg.per "DMH00,MDM_HI0_CH12_DBG_0"
)
if "&choice"=="MDM_HI0_CH13_DBG_0"
(
  per.view hwioreg.per "DMH00,MDM_HI0_CH13_DBG_0"
)
if "&choice"=="MDM_HI0_CH14_DBG_0"
(
  per.view hwioreg.per "DMH00,MDM_HI0_CH14_DBG_0"
)
if "&choice"=="MDM_HI0_CH15_DBG_0"
(
  per.view hwioreg.per "DMH00,MDM_HI0_CH15_DBG_0"
)
if "&choice"=="MDM_HI0_CH0_DBG_1"
(
  per.view hwioreg.per "DMH00,MDM_HI0_CH0_DBG_1"
)
if "&choice"=="MDM_HI0_CH1_DBG_1"
(
  per.view hwioreg.per "DMH00,MDM_HI0_CH1_DBG_1"
)
if "&choice"=="MDM_HI0_CH2_DBG_1"
(
  per.view hwioreg.per "DMH00,MDM_HI0_CH2_DBG_1"
)
if "&choice"=="MDM_HI0_CH3_DBG_1"
(
  per.view hwioreg.per "DMH00,MDM_HI0_CH3_DBG_1"
)
if "&choice"=="MDM_HI0_CH4_DBG_1"
(
  per.view hwioreg.per "DMH00,MDM_HI0_CH4_DBG_1"
)
if "&choice"=="MDM_HI0_CH5_DBG_1"
(
  per.view hwioreg.per "DMH00,MDM_HI0_CH5_DBG_1"
)
if "&choice"=="MDM_HI0_CH6_DBG_1"
(
  per.view hwioreg.per "DMH00,MDM_HI0_CH6_DBG_1"
)
if "&choice"=="MDM_HI0_CH7_DBG_1"
(
  per.view hwioreg.per "DMH00,MDM_HI0_CH7_DBG_1"
)
if "&choice"=="MDM_HI0_CH8_DBG_1"
(
  per.view hwioreg.per "DMH00,MDM_HI0_CH8_DBG_1"
)
if "&choice"=="MDM_HI0_CH9_DBG_1"
(
  per.view hwioreg.per "DMH00,MDM_HI0_CH9_DBG_1"
)
if "&choice"=="MDM_HI0_CH10_DBG_1"
(
  per.view hwioreg.per "DMH00,MDM_HI0_CH10_DBG_1"
)
if "&choice"=="MDM_HI0_CH11_DBG_1"
(
  per.view hwioreg.per "DMH00,MDM_HI0_CH11_DBG_1"
)
if "&choice"=="MDM_HI0_CH12_DBG_1"
(
  per.view hwioreg.per "DMH00,MDM_HI0_CH12_DBG_1"
)
if "&choice"=="MDM_HI0_CH13_DBG_1"
(
  per.view hwioreg.per "DMH00,MDM_HI0_CH13_DBG_1"
)
if "&choice"=="MDM_HI0_CH14_DBG_1"
(
  per.view hwioreg.per "DMH00,MDM_HI0_CH14_DBG_1"
)
if "&choice"=="MDM_HI0_CH15_DBG_1"
(
  per.view hwioreg.per "DMH00,MDM_HI0_CH15_DBG_1"
)
if "&choice"=="MDM_HI0_CI0_CONF"
(
  per.view hwioreg.per "DMH00,MDM_HI0_CI0_CONF"
)
if "&choice"=="MDM_HI0_CI1_CONF"
(
  per.view hwioreg.per "DMH00,MDM_HI0_CI1_CONF"
)
if "&choice"=="MDM_HI0_CI2_CONF"
(
  per.view hwioreg.per "DMH00,MDM_HI0_CI2_CONF"
)
if "&choice"=="MDM_HI0_CI3_CONF"
(
  per.view hwioreg.per "DMH00,MDM_HI0_CI3_CONF"
)
if "&choice"=="MDM_HI0_CI4_CONF"
(
  per.view hwioreg.per "DMH00,MDM_HI0_CI4_CONF"
)
if "&choice"=="MDM_HI0_CI5_CONF"
(
  per.view hwioreg.per "DMH00,MDM_HI0_CI5_CONF"
)
if "&choice"=="MDM_HI0_CI6_CONF"
(
  per.view hwioreg.per "DMH00,MDM_HI0_CI6_CONF"
)
if "&choice"=="MDM_HI0_CI7_CONF"
(
  per.view hwioreg.per "DMH00,MDM_HI0_CI7_CONF"
)
if "&choice"=="MDM_HI0_CI0_DBG_ERR"
(
  per.view hwioreg.per "DMH00,MDM_HI0_CI0_DBG_ERR"
)
if "&choice"=="MDM_HI0_CI1_DBG_ERR"
(
  per.view hwioreg.per "DMH00,MDM_HI0_CI1_DBG_ERR"
)
if "&choice"=="MDM_HI0_CI2_DBG_ERR"
(
  per.view hwioreg.per "DMH00,MDM_HI0_CI2_DBG_ERR"
)
if "&choice"=="MDM_HI0_CI3_DBG_ERR"
(
  per.view hwioreg.per "DMH00,MDM_HI0_CI3_DBG_ERR"
)
if "&choice"=="MDM_HI0_CI4_DBG_ERR"
(
  per.view hwioreg.per "DMH00,MDM_HI0_CI4_DBG_ERR"
)
if "&choice"=="MDM_HI0_CI5_DBG_ERR"
(
  per.view hwioreg.per "DMH00,MDM_HI0_CI5_DBG_ERR"
)
if "&choice"=="MDM_HI0_CI6_DBG_ERR"
(
  per.view hwioreg.per "DMH00,MDM_HI0_CI6_DBG_ERR"
)
if "&choice"=="MDM_HI0_CI7_DBG_ERR"
(
  per.view hwioreg.per "DMH00,MDM_HI0_CI7_DBG_ERR"
)
if "&choice"=="MDM_HI0_CRCI_DBG"
(
  per.view hwioreg.per "DMH00,MDM_HI0_CRCI_DBG"
)
if "&choice"=="MDM_HI0_CRCI_STATUS"
(
  per.view hwioreg.per "DMH00,MDM_HI0_CRCI_STATUS"
)
if "&choice"=="MDM_HI0_GP_CTL"
(
  per.view hwioreg.per "DMH00,MDM_HI0_GP_CTL"
)
if "&choice"=="MDM_HI0_GP_STATUS"
(
  per.view hwioreg.per "DMH00,MDM_HI0_GP_STATUS"
)
if "&choice"=="MDM_HI0_GLBL_DBG_CMD_ENG"
(
  per.view hwioreg.per "DMH00,MDM_HI0_GLBL_DBG_CMD_ENG"
)
if "&choice"=="MDM_HI0_GLBL_DBG_REQ_ENG"
(
  per.view hwioreg.per "DMH00,MDM_HI0_GLBL_DBG_REQ_ENG"
)
if "&choice"=="MDM_HI0_GLBL_DBG_XFR_ENG"
(
  per.view hwioreg.per "DMH00,MDM_HI0_GLBL_DBG_XFR_ENG"
)
if "&choice"=="MDM_HI0_GLBL_DBG_CHAN_BLK"
(
  per.view hwioreg.per "DMH00,MDM_HI0_GLBL_DBG_CHAN_BLK"
)
if "&choice"=="MDM_HI0_GLBL_DBG_CHAN_BLK_CLR"
(
  per.view hwioreg.per "DMH00,MDM_HI0_GLBL_DBG_CHAN_BLK_CLR"
)
if "&choice"=="MDM_HI0_GLBL_DBG_TEST_SEL"
(
  per.view hwioreg.per "DMH00,MDM_HI0_GLBL_DBG_TEST_SEL"
)
if "&choice"=="EBI1_CFG"
(
  per.view hwioreg.per "EBI,EBI1_REGS,EBI1_CFG"
)
if "&choice"=="EBI1_CS0_CFG0"
(
  per.view hwioreg.per "EBI,EBI1_REGS,EBI1_CS0_CFG0"
)
if "&choice"=="EBI1_CS1_CFG0"
(
  per.view hwioreg.per "EBI,EBI1_REGS,EBI1_CS1_CFG0"
)
if "&choice"=="EBI1_CS2_CFG0"
(
  per.view hwioreg.per "EBI,EBI1_REGS,EBI1_CS2_CFG0"
)
if "&choice"=="EBI1_CS3_CFG0"
(
  per.view hwioreg.per "EBI,EBI1_REGS,EBI1_CS3_CFG0"
)
if "&choice"=="EBI1_CS0_CFG1"
(
  per.view hwioreg.per "EBI,EBI1_REGS,EBI1_CS0_CFG1"
)
if "&choice"=="EBI1_CS1_CFG1"
(
  per.view hwioreg.per "EBI,EBI1_REGS,EBI1_CS1_CFG1"
)
if "&choice"=="EBI1_CS2_CFG1"
(
  per.view hwioreg.per "EBI,EBI1_REGS,EBI1_CS2_CFG1"
)
if "&choice"=="EBI1_CS3_CFG1"
(
  per.view hwioreg.per "EBI,EBI1_REGS,EBI1_CS3_CFG1"
)
if "&choice"=="EBI1_AHB_RD_PRIORITY"
(
  per.view hwioreg.per "EBI,EBI1_REGS,EBI1_AHB_RD_PRIORITY"
)
if "&choice"=="EBI1_AHB_WR_PRIORITY"
(
  per.view hwioreg.per "EBI,EBI1_REGS,EBI1_AHB_WR_PRIORITY"
)
if "&choice"=="EBI1_BUFC_CFG"
(
  per.view hwioreg.per "EBI,EBI1_REGS,EBI1_BUFC_CFG"
)
if "&choice"=="EBI1_BUFC_STATUS"
(
  per.view hwioreg.per "EBI,EBI1_REGS,EBI1_BUFC_STATUS"
)
if "&choice"=="EBI1_BUFC_PROF_COUNT_CFG"
(
  per.view hwioreg.per "EBI,EBI1_REGS,EBI1_BUFC_PROF_COUNT_CFG"
)
if "&choice"=="EBI1_PSRAM_REFRESH_CFG"
(
  per.view hwioreg.per "EBI,EBI1_REGS,EBI1_PSRAM_REFRESH_CFG"
)
if "&choice"=="EBI1_BUFC_PROF_COUNT0"
(
  per.view hwioreg.per "EBI,EBI1_REGS,EBI1_BUFC_PROF_COUNT0"
)
if "&choice"=="EBI1_BUFC_PROF_COUNT1"
(
  per.view hwioreg.per "EBI,EBI1_REGS,EBI1_BUFC_PROF_COUNT1"
)
if "&choice"=="EBI1_BUFC_PROF_COUNT2"
(
  per.view hwioreg.per "EBI,EBI1_REGS,EBI1_BUFC_PROF_COUNT2"
)
if "&choice"=="EBI1_DEBUG_BUS_CFG0"
(
  per.view hwioreg.per "EBI,EBI1_REGS,EBI1_DEBUG_BUS_CFG0"
)
if "&choice"=="EBI1_DEBUG_BUS_CFG1"
(
  per.view hwioreg.per "EBI,EBI1_REGS,EBI1_DEBUG_BUS_CFG1"
)
if "&choice"=="EBI1_DEBUG_WORD0_BUFC"
(
  per.view hwioreg.per "EBI,EBI1_REGS,EBI1_DEBUG_WORD0_BUFC"
)
if "&choice"=="EBI1_DEBUG_WORD1_BUFC"
(
  per.view hwioreg.per "EBI,EBI1_REGS,EBI1_DEBUG_WORD1_BUFC"
)
if "&choice"=="EBI1_DEBUG_WORD2_BUFC"
(
  per.view hwioreg.per "EBI,EBI1_REGS,EBI1_DEBUG_WORD2_BUFC"
)
if "&choice"=="EBI1_DEBUG_WORD3_BUFC"
(
  per.view hwioreg.per "EBI,EBI1_REGS,EBI1_DEBUG_WORD3_BUFC"
)
if "&choice"=="EBI1_DEBUG_WORD4_BUFC"
(
  per.view hwioreg.per "EBI,EBI1_REGS,EBI1_DEBUG_WORD4_BUFC"
)
if "&choice"=="EBI1_DEBUG_WORD5_BUFC"
(
  per.view hwioreg.per "EBI,EBI1_REGS,EBI1_DEBUG_WORD5_BUFC"
)
if "&choice"=="EBI1_DEBUG_WORD6_BUFC"
(
  per.view hwioreg.per "EBI,EBI1_REGS,EBI1_DEBUG_WORD6_BUFC"
)
if "&choice"=="EBI1_DEBUG_WORD7_BUFC"
(
  per.view hwioreg.per "EBI,EBI1_REGS,EBI1_DEBUG_WORD7_BUFC"
)
if "&choice"=="EBI1_DEBUG_WORD_EN0_BUFC"
(
  per.view hwioreg.per "EBI,EBI1_REGS,EBI1_DEBUG_WORD_EN0_BUFC"
)
if "&choice"=="EBI1_DEBUG_WORD_EN1_BUFC"
(
  per.view hwioreg.per "EBI,EBI1_REGS,EBI1_DEBUG_WORD_EN1_BUFC"
)
if "&choice"=="EBI1_DEBUG_WORD_EN2_BUFC"
(
  per.view hwioreg.per "EBI,EBI1_REGS,EBI1_DEBUG_WORD_EN2_BUFC"
)
if "&choice"=="EBI1_DEBUG_WORD_EN3_BUFC"
(
  per.view hwioreg.per "EBI,EBI1_REGS,EBI1_DEBUG_WORD_EN3_BUFC"
)
if "&choice"=="EBI1_DEBUG_WORD_EN4_BUFC"
(
  per.view hwioreg.per "EBI,EBI1_REGS,EBI1_DEBUG_WORD_EN4_BUFC"
)
if "&choice"=="EBI1_DEBUG_WORD_EN5_BUFC"
(
  per.view hwioreg.per "EBI,EBI1_REGS,EBI1_DEBUG_WORD_EN5_BUFC"
)
if "&choice"=="EBI1_DEBUG_WORD_EN6_BUFC"
(
  per.view hwioreg.per "EBI,EBI1_REGS,EBI1_DEBUG_WORD_EN6_BUFC"
)
if "&choice"=="EBI1_DEBUG_WORD_EN7_BUFC"
(
  per.view hwioreg.per "EBI,EBI1_REGS,EBI1_DEBUG_WORD_EN7_BUFC"
)
if "&choice"=="EBI1_DEBUG_BUFC_CFG"
(
  per.view hwioreg.per "EBI,EBI1_REGS,EBI1_DEBUG_BUFC_CFG"
)
if "&choice"=="EBI1_DEBUG_BUFC_TAG_RD0"
(
  per.view hwioreg.per "EBI,EBI1_REGS,EBI1_DEBUG_BUFC_TAG_RD0"
)
if "&choice"=="EBI1_DEBUG_BUFC_TAG_RD1"
(
  per.view hwioreg.per "EBI,EBI1_REGS,EBI1_DEBUG_BUFC_TAG_RD1"
)
if "&choice"=="EBI1_BUFC_PROFILING_CFG"
(
  per.view hwioreg.per "EBI,EBI1_REGS,EBI1_BUFC_PROFILING_CFG"
)
if "&choice"=="EBI1_CS0_CFG2"
(
  per.view hwioreg.per "EBI,EBI1_REGS,EBI1_CS0_CFG2"
)
if "&choice"=="EBI1_CS1_CFG2"
(
  per.view hwioreg.per "EBI,EBI1_REGS,EBI1_CS1_CFG2"
)
if "&choice"=="EBI1_CS2_CFG2"
(
  per.view hwioreg.per "EBI,EBI1_REGS,EBI1_CS2_CFG2"
)
if "&choice"=="EBI1_CS3_CFG2"
(
  per.view hwioreg.per "EBI,EBI1_REGS,EBI1_CS3_CFG2"
)
if "&choice"=="EBI1_LCD_CFG"
(
  per.view hwioreg.per "EBI,EBI1_REGS,EBI1_LCD_CFG"
)
if "&choice"=="EBI1_2X_XLTR_CFG"
(
  per.view hwioreg.per "EBI,EBI1_REGS,EBI1_2X_XLTR_CFG"
)
if "&choice"=="EBI2_CFG"
(
  per.view hwioreg.per "EBI,EBI2_REGS,EBI2_CFG"
)
if "&choice"=="LCD_CFG0"
(
  per.view hwioreg.per "EBI,EBI2_REGS,LCD_CFG0"
)
if "&choice"=="LCD_CFG1"
(
  per.view hwioreg.per "EBI,EBI2_REGS,LCD_CFG1"
)
if "&choice"=="EBI2_CS0_CFG0"
(
  per.view hwioreg.per "EBI,EBI2_REGS,EBI2_CS0_CFG0"
)
if "&choice"=="EBI2_CS1_CFG0"
(
  per.view hwioreg.per "EBI,EBI2_REGS,EBI2_CS1_CFG0"
)
if "&choice"=="EBI2_CS2_CFG0"
(
  per.view hwioreg.per "EBI,EBI2_REGS,EBI2_CS2_CFG0"
)
if "&choice"=="EBI2_CS3_CFG0"
(
  per.view hwioreg.per "EBI,EBI2_REGS,EBI2_CS3_CFG0"
)
if "&choice"=="EBI2_CS0_CFG1"
(
  per.view hwioreg.per "EBI,EBI2_REGS,EBI2_CS0_CFG1"
)
if "&choice"=="EBI2_CS1_CFG1"
(
  per.view hwioreg.per "EBI,EBI2_REGS,EBI2_CS1_CFG1"
)
if "&choice"=="EBI2_CS2_CFG1"
(
  per.view hwioreg.per "EBI,EBI2_REGS,EBI2_CS2_CFG1"
)
if "&choice"=="EBI2_CS3_CFG1"
(
  per.view hwioreg.per "EBI,EBI2_REGS,EBI2_CS3_CFG1"
)
if "&choice"=="EBI2_CS0_CFG2"
(
  per.view hwioreg.per "EBI,EBI2_REGS,EBI2_CS0_CFG2"
)
if "&choice"=="EBI2_CS1_CFG2"
(
  per.view hwioreg.per "EBI,EBI2_REGS,EBI2_CS1_CFG2"
)
if "&choice"=="EBI2_CS2_CFG2"
(
  per.view hwioreg.per "EBI,EBI2_REGS,EBI2_CS2_CFG2"
)
if "&choice"=="EBI2_CS3_CFG2"
(
  per.view hwioreg.per "EBI,EBI2_REGS,EBI2_CS3_CFG2"
)
if "&choice"=="ETM_GPIO2_CFG0"
(
  per.view hwioreg.per "EBI,EBI2_REGS,ETM_GPIO2_CFG0"
)
if "&choice"=="ETM_GPIO2_CFG1"
(
  per.view hwioreg.per "EBI,EBI2_REGS,ETM_GPIO2_CFG1"
)
if "&choice"=="EBI2_DEBUG_BUS_CFG"
(
  per.view hwioreg.per "EBI,EBI2_REGS,EBI2_DEBUG_BUS_CFG"
)
if "&choice"=="EBI2_PROFILING_CFG"
(
  per.view hwioreg.per "EBI,EBI2_REGS,EBI2_PROFILING_CFG"
)
if "&choice"=="EBI2_SWBM_AHB_PRIORITY"
(
  per.view hwioreg.per "EBI,EBI2_REGS,EBI2_SWBM_AHB_PRIORITY"
)
if "&choice"=="EBI2_SWBM_STATUS"
(
  per.view hwioreg.per "EBI,EBI2_REGS,EBI2_SWBM_STATUS"
)
if "&choice"=="EBI2_SWBM_DEBUG_BUS_CFG"
(
  per.view hwioreg.per "EBI,EBI2_REGS,EBI2_SWBM_DEBUG_BUS_CFG"
)
if "&choice"=="EBI2_CBC_AHB_RD_PRIORITY"
(
  per.view hwioreg.per "EBI,EBI2_REGS,EBI2_CBC_AHB_RD_PRIORITY"
)
if "&choice"=="EBI2_CBC_AHB_WR_PRIORITY"
(
  per.view hwioreg.per "EBI,EBI2_REGS,EBI2_CBC_AHB_WR_PRIORITY"
)
if "&choice"=="EBI2_CBC_BUFC_CFG"
(
  per.view hwioreg.per "EBI,EBI2_REGS,EBI2_CBC_BUFC_CFG"
)
if "&choice"=="EBI2_CBC_BUFC_STATUS"
(
  per.view hwioreg.per "EBI,EBI2_REGS,EBI2_CBC_BUFC_STATUS"
)
if "&choice"=="EBI2_CBC_PRF_CNT_CFG"
(
  per.view hwioreg.per "EBI,EBI2_REGS,EBI2_CBC_PRF_CNT_CFG"
)
if "&choice"=="EBI2_CBC_PRF_CNT0"
(
  per.view hwioreg.per "EBI,EBI2_REGS,EBI2_CBC_PRF_CNT0"
)
if "&choice"=="EBI2_CBC_PRF_CNT1"
(
  per.view hwioreg.per "EBI,EBI2_REGS,EBI2_CBC_PRF_CNT1"
)
if "&choice"=="EBI2_CBC_PRF_CNT2"
(
  per.view hwioreg.per "EBI,EBI2_REGS,EBI2_CBC_PRF_CNT2"
)
if "&choice"=="EBI2_CBC_DEBUG_BUS_CFG0"
(
  per.view hwioreg.per "EBI,EBI2_REGS,EBI2_CBC_DEBUG_BUS_CFG0"
)
if "&choice"=="EBI2_CBC_DEBUG_WORD0"
(
  per.view hwioreg.per "EBI,EBI2_REGS,EBI2_CBC_DEBUG_WORD0"
)
if "&choice"=="EBI2_CBC_DEBUG_WORD1"
(
  per.view hwioreg.per "EBI,EBI2_REGS,EBI2_CBC_DEBUG_WORD1"
)
if "&choice"=="EBI2_CBC_DEBUG_WORD2"
(
  per.view hwioreg.per "EBI,EBI2_REGS,EBI2_CBC_DEBUG_WORD2"
)
if "&choice"=="EBI2_CBC_DEBUG_WORD3"
(
  per.view hwioreg.per "EBI,EBI2_REGS,EBI2_CBC_DEBUG_WORD3"
)
if "&choice"=="EBI2_CBC_DEBUG_WORD4"
(
  per.view hwioreg.per "EBI,EBI2_REGS,EBI2_CBC_DEBUG_WORD4"
)
if "&choice"=="EBI2_CBC_DEBUG_WORD5"
(
  per.view hwioreg.per "EBI,EBI2_REGS,EBI2_CBC_DEBUG_WORD5"
)
if "&choice"=="EBI2_CBC_DEBUG_WORD6"
(
  per.view hwioreg.per "EBI,EBI2_REGS,EBI2_CBC_DEBUG_WORD6"
)
if "&choice"=="EBI2_CBC_DEBUG_WORD7"
(
  per.view hwioreg.per "EBI,EBI2_REGS,EBI2_CBC_DEBUG_WORD7"
)
if "&choice"=="EBI2_CBC_DEBUG_WORD_EN0"
(
  per.view hwioreg.per "EBI,EBI2_REGS,EBI2_CBC_DEBUG_WORD_EN0"
)
if "&choice"=="EBI2_CBC_DEBUG_WORD_EN1"
(
  per.view hwioreg.per "EBI,EBI2_REGS,EBI2_CBC_DEBUG_WORD_EN1"
)
if "&choice"=="EBI2_CBC_DEBUG_WORD_EN2"
(
  per.view hwioreg.per "EBI,EBI2_REGS,EBI2_CBC_DEBUG_WORD_EN2"
)
if "&choice"=="EBI2_CBC_DEBUG_WORD_EN3"
(
  per.view hwioreg.per "EBI,EBI2_REGS,EBI2_CBC_DEBUG_WORD_EN3"
)
if "&choice"=="EBI2_CBC_DEBUG_WORD_EN4"
(
  per.view hwioreg.per "EBI,EBI2_REGS,EBI2_CBC_DEBUG_WORD_EN4"
)
if "&choice"=="EBI2_CBC_DEBUG_WORD_EN5"
(
  per.view hwioreg.per "EBI,EBI2_REGS,EBI2_CBC_DEBUG_WORD_EN5"
)
if "&choice"=="EBI2_CBC_DEBUG_WORD_EN6"
(
  per.view hwioreg.per "EBI,EBI2_REGS,EBI2_CBC_DEBUG_WORD_EN6"
)
if "&choice"=="EBI2_CBC_DEBUG_WORD_EN7"
(
  per.view hwioreg.per "EBI,EBI2_REGS,EBI2_CBC_DEBUG_WORD_EN7"
)
if "&choice"=="EBI2_CBC_DEBUG_CFG"
(
  per.view hwioreg.per "EBI,EBI2_REGS,EBI2_CBC_DEBUG_CFG"
)
if "&choice"=="EBI2_CBC_DEBUG_TAG_RD0"
(
  per.view hwioreg.per "EBI,EBI2_REGS,EBI2_CBC_DEBUG_TAG_RD0"
)
if "&choice"=="EBI2_CBC_DEBUG_TAG_RD1"
(
  per.view hwioreg.per "EBI,EBI2_REGS,EBI2_CBC_DEBUG_TAG_RD1"
)
if "&choice"=="EBI2_CBC_PRF_CFG"
(
  per.view hwioreg.per "EBI,EBI2_REGS,EBI2_CBC_PRF_CFG"
)
if "&choice"=="EF_CHAIN_SEL"
(
  per.view hwioreg.per "EFUSE,EFUSE,EF_CHAIN_SEL"
)
if "&choice"=="EF_BLOW_TIMER"
(
  per.view hwioreg.per "EFUSE,EFUSE,EF_BLOW_TIMER"
)
if "&choice"=="EF_BLOW_VALUE"
(
  per.view hwioreg.per "EFUSE,EFUSE,EF_BLOW_VALUE"
)
if "&choice"=="EF_SHIFT_VALUE"
(
  per.view hwioreg.per "EFUSE,EFUSE,EF_SHIFT_VALUE"
)
if "&choice"=="EF_STATUS"
(
  per.view hwioreg.per "EFUSE,EFUSE,EF_STATUS"
)
if "&choice"=="EF_PWR_CTL"
(
  per.view hwioreg.per "EFUSE,EFUSE,EF_PWR_CTL"
)
if "&choice"=="EF_CONFIG_LSB"
(
  per.view hwioreg.per "EFUSE,EFUSE,EF_CONFIG_LSB"
)
if "&choice"=="EF_CONFIG_MSB"
(
  per.view hwioreg.per "EFUSE,EFUSE,EF_CONFIG_MSB"
)
if "&choice"=="ENABLE_ARM9_JTAG"
(
  per.view hwioreg.per "EFUSE,EFUSE,ENABLE_ARM9_JTAG"
)
if "&choice"=="RF_CAL_PART1"
(
  per.view hwioreg.per "EFUSE,EFUSE2,RF_CAL_PART1"
)
if "&choice"=="RF_CAL_PART2"
(
  per.view hwioreg.per "EFUSE,EFUSE2,RF_CAL_PART2"
)
if "&choice"=="RF_CAL_PART3"
(
  per.view hwioreg.per "EFUSE,EFUSE2,RF_CAL_PART3"
)
if "&choice"=="EMU_ANT_RAM_ADDR_VAL"
(
  per.view hwioreg.per "EMU,EMU_ANTRAM,EMU_ANT_RAM_ADDR_VAL"
)
if "&choice"=="EMU_ANT_RAM_DATA"
(
  per.view hwioreg.per "EMU,EMU_ANTRAM,EMU_ANT_RAM_DATA"
)
if "&choice"=="EMU_ANT_RAM_RTCMATCH"
(
  per.view hwioreg.per "EMU,EMU_ANTRAM,EMU_ANT_RAM_RTCMATCH"
)
if "&choice"=="EMU_ANT_RAM_CTL"
(
  per.view hwioreg.per "EMU,EMU_ANTRAM,EMU_ANT_RAM_CTL"
)
if "&choice"=="EMU_ANT_RAM_DEBUG_CTL"
(
  per.view hwioreg.per "EMU,EMU_ANTRAM,EMU_ANT_RAM_DEBUG_CTL"
)
if "&choice"=="EMU_ANT_RAM_GPO"
(
  per.view hwioreg.per "EMU,EMU_ANTRAM,EMU_ANT_RAM_GPO"
)
if "&choice"=="EMU_ANT_RAM_DEBUG2_CTL"
(
  per.view hwioreg.per "EMU,EMU_ANTRAM,EMU_ANT_RAM_DEBUG2_CTL"
)
if "&choice"=="EMU_RXFPGA_MODE_SEL"
(
  per.view hwioreg.per "EMU,EMU_ANTRAM,EMU_RXFPGA_MODE_SEL"
)
if "&choice"=="EMU_QDSP_CTL_ADDR"
(
  per.view hwioreg.per "EMU,EMU_ANTRAM,EMU_QDSP_CTL_ADDR"
)
if "&choice"=="EMU_QDSP_PC_DEBIG"
(
  per.view hwioreg.per "EMU,EMU_ANTRAM,EMU_QDSP_PC_DEBIG"
)
if "&choice"=="EMU_USB_CTL"
(
  per.view hwioreg.per "EMU,EMU_ANTRAM,EMU_USB_CTL"
)
if "&choice"=="EMU_USB_DET"
(
  per.view hwioreg.per "EMU,EMU_ANTRAM,EMU_USB_DET"
)
if "&choice"=="EMU_RX_FPGA_VERSION_RD"
(
  per.view hwioreg.per "EMU,EMU_RXFPGA,EMU_RX_FPGA_VERSION_RD"
)
if "&choice"=="EMU_TDEC_FPGA_VERSION_RD"
(
  per.view hwioreg.per "EMU,EMU_TDECFPGA,EMU_TDEC_FPGA_VERSION_RD"
)
if "&choice"=="EMU_TDEC_DBG_BUS_RD"
(
  per.view hwioreg.per "EMU,EMU_TDECFPGA,EMU_TDEC_DBG_BUS_RD"
)
if "&choice"=="EMU_TDEC_DSP_PC_RD"
(
  per.view hwioreg.per "EMU,EMU_TDECFPGA,EMU_TDEC_DSP_PC_RD"
)
if "&choice"=="EMU_TDEC_DSP_XMEMC_SIG_RD"
(
  per.view hwioreg.per "EMU,EMU_TDECFPGA,EMU_TDEC_DSP_XMEMC_SIG_RD"
)
if "&choice"=="EMU_TX_FPGA_VERSION_RD"
(
  per.view hwioreg.per "EMU,EMU_TXFPGA,EMU_TX_FPGA_VERSION_RD"
)
if "&choice"=="EMU_TX_SYSTEM_MODE"
(
  per.view hwioreg.per "EMU,EMU_TXFPGA,EMU_TX_SYSTEM_MODE"
)
if "&choice"=="EMU_TX_GPIO_WR"
(
  per.view hwioreg.per "EMU,EMU_TXFPGA,EMU_TX_GPIO_WR"
)
if "&choice"=="EMU_TX_GPIO_STATUS_RD"
(
  per.view hwioreg.per "EMU,EMU_TXFPGA,EMU_TX_GPIO_STATUS_RD"
)
if "&choice"=="EMU_TX_GPIO_OE"
(
  per.view hwioreg.per "EMU,EMU_TXFPGA,EMU_TX_GPIO_OE"
)
if "&choice"=="EMU_PA_ON_CTL"
(
  per.view hwioreg.per "EMU,EMU_TXFPGA,EMU_PA_ON_CTL"
)
if "&choice"=="EMU_PA_ON_STATUS_RD"
(
  per.view hwioreg.per "EMU,EMU_TXFPGA,EMU_PA_ON_STATUS_RD"
)
if "&choice"=="FL_SYM_BUFF_MODE"
(
  per.view hwioreg.per "FL_SYM_BUFF,FL_SYM_BUFF_MODE"
)
if "&choice"=="FL_SYM_BUFF_CLK_CTL"
(
  per.view hwioreg.per "FL_SYM_BUFF,FL_SYM_BUFF_CLK_CTL"
)
if "&choice"=="FL_SYM_BUFF_CLK_OVERRIDE"
(
  per.view hwioreg.per "FL_SYM_BUFF,FL_SYM_BUFF_CLK_OVERRIDE"
)
if "&choice"=="FL_SYM_BUFF_CLK_STATUS_RD"
(
  per.view hwioreg.per "FL_SYM_BUFF,FL_SYM_BUFF_CLK_STATUS_RD"
)
if "&choice"=="FL_SYM_BUFF_MEM_RD"
(
  per.view hwioreg.per "FL_SYM_BUFF,FL_SYM_BUFF_MEM_RD"
)
if "&choice"=="GACC_DM_BYPASS"
(
  per.view hwioreg.per "GACC,GACC_DM_BYPASS"
)
if "&choice"=="GACC_CLK_CTL"
(
  per.view hwioreg.per "GACC,GACC_CLK_CTL"
)
if "&choice"=="GACC_TEST_BUS_OUT"
(
  per.view hwioreg.per "GACC,GACC_TEST_BUS_OUT"
)
if "&choice"=="GACC_RTC_WAIT_ALT"
(
  per.view hwioreg.per "GACC,GACC_RTC_WAIT_ALT"
)
if "&choice"=="GACC_START_ADDR_ALT"
(
  per.view hwioreg.per "GACC,GACC_START_ADDR_ALT"
)
if "&choice"=="GACC_COUNT_ALT"
(
  per.view hwioreg.per "GACC,GACC_COUNT_ALT"
)
if "&choice"=="GACC_INCR_ALT"
(
  per.view hwioreg.per "GACC,GACC_INCR_ALT"
)
if "&choice"=="GACC_FREQ_ALT"
(
  per.view hwioreg.per "GACC,GACC_FREQ_ALT"
)
if "&choice"=="GACC_CONFIG_ALT"
(
  per.view hwioreg.per "GACC,GACC_CONFIG_ALT"
)
if "&choice"=="GACC_PEAK_ALT"
(
  per.view hwioreg.per "GACC,GACC_PEAK_ALT"
)
if "&choice"=="GACC_DONE_ALT"
(
  per.view hwioreg.per "GACC,GACC_DONE_ALT"
)
if "&choice"=="GACC_RTC_ALT"
(
  per.view hwioreg.per "GACC,GACC_RTC_ALT"
)
if "&choice"=="GACC_SAMPLE_MEM_START_ADDR_ALT"
(
  per.view hwioreg.per "GACC,GACC_SAMPLE_MEM_START_ADDR_ALT"
)
if "&choice"=="GACC_SAMPLE_MEM_END_ADDR_ALT"
(
  per.view hwioreg.per "GACC,GACC_SAMPLE_MEM_END_ADDR_ALT"
)
if "&choice"=="GACC_ENERGY_MEM_START_ADDR_ALT"
(
  per.view hwioreg.per "GACC,GACC_ENERGY_MEM_START_ADDR_ALT"
)
if "&choice"=="GACC_ENERGY_MEM_END_ADDR_ALT"
(
  per.view hwioreg.per "GACC,GACC_ENERGY_MEM_END_ADDR_ALT"
)
if "&choice"=="GACC_RTC_WAIT"
(
  per.view hwioreg.per "GACC,GACC_RTC_WAIT"
)
if "&choice"=="GACC_START_ADDR"
(
  per.view hwioreg.per "GACC,GACC_START_ADDR"
)
if "&choice"=="GACC_COUNT"
(
  per.view hwioreg.per "GACC,GACC_COUNT"
)
if "&choice"=="GACC_INCR"
(
  per.view hwioreg.per "GACC,GACC_INCR"
)
if "&choice"=="GACC_FREQ"
(
  per.view hwioreg.per "GACC,GACC_FREQ"
)
if "&choice"=="GACC_CONFIG"
(
  per.view hwioreg.per "GACC,GACC_CONFIG"
)
if "&choice"=="GACC_PEAK"
(
  per.view hwioreg.per "GACC,GACC_PEAK"
)
if "&choice"=="GACC_DONE"
(
  per.view hwioreg.per "GACC,GACC_DONE"
)
if "&choice"=="GACC_RTC"
(
  per.view hwioreg.per "GACC,GACC_RTC"
)
if "&choice"=="GACC_SAMPLE_MEM_START_ADDR"
(
  per.view hwioreg.per "GACC,GACC_SAMPLE_MEM_START_ADDR"
)
if "&choice"=="GACC_SAMPLE_MEM_END_ADDR"
(
  per.view hwioreg.per "GACC,GACC_SAMPLE_MEM_END_ADDR"
)
if "&choice"=="GACC_ENERGY_MEM_START_ADDR"
(
  per.view hwioreg.per "GACC,GACC_ENERGY_MEM_START_ADDR"
)
if "&choice"=="GACC_ENERGY_MEM_END_ADDR"
(
  per.view hwioreg.per "GACC,GACC_ENERGY_MEM_END_ADDR"
)
if "&choice"=="GPIO_OUT_0"
(
  per.view hwioreg.per "GPIO,GPIO,GPIO_OUT_0"
)
if "&choice"=="GPIO_OUT_1"
(
  per.view hwioreg.per "GPIO,GPIO,GPIO_OUT_1"
)
if "&choice"=="GPIO_OE_0"
(
  per.view hwioreg.per "GPIO,GPIO,GPIO_OE_0"
)
if "&choice"=="GPIO_OE_1"
(
  per.view hwioreg.per "GPIO,GPIO,GPIO_OE_1"
)
if "&choice"=="GPIO_PAGE"
(
  per.view hwioreg.per "GPIO,GPIO,GPIO_PAGE"
)
if "&choice"=="GPIO_CFG"
(
  per.view hwioreg.per "GPIO,GPIO,GPIO_CFG"
)
if "&choice"=="GPIO_IN_0"
(
  per.view hwioreg.per "GPIO,GPIO,GPIO_IN_0"
)
if "&choice"=="GPIO_IN_1"
(
  per.view hwioreg.per "GPIO,GPIO,GPIO_IN_1"
)
if "&choice"=="GPIO2_OE_0"
(
  per.view hwioreg.per "GPIO,GPIO2,GPIO2_OE_0"
)
if "&choice"=="GPIO2_OE_1"
(
  per.view hwioreg.per "GPIO,GPIO2,GPIO2_OE_1"
)
if "&choice"=="GPIO2_OUT_0"
(
  per.view hwioreg.per "GPIO,GPIO2,GPIO2_OUT_0"
)
if "&choice"=="GPIO2_OUT_1"
(
  per.view hwioreg.per "GPIO,GPIO2,GPIO2_OUT_1"
)
if "&choice"=="GPIO2_PAGE"
(
  per.view hwioreg.per "GPIO,GPIO2,GPIO2_PAGE"
)
if "&choice"=="GPIO2_CFG"
(
  per.view hwioreg.per "GPIO,GPIO2,GPIO2_CFG"
)
if "&choice"=="GPIO2_IN_0"
(
  per.view hwioreg.per "GPIO,GPIO2,GPIO2_IN_0"
)
if "&choice"=="GPIO2_IN_1"
(
  per.view hwioreg.per "GPIO,GPIO2,GPIO2_IN_1"
)
if "&choice"=="GPS_SRCH_DM_BYPASS"
(
  per.view hwioreg.per "GPS_SRCH,GPS_SRCH_DM_BYPASS"
)
if "&choice"=="GPS_SRCH_RESET"
(
  per.view hwioreg.per "GPS_SRCH,GPS_SRCH_RESET"
)
if "&choice"=="GPS_SRCH_CTL"
(
  per.view hwioreg.per "GPS_SRCH,GPS_SRCH_CTL"
)
if "&choice"=="GPS_SRCH_TESTBUS_OUT"
(
  per.view hwioreg.per "GPS_SRCH,GPS_SRCH_TESTBUS_OUT"
)
if "&choice"=="GPS_SRCH_SS_TESTBUS_OUT"
(
  per.view hwioreg.per "GPS_SRCH,GPS_SRCH_SS_TESTBUS_OUT"
)
if "&choice"=="ALT_GPS_SRCH_CMD"
(
  per.view hwioreg.per "GPS_SRCH,ALT_GPS_SRCH_CMD"
)
if "&choice"=="ALT_GPS_SRCH_OUT"
(
  per.view hwioreg.per "GPS_SRCH,ALT_GPS_SRCH_OUT"
)
if "&choice"=="GPS_SRCH_CMD_START_ADDR"
(
  per.view hwioreg.per "GPS_SRCH,GPS_SRCH_CMD_START_ADDR"
)
if "&choice"=="GPS_SRCH_CMD_END_ADDR"
(
  per.view hwioreg.per "GPS_SRCH,GPS_SRCH_CMD_END_ADDR"
)
if "&choice"=="GPS_SRCH_OUT_START_ADDR"
(
  per.view hwioreg.per "GPS_SRCH,GPS_SRCH_OUT_START_ADDR"
)
if "&choice"=="GPS_SRCH_OUT_END_ADDR"
(
  per.view hwioreg.per "GPS_SRCH,GPS_SRCH_OUT_END_ADDR"
)
if "&choice"=="GPS_SRCH_CMD_ST0"
(
  per.view hwioreg.per "GPS_SRCH,GPS_SRCH_CMD_ST0"
)
if "&choice"=="GPS_SRCH_CMD_DIAG0"
(
  per.view hwioreg.per "GPS_SRCH,GPS_SRCH_CMD_DIAG0"
)
if "&choice"=="GPS_SRCH_CMD_WD0"
(
  per.view hwioreg.per "GPS_SRCH,GPS_SRCH_CMD_WD0"
)
if "&choice"=="GPS_SRCH_CMD_WD1"
(
  per.view hwioreg.per "GPS_SRCH,GPS_SRCH_CMD_WD1"
)
if "&choice"=="GPS_SRCH_CMD_WD2"
(
  per.view hwioreg.per "GPS_SRCH,GPS_SRCH_CMD_WD2"
)
if "&choice"=="GPS_SRCH_CMD_CDMA_WD3"
(
  per.view hwioreg.per "GPS_SRCH,GPS_SRCH_CMD_CDMA_WD3"
)
if "&choice"=="GPS_SRCH_CMD_GPS_WD3"
(
  per.view hwioreg.per "GPS_SRCH,GPS_SRCH_CMD_GPS_WD3"
)
if "&choice"=="GPS_SRCH_CMD_HDR_WD3"
(
  per.view hwioreg.per "GPS_SRCH,GPS_SRCH_CMD_HDR_WD3"
)
if "&choice"=="IBI0_CFG"
(
  per.view hwioreg.per "IBI_REGS,IBI0_CFG"
)
if "&choice"=="IBI1_CFG"
(
  per.view hwioreg.per "IBI_REGS,IBI1_CFG"
)
if "&choice"=="IBI0_AHB_PRIORITY"
(
  per.view hwioreg.per "IBI_REGS,IBI0_AHB_PRIORITY"
)
if "&choice"=="IBI1_AHB_PRIORITY"
(
  per.view hwioreg.per "IBI_REGS,IBI1_AHB_PRIORITY"
)
if "&choice"=="IMEM0_CFG"
(
  per.view hwioreg.per "IBI_REGS,IMEM0_CFG"
)
if "&choice"=="IMEM1_CFG"
(
  per.view hwioreg.per "IBI_REGS,IMEM1_CFG"
)
if "&choice"=="IMEM2_CFG"
(
  per.view hwioreg.per "IBI_REGS,IMEM2_CFG"
)
if "&choice"=="IMEM3_CFG"
(
  per.view hwioreg.per "IBI_REGS,IMEM3_CFG"
)
if "&choice"=="IMEM0_BASE_ADDR"
(
  per.view hwioreg.per "IBI_REGS,IMEM0_BASE_ADDR"
)
if "&choice"=="IMEM1_BASE_ADDR"
(
  per.view hwioreg.per "IBI_REGS,IMEM1_BASE_ADDR"
)
if "&choice"=="IMEM2_BASE_ADDR"
(
  per.view hwioreg.per "IBI_REGS,IMEM2_BASE_ADDR"
)
if "&choice"=="IMEM3_BASE_ADDR"
(
  per.view hwioreg.per "IBI_REGS,IMEM3_BASE_ADDR"
)
if "&choice"=="IMEM_BASE_ADDR_EN"
(
  per.view hwioreg.per "IBI_REGS,IMEM_BASE_ADDR_EN"
)
if "&choice"=="IBI0_DEBUG_BUS_CFG"
(
  per.view hwioreg.per "IBI_REGS,IBI0_DEBUG_BUS_CFG"
)
if "&choice"=="IBI1_DEBUG_BUS_CFG"
(
  per.view hwioreg.per "IBI_REGS,IBI1_DEBUG_BUS_CFG"
)
if "&choice"=="IBI0_PROFILING_CFG"
(
  per.view hwioreg.per "IBI_REGS,IBI0_PROFILING_CFG"
)
if "&choice"=="IBI1_PROFILING_CFG"
(
  per.view hwioreg.per "IBI_REGS,IBI1_PROFILING_CFG"
)
if "&choice"=="INT_POL_SET"
(
  per.view hwioreg.per "INT,INT_CTL,INT_POL_SET"
)
if "&choice"=="IRQ_EN_0"
(
  per.view hwioreg.per "INT,INT_CTL,IRQ_EN_0"
)
if "&choice"=="IRQ_EN_1"
(
  per.view hwioreg.per "INT,INT_CTL,IRQ_EN_1"
)
if "&choice"=="FIQ_EN_0"
(
  per.view hwioreg.per "INT,INT_CTL,FIQ_EN_0"
)
if "&choice"=="FIQ_EN_1"
(
  per.view hwioreg.per "INT,INT_CTL,FIQ_EN_1"
)
if "&choice"=="INT_DET_REG_0"
(
  per.view hwioreg.per "INT,INT_CTL,INT_DET_REG_0"
)
if "&choice"=="INT_DET_REG_1"
(
  per.view hwioreg.per "INT,INT_CTL,INT_DET_REG_1"
)
if "&choice"=="IRQ_STATUS_0"
(
  per.view hwioreg.per "INT,INT_CTL,IRQ_STATUS_0"
)
if "&choice"=="IRQ_STATUS_1"
(
  per.view hwioreg.per "INT,INT_CTL,IRQ_STATUS_1"
)
if "&choice"=="FIQ_STATUS_0"
(
  per.view hwioreg.per "INT,INT_CTL,FIQ_STATUS_0"
)
if "&choice"=="FIQ_STATUS_1"
(
  per.view hwioreg.per "INT,INT_CTL,FIQ_STATUS_1"
)
if "&choice"=="IRQ_VEC_INDEX_RD"
(
  per.view hwioreg.per "INT,INT_CTL,IRQ_VEC_INDEX_RD"
)
if "&choice"=="IRQ_VEC_INDEX_PEND_RD"
(
  per.view hwioreg.per "INT,INT_CTL,IRQ_VEC_INDEX_PEND_RD"
)
if "&choice"=="IRQ_IN_SERVICE_RD"
(
  per.view hwioreg.per "INT,INT_CTL,IRQ_IN_SERVICE_RD"
)
if "&choice"=="IRQ_IN_STACK_RD"
(
  per.view hwioreg.per "INT,INT_CTL,IRQ_IN_STACK_RD"
)
if "&choice"=="INT_0_PRIORITY"
(
  per.view hwioreg.per "INT,INT_CTL,INT_0_PRIORITY"
)
if "&choice"=="INT_1_PRIORITY"
(
  per.view hwioreg.per "INT,INT_CTL,INT_1_PRIORITY"
)
if "&choice"=="INT_2_PRIORITY"
(
  per.view hwioreg.per "INT,INT_CTL,INT_2_PRIORITY"
)
if "&choice"=="INT_3_PRIORITY"
(
  per.view hwioreg.per "INT,INT_CTL,INT_3_PRIORITY"
)
if "&choice"=="INT_4_PRIORITY"
(
  per.view hwioreg.per "INT,INT_CTL,INT_4_PRIORITY"
)
if "&choice"=="INT_5_PRIORITY"
(
  per.view hwioreg.per "INT,INT_CTL,INT_5_PRIORITY"
)
if "&choice"=="INT_6_PRIORITY"
(
  per.view hwioreg.per "INT,INT_CTL,INT_6_PRIORITY"
)
if "&choice"=="INT_7_PRIORITY"
(
  per.view hwioreg.per "INT,INT_CTL,INT_7_PRIORITY"
)
if "&choice"=="INT_8_PRIORITY"
(
  per.view hwioreg.per "INT,INT_CTL,INT_8_PRIORITY"
)
if "&choice"=="INT_9_PRIORITY"
(
  per.view hwioreg.per "INT,INT_CTL,INT_9_PRIORITY"
)
if "&choice"=="INT_10_PRIORITY"
(
  per.view hwioreg.per "INT,INT_CTL,INT_10_PRIORITY"
)
if "&choice"=="INT_11_PRIORITY"
(
  per.view hwioreg.per "INT,INT_CTL,INT_11_PRIORITY"
)
if "&choice"=="INT_12_PRIORITY"
(
  per.view hwioreg.per "INT,INT_CTL,INT_12_PRIORITY"
)
if "&choice"=="INT_13_PRIORITY"
(
  per.view hwioreg.per "INT,INT_CTL,INT_13_PRIORITY"
)
if "&choice"=="INT_14_PRIORITY"
(
  per.view hwioreg.per "INT,INT_CTL,INT_14_PRIORITY"
)
if "&choice"=="INT_15_PRIORITY"
(
  per.view hwioreg.per "INT,INT_CTL,INT_15_PRIORITY"
)
if "&choice"=="INT_16_PRIORITY"
(
  per.view hwioreg.per "INT,INT_CTL,INT_16_PRIORITY"
)
if "&choice"=="INT_17_PRIORITY"
(
  per.view hwioreg.per "INT,INT_CTL,INT_17_PRIORITY"
)
if "&choice"=="INT_18_PRIORITY"
(
  per.view hwioreg.per "INT,INT_CTL,INT_18_PRIORITY"
)
if "&choice"=="INT_19_PRIORITY"
(
  per.view hwioreg.per "INT,INT_CTL,INT_19_PRIORITY"
)
if "&choice"=="INT_20_PRIORITY"
(
  per.view hwioreg.per "INT,INT_CTL,INT_20_PRIORITY"
)
if "&choice"=="INT_21_PRIORITY"
(
  per.view hwioreg.per "INT,INT_CTL,INT_21_PRIORITY"
)
if "&choice"=="INT_22_PRIORITY"
(
  per.view hwioreg.per "INT,INT_CTL,INT_22_PRIORITY"
)
if "&choice"=="INT_23_PRIORITY"
(
  per.view hwioreg.per "INT,INT_CTL,INT_23_PRIORITY"
)
if "&choice"=="INT_24_PRIORITY"
(
  per.view hwioreg.per "INT,INT_CTL,INT_24_PRIORITY"
)
if "&choice"=="INT_25_PRIORITY"
(
  per.view hwioreg.per "INT,INT_CTL,INT_25_PRIORITY"
)
if "&choice"=="INT_26_PRIORITY"
(
  per.view hwioreg.per "INT,INT_CTL,INT_26_PRIORITY"
)
if "&choice"=="INT_27_PRIORITY"
(
  per.view hwioreg.per "INT,INT_CTL,INT_27_PRIORITY"
)
if "&choice"=="INT_28_PRIORITY"
(
  per.view hwioreg.per "INT,INT_CTL,INT_28_PRIORITY"
)
if "&choice"=="INT_29_PRIORITY"
(
  per.view hwioreg.per "INT,INT_CTL,INT_29_PRIORITY"
)
if "&choice"=="INT_30_PRIORITY"
(
  per.view hwioreg.per "INT,INT_CTL,INT_30_PRIORITY"
)
if "&choice"=="INT_31_PRIORITY"
(
  per.view hwioreg.per "INT,INT_CTL,INT_31_PRIORITY"
)
if "&choice"=="INT_32_PRIORITY"
(
  per.view hwioreg.per "INT,INT_CTL,INT_32_PRIORITY"
)
if "&choice"=="INT_33_PRIORITY"
(
  per.view hwioreg.per "INT,INT_CTL,INT_33_PRIORITY"
)
if "&choice"=="INT_34_PRIORITY"
(
  per.view hwioreg.per "INT,INT_CTL,INT_34_PRIORITY"
)
if "&choice"=="INT_35_PRIORITY"
(
  per.view hwioreg.per "INT,INT_CTL,INT_35_PRIORITY"
)
if "&choice"=="INT_36_PRIORITY"
(
  per.view hwioreg.per "INT,INT_CTL,INT_36_PRIORITY"
)
if "&choice"=="INT_37_PRIORITY"
(
  per.view hwioreg.per "INT,INT_CTL,INT_37_PRIORITY"
)
if "&choice"=="INT_38_PRIORITY"
(
  per.view hwioreg.per "INT,INT_CTL,INT_38_PRIORITY"
)
if "&choice"=="INT_39_PRIORITY"
(
  per.view hwioreg.per "INT,INT_CTL,INT_39_PRIORITY"
)
if "&choice"=="INT_40_PRIORITY"
(
  per.view hwioreg.per "INT,INT_CTL,INT_40_PRIORITY"
)
if "&choice"=="INT_41_PRIORITY"
(
  per.view hwioreg.per "INT,INT_CTL,INT_41_PRIORITY"
)
if "&choice"=="INT_42_PRIORITY"
(
  per.view hwioreg.per "INT,INT_CTL,INT_42_PRIORITY"
)
if "&choice"=="INT_43_PRIORITY"
(
  per.view hwioreg.per "INT,INT_CTL,INT_43_PRIORITY"
)
if "&choice"=="INT_44_PRIORITY"
(
  per.view hwioreg.per "INT,INT_CTL,INT_44_PRIORITY"
)
if "&choice"=="INT_45_PRIORITY"
(
  per.view hwioreg.per "INT,INT_CTL,INT_45_PRIORITY"
)
if "&choice"=="INT_46_PRIORITY"
(
  per.view hwioreg.per "INT,INT_CTL,INT_46_PRIORITY"
)
if "&choice"=="INT_47_PRIORITY"
(
  per.view hwioreg.per "INT,INT_CTL,INT_47_PRIORITY"
)
if "&choice"=="INT_48_PRIORITY"
(
  per.view hwioreg.per "INT,INT_CTL,INT_48_PRIORITY"
)
if "&choice"=="INT_49_PRIORITY"
(
  per.view hwioreg.per "INT,INT_CTL,INT_49_PRIORITY"
)
if "&choice"=="INT_50_PRIORITY"
(
  per.view hwioreg.per "INT,INT_CTL,INT_50_PRIORITY"
)
if "&choice"=="INT_51_PRIORITY"
(
  per.view hwioreg.per "INT,INT_CTL,INT_51_PRIORITY"
)
if "&choice"=="INT_52_PRIORITY"
(
  per.view hwioreg.per "INT,INT_CTL,INT_52_PRIORITY"
)
if "&choice"=="INT_53_PRIORITY"
(
  per.view hwioreg.per "INT,INT_CTL,INT_53_PRIORITY"
)
if "&choice"=="INT_54_PRIORITY"
(
  per.view hwioreg.per "INT,INT_CTL,INT_54_PRIORITY"
)
if "&choice"=="INT_55_PRIORITY"
(
  per.view hwioreg.per "INT,INT_CTL,INT_55_PRIORITY"
)
if "&choice"=="INT_56_PRIORITY"
(
  per.view hwioreg.per "INT,INT_CTL,INT_56_PRIORITY"
)
if "&choice"=="INT_57_PRIORITY"
(
  per.view hwioreg.per "INT,INT_CTL,INT_57_PRIORITY"
)
if "&choice"=="INT_58_PRIORITY"
(
  per.view hwioreg.per "INT,INT_CTL,INT_58_PRIORITY"
)
if "&choice"=="INT_59_PRIORITY"
(
  per.view hwioreg.per "INT,INT_CTL,INT_59_PRIORITY"
)
if "&choice"=="MSM_GPIO1_INT_EN_0"
(
  per.view hwioreg.per "INT,INT_CTL,MSM_GPIO1_INT_EN_0"
)
if "&choice"=="MSM_GPIO1_INT_POLARITY_0"
(
  per.view hwioreg.per "INT,INT_CTL,MSM_GPIO1_INT_POLARITY_0"
)
if "&choice"=="MSM_GPIO1_DETECT_CTL_0"
(
  per.view hwioreg.per "INT,INT_CTL,MSM_GPIO1_DETECT_CTL_0"
)
if "&choice"=="MSM_GPIO1_INT_STATUS_0"
(
  per.view hwioreg.per "INT,INT_CTL,MSM_GPIO1_INT_STATUS_0"
)
if "&choice"=="MSM_GPIO1_INT_EN_1"
(
  per.view hwioreg.per "INT,INT_CTL,MSM_GPIO1_INT_EN_1"
)
if "&choice"=="MSM_GPIO1_INT_POLARITY_1"
(
  per.view hwioreg.per "INT,INT_CTL,MSM_GPIO1_INT_POLARITY_1"
)
if "&choice"=="MSM_GPIO1_DETECT_CTL_1"
(
  per.view hwioreg.per "INT,INT_CTL,MSM_GPIO1_DETECT_CTL_1"
)
if "&choice"=="MSM_GPIO1_INT_STATUS_1"
(
  per.view hwioreg.per "INT,INT_CTL,MSM_GPIO1_INT_STATUS_1"
)
if "&choice"=="MSM_INT_EN"
(
  per.view hwioreg.per "INT,INT_CTL_GPIO2,MSM_INT_EN"
)
if "&choice"=="MSM_INT_POLARITY"
(
  per.view hwioreg.per "INT,INT_CTL_GPIO2,MSM_INT_POLARITY"
)
if "&choice"=="MSM_DETECT_CTL"
(
  per.view hwioreg.per "INT,INT_CTL_GPIO2,MSM_DETECT_CTL"
)
if "&choice"=="MSM_INT_STATUS"
(
  per.view hwioreg.per "INT,INT_CTL_GPIO2,MSM_INT_STATUS"
)
if "&choice"=="MSM_KEYSENSE_GROUP_STATUS"
(
  per.view hwioreg.per "INT,INT_CTL_GPIO2,MSM_KEYSENSE_GROUP_STATUS"
)
if "&choice"=="MSM_GPIO2_INT_EN"
(
  per.view hwioreg.per "INT,INT_CTL_GPIO2,MSM_GPIO2_INT_EN"
)
if "&choice"=="MSM_GPIO2_INT_POLARITY"
(
  per.view hwioreg.per "INT,INT_CTL_GPIO2,MSM_GPIO2_INT_POLARITY"
)
if "&choice"=="MSM_GPIO2_DETECT_CTL"
(
  per.view hwioreg.per "INT,INT_CTL_GPIO2,MSM_GPIO2_DETECT_CTL"
)
if "&choice"=="MSM_GPIO2_INT_STATUS"
(
  per.view hwioreg.per "INT,INT_CTL_GPIO2,MSM_GPIO2_INT_STATUS"
)
if "&choice"=="MDP_TEST_MODE"
(
  per.view hwioreg.per "MDP,MDP_TEST_MODE"
)
if "&choice"=="MDP_COMMAND"
(
  per.view hwioreg.per "MDP,MDP_COMMAND"
)
if "&choice"=="MDP_SCRIPT_ADDR"
(
  per.view hwioreg.per "MDP,MDP_SCRIPT_ADDR"
)
if "&choice"=="MDP_CGC_CONFIG"
(
  per.view hwioreg.per "MDP,MDP_CGC_CONFIG"
)
if "&choice"=="MDP_SYNC_CONFIG"
(
  per.view hwioreg.per "MDP,MDP_SYNC_CONFIG"
)
if "&choice"=="MDP_SYNC_STATUS"
(
  per.view hwioreg.per "MDP,MDP_SYNC_STATUS"
)
if "&choice"=="MDP_SST_REFRESH_COUNT"
(
  per.view hwioreg.per "MDP,MDP_SST_REFRESH_COUNT"
)
if "&choice"=="MDP_SCRIPT_STATUS"
(
  per.view hwioreg.per "MDP,MDP_SCRIPT_STATUS"
)
if "&choice"=="MDP_INTR_ENABLE"
(
  per.view hwioreg.per "MDP,MDP_INTR_ENABLE"
)
if "&choice"=="MDP_INTR_STATUS"
(
  per.view hwioreg.per "MDP,MDP_INTR_STATUS"
)
if "&choice"=="MDP_INTR_CLEAR"
(
  per.view hwioreg.per "MDP,MDP_INTR_CLEAR"
)
if "&choice"=="MDP_TEST_MISR_RESET"
(
  per.view hwioreg.per "MDP,MDP_TEST_MISR_RESET"
)
if "&choice"=="MDP_TEST_EXPORT_MISR"
(
  per.view hwioreg.per "MDP,MDP_TEST_EXPORT_MISR"
)
if "&choice"=="MDP_TEST_MISR_CURR_VAL"
(
  per.view hwioreg.per "MDP,MDP_TEST_MISR_CURR_VAL"
)
if "&choice"=="MDP_INIT_SST_RD_PTR"
(
  per.view hwioreg.per "MDP,MDP_INIT_SST_RD_PTR"
)
if "&choice"=="MDP_ADDRESS_14"
(
  per.view hwioreg.per "MDP,MDP_ADDRESS_14"
)
if "&choice"=="MDP_MAX_SST_RD_PTR"
(
  per.view hwioreg.per "MDP,MDP_MAX_SST_RD_PTR"
)
if "&choice"=="MDP_ADDRESS_15"
(
  per.view hwioreg.per "MDP,MDP_ADDRESS_15"
)
if "&choice"=="MDP_DEBUG_BUS_VALUE"
(
  per.view hwioreg.per "MDP,MDP_DEBUG_BUS_VALUE"
)
if "&choice"=="UXMC_PSRAM_CRE_CFG"
(
  per.view hwioreg.per "MISC_REGS,UXMC_PSRAM_CRE_CFG"
)
if "&choice"=="UXMC_CALIB_CFG"
(
  per.view hwioreg.per "MISC_REGS,UXMC_CALIB_CFG"
)
if "&choice"=="UXMC_CALIB_STATUS"
(
  per.view hwioreg.per "MISC_REGS,UXMC_CALIB_STATUS"
)
if "&choice"=="UXMC_CORE_ID"
(
  per.view hwioreg.per "MISC_REGS,UXMC_CORE_ID"
)
if "&choice"=="MOD_ERAM_DATA"
(
  per.view hwioreg.per "MOD_ERAM,MOD_ERAM_DATA"
)
if "&choice"=="MOD_ERAM_DATA_CTL"
(
  per.view hwioreg.per "MOD_ERAM,MOD_ERAM_DATA_CTL"
)
if "&choice"=="MOD_ERAM_RESERVED_BITS"
(
  per.view hwioreg.per "MOD_ERAM,MOD_ERAM_RESERVED_BITS"
)
if "&choice"=="MOD_TEST_MEM_MODE"
(
  per.view hwioreg.per "MOD_ERAM,MOD_TEST_MEM_MODE"
)
if "&choice"=="MOD_TEST_MEM_SEL"
(
  per.view hwioreg.per "MOD_ERAM,MOD_TEST_MEM_SEL"
)
if "&choice"=="MOD_TEST_MEM_ADDR"
(
  per.view hwioreg.per "MOD_ERAM,MOD_TEST_MEM_ADDR"
)
if "&choice"=="MOD_TEST_MEM_DATA"
(
  per.view hwioreg.per "MOD_ERAM,MOD_TEST_MEM_DATA"
)
if "&choice"=="MOD_TXCX16_SPARE_READ_REG_0"
(
  per.view hwioreg.per "MOD_ERAM,MOD_TXCX16_SPARE_READ_REG_0"
)
if "&choice"=="MOD_TXCX16_SPARE_READ_REG_1"
(
  per.view hwioreg.per "MOD_ERAM,MOD_TXCX16_SPARE_READ_REG_1"
)
if "&choice"=="MODEM_CLK_HALT"
(
  per.view hwioreg.per "MODEM,MODEM_CLK,MODEM_CLK_HALT"
)
if "&choice"=="MODEM_CLK_HALT_2"
(
  per.view hwioreg.per "MODEM,MODEM_CLK,MODEM_CLK_HALT_2"
)
if "&choice"=="MODEM_CLK_RESET"
(
  per.view hwioreg.per "MODEM,MODEM_CLK,MODEM_CLK_RESET"
)
if "&choice"=="MODEM_CLK_RESET_2"
(
  per.view hwioreg.per "MODEM,MODEM_CLK,MODEM_CLK_RESET_2"
)
if "&choice"=="MODEM_CLK_INV"
(
  per.view hwioreg.per "MODEM,MODEM_CLK,MODEM_CLK_INV"
)
if "&choice"=="MODEM_CLK_INV_2"
(
  per.view hwioreg.per "MODEM,MODEM_CLK,MODEM_CLK_INV_2"
)
if "&choice"=="MODEM_RXF_SAMP_REF_CLK_CTL"
(
  per.view hwioreg.per "MODEM,MODEM_CLK,MODEM_RXF_SAMP_REF_CLK_CTL"
)
if "&choice"=="MODEM_IN_N_OUT_CLK_CTL"
(
  per.view hwioreg.per "MODEM,MODEM_CLK,MODEM_IN_N_OUT_CLK_CTL"
)
if "&choice"=="MODEM_MF_CHIPXN_CLK_CTL"
(
  per.view hwioreg.per "MODEM,MODEM_CLK,MODEM_MF_CHIPXN_CLK_CTL"
)
if "&choice"=="MODEM_CHIPXN_CLK_CTL"
(
  per.view hwioreg.per "MODEM,MODEM_CLK,MODEM_CHIPXN_CLK_CTL"
)
if "&choice"=="MODEM_OFFLINE_MNCNTR_M"
(
  per.view hwioreg.per "MODEM,MODEM_CLK,MODEM_OFFLINE_MNCNTR_M"
)
if "&choice"=="MODEM_OFFLINE_MNCNTR_NOT_2D"
(
  per.view hwioreg.per "MODEM,MODEM_CLK,MODEM_OFFLINE_MNCNTR_NOT_2D"
)
if "&choice"=="MODEM_OFFLINE_MNCNTR_NOT_N_M"
(
  per.view hwioreg.per "MODEM,MODEM_CLK,MODEM_OFFLINE_MNCNTR_NOT_N_M"
)
if "&choice"=="MODEM_OFFLINE_CLK_CTL"
(
  per.view hwioreg.per "MODEM,MODEM_CLK,MODEM_OFFLINE_CLK_CTL"
)
if "&choice"=="MODEM_GACC_MNCNTR_M"
(
  per.view hwioreg.per "MODEM,MODEM_CLK,MODEM_GACC_MNCNTR_M"
)
if "&choice"=="MODEM_GACC_MNCNTR_NOT_2D"
(
  per.view hwioreg.per "MODEM,MODEM_CLK,MODEM_GACC_MNCNTR_NOT_2D"
)
if "&choice"=="MODEM_GACC_MNCNTR_NOT_N_M"
(
  per.view hwioreg.per "MODEM,MODEM_CLK,MODEM_GACC_MNCNTR_NOT_N_M"
)
if "&choice"=="MODEM_GACC_CLK_CTL"
(
  per.view hwioreg.per "MODEM,MODEM_CLK,MODEM_GACC_CLK_CTL"
)
if "&choice"=="MODEM_GPS_CLK_CTL"
(
  per.view hwioreg.per "MODEM,MODEM_CLK,MODEM_GPS_CLK_CTL"
)
if "&choice"=="MODEM_GPS_MNCNTR_M"
(
  per.view hwioreg.per "MODEM,MODEM_CLK,MODEM_GPS_MNCNTR_M"
)
if "&choice"=="MODEM_GPS_MNCNTR_NOT_2D"
(
  per.view hwioreg.per "MODEM,MODEM_CLK,MODEM_GPS_MNCNTR_NOT_2D"
)
if "&choice"=="MODEM_GPS_MNCNTR_NOT_N_M"
(
  per.view hwioreg.per "MODEM,MODEM_CLK,MODEM_GPS_MNCNTR_NOT_N_M"
)
if "&choice"=="MODEM_F9_CLK_CTL"
(
  per.view hwioreg.per "MODEM,MODEM_CLK,MODEM_F9_CLK_CTL"
)
if "&choice"=="MODEM_EDGE_CLK_CTL"
(
  per.view hwioreg.per "MODEM,MODEM_CLK,MODEM_EDGE_CLK_CTL"
)
if "&choice"=="MODEM_EDGE_MNCNTR_M"
(
  per.view hwioreg.per "MODEM,MODEM_CLK,MODEM_EDGE_MNCNTR_M"
)
if "&choice"=="MODEM_EDGE_MNCNTR_NOT_2D"
(
  per.view hwioreg.per "MODEM,MODEM_CLK,MODEM_EDGE_MNCNTR_NOT_2D"
)
if "&choice"=="MODEM_EDGE_MNCNTR_NOT_N_M"
(
  per.view hwioreg.per "MODEM,MODEM_CLK,MODEM_EDGE_MNCNTR_NOT_N_M"
)
if "&choice"=="MODEM_WCDMA_CHIPXN_MNCTNR_UPDATE"
(
  per.view hwioreg.per "MODEM,MODEM_CLK,MODEM_WCDMA_CHIPXN_MNCTNR_UPDATE"
)
if "&choice"=="MODEM_WEB_CLK_CTL"
(
  per.view hwioreg.per "MODEM,MODEM_CLK,MODEM_WEB_CLK_CTL"
)
if "&choice"=="MODEM_CHIPXN_CLK_MISC_CTL"
(
  per.view hwioreg.per "MODEM,MODEM_CLK,MODEM_CHIPXN_CLK_MISC_CTL"
)
if "&choice"=="MODEM_CLK_MISC_CTL"
(
  per.view hwioreg.per "MODEM,MODEM_CLK,MODEM_CLK_MISC_CTL"
)
if "&choice"=="MODEM_CLK_MISC_CTL_2"
(
  per.view hwioreg.per "MODEM,MODEM_CLK,MODEM_CLK_MISC_CTL_2"
)
if "&choice"=="MODEM_CLK_MDSP_FS_CTL"
(
  per.view hwioreg.per "MODEM,MODEM_CLK,MODEM_CLK_MDSP_FS_CTL"
)
if "&choice"=="MODEM_CLK_STATUS_RD"
(
  per.view hwioreg.per "MODEM,MODEM_CLK,MODEM_CLK_STATUS_RD"
)
if "&choice"=="MODEM_CLK_STATUS_RD_2"
(
  per.view hwioreg.per "MODEM,MODEM_CLK,MODEM_CLK_STATUS_RD_2"
)
if "&choice"=="MODEM_CLK_TEST"
(
  per.view hwioreg.per "MODEM,MODEM_CLK,MODEM_CLK_TEST"
)
if "&choice"=="MODEM_CLK_TEST_2"
(
  per.view hwioreg.per "MODEM,MODEM_CLK,MODEM_CLK_TEST_2"
)
if "&choice"=="MODEM_CDMA_CHIPXN_MNCNTR_M"
(
  per.view hwioreg.per "MODEM,MODEM_CLK,MODEM_CDMA_CHIPXN_MNCNTR_M"
)
if "&choice"=="MODEM_CDMA_CHIPXN_MNCNTR_NOT_2D"
(
  per.view hwioreg.per "MODEM,MODEM_CLK,MODEM_CDMA_CHIPXN_MNCNTR_NOT_2D"
)
if "&choice"=="MODEM_CDMA_CHIPXN_MNCNTR_NOT_N_M"
(
  per.view hwioreg.per "MODEM,MODEM_CLK,MODEM_CDMA_CHIPXN_MNCNTR_NOT_N_M"
)
if "&choice"=="MODEM_CDMA_CHIPXN_MNCTNR_UPDATE"
(
  per.view hwioreg.per "MODEM,MODEM_CLK,MODEM_CDMA_CHIPXN_MNCTNR_UPDATE"
)
if "&choice"=="MODEM_WCDMA_CHIPXN_MNCNTR_M"
(
  per.view hwioreg.per "MODEM,MODEM_CLK,MODEM_WCDMA_CHIPXN_MNCNTR_M"
)
if "&choice"=="MODEM_WCDMA_CHIPXN_MNCNTR_NOT_2D"
(
  per.view hwioreg.per "MODEM,MODEM_CLK,MODEM_WCDMA_CHIPXN_MNCNTR_NOT_2D"
)
if "&choice"=="MODEM_WCDMA_CHIPXN_MNCNTR_NOT_N_M"
(
  per.view hwioreg.per "MODEM,MODEM_CLK,MODEM_WCDMA_CHIPXN_MNCNTR_NOT_N_M"
)
if "&choice"=="MODEM_GPS_MNCNTR_UPDATE"
(
  per.view hwioreg.per "MODEM,MODEM_CLK,MODEM_GPS_MNCNTR_UPDATE"
)
if "&choice"=="MDSP_MNCNTR_MD"
(
  per.view hwioreg.per "MODEM,MODEM_CLK,MDSP_MNCNTR_MD"
)
if "&choice"=="MDSP_MNCNTR_NS"
(
  per.view hwioreg.per "MODEM,MODEM_CLK,MDSP_MNCNTR_NS"
)
if "&choice"=="MDSP_ACTIVE_MD_RD"
(
  per.view hwioreg.per "MODEM,MODEM_CLK,MDSP_ACTIVE_MD_RD"
)
if "&choice"=="MDSP_ACTIVE_NS_RD"
(
  per.view hwioreg.per "MODEM,MODEM_CLK,MDSP_ACTIVE_NS_RD"
)
if "&choice"=="MDSP_CLK_SWITCH"
(
  per.view hwioreg.per "MODEM,MODEM_CLK,MDSP_CLK_SWITCH"
)
if "&choice"=="MODEM_CLK_DYN_SW_BYPASS"
(
  per.view hwioreg.per "MODEM,MODEM_CLK,MODEM_CLK_DYN_SW_BYPASS"
)
if "&choice"=="MODEM_CLK_DYN_SW_SPARE_READ_REG0"
(
  per.view hwioreg.per "MODEM,MODEM_CLK,MODEM_CLK_DYN_SW_SPARE_READ_REG0"
)
if "&choice"=="MODEM_CDXO_CTL"
(
  per.view hwioreg.per "MODEM,MODEM_CLK,MODEM_CDXO_CTL"
)
if "&choice"=="MODEM_CDXO_Y_CUT_CNTR_CTL"
(
  per.view hwioreg.per "MODEM,MODEM_CLK,MODEM_CDXO_Y_CUT_CNTR_CTL"
)
if "&choice"=="MODEM_CDXO_AT_CUT_CNTR"
(
  per.view hwioreg.per "MODEM,MODEM_CLK,MODEM_CDXO_AT_CUT_CNTR"
)
if "&choice"=="MODEM_CLK_SSBI_CLK_CTL"
(
  per.view hwioreg.per "MODEM,MODEM_CLK,MODEM_CLK_SSBI_CLK_CTL"
)
if "&choice"=="MODEM_EDGE_SWC_CNT"
(
  per.view hwioreg.per "MODEM,MODEM_CLK,MODEM_EDGE_SWC_CNT"
)
if "&choice"=="MODEM_SBI0_CLK_EN"
(
  per.view hwioreg.per "MODEM,MODEM_SBI,MODEM_SBI0_CLK_EN"
)
if "&choice"=="MODEM_SBI1_CLK_EN"
(
  per.view hwioreg.per "MODEM,MODEM_SBI,MODEM_SBI1_CLK_EN"
)
if "&choice"=="MODEM_SBI0_CGC_HW_EN"
(
  per.view hwioreg.per "MODEM,MODEM_SBI,MODEM_SBI0_CGC_HW_EN"
)
if "&choice"=="MODEM_SBI1_CGC_HW_EN"
(
  per.view hwioreg.per "MODEM,MODEM_SBI,MODEM_SBI1_CGC_HW_EN"
)
if "&choice"=="MODEM_SBI0_CLK_CTL"
(
  per.view hwioreg.per "MODEM,MODEM_SBI,MODEM_SBI0_CLK_CTL"
)
if "&choice"=="MODEM_SBI1_CLK_CTL"
(
  per.view hwioreg.per "MODEM,MODEM_SBI,MODEM_SBI1_CLK_CTL"
)
if "&choice"=="MODEM_SBI0_CTL"
(
  per.view hwioreg.per "MODEM,MODEM_SBI,MODEM_SBI0_CTL"
)
if "&choice"=="MODEM_SBI1_CTL"
(
  per.view hwioreg.per "MODEM,MODEM_SBI,MODEM_SBI1_CTL"
)
if "&choice"=="MODEM_SBI0_BYPASS_WR"
(
  per.view hwioreg.per "MODEM,MODEM_SBI,MODEM_SBI0_BYPASS_WR"
)
if "&choice"=="MODEM_SBI1_BYPASS_WR"
(
  per.view hwioreg.per "MODEM,MODEM_SBI,MODEM_SBI1_BYPASS_WR"
)
if "&choice"=="MODEM_SBI0_WR"
(
  per.view hwioreg.per "MODEM,MODEM_SBI,MODEM_SBI0_WR"
)
if "&choice"=="MODEM_SBI1_WR"
(
  per.view hwioreg.per "MODEM,MODEM_SBI,MODEM_SBI1_WR"
)
if "&choice"=="MODEM_SBI0_START_CTL"
(
  per.view hwioreg.per "MODEM,MODEM_SBI,MODEM_SBI0_START_CTL"
)
if "&choice"=="MODEM_SBI1_START_CTL"
(
  per.view hwioreg.per "MODEM,MODEM_SBI,MODEM_SBI1_START_CTL"
)
if "&choice"=="MODEM_SBI0_SECOND_IDCODE"
(
  per.view hwioreg.per "MODEM,MODEM_SBI,MODEM_SBI0_SECOND_IDCODE"
)
if "&choice"=="MODEM_SBI1_SECOND_IDCODE"
(
  per.view hwioreg.per "MODEM,MODEM_SBI,MODEM_SBI1_SECOND_IDCODE"
)
if "&choice"=="MODEM_SBI0_STATUS"
(
  per.view hwioreg.per "MODEM,MODEM_SBI,MODEM_SBI0_STATUS"
)
if "&choice"=="MODEM_SBI1_STATUS"
(
  per.view hwioreg.per "MODEM,MODEM_SBI,MODEM_SBI1_STATUS"
)
if "&choice"=="MODEM_SBI0_BYPASS_RD"
(
  per.view hwioreg.per "MODEM,MODEM_SBI,MODEM_SBI0_BYPASS_RD"
)
if "&choice"=="MODEM_SBI1_BYPASS_RD"
(
  per.view hwioreg.per "MODEM,MODEM_SBI,MODEM_SBI1_BYPASS_RD"
)
if "&choice"=="MODEM_SBI0_RD"
(
  per.view hwioreg.per "MODEM,MODEM_SBI,MODEM_SBI0_RD"
)
if "&choice"=="MODEM_SBI1_RD"
(
  per.view hwioreg.per "MODEM,MODEM_SBI,MODEM_SBI1_RD"
)
if "&choice"=="MODEM_SBI0_RD1"
(
  per.view hwioreg.per "MODEM,MODEM_SBI,MODEM_SBI0_RD1"
)
if "&choice"=="MODEM_SBI1_RD1"
(
  per.view hwioreg.per "MODEM,MODEM_SBI,MODEM_SBI1_RD1"
)
if "&choice"=="MODEM_SBI0_RD2"
(
  per.view hwioreg.per "MODEM,MODEM_SBI,MODEM_SBI0_RD2"
)
if "&choice"=="MODEM_SBI1_RD2"
(
  per.view hwioreg.per "MODEM,MODEM_SBI,MODEM_SBI1_RD2"
)
if "&choice"=="MODEM_SSBI0_CLK_EN"
(
  per.view hwioreg.per "MODEM,MODEM_SBI,MODEM_SSBI0_CLK_EN"
)
if "&choice"=="MODEM_SSBI1_CLK_EN"
(
  per.view hwioreg.per "MODEM,MODEM_SBI,MODEM_SSBI1_CLK_EN"
)
if "&choice"=="MODEM_SSBI2_CLK_EN"
(
  per.view hwioreg.per "MODEM,MODEM_SBI,MODEM_SSBI2_CLK_EN"
)
if "&choice"=="MODEM_SSBI0_CGC_HW_EN"
(
  per.view hwioreg.per "MODEM,MODEM_SBI,MODEM_SSBI0_CGC_HW_EN"
)
if "&choice"=="MODEM_SSBI1_CGC_HW_EN"
(
  per.view hwioreg.per "MODEM,MODEM_SBI,MODEM_SSBI1_CGC_HW_EN"
)
if "&choice"=="MODEM_SSBI2_CGC_HW_EN"
(
  per.view hwioreg.per "MODEM,MODEM_SBI,MODEM_SSBI2_CGC_HW_EN"
)
if "&choice"=="MODEM_SSBI0_CTL"
(
  per.view hwioreg.per "MODEM,MODEM_SBI,MODEM_SSBI0_CTL"
)
if "&choice"=="MODEM_SSBI1_CTL"
(
  per.view hwioreg.per "MODEM,MODEM_SBI,MODEM_SSBI1_CTL"
)
if "&choice"=="MODEM_SSBI2_CTL"
(
  per.view hwioreg.per "MODEM,MODEM_SBI,MODEM_SSBI2_CTL"
)
if "&choice"=="MODEM_SSBI0_RESET"
(
  per.view hwioreg.per "MODEM,MODEM_SBI,MODEM_SSBI0_RESET"
)
if "&choice"=="MODEM_SSBI1_RESET"
(
  per.view hwioreg.per "MODEM,MODEM_SBI,MODEM_SSBI1_RESET"
)
if "&choice"=="MODEM_SSBI2_RESET"
(
  per.view hwioreg.per "MODEM,MODEM_SBI,MODEM_SSBI2_RESET"
)
if "&choice"=="MODEM_SSBI0_CMD"
(
  per.view hwioreg.per "MODEM,MODEM_SBI,MODEM_SSBI0_CMD"
)
if "&choice"=="MODEM_SSBI1_CMD"
(
  per.view hwioreg.per "MODEM,MODEM_SBI,MODEM_SSBI1_CMD"
)
if "&choice"=="MODEM_SSBI2_CMD"
(
  per.view hwioreg.per "MODEM,MODEM_SBI,MODEM_SSBI2_CMD"
)
if "&choice"=="MODEM_SSBI0_BYPASS"
(
  per.view hwioreg.per "MODEM,MODEM_SBI,MODEM_SSBI0_BYPASS"
)
if "&choice"=="MODEM_SSBI1_BYPASS"
(
  per.view hwioreg.per "MODEM,MODEM_SBI,MODEM_SSBI1_BYPASS"
)
if "&choice"=="MODEM_SSBI2_BYPASS"
(
  per.view hwioreg.per "MODEM,MODEM_SBI,MODEM_SSBI2_BYPASS"
)
if "&choice"=="MODEM_SSBI0_PRIORITIES"
(
  per.view hwioreg.per "MODEM,MODEM_SBI,MODEM_SSBI0_PRIORITIES"
)
if "&choice"=="MODEM_SSBI1_PRIORITIES"
(
  per.view hwioreg.per "MODEM,MODEM_SBI,MODEM_SSBI1_PRIORITIES"
)
if "&choice"=="MODEM_SSBI2_PRIORITIES"
(
  per.view hwioreg.per "MODEM,MODEM_SBI,MODEM_SSBI2_PRIORITIES"
)
if "&choice"=="MODEM_SSBI0_RD"
(
  per.view hwioreg.per "MODEM,MODEM_SBI,MODEM_SSBI0_RD"
)
if "&choice"=="MODEM_SSBI1_RD"
(
  per.view hwioreg.per "MODEM,MODEM_SBI,MODEM_SSBI1_RD"
)
if "&choice"=="MODEM_SSBI2_RD"
(
  per.view hwioreg.per "MODEM,MODEM_SBI,MODEM_SSBI2_RD"
)
if "&choice"=="MODEM_SSBI0_STATUS"
(
  per.view hwioreg.per "MODEM,MODEM_SBI,MODEM_SSBI0_STATUS"
)
if "&choice"=="MODEM_SSBI1_STATUS"
(
  per.view hwioreg.per "MODEM,MODEM_SBI,MODEM_SSBI1_STATUS"
)
if "&choice"=="MODEM_SSBI2_STATUS"
(
  per.view hwioreg.per "MODEM,MODEM_SBI,MODEM_SSBI2_STATUS"
)
if "&choice"=="MODEM_SBI_PIN_CFG"
(
  per.view hwioreg.per "MODEM,MODEM_SBI,MODEM_SBI_PIN_CFG"
)
if "&choice"=="MODEM_SBI_INOUT_CONFIG"
(
  per.view hwioreg.per "MODEM,MODEM_SBI,MODEM_SBI_INOUT_CONFIG"
)
if "&choice"=="MODEM_SBI_RXF_AGC_CONFIG"
(
  per.view hwioreg.per "MODEM,MODEM_SBI,MODEM_SBI_RXF_AGC_CONFIG"
)
if "&choice"=="MODEM_SBI_INTR_MASK"
(
  per.view hwioreg.per "MODEM,MODEM_SBI,MODEM_SBI_INTR_MASK"
)
if "&choice"=="MODEM_SBI_INTR_STATUS"
(
  per.view hwioreg.per "MODEM,MODEM_SBI,MODEM_SBI_INTR_STATUS"
)
if "&choice"=="MODEM_SBI_BUGFIX_DISABLE"
(
  per.view hwioreg.per "MODEM,MODEM_SBI,MODEM_SBI_BUGFIX_DISABLE"
)
if "&choice"=="MODEM_SBI_EXT_SSBI_CLK_FORCE_ON"
(
  per.view hwioreg.per "MODEM,MODEM_SBI,MODEM_SBI_EXT_SSBI_CLK_FORCE_ON"
)
if "&choice"=="MODEM_SBI_EXT_SSBI_CLK_DLY"
(
  per.view hwioreg.per "MODEM,MODEM_SBI,MODEM_SBI_EXT_SSBI_CLK_DLY"
)
if "&choice"=="MODEM_HW_REV_RD"
(
  per.view hwioreg.per "MODEM,MODEM_WEB,MODEM_HW_REV_RD"
)
if "&choice"=="MODEM_MISC_CFG0"
(
  per.view hwioreg.per "MODEM,MODEM_WEB,MODEM_MISC_CFG0"
)
if "&choice"=="MODEM_MISC_CFG1"
(
  per.view hwioreg.per "MODEM,MODEM_WEB,MODEM_MISC_CFG1"
)
if "&choice"=="MODEM_MISC_CFG2"
(
  per.view hwioreg.per "MODEM,MODEM_WEB,MODEM_MISC_CFG2"
)
if "&choice"=="MODEM_TX_DAC_SLEEP"
(
  per.view hwioreg.per "MODEM,MODEM_WEB,MODEM_TX_DAC_SLEEP"
)
if "&choice"=="MODEM_DBG_BUS_OUT_GATING"
(
  per.view hwioreg.per "MODEM,MODEM_WEB,MODEM_DBG_BUS_OUT_GATING"
)
if "&choice"=="MODEM_WEB_SPARE_READ_REG0"
(
  per.view hwioreg.per "MODEM,MODEM_WEB,MODEM_WEB_SPARE_READ_REG0"
)
if "&choice"=="MODEM_GENERIC_CTL_REG"
(
  per.view hwioreg.per "MODEM,MODEM_WEB,MODEM_GENERIC_CTL_REG"
)
if "&choice"=="MODEM_BRIDGE_TIMEOUT_CFG"
(
  per.view hwioreg.per "MODEM,MODEM_WEB,MODEM_BRIDGE_TIMEOUT_CFG"
)
if "&choice"=="MODEM_PA_ON_STATUS"
(
  per.view hwioreg.per "MODEM,MODEM_WEB,MODEM_PA_ON_STATUS"
)
if "&choice"=="MODEM_PA_ON_CTL"
(
  per.view hwioreg.per "MODEM,MODEM_WEB,MODEM_PA_ON_CTL"
)
if "&choice"=="MODEM_PA_ON_PROTECTION"
(
  per.view hwioreg.per "MODEM,MODEM_WEB,MODEM_PA_ON_PROTECTION"
)
if "&choice"=="MDM_SEC_DOMAIN_CFG"
(
  per.view hwioreg.per "MODEM,MODEM_WEB,MDM_SEC_DOMAIN_CFG"
)
if "&choice"=="MODEM_WEB_DBG_BUS_SEL"
(
  per.view hwioreg.per "MODEM,MODEM_WEB,MODEM_WEB_DBG_BUS_SEL"
)
if "&choice"=="MODEM_OUTPORT_OVERRIDE0"
(
  per.view hwioreg.per "MODEM,MODEM_WEB,MODEM_OUTPORT_OVERRIDE0"
)
if "&choice"=="MODEM_OUTPORT_OVERRIDE1"
(
  per.view hwioreg.per "MODEM,MODEM_WEB,MODEM_OUTPORT_OVERRIDE1"
)
if "&choice"=="MODEM_OUTPORT_OVERRIDE2"
(
  per.view hwioreg.per "MODEM,MODEM_WEB,MODEM_OUTPORT_OVERRIDE2"
)
if "&choice"=="MODEM_OUTPORT_OVERRIDE3"
(
  per.view hwioreg.per "MODEM,MODEM_WEB,MODEM_OUTPORT_OVERRIDE3"
)
if "&choice"=="MODEM_OUTPORT_OVERRIDE4"
(
  per.view hwioreg.per "MODEM,MODEM_WEB,MODEM_OUTPORT_OVERRIDE4"
)
if "&choice"=="MODEM_OUTPORT_OVERRIDE5"
(
  per.view hwioreg.per "MODEM,MODEM_WEB,MODEM_OUTPORT_OVERRIDE5"
)
if "&choice"=="MODEM_OUTPORT_OVERRIDE_EN"
(
  per.view hwioreg.per "MODEM,MODEM_WEB,MODEM_OUTPORT_OVERRIDE_EN"
)
if "&choice"=="MODEM_INPORT_RD_DATA0"
(
  per.view hwioreg.per "MODEM,MODEM_WEB,MODEM_INPORT_RD_DATA0"
)
if "&choice"=="MODEM_INPORT_RD_DATA1"
(
  per.view hwioreg.per "MODEM,MODEM_WEB,MODEM_INPORT_RD_DATA1"
)
if "&choice"=="MODEM_INPORT_RD_DATA2"
(
  per.view hwioreg.per "MODEM,MODEM_WEB,MODEM_INPORT_RD_DATA2"
)
if "&choice"=="AGC_CARRIER_FREQ_ERR"
(
  per.view hwioreg.per "MODEM,MODEM_WEB,AGC_CARRIER_FREQ_ERR"
)
if "&choice"=="AGC_FREQ_COMB_CTL"
(
  per.view hwioreg.per "MODEM,MODEM_WEB,AGC_FREQ_COMB_CTL"
)
if "&choice"=="CHIP_MODE"
(
  per.view hwioreg.per "PERIPH,PERIPH_HCLK,CHIP_MODE"
)
if "&choice"=="WEB_MISC_WR"
(
  per.view hwioreg.per "PERIPH,PERIPH_HCLK,WEB_MISC_WR"
)
if "&choice"=="EBI1_PAD_PULL_0"
(
  per.view hwioreg.per "PERIPH,PERIPH_HCLK,EBI1_PAD_PULL_0"
)
if "&choice"=="EBI1_PAD_PULL_1"
(
  per.view hwioreg.per "PERIPH,PERIPH_HCLK,EBI1_PAD_PULL_1"
)
if "&choice"=="EBI2_PAD_PULL_0"
(
  per.view hwioreg.per "PERIPH,PERIPH_HCLK,EBI2_PAD_PULL_0"
)
if "&choice"=="EBI2_PAD_PULL_1"
(
  per.view hwioreg.per "PERIPH,PERIPH_HCLK,EBI2_PAD_PULL_1"
)
if "&choice"=="D2D_PAD_PULL_0"
(
  per.view hwioreg.per "PERIPH,PERIPH_HCLK,D2D_PAD_PULL_0"
)
if "&choice"=="D2D_PAD_PULL_1"
(
  per.view hwioreg.per "PERIPH,PERIPH_HCLK,D2D_PAD_PULL_1"
)
if "&choice"=="D2D_PAD_HDRIVE_MSEL_0"
(
  per.view hwioreg.per "PERIPH,PERIPH_HCLK,D2D_PAD_HDRIVE_MSEL_0"
)
if "&choice"=="D2D_PAD_HDRIVE_MSEL_1"
(
  per.view hwioreg.per "PERIPH,PERIPH_HCLK,D2D_PAD_HDRIVE_MSEL_1"
)
if "&choice"=="PAD_HDRIVE_MSEL"
(
  per.view hwioreg.per "PERIPH,PERIPH_HCLK,PAD_HDRIVE_MSEL"
)
if "&choice"=="EBI1_PAD_HDRIVE_MSEL_0"
(
  per.view hwioreg.per "PERIPH,PERIPH_HCLK,EBI1_PAD_HDRIVE_MSEL_0"
)
if "&choice"=="EBI1_PAD_HDRIVE_MSEL_1"
(
  per.view hwioreg.per "PERIPH,PERIPH_HCLK,EBI1_PAD_HDRIVE_MSEL_1"
)
if "&choice"=="EBI2_PAD_HDRIVE_MSEL_0"
(
  per.view hwioreg.per "PERIPH,PERIPH_HCLK,EBI2_PAD_HDRIVE_MSEL_0"
)
if "&choice"=="GPIO_PAD_HDRIVE_MSEL_0"
(
  per.view hwioreg.per "PERIPH,PERIPH_HCLK,GPIO_PAD_HDRIVE_MSEL_0"
)
if "&choice"=="GPIO_PAD_HDRIVE_MSEL_1"
(
  per.view hwioreg.per "PERIPH,PERIPH_HCLK,GPIO_PAD_HDRIVE_MSEL_1"
)
if "&choice"=="GPIO_PAD_HDRIVE_MSEL_2"
(
  per.view hwioreg.per "PERIPH,PERIPH_HCLK,GPIO_PAD_HDRIVE_MSEL_2"
)
if "&choice"=="GPIO_PAD_HDRIVE_MSEL_3"
(
  per.view hwioreg.per "PERIPH,PERIPH_HCLK,GPIO_PAD_HDRIVE_MSEL_3"
)
if "&choice"=="GPIO_PAD_HDRIVE_MSEL_4"
(
  per.view hwioreg.per "PERIPH,PERIPH_HCLK,GPIO_PAD_HDRIVE_MSEL_4"
)
if "&choice"=="GPIO_PAD_HDRIVE_MSEL_5"
(
  per.view hwioreg.per "PERIPH,PERIPH_HCLK,GPIO_PAD_HDRIVE_MSEL_5"
)
if "&choice"=="GPIO_PAD_HDRIVE_MSEL_6"
(
  per.view hwioreg.per "PERIPH,PERIPH_HCLK,GPIO_PAD_HDRIVE_MSEL_6"
)
if "&choice"=="GPIO_PAD_HDRIVE_MSEL_7"
(
  per.view hwioreg.per "PERIPH,PERIPH_HCLK,GPIO_PAD_HDRIVE_MSEL_7"
)
if "&choice"=="PMIC_CONTROL"
(
  per.view hwioreg.per "PERIPH,PERIPH_HCLK,PMIC_CONTROL"
)
if "&choice"=="ANALOG_TEST_SEL"
(
  per.view hwioreg.per "PERIPH,PERIPH_HCLK,ANALOG_TEST_SEL"
)
if "&choice"=="ADIE_TEST_CONTROL"
(
  per.view hwioreg.per "PERIPH,PERIPH_HCLK,ADIE_TEST_CONTROL"
)
if "&choice"=="TXDAC_TEST_CONTROL"
(
  per.view hwioreg.per "PERIPH,PERIPH_HCLK,TXDAC_TEST_CONTROL"
)
if "&choice"=="HW_REVISION_NUMBER"
(
  per.view hwioreg.per "PERIPH,PERIPH_HCLK,HW_REVISION_NUMBER"
)
if "&choice"=="CHIP_FEATURE_ID"
(
  per.view hwioreg.per "PERIPH,PERIPH_HCLK,CHIP_FEATURE_ID"
)
if "&choice"=="USB_GPIO_TEST"
(
  per.view hwioreg.per "PERIPH,PERIPH_HCLK,USB_GPIO_TEST"
)
if "&choice"=="SSBI_GPIO_TEST"
(
  per.view hwioreg.per "PERIPH,PERIPH_HCLK,SSBI_GPIO_TEST"
)
if "&choice"=="USB_PIN_CONFIG"
(
  per.view hwioreg.per "PERIPH,PERIPH_HCLK,USB_PIN_CONFIG"
)
if "&choice"=="USB_PIN_SEL"
(
  per.view hwioreg.per "PERIPH,PERIPH_HCLK,USB_PIN_SEL"
)
if "&choice"=="TEST_BUS_EN"
(
  per.view hwioreg.per "PERIPH,PERIPH_HCLK,TEST_BUS_EN"
)
if "&choice"=="PMBLK_CONFIG"
(
  per.view hwioreg.per "PERIPH,PERIPH_HCLK,PMBLK_CONFIG"
)
if "&choice"=="PMBLK_CNT0"
(
  per.view hwioreg.per "PERIPH,PERIPH_HCLK,PMBLK_CNT0"
)
if "&choice"=="PMBLK_CNT1"
(
  per.view hwioreg.per "PERIPH,PERIPH_HCLK,PMBLK_CNT1"
)
if "&choice"=="PMBLK_CNT2"
(
  per.view hwioreg.per "PERIPH,PERIPH_HCLK,PMBLK_CNT2"
)
if "&choice"=="PMBLK_CNT3"
(
  per.view hwioreg.per "PERIPH,PERIPH_HCLK,PMBLK_CNT3"
)
if "&choice"=="PMBLK_CNT4"
(
  per.view hwioreg.per "PERIPH,PERIPH_HCLK,PMBLK_CNT4"
)
if "&choice"=="TIME_TICK_CTL"
(
  per.view hwioreg.per "PERIPH,PERIPH_XO4,TIME_TICK_CTL"
)
if "&choice"=="TIME_TICK_INT_MSB"
(
  per.view hwioreg.per "PERIPH,PERIPH_XO4,TIME_TICK_INT_MSB"
)
if "&choice"=="I2C_WRITE_DATA"
(
  per.view hwioreg.per "PERPH,PERPH_WEB_I2C,I2C_WRITE_DATA"
)
if "&choice"=="I2C_CLK_CTL"
(
  per.view hwioreg.per "PERPH,PERPH_WEB_I2C,I2C_CLK_CTL"
)
if "&choice"=="I2C_STATUS"
(
  per.view hwioreg.per "PERPH,PERPH_WEB_I2C,I2C_STATUS"
)
if "&choice"=="I2C_READ_DATA"
(
  per.view hwioreg.per "PERPH,PERPH_WEB_I2C,I2C_READ_DATA"
)
if "&choice"=="I2C_INTERFACE_SELECT"
(
  per.view hwioreg.per "PERPH,PERPH_WEB_I2C,I2C_INTERFACE_SELECT"
)
if "&choice"=="TCXO_PDM_CTL"
(
  per.view hwioreg.per "PERPH,PERPH_WEB_XO4,TCXO_PDM_CTL"
)
if "&choice"=="PDM0_CTL"
(
  per.view hwioreg.per "PERPH,PERPH_WEB_XO4,PDM0_CTL"
)
if "&choice"=="PDM1_CTL"
(
  per.view hwioreg.per "PERPH,PERPH_WEB_XO4,PDM1_CTL"
)
if "&choice"=="GP_MN_CLK_MDIV"
(
  per.view hwioreg.per "PERPH,PERPH_WEB_XO4,GP_MN_CLK_MDIV"
)
if "&choice"=="GP_MN_CLK_NDIV"
(
  per.view hwioreg.per "PERPH,PERPH_WEB_XO4,GP_MN_CLK_NDIV"
)
if "&choice"=="GP_MN_CLK_DUTY"
(
  per.view hwioreg.per "PERPH,PERPH_WEB_XO4,GP_MN_CLK_DUTY"
)
if "&choice"=="WEB_TCXO4_TEST"
(
  per.view hwioreg.per "PERPH,PERPH_WEB_XO4,WEB_TCXO4_TEST"
)
if "&choice"=="QLIC_MTI_CTL"
(
  per.view hwioreg.per "QLIC,QLIC_MTI_CTL"
)
if "&choice"=="QLIC_FERAM0_WORD0"
(
  per.view hwioreg.per "QLIC,QLIC_FERAM0_WORD0"
)
if "&choice"=="QLIC_FERAM0_WORD1"
(
  per.view hwioreg.per "QLIC,QLIC_FERAM0_WORD1"
)
if "&choice"=="QLIC_FERAM1_WORD0"
(
  per.view hwioreg.per "QLIC,QLIC_FERAM1_WORD0"
)
if "&choice"=="QLIC_FERAM1_WORD1"
(
  per.view hwioreg.per "QLIC,QLIC_FERAM1_WORD1"
)
if "&choice"=="QLIC_OMGRAM_WORD0"
(
  per.view hwioreg.per "QLIC,QLIC_OMGRAM_WORD0"
)
if "&choice"=="QLIC_OMGRAM_WORD1"
(
  per.view hwioreg.per "QLIC,QLIC_OMGRAM_WORD1"
)
if "&choice"=="QLIC_SECRAM_WORD0"
(
  per.view hwioreg.per "QLIC,QLIC_SECRAM_WORD0"
)
if "&choice"=="QLIC_SECRAM_WORD1"
(
  per.view hwioreg.per "QLIC,QLIC_SECRAM_WORD1"
)
if "&choice"=="QLIC_COMBRAM0_WORD0"
(
  per.view hwioreg.per "QLIC,QLIC_COMBRAM0_WORD0"
)
if "&choice"=="QLIC_COMBRAM0_WORD1"
(
  per.view hwioreg.per "QLIC,QLIC_COMBRAM0_WORD1"
)
if "&choice"=="QLIC_COMBRAM0_WORD2"
(
  per.view hwioreg.per "QLIC,QLIC_COMBRAM0_WORD2"
)
if "&choice"=="QLIC_COMBRAM1_WORD0"
(
  per.view hwioreg.per "QLIC,QLIC_COMBRAM1_WORD0"
)
if "&choice"=="QLIC_COMBRAM1_WORD1"
(
  per.view hwioreg.per "QLIC,QLIC_COMBRAM1_WORD1"
)
if "&choice"=="QLIC_COMBRAM1_WORD2"
(
  per.view hwioreg.per "QLIC,QLIC_COMBRAM1_WORD2"
)
if "&choice"=="QLIC_CGC_TASK_STATE_ARM"
(
  per.view hwioreg.per "QLIC,QLIC_CGC_TASK_STATE_ARM"
)
if "&choice"=="QLIC_TESTBUS_ARM"
(
  per.view hwioreg.per "QLIC,QLIC_TESTBUS_ARM"
)
if "&choice"=="QMEMBIST_CLK_ENA"
(
  per.view hwioreg.per "QMEMBIST,QMEMBIST_CLK_ENA"
)
if "&choice"=="QMEMBIST_IO_CFG"
(
  per.view hwioreg.per "QMEMBIST,QMEMBIST_IO_CFG"
)
if "&choice"=="QMEMBIST_RESET"
(
  per.view hwioreg.per "QMEMBIST,QMEMBIST_RESET"
)
if "&choice"=="QMEMBIST_FA_SEQUENCER_SEL"
(
  per.view hwioreg.per "QMEMBIST,QMEMBIST_FA_SEQUENCER_SEL"
)
if "&choice"=="QMEMBIST_EMBEDDED_ALG_CFG"
(
  per.view hwioreg.per "QMEMBIST,QMEMBIST_EMBEDDED_ALG_CFG"
)
if "&choice"=="QMEMBIST_USR_CMD_DESTINATION"
(
  per.view hwioreg.per "QMEMBIST,QMEMBIST_USR_CMD_DESTINATION"
)
if "&choice"=="QMEMBIST_USR_CMD_CFG"
(
  per.view hwioreg.per "QMEMBIST,QMEMBIST_USR_CMD_CFG"
)
if "&choice"=="QMEMBIST_TEST_TRIGGER"
(
  per.view hwioreg.per "QMEMBIST,QMEMBIST_TEST_TRIGGER"
)
if "&choice"=="QMEMBIST_TEST_STATUS"
(
  per.view hwioreg.per "QMEMBIST,QMEMBIST_TEST_STATUS"
)
if "&choice"=="QMEMBIST_TESTED0"
(
  per.view hwioreg.per "QMEMBIST,QMEMBIST_TESTED0"
)
if "&choice"=="QMEMBIST_TESTED1"
(
  per.view hwioreg.per "QMEMBIST,QMEMBIST_TESTED1"
)
if "&choice"=="QMEMBIST_TESTED2"
(
  per.view hwioreg.per "QMEMBIST,QMEMBIST_TESTED2"
)
if "&choice"=="QMEMBIST_TESTED3"
(
  per.view hwioreg.per "QMEMBIST,QMEMBIST_TESTED3"
)
if "&choice"=="QMEMBIST_FAILED0"
(
  per.view hwioreg.per "QMEMBIST,QMEMBIST_FAILED0"
)
if "&choice"=="QMEMBIST_FAILED1"
(
  per.view hwioreg.per "QMEMBIST,QMEMBIST_FAILED1"
)
if "&choice"=="QMEMBIST_FAILED2"
(
  per.view hwioreg.per "QMEMBIST,QMEMBIST_FAILED2"
)
if "&choice"=="QMEMBIST_FAILED3"
(
  per.view hwioreg.per "QMEMBIST,QMEMBIST_FAILED3"
)
if "&choice"=="QMEMBIST_RAM_FAIL_MAP"
(
  per.view hwioreg.per "QMEMBIST,QMEMBIST_RAM_FAIL_MAP"
)
if "&choice"=="QMEMBIST_CLKOFF0"
(
  per.view hwioreg.per "QMEMBIST,QMEMBIST_CLKOFF0"
)
if "&choice"=="RXA2D_GPR_A1"
(
  per.view hwioreg.per "RXADC_WRAPPER,RXA2D_GPR_A1"
)
if "&choice"=="RXA2D_DDO"
(
  per.view hwioreg.per "RXADC_WRAPPER,RXA2D_DDO"
)
if "&choice"=="RXA2D_EN"
(
  per.view hwioreg.per "RXADC_WRAPPER,RXA2D_EN"
)
if "&choice"=="RXA2D_CONF"
(
  per.view hwioreg.per "RXADC_WRAPPER,RXA2D_CONF"
)
if "&choice"=="RXA2D_CLK"
(
  per.view hwioreg.per "RXADC_WRAPPER,RXA2D_CLK"
)
if "&choice"=="RXA2D_CLK_HDRV"
(
  per.view hwioreg.per "RXADC_WRAPPER,RXA2D_CLK_HDRV"
)
if "&choice"=="RXA2D_CM1"
(
  per.view hwioreg.per "RXADC_WRAPPER,RXA2D_CM1"
)
if "&choice"=="RXA2D_BOOST"
(
  per.view hwioreg.per "RXADC_WRAPPER,RXA2D_BOOST"
)
if "&choice"=="RXA2D_I1"
(
  per.view hwioreg.per "RXADC_WRAPPER,RXA2D_I1"
)
if "&choice"=="RXA2D_I2"
(
  per.view hwioreg.per "RXADC_WRAPPER,RXA2D_I2"
)
if "&choice"=="RXA2D_I3"
(
  per.view hwioreg.per "RXADC_WRAPPER,RXA2D_I3"
)
if "&choice"=="RXA2D_TMUX"
(
  per.view hwioreg.per "RXADC_WRAPPER,RXA2D_TMUX"
)
if "&choice"=="RXA2D_CMP"
(
  per.view hwioreg.per "RXADC_WRAPPER,RXA2D_CMP"
)
if "&choice"=="RXA2D_AAF"
(
  per.view hwioreg.per "RXADC_WRAPPER,RXA2D_AAF"
)
if "&choice"=="RX_AGC0_RESET"
(
  per.view hwioreg.per "RXF,RXF_AGC,RX_AGC0_RESET"
)
if "&choice"=="RX_AGC1_RESET"
(
  per.view hwioreg.per "RXF,RXF_AGC,RX_AGC1_RESET"
)
if "&choice"=="RX_AGC0_MODE_SEL"
(
  per.view hwioreg.per "RXF,RXF_AGC,RX_AGC0_MODE_SEL"
)
if "&choice"=="RX_AGC1_MODE_SEL"
(
  per.view hwioreg.per "RXF,RXF_AGC,RX_AGC1_MODE_SEL"
)
if "&choice"=="RX_AGC0_LGLUT_LVAL"
(
  per.view hwioreg.per "RXF,RXF_AGC,RX_AGC0_LGLUT_LVAL"
)
if "&choice"=="RX_AGC1_LGLUT_LVAL"
(
  per.view hwioreg.per "RXF,RXF_AGC,RX_AGC1_LGLUT_LVAL"
)
if "&choice"=="RX_AGC0_LGLUT_HVAL"
(
  per.view hwioreg.per "RXF,RXF_AGC,RX_AGC0_LGLUT_HVAL"
)
if "&choice"=="RX_AGC1_LGLUT_HVAL"
(
  per.view hwioreg.per "RXF,RXF_AGC,RX_AGC1_LGLUT_HVAL"
)
if "&choice"=="RX_AGC0_GAIN_CTL"
(
  per.view hwioreg.per "RXF,RXF_AGC,RX_AGC0_GAIN_CTL"
)
if "&choice"=="RX_AGC1_GAIN_CTL"
(
  per.view hwioreg.per "RXF,RXF_AGC,RX_AGC1_GAIN_CTL"
)
if "&choice"=="RX_AGC0_LNA_CTL"
(
  per.view hwioreg.per "RXF,RXF_AGC,RX_AGC0_LNA_CTL"
)
if "&choice"=="RX_AGC1_LNA_CTL"
(
  per.view hwioreg.per "RXF,RXF_AGC,RX_AGC1_LNA_CTL"
)
if "&choice"=="RX_AGC0_LNA_DATA"
(
  per.view hwioreg.per "RXF,RXF_AGC,RX_AGC0_LNA_DATA"
)
if "&choice"=="RX_AGC1_LNA_DATA"
(
  per.view hwioreg.per "RXF,RXF_AGC,RX_AGC1_LNA_DATA"
)
if "&choice"=="RX_AGC0_VALUE_WR"
(
  per.view hwioreg.per "RXF,RXF_AGC,RX_AGC0_VALUE_WR"
)
if "&choice"=="RX_AGC1_VALUE_WR"
(
  per.view hwioreg.per "RXF,RXF_AGC,RX_AGC1_VALUE_WR"
)
if "&choice"=="RX_AGC0_LNA_FILT_WR"
(
  per.view hwioreg.per "RXF,RXF_AGC,RX_AGC0_LNA_FILT_WR"
)
if "&choice"=="RX_AGC1_LNA_FILT_WR"
(
  per.view hwioreg.per "RXF,RXF_AGC,RX_AGC1_LNA_FILT_WR"
)
if "&choice"=="RX_AGC0_DC_GAIN"
(
  per.view hwioreg.per "RXF,RXF_AGC,RX_AGC0_DC_GAIN"
)
if "&choice"=="RX_AGC1_DC_GAIN"
(
  per.view hwioreg.per "RXF,RXF_AGC,RX_AGC1_DC_GAIN"
)
if "&choice"=="RX_AGC0_VALUE_1_MIN"
(
  per.view hwioreg.per "RXF,RXF_AGC,RX_AGC0_VALUE_1_MIN"
)
if "&choice"=="RX_AGC0_VALUE_2_MIN"
(
  per.view hwioreg.per "RXF,RXF_AGC,RX_AGC0_VALUE_2_MIN"
)
if "&choice"=="RX_AGC0_VALUE_3_MIN"
(
  per.view hwioreg.per "RXF,RXF_AGC,RX_AGC0_VALUE_3_MIN"
)
if "&choice"=="RX_AGC0_VALUE_4_MIN"
(
  per.view hwioreg.per "RXF,RXF_AGC,RX_AGC0_VALUE_4_MIN"
)
if "&choice"=="RX_AGC1_VALUE_1_MIN"
(
  per.view hwioreg.per "RXF,RXF_AGC,RX_AGC1_VALUE_1_MIN"
)
if "&choice"=="RX_AGC1_VALUE_2_MIN"
(
  per.view hwioreg.per "RXF,RXF_AGC,RX_AGC1_VALUE_2_MIN"
)
if "&choice"=="RX_AGC1_VALUE_3_MIN"
(
  per.view hwioreg.per "RXF,RXF_AGC,RX_AGC1_VALUE_3_MIN"
)
if "&choice"=="RX_AGC1_VALUE_4_MIN"
(
  per.view hwioreg.per "RXF,RXF_AGC,RX_AGC1_VALUE_4_MIN"
)
if "&choice"=="RX_AGC0_VALUE_MAX"
(
  per.view hwioreg.per "RXF,RXF_AGC,RX_AGC0_VALUE_MAX"
)
if "&choice"=="RX_AGC1_VALUE_MAX"
(
  per.view hwioreg.per "RXF,RXF_AGC,RX_AGC1_VALUE_MAX"
)
if "&choice"=="RX_AGC0_IM_LEVEL1"
(
  per.view hwioreg.per "RXF,RXF_AGC,RX_AGC0_IM_LEVEL1"
)
if "&choice"=="RX_AGC0_IM_LEVEL2"
(
  per.view hwioreg.per "RXF,RXF_AGC,RX_AGC0_IM_LEVEL2"
)
if "&choice"=="RX_AGC0_IM_LEVEL3"
(
  per.view hwioreg.per "RXF,RXF_AGC,RX_AGC0_IM_LEVEL3"
)
if "&choice"=="RX_AGC0_IM_LEVEL4"
(
  per.view hwioreg.per "RXF,RXF_AGC,RX_AGC0_IM_LEVEL4"
)
if "&choice"=="RX_AGC1_IM_LEVEL1"
(
  per.view hwioreg.per "RXF,RXF_AGC,RX_AGC1_IM_LEVEL1"
)
if "&choice"=="RX_AGC1_IM_LEVEL2"
(
  per.view hwioreg.per "RXF,RXF_AGC,RX_AGC1_IM_LEVEL2"
)
if "&choice"=="RX_AGC1_IM_LEVEL3"
(
  per.view hwioreg.per "RXF,RXF_AGC,RX_AGC1_IM_LEVEL3"
)
if "&choice"=="RX_AGC1_IM_LEVEL4"
(
  per.view hwioreg.per "RXF,RXF_AGC,RX_AGC1_IM_LEVEL4"
)
if "&choice"=="RX_AGC0_LNA_1_FALL"
(
  per.view hwioreg.per "RXF,RXF_AGC,RX_AGC0_LNA_1_FALL"
)
if "&choice"=="RX_AGC0_LNA_2_FALL"
(
  per.view hwioreg.per "RXF,RXF_AGC,RX_AGC0_LNA_2_FALL"
)
if "&choice"=="RX_AGC0_LNA_3_FALL"
(
  per.view hwioreg.per "RXF,RXF_AGC,RX_AGC0_LNA_3_FALL"
)
if "&choice"=="RX_AGC0_LNA_4_FALL"
(
  per.view hwioreg.per "RXF,RXF_AGC,RX_AGC0_LNA_4_FALL"
)
if "&choice"=="RX_AGC1_LNA_1_FALL"
(
  per.view hwioreg.per "RXF,RXF_AGC,RX_AGC1_LNA_1_FALL"
)
if "&choice"=="RX_AGC1_LNA_2_FALL"
(
  per.view hwioreg.per "RXF,RXF_AGC,RX_AGC1_LNA_2_FALL"
)
if "&choice"=="RX_AGC1_LNA_3_FALL"
(
  per.view hwioreg.per "RXF,RXF_AGC,RX_AGC1_LNA_3_FALL"
)
if "&choice"=="RX_AGC1_LNA_4_FALL"
(
  per.view hwioreg.per "RXF,RXF_AGC,RX_AGC1_LNA_4_FALL"
)
if "&choice"=="RX_AGC0_LNA_1_RISE"
(
  per.view hwioreg.per "RXF,RXF_AGC,RX_AGC0_LNA_1_RISE"
)
if "&choice"=="RX_AGC0_LNA_2_RISE"
(
  per.view hwioreg.per "RXF,RXF_AGC,RX_AGC0_LNA_2_RISE"
)
if "&choice"=="RX_AGC0_LNA_3_RISE"
(
  per.view hwioreg.per "RXF,RXF_AGC,RX_AGC0_LNA_3_RISE"
)
if "&choice"=="RX_AGC0_LNA_4_RISE"
(
  per.view hwioreg.per "RXF,RXF_AGC,RX_AGC0_LNA_4_RISE"
)
if "&choice"=="RX_AGC1_LNA_1_RISE"
(
  per.view hwioreg.per "RXF,RXF_AGC,RX_AGC1_LNA_1_RISE"
)
if "&choice"=="RX_AGC1_LNA_2_RISE"
(
  per.view hwioreg.per "RXF,RXF_AGC,RX_AGC1_LNA_2_RISE"
)
if "&choice"=="RX_AGC1_LNA_3_RISE"
(
  per.view hwioreg.per "RXF,RXF_AGC,RX_AGC1_LNA_3_RISE"
)
if "&choice"=="RX_AGC1_LNA_4_RISE"
(
  per.view hwioreg.per "RXF,RXF_AGC,RX_AGC1_LNA_4_RISE"
)
if "&choice"=="RX_AGC0_LNA_1_OFFSET"
(
  per.view hwioreg.per "RXF,RXF_AGC,RX_AGC0_LNA_1_OFFSET"
)
if "&choice"=="RX_AGC0_LNA_2_OFFSET"
(
  per.view hwioreg.per "RXF,RXF_AGC,RX_AGC0_LNA_2_OFFSET"
)
if "&choice"=="RX_AGC0_LNA_3_OFFSET"
(
  per.view hwioreg.per "RXF,RXF_AGC,RX_AGC0_LNA_3_OFFSET"
)
if "&choice"=="RX_AGC0_LNA_4_OFFSET"
(
  per.view hwioreg.per "RXF,RXF_AGC,RX_AGC0_LNA_4_OFFSET"
)
if "&choice"=="RX_AGC1_LNA_1_OFFSET"
(
  per.view hwioreg.per "RXF,RXF_AGC,RX_AGC1_LNA_1_OFFSET"
)
if "&choice"=="RX_AGC1_LNA_2_OFFSET"
(
  per.view hwioreg.per "RXF,RXF_AGC,RX_AGC1_LNA_2_OFFSET"
)
if "&choice"=="RX_AGC1_LNA_3_OFFSET"
(
  per.view hwioreg.per "RXF,RXF_AGC,RX_AGC1_LNA_3_OFFSET"
)
if "&choice"=="RX_AGC1_LNA_4_OFFSET"
(
  per.view hwioreg.per "RXF,RXF_AGC,RX_AGC1_LNA_4_OFFSET"
)
if "&choice"=="RX_AGC0_LNA_BP_TIMER_0"
(
  per.view hwioreg.per "RXF,RXF_AGC,RX_AGC0_LNA_BP_TIMER_0"
)
if "&choice"=="RX_AGC0_LNA_BP_TIMER_1"
(
  per.view hwioreg.per "RXF,RXF_AGC,RX_AGC0_LNA_BP_TIMER_1"
)
if "&choice"=="RX_AGC0_LNA_BP_TIMER_2"
(
  per.view hwioreg.per "RXF,RXF_AGC,RX_AGC0_LNA_BP_TIMER_2"
)
if "&choice"=="RX_AGC0_LNA_BP_TIMER_3"
(
  per.view hwioreg.per "RXF,RXF_AGC,RX_AGC0_LNA_BP_TIMER_3"
)
if "&choice"=="RX_AGC1_LNA_BP_TIMER_0"
(
  per.view hwioreg.per "RXF,RXF_AGC,RX_AGC1_LNA_BP_TIMER_0"
)
if "&choice"=="RX_AGC1_LNA_BP_TIMER_1"
(
  per.view hwioreg.per "RXF,RXF_AGC,RX_AGC1_LNA_BP_TIMER_1"
)
if "&choice"=="RX_AGC1_LNA_BP_TIMER_2"
(
  per.view hwioreg.per "RXF,RXF_AGC,RX_AGC1_LNA_BP_TIMER_2"
)
if "&choice"=="RX_AGC1_LNA_BP_TIMER_3"
(
  per.view hwioreg.per "RXF,RXF_AGC,RX_AGC1_LNA_BP_TIMER_3"
)
if "&choice"=="RX_AGC0_LNA_NBP_TIMER_0"
(
  per.view hwioreg.per "RXF,RXF_AGC,RX_AGC0_LNA_NBP_TIMER_0"
)
if "&choice"=="RX_AGC0_LNA_NBP_TIMER_1"
(
  per.view hwioreg.per "RXF,RXF_AGC,RX_AGC0_LNA_NBP_TIMER_1"
)
if "&choice"=="RX_AGC0_LNA_NBP_TIMER_2"
(
  per.view hwioreg.per "RXF,RXF_AGC,RX_AGC0_LNA_NBP_TIMER_2"
)
if "&choice"=="RX_AGC0_LNA_NBP_TIMER_3"
(
  per.view hwioreg.per "RXF,RXF_AGC,RX_AGC0_LNA_NBP_TIMER_3"
)
if "&choice"=="RX_AGC1_LNA_NBP_TIMER_0"
(
  per.view hwioreg.per "RXF,RXF_AGC,RX_AGC1_LNA_NBP_TIMER_0"
)
if "&choice"=="RX_AGC1_LNA_NBP_TIMER_1"
(
  per.view hwioreg.per "RXF,RXF_AGC,RX_AGC1_LNA_NBP_TIMER_1"
)
if "&choice"=="RX_AGC1_LNA_NBP_TIMER_2"
(
  per.view hwioreg.per "RXF,RXF_AGC,RX_AGC1_LNA_NBP_TIMER_2"
)
if "&choice"=="RX_AGC1_LNA_NBP_TIMER_3"
(
  per.view hwioreg.per "RXF,RXF_AGC,RX_AGC1_LNA_NBP_TIMER_3"
)
if "&choice"=="RX_AGC0_LNA_RANGE_DELAY"
(
  per.view hwioreg.per "RXF,RXF_AGC,RX_AGC0_LNA_RANGE_DELAY"
)
if "&choice"=="RX_AGC1_LNA_RANGE_DELAY"
(
  per.view hwioreg.per "RXF,RXF_AGC,RX_AGC1_LNA_RANGE_DELAY"
)
if "&choice"=="RX_AGC0_SBI_CTL"
(
  per.view hwioreg.per "RXF,RXF_AGC,RX_AGC0_SBI_CTL"
)
if "&choice"=="RX_AGC1_SBI_CTL"
(
  per.view hwioreg.per "RXF,RXF_AGC,RX_AGC1_SBI_CTL"
)
if "&choice"=="RX_AGC0_SBI_ID"
(
  per.view hwioreg.per "RXF,RXF_AGC,RX_AGC0_SBI_ID"
)
if "&choice"=="RX_AGC1_SBI_ID"
(
  per.view hwioreg.per "RXF,RXF_AGC,RX_AGC1_SBI_ID"
)
if "&choice"=="RX_AGC0_SBI_ADDR"
(
  per.view hwioreg.per "RXF,RXF_AGC,RX_AGC0_SBI_ADDR"
)
if "&choice"=="RX_AGC1_SBI_ADDR"
(
  per.view hwioreg.per "RXF,RXF_AGC,RX_AGC1_SBI_ADDR"
)
if "&choice"=="RX_AGC0_SBI_DATA0"
(
  per.view hwioreg.per "RXF,RXF_AGC,RX_AGC0_SBI_DATA0"
)
if "&choice"=="RX_AGC1_SBI_DATA0"
(
  per.view hwioreg.per "RXF,RXF_AGC,RX_AGC1_SBI_DATA0"
)
if "&choice"=="RX_AGC0_SBI_DATA1"
(
  per.view hwioreg.per "RXF,RXF_AGC,RX_AGC0_SBI_DATA1"
)
if "&choice"=="RX_AGC1_SBI_DATA1"
(
  per.view hwioreg.per "RXF,RXF_AGC,RX_AGC1_SBI_DATA1"
)
if "&choice"=="RX_AGC0_VREF_DELAY_TIMER"
(
  per.view hwioreg.per "RXF,RXF_AGC,RX_AGC0_VREF_DELAY_TIMER"
)
if "&choice"=="RX_AGC1_VREF_DELAY_TIMER"
(
  per.view hwioreg.per "RXF,RXF_AGC,RX_AGC1_VREF_DELAY_TIMER"
)
if "&choice"=="RX_AGC0_VREF_VAL"
(
  per.view hwioreg.per "RXF,RXF_AGC,RX_AGC0_VREF_VAL"
)
if "&choice"=="RX_AGC1_VREF_VAL"
(
  per.view hwioreg.per "RXF,RXF_AGC,RX_AGC1_VREF_VAL"
)
if "&choice"=="RX_AGC0_TEST_CTL"
(
  per.view hwioreg.per "RXF,RXF_AGC,RX_AGC0_TEST_CTL"
)
if "&choice"=="RX_AGC1_TEST_CTL"
(
  per.view hwioreg.per "RXF,RXF_AGC,RX_AGC1_TEST_CTL"
)
if "&choice"=="RX_AGC0_1X_VALUE_RD"
(
  per.view hwioreg.per "RXF,RXF_AGC,RX_AGC0_1X_VALUE_RD"
)
if "&choice"=="RX_AGC1_1X_VALUE_RD"
(
  per.view hwioreg.per "RXF,RXF_AGC,RX_AGC1_1X_VALUE_RD"
)
if "&choice"=="RX_AGC0_HDR_VALUE_RD"
(
  per.view hwioreg.per "RXF,RXF_AGC,RX_AGC0_HDR_VALUE_RD"
)
if "&choice"=="RX_AGC1_HDR_VALUE_RD"
(
  per.view hwioreg.per "RXF,RXF_AGC,RX_AGC1_HDR_VALUE_RD"
)
if "&choice"=="RX_AGC0_1X_VGA_GAIN_RD"
(
  per.view hwioreg.per "RXF,RXF_AGC,RX_AGC0_1X_VGA_GAIN_RD"
)
if "&choice"=="RX_AGC1_1X_VGA_GAIN_RD"
(
  per.view hwioreg.per "RXF,RXF_AGC,RX_AGC1_1X_VGA_GAIN_RD"
)
if "&choice"=="RX_AGC0_HDR_VGA_GAIN_RD"
(
  per.view hwioreg.per "RXF,RXF_AGC,RX_AGC0_HDR_VGA_GAIN_RD"
)
if "&choice"=="RX_AGC1_HDR_VGA_GAIN_RD"
(
  per.view hwioreg.per "RXF,RXF_AGC,RX_AGC1_HDR_VGA_GAIN_RD"
)
if "&choice"=="RX_AGC0_LNA_FILT_RD"
(
  per.view hwioreg.per "RXF,RXF_AGC,RX_AGC0_LNA_FILT_RD"
)
if "&choice"=="RX_AGC1_LNA_FILT_RD"
(
  per.view hwioreg.per "RXF,RXF_AGC,RX_AGC1_LNA_FILT_RD"
)
if "&choice"=="RX_AGC0_LNA_RANGE_RD"
(
  per.view hwioreg.per "RXF,RXF_AGC,RX_AGC0_LNA_RANGE_RD"
)
if "&choice"=="RXF_SRC0_RESET"
(
  per.view hwioreg.per "RXF,RXF_SRC_RF,RXF_SRC0_RESET"
)
if "&choice"=="RXF_SRC1_RESET"
(
  per.view hwioreg.per "RXF,RXF_SRC_RF,RXF_SRC1_RESET"
)
if "&choice"=="RXF_SRC0_CTL"
(
  per.view hwioreg.per "RXF,RXF_SRC_RF,RXF_SRC0_CTL"
)
if "&choice"=="RXF_SRC1_CTL"
(
  per.view hwioreg.per "RXF,RXF_SRC_RF,RXF_SRC1_CTL"
)
if "&choice"=="RXF_SRC0_PHASE_DEL"
(
  per.view hwioreg.per "RXF,RXF_SRC_RF,RXF_SRC0_PHASE_DEL"
)
if "&choice"=="RXF_SRC1_PHASE_DEL"
(
  per.view hwioreg.per "RXF,RXF_SRC_RF,RXF_SRC1_PHASE_DEL"
)
if "&choice"=="RXF_SRC0_LNA_S0_PHASE_OFFSET"
(
  per.view hwioreg.per "RXF,RXF_SRC_RF,RXF_SRC0_LNA_S0_PHASE_OFFSET"
)
if "&choice"=="RXF_SRC1_LNA_S0_PHASE_OFFSET"
(
  per.view hwioreg.per "RXF,RXF_SRC_RF,RXF_SRC1_LNA_S0_PHASE_OFFSET"
)
if "&choice"=="RXF_SRC0_LNA_S1_PHASE_OFFSET"
(
  per.view hwioreg.per "RXF,RXF_SRC_RF,RXF_SRC0_LNA_S1_PHASE_OFFSET"
)
if "&choice"=="RXF_SRC1_LNA_S1_PHASE_OFFSET"
(
  per.view hwioreg.per "RXF,RXF_SRC_RF,RXF_SRC1_LNA_S1_PHASE_OFFSET"
)
if "&choice"=="RXF_SRC0_LNA_S2_PHASE_OFFSET"
(
  per.view hwioreg.per "RXF,RXF_SRC_RF,RXF_SRC0_LNA_S2_PHASE_OFFSET"
)
if "&choice"=="RXF_SRC1_LNA_S2_PHASE_OFFSET"
(
  per.view hwioreg.per "RXF,RXF_SRC_RF,RXF_SRC1_LNA_S2_PHASE_OFFSET"
)
if "&choice"=="RXF_SRC0_LNA_S3_PHASE_OFFSET"
(
  per.view hwioreg.per "RXF,RXF_SRC_RF,RXF_SRC0_LNA_S3_PHASE_OFFSET"
)
if "&choice"=="RXF_SRC1_LNA_S3_PHASE_OFFSET"
(
  per.view hwioreg.per "RXF,RXF_SRC_RF,RXF_SRC1_LNA_S3_PHASE_OFFSET"
)
if "&choice"=="RXF_SRC0_LNA_S4_PHASE_OFFSET"
(
  per.view hwioreg.per "RXF,RXF_SRC_RF,RXF_SRC0_LNA_S4_PHASE_OFFSET"
)
if "&choice"=="RXF_SRC1_LNA_S4_PHASE_OFFSET"
(
  per.view hwioreg.per "RXF,RXF_SRC_RF,RXF_SRC1_LNA_S4_PHASE_OFFSET"
)
if "&choice"=="RXF_SRC0_BBF_NOTCH0_PARAMS"
(
  per.view hwioreg.per "RXF,RXF_SRC_RF,RXF_SRC0_BBF_NOTCH0_PARAMS"
)
if "&choice"=="RXF_SRC1_BBF_NOTCH0_PARAMS"
(
  per.view hwioreg.per "RXF,RXF_SRC_RF,RXF_SRC1_BBF_NOTCH0_PARAMS"
)
if "&choice"=="RXF_SRC0_BBF_NOTCH1_PARAMS"
(
  per.view hwioreg.per "RXF,RXF_SRC_RF,RXF_SRC0_BBF_NOTCH1_PARAMS"
)
if "&choice"=="RXF_SRC1_BBF_NOTCH1_PARAMS"
(
  per.view hwioreg.per "RXF,RXF_SRC_RF,RXF_SRC1_BBF_NOTCH1_PARAMS"
)
if "&choice"=="RXF_SRC0_BBF_NOTCH2_PARAMS"
(
  per.view hwioreg.per "RXF,RXF_SRC_RF,RXF_SRC0_BBF_NOTCH2_PARAMS"
)
if "&choice"=="RXF_SRC1_BBF_NOTCH2_PARAMS"
(
  per.view hwioreg.per "RXF,RXF_SRC_RF,RXF_SRC1_BBF_NOTCH2_PARAMS"
)
if "&choice"=="RXF_SRC0_MIS_COMP_A_COEFF"
(
  per.view hwioreg.per "RXF,RXF_SRC_RF,RXF_SRC0_MIS_COMP_A_COEFF"
)
if "&choice"=="RXF_SRC1_MIS_COMP_A_COEFF"
(
  per.view hwioreg.per "RXF,RXF_SRC_RF,RXF_SRC1_MIS_COMP_A_COEFF"
)
if "&choice"=="RXF_SRC0_MIS_COMP_B_COEFF"
(
  per.view hwioreg.per "RXF,RXF_SRC_RF,RXF_SRC0_MIS_COMP_B_COEFF"
)
if "&choice"=="RXF_SRC1_MIS_COMP_B_COEFF"
(
  per.view hwioreg.per "RXF,RXF_SRC_RF,RXF_SRC1_MIS_COMP_B_COEFF"
)
if "&choice"=="RXF_SRC0_RESAMP_PHASE_MAP0"
(
  per.view hwioreg.per "RXF,RXF_SRC_RF,RXF_SRC0_RESAMP_PHASE_MAP0"
)
if "&choice"=="RXF_SRC1_RESAMP_PHASE_MAP0"
(
  per.view hwioreg.per "RXF,RXF_SRC_RF,RXF_SRC1_RESAMP_PHASE_MAP0"
)
if "&choice"=="RXF_SRC0_RESAMP_PHASE_MAP1"
(
  per.view hwioreg.per "RXF,RXF_SRC_RF,RXF_SRC0_RESAMP_PHASE_MAP1"
)
if "&choice"=="RXF_SRC1_RESAMP_PHASE_MAP1"
(
  per.view hwioreg.per "RXF,RXF_SRC_RF,RXF_SRC1_RESAMP_PHASE_MAP1"
)
if "&choice"=="RXF_SRC0_RESAMP_PHASE_MAP2"
(
  per.view hwioreg.per "RXF,RXF_SRC_RF,RXF_SRC0_RESAMP_PHASE_MAP2"
)
if "&choice"=="RXF_SRC1_RESAMP_PHASE_MAP2"
(
  per.view hwioreg.per "RXF,RXF_SRC_RF,RXF_SRC1_RESAMP_PHASE_MAP2"
)
if "&choice"=="RXF_SRC0_RESAMP_PHASE_MAP3"
(
  per.view hwioreg.per "RXF,RXF_SRC_RF,RXF_SRC0_RESAMP_PHASE_MAP3"
)
if "&choice"=="RXF_SRC1_RESAMP_PHASE_MAP3"
(
  per.view hwioreg.per "RXF,RXF_SRC_RF,RXF_SRC1_RESAMP_PHASE_MAP3"
)
if "&choice"=="RXF_SRC0_RESAMP_END_CNT"
(
  per.view hwioreg.per "RXF,RXF_SRC_RF,RXF_SRC0_RESAMP_END_CNT"
)
if "&choice"=="RXF_SRC1_RESAMP_END_CNT"
(
  per.view hwioreg.per "RXF,RXF_SRC_RF,RXF_SRC1_RESAMP_END_CNT"
)
if "&choice"=="RXF_SRC0_DVGA_PARAMS"
(
  per.view hwioreg.per "RXF,RXF_SRC_RF,RXF_SRC0_DVGA_PARAMS"
)
if "&choice"=="RXF_SRC1_DVGA_PARAMS"
(
  per.view hwioreg.per "RXF,RXF_SRC_RF,RXF_SRC1_DVGA_PARAMS"
)
if "&choice"=="RXF_SRC0_TEST_BUS_SEL"
(
  per.view hwioreg.per "RXF,RXF_SRC_RF,RXF_SRC0_TEST_BUS_SEL"
)
if "&choice"=="RXF_SRC1_TEST_BUS_SEL"
(
  per.view hwioreg.per "RXF,RXF_SRC_RF,RXF_SRC1_TEST_BUS_SEL"
)
if "&choice"=="RXF_SRC0_CXN_CLK_STATUS"
(
  per.view hwioreg.per "RXF,RXF_SRC_RF,RXF_SRC0_CXN_CLK_STATUS"
)
if "&choice"=="RXF_SRC0_BBF_COEF0"
(
  per.view hwioreg.per "RXF,RXF_SRC_RS,RXF_SRC0_BBF_COEF0"
)
if "&choice"=="RXF_SRC1_BBF_COEF0"
(
  per.view hwioreg.per "RXF,RXF_SRC_RS,RXF_SRC1_BBF_COEF0"
)
if "&choice"=="RXF_SRC0_BBF_COEF1"
(
  per.view hwioreg.per "RXF,RXF_SRC_RS,RXF_SRC0_BBF_COEF1"
)
if "&choice"=="RXF_SRC1_BBF_COEF1"
(
  per.view hwioreg.per "RXF,RXF_SRC_RS,RXF_SRC1_BBF_COEF1"
)
if "&choice"=="RXF_SRC0_BBF_COEF_NOTCH0"
(
  per.view hwioreg.per "RXF,RXF_SRC_RS,RXF_SRC0_BBF_COEF_NOTCH0"
)
if "&choice"=="RXF_SRC1_BBF_COEF_NOTCH0"
(
  per.view hwioreg.per "RXF,RXF_SRC_RS,RXF_SRC1_BBF_COEF_NOTCH0"
)
if "&choice"=="RXF_SRC0_BBF_COEF_NOTCH1"
(
  per.view hwioreg.per "RXF,RXF_SRC_RS,RXF_SRC0_BBF_COEF_NOTCH1"
)
if "&choice"=="RXF_SRC1_BBF_COEF_NOTCH1"
(
  per.view hwioreg.per "RXF,RXF_SRC_RS,RXF_SRC1_BBF_COEF_NOTCH1"
)
if "&choice"=="RXF_SRC0_BBF_COEF_NOTCH2"
(
  per.view hwioreg.per "RXF,RXF_SRC_RS,RXF_SRC0_BBF_COEF_NOTCH2"
)
if "&choice"=="RXF_SRC1_BBF_COEF_NOTCH2"
(
  per.view hwioreg.per "RXF,RXF_SRC_RS,RXF_SRC1_BBF_COEF_NOTCH2"
)
if "&choice"=="RXF_SRC0_OFFSET_CTL"
(
  per.view hwioreg.per "RXF,RXF_SRC_RS,RXF_SRC0_OFFSET_CTL"
)
if "&choice"=="RXF_SRC1_OFFSET_CTL"
(
  per.view hwioreg.per "RXF,RXF_SRC_RS,RXF_SRC1_OFFSET_CTL"
)
if "&choice"=="RXF_SRC0_DACC_CTL"
(
  per.view hwioreg.per "RXF,RXF_SRC_RS,RXF_SRC0_DACC_CTL"
)
if "&choice"=="RXF_SRC1_DACC_CTL"
(
  per.view hwioreg.per "RXF,RXF_SRC_RS,RXF_SRC1_DACC_CTL"
)
if "&choice"=="RXF_SRC0_FG_IOFFSET"
(
  per.view hwioreg.per "RXF,RXF_SRC_RS,RXF_SRC0_FG_IOFFSET"
)
if "&choice"=="RXF_SRC1_FG_IOFFSET"
(
  per.view hwioreg.per "RXF,RXF_SRC_RS,RXF_SRC1_FG_IOFFSET"
)
if "&choice"=="RXF_SRC0_FG_QOFFSET"
(
  per.view hwioreg.per "RXF,RXF_SRC_RS,RXF_SRC0_FG_QOFFSET"
)
if "&choice"=="RXF_SRC1_FG_QOFFSET"
(
  per.view hwioreg.per "RXF,RXF_SRC_RS,RXF_SRC1_FG_QOFFSET"
)
if "&choice"=="RXF_SRC0_DC_IOFFSET_ADJ"
(
  per.view hwioreg.per "RXF,RXF_SRC_RS,RXF_SRC0_DC_IOFFSET_ADJ"
)
if "&choice"=="RXF_SRC1_DC_IOFFSET_ADJ"
(
  per.view hwioreg.per "RXF,RXF_SRC_RS,RXF_SRC1_DC_IOFFSET_ADJ"
)
if "&choice"=="RXF_SRC0_DC_QOFFSET_ADJ"
(
  per.view hwioreg.per "RXF,RXF_SRC_RS,RXF_SRC0_DC_QOFFSET_ADJ"
)
if "&choice"=="RXF_SRC1_DC_QOFFSET_ADJ"
(
  per.view hwioreg.per "RXF,RXF_SRC_RS,RXF_SRC1_DC_QOFFSET_ADJ"
)
if "&choice"=="RXF_SRC0_DACC_ACQ_TIMER"
(
  per.view hwioreg.per "RXF,RXF_SRC_RS,RXF_SRC0_DACC_ACQ_TIMER"
)
if "&choice"=="RXF_SRC1_DACC_ACQ_TIMER"
(
  per.view hwioreg.per "RXF,RXF_SRC_RS,RXF_SRC1_DACC_ACQ_TIMER"
)
if "&choice"=="RXF_SRC0_DACC_TRC_TIMER"
(
  per.view hwioreg.per "RXF,RXF_SRC_RS,RXF_SRC0_DACC_TRC_TIMER"
)
if "&choice"=="RXF_SRC1_DACC_TRC_TIMER"
(
  per.view hwioreg.per "RXF,RXF_SRC_RS,RXF_SRC1_DACC_TRC_TIMER"
)
if "&choice"=="RXF_SRC0_DACC_CLR_TIMER"
(
  per.view hwioreg.per "RXF,RXF_SRC_RS,RXF_SRC0_DACC_CLR_TIMER"
)
if "&choice"=="RXF_SRC1_DACC_CLR_TIMER"
(
  per.view hwioreg.per "RXF,RXF_SRC_RS,RXF_SRC1_DACC_CLR_TIMER"
)
if "&choice"=="RXF_SRC0_DACC_EST_THRESH"
(
  per.view hwioreg.per "RXF,RXF_SRC_RS,RXF_SRC0_DACC_EST_THRESH"
)
if "&choice"=="RXF_SRC1_DACC_EST_THRESH"
(
  per.view hwioreg.per "RXF,RXF_SRC_RS,RXF_SRC1_DACC_EST_THRESH"
)
if "&choice"=="RXF_SRC0_DACC_EST_IOFFSET"
(
  per.view hwioreg.per "RXF,RXF_SRC_RS,RXF_SRC0_DACC_EST_IOFFSET"
)
if "&choice"=="RXF_SRC1_DACC_EST_IOFFSET"
(
  per.view hwioreg.per "RXF,RXF_SRC_RS,RXF_SRC1_DACC_EST_IOFFSET"
)
if "&choice"=="RXF_SRC0_DACC_EST_QOFFSET"
(
  per.view hwioreg.per "RXF,RXF_SRC_RS,RXF_SRC0_DACC_EST_QOFFSET"
)
if "&choice"=="RXF_SRC1_DACC_EST_QOFFSET"
(
  per.view hwioreg.per "RXF,RXF_SRC_RS,RXF_SRC1_DACC_EST_QOFFSET"
)
if "&choice"=="RXF_SRC0_DACC_IACCUM0"
(
  per.view hwioreg.per "RXF,RXF_SRC_RS,RXF_SRC0_DACC_IACCUM0"
)
if "&choice"=="RXF_SRC1_DACC_IACCUM0"
(
  per.view hwioreg.per "RXF,RXF_SRC_RS,RXF_SRC1_DACC_IACCUM0"
)
if "&choice"=="RXF_SRC0_DACC_IACCUM1"
(
  per.view hwioreg.per "RXF,RXF_SRC_RS,RXF_SRC0_DACC_IACCUM1"
)
if "&choice"=="RXF_SRC1_DACC_IACCUM1"
(
  per.view hwioreg.per "RXF,RXF_SRC_RS,RXF_SRC1_DACC_IACCUM1"
)
if "&choice"=="RXF_SRC0_DACC_IACCUM2"
(
  per.view hwioreg.per "RXF,RXF_SRC_RS,RXF_SRC0_DACC_IACCUM2"
)
if "&choice"=="RXF_SRC1_DACC_IACCUM2"
(
  per.view hwioreg.per "RXF,RXF_SRC_RS,RXF_SRC1_DACC_IACCUM2"
)
if "&choice"=="RXF_SRC0_DACC_IACCUM3"
(
  per.view hwioreg.per "RXF,RXF_SRC_RS,RXF_SRC0_DACC_IACCUM3"
)
if "&choice"=="RXF_SRC1_DACC_IACCUM3"
(
  per.view hwioreg.per "RXF,RXF_SRC_RS,RXF_SRC1_DACC_IACCUM3"
)
if "&choice"=="RXF_SRC0_DACC_IACCUM4"
(
  per.view hwioreg.per "RXF,RXF_SRC_RS,RXF_SRC0_DACC_IACCUM4"
)
if "&choice"=="RXF_SRC1_DACC_IACCUM4"
(
  per.view hwioreg.per "RXF,RXF_SRC_RS,RXF_SRC1_DACC_IACCUM4"
)
if "&choice"=="RXF_SRC0_DACC_QACCUM0"
(
  per.view hwioreg.per "RXF,RXF_SRC_RS,RXF_SRC0_DACC_QACCUM0"
)
if "&choice"=="RXF_SRC1_DACC_QACCUM0"
(
  per.view hwioreg.per "RXF,RXF_SRC_RS,RXF_SRC1_DACC_QACCUM0"
)
if "&choice"=="RXF_SRC0_DACC_QACCUM1"
(
  per.view hwioreg.per "RXF,RXF_SRC_RS,RXF_SRC0_DACC_QACCUM1"
)
if "&choice"=="RXF_SRC1_DACC_QACCUM1"
(
  per.view hwioreg.per "RXF,RXF_SRC_RS,RXF_SRC1_DACC_QACCUM1"
)
if "&choice"=="RXF_SRC0_DACC_QACCUM2"
(
  per.view hwioreg.per "RXF,RXF_SRC_RS,RXF_SRC0_DACC_QACCUM2"
)
if "&choice"=="RXF_SRC1_DACC_QACCUM2"
(
  per.view hwioreg.per "RXF,RXF_SRC_RS,RXF_SRC1_DACC_QACCUM2"
)
if "&choice"=="RXF_SRC0_DACC_QACCUM3"
(
  per.view hwioreg.per "RXF,RXF_SRC_RS,RXF_SRC0_DACC_QACCUM3"
)
if "&choice"=="RXF_SRC1_DACC_QACCUM3"
(
  per.view hwioreg.per "RXF,RXF_SRC_RS,RXF_SRC1_DACC_QACCUM3"
)
if "&choice"=="RXF_SRC0_DACC_QACCUM4"
(
  per.view hwioreg.per "RXF,RXF_SRC_RS,RXF_SRC0_DACC_QACCUM4"
)
if "&choice"=="RXF_SRC1_DACC_QACCUM4"
(
  per.view hwioreg.per "RXF,RXF_SRC_RS,RXF_SRC1_DACC_QACCUM4"
)
if "&choice"=="RXF_SRC0_MICRO_DACC_UPDATE"
(
  per.view hwioreg.per "RXF,RXF_SRC_RS,RXF_SRC0_MICRO_DACC_UPDATE"
)
if "&choice"=="RXF_SRC1_MICRO_DACC_UPDATE"
(
  per.view hwioreg.per "RXF,RXF_SRC_RS,RXF_SRC1_MICRO_DACC_UPDATE"
)
if "&choice"=="RXF_SRC0_DACC_SSBI_INFO"
(
  per.view hwioreg.per "RXF,RXF_SRC_RS,RXF_SRC0_DACC_SSBI_INFO"
)
if "&choice"=="RXF_SRC1_DACC_SSBI_INFO"
(
  per.view hwioreg.per "RXF,RXF_SRC_RS,RXF_SRC1_DACC_SSBI_INFO"
)
if "&choice"=="RXF_SRC0_DACC_GAIN_MULT"
(
  per.view hwioreg.per "RXF,RXF_SRC_RS,RXF_SRC0_DACC_GAIN_MULT"
)
if "&choice"=="RXF_SRC1_DACC_GAIN_MULT"
(
  per.view hwioreg.per "RXF,RXF_SRC_RS,RXF_SRC1_DACC_GAIN_MULT"
)
if "&choice"=="RXF_SRC0_NOTCH_CFG"
(
  per.view hwioreg.per "RXF,RXF_SRC_RS,RXF_SRC0_NOTCH_CFG"
)
if "&choice"=="RXF_SRC1_NOTCH_CFG"
(
  per.view hwioreg.per "RXF,RXF_SRC_RS,RXF_SRC1_NOTCH_CFG"
)
if "&choice"=="RXF_SRC0_MICRO_SYNC_CMD"
(
  per.view hwioreg.per "RXF,RXF_SRC_RS,RXF_SRC0_MICRO_SYNC_CMD"
)
if "&choice"=="RXF_SRC1_MICRO_SYNC_CMD"
(
  per.view hwioreg.per "RXF,RXF_SRC_RS,RXF_SRC1_MICRO_SYNC_CMD"
)
if "&choice"=="RXF_SRC0_ARM_IRQ_STATUS"
(
  per.view hwioreg.per "RXF,RXF_SRC_RS,RXF_SRC0_ARM_IRQ_STATUS"
)
if "&choice"=="MCI_POWER"
(
  per.view hwioreg.per "SDCC,MCI_POWER"
)
if "&choice"=="MCI_CLK"
(
  per.view hwioreg.per "SDCC,MCI_CLK"
)
if "&choice"=="MCI_ARGUMENT"
(
  per.view hwioreg.per "SDCC,MCI_ARGUMENT"
)
if "&choice"=="MCI_CMD"
(
  per.view hwioreg.per "SDCC,MCI_CMD"
)
if "&choice"=="MCI_RESP_CMD"
(
  per.view hwioreg.per "SDCC,MCI_RESP_CMD"
)
if "&choice"=="MCI_RESP0"
(
  per.view hwioreg.per "SDCC,MCI_RESP0"
)
if "&choice"=="MCI_RESP1"
(
  per.view hwioreg.per "SDCC,MCI_RESP1"
)
if "&choice"=="MCI_RESP2"
(
  per.view hwioreg.per "SDCC,MCI_RESP2"
)
if "&choice"=="MCI_RESP3"
(
  per.view hwioreg.per "SDCC,MCI_RESP3"
)
if "&choice"=="MCI_DATA_TIMER"
(
  per.view hwioreg.per "SDCC,MCI_DATA_TIMER"
)
if "&choice"=="MCI_DATA_LENGTH"
(
  per.view hwioreg.per "SDCC,MCI_DATA_LENGTH"
)
if "&choice"=="MCI_DATA_CTL"
(
  per.view hwioreg.per "SDCC,MCI_DATA_CTL"
)
if "&choice"=="MCI_DATA_COUNT"
(
  per.view hwioreg.per "SDCC,MCI_DATA_COUNT"
)
if "&choice"=="MCI_STATUS"
(
  per.view hwioreg.per "SDCC,MCI_STATUS"
)
if "&choice"=="MCI_CLEAR"
(
  per.view hwioreg.per "SDCC,MCI_CLEAR"
)
if "&choice"=="MCI_INT_MASK0"
(
  per.view hwioreg.per "SDCC,MCI_INT_MASK0"
)
if "&choice"=="MCI_INT_MASK1"
(
  per.view hwioreg.per "SDCC,MCI_INT_MASK1"
)
if "&choice"=="MCI_FIFO_COUNT"
(
  per.view hwioreg.per "SDCC,MCI_FIFO_COUNT"
)
if "&choice"=="MCI_FIFO"
(
  per.view hwioreg.per "SDCC,MCI_FIFO"
)
if "&choice"=="MCI_ABORT"
(
  per.view hwioreg.per "SDCC,MCI_ABORT"
)
if "&choice"=="MCI_START_ADDR"
(
  per.view hwioreg.per "SDCC,MCI_START_ADDR"
)
if "&choice"=="MCI_DMA_CONFIG"
(
  per.view hwioreg.per "SDCC,MCI_DMA_CONFIG"
)
if "&choice"=="MCI_TESTBUS_CONFIG"
(
  per.view hwioreg.per "SDCC,MCI_TESTBUS_CONFIG"
)
if "&choice"=="MCI_TEST_CTL"
(
  per.view hwioreg.per "SDCC,MCI_TEST_CTL"
)
if "&choice"=="MCI_TEST_INPUT"
(
  per.view hwioreg.per "SDCC,MCI_TEST_INPUT"
)
if "&choice"=="MCI_TEST_OUT"
(
  per.view hwioreg.per "SDCC,MCI_TEST_OUT"
)
if "&choice"=="MCI_PERPH_ID0"
(
  per.view hwioreg.per "SDCC,MCI_PERPH_ID0"
)
if "&choice"=="MCI_PERPH_ID1"
(
  per.view hwioreg.per "SDCC,MCI_PERPH_ID1"
)
if "&choice"=="MCI_PERPH_ID2"
(
  per.view hwioreg.per "SDCC,MCI_PERPH_ID2"
)
if "&choice"=="MCI_PERPH_ID3"
(
  per.view hwioreg.per "SDCC,MCI_PERPH_ID3"
)
if "&choice"=="MCI_PCELL_ID0"
(
  per.view hwioreg.per "SDCC,MCI_PCELL_ID0"
)
if "&choice"=="MCI_PCELL_ID1"
(
  per.view hwioreg.per "SDCC,MCI_PCELL_ID1"
)
if "&choice"=="MCI_PCELL_ID2"
(
  per.view hwioreg.per "SDCC,MCI_PCELL_ID2"
)
if "&choice"=="MCI_PCELL_ID3"
(
  per.view hwioreg.per "SDCC,MCI_PCELL_ID3"
)
if "&choice"=="SDRAM_OPT_CFG"
(
  per.view hwioreg.per "SDRAM_REGS,SDRAM_OPT_CFG"
)
if "&choice"=="SDRAM_RFRSH_CFG"
(
  per.view hwioreg.per "SDRAM_REGS,SDRAM_RFRSH_CFG"
)
if "&choice"=="SDRAM_DEV_PARAM_CFG1"
(
  per.view hwioreg.per "SDRAM_REGS,SDRAM_DEV_PARAM_CFG1"
)
if "&choice"=="SDRAM_DEV_PARAM_CFG2"
(
  per.view hwioreg.per "SDRAM_REGS,SDRAM_DEV_PARAM_CFG2"
)
if "&choice"=="SDRAM_DEV_PARAM_CFG3"
(
  per.view hwioreg.per "SDRAM_REGS,SDRAM_DEV_PARAM_CFG3"
)
if "&choice"=="SDRAM_CTRL_CFG"
(
  per.view hwioreg.per "SDRAM_REGS,SDRAM_CTRL_CFG"
)
if "&choice"=="SDRAM_DEV_INIT_CFG"
(
  per.view hwioreg.per "SDRAM_REGS,SDRAM_DEV_INIT_CFG"
)
if "&choice"=="SDRAM_COL_ROW_SIZE_CFG"
(
  per.view hwioreg.per "SDRAM_REGS,SDRAM_COL_ROW_SIZE_CFG"
)
if "&choice"=="SDRAM_HW_DEV_INIT_CFG"
(
  per.view hwioreg.per "SDRAM_REGS,SDRAM_HW_DEV_INIT_CFG"
)
if "&choice"=="SDRAM_CDCM_CFG"
(
  per.view hwioreg.per "SDRAM_REGS,SDRAM_CDCM_CFG"
)
if "&choice"=="SDRAM_CDCM_INTERNAL1"
(
  per.view hwioreg.per "SDRAM_REGS,SDRAM_CDCM_INTERNAL1"
)
if "&choice"=="SDRAM_CDC0_CFG"
(
  per.view hwioreg.per "SDRAM_REGS,SDRAM_CDC0_CFG"
)
if "&choice"=="SDRAM_CDC1_CFG"
(
  per.view hwioreg.per "SDRAM_REGS,SDRAM_CDC1_CFG"
)
if "&choice"=="SDRAM_CDCM_STATUS"
(
  per.view hwioreg.per "SDRAM_REGS,SDRAM_CDCM_STATUS"
)
if "&choice"=="SDRAM_CLOCK_VOLTAGE_SWITCH_CFG"
(
  per.view hwioreg.per "SDRAM_REGS,SDRAM_CLOCK_VOLTAGE_SWITCH_CFG"
)
if "&choice"=="SDRAM_CLK_PWR_DOWN_CFG"
(
  per.view hwioreg.per "SDRAM_REGS,SDRAM_CLK_PWR_DOWN_CFG"
)
if "&choice"=="SDRAM_PERF_MON_CFG"
(
  per.view hwioreg.per "SDRAM_REGS,SDRAM_PERF_MON_CFG"
)
if "&choice"=="SDRAM_PERF_CNTR0_CFG"
(
  per.view hwioreg.per "SDRAM_REGS,SDRAM_PERF_CNTR0_CFG"
)
if "&choice"=="SDRAM_PERF_CNTR1_CFG"
(
  per.view hwioreg.per "SDRAM_REGS,SDRAM_PERF_CNTR1_CFG"
)
if "&choice"=="SDRAM_PERF_CNTR2_CFG"
(
  per.view hwioreg.per "SDRAM_REGS,SDRAM_PERF_CNTR2_CFG"
)
if "&choice"=="SDRAM_PERF_CNTR0_OUT"
(
  per.view hwioreg.per "SDRAM_REGS,SDRAM_PERF_CNTR0_OUT"
)
if "&choice"=="SDRAM_PERF_CNTR1_OUT"
(
  per.view hwioreg.per "SDRAM_REGS,SDRAM_PERF_CNTR1_OUT"
)
if "&choice"=="SDRAM_PERF_CNTR2_OUT"
(
  per.view hwioreg.per "SDRAM_REGS,SDRAM_PERF_CNTR2_OUT"
)
if "&choice"=="SDRAM_PERF_CNTR_STATUS"
(
  per.view hwioreg.per "SDRAM_REGS,SDRAM_PERF_CNTR_STATUS"
)
if "&choice"=="SDRAM_TEST_BUS_CFG"
(
  per.view hwioreg.per "SDRAM_REGS,SDRAM_TEST_BUS_CFG"
)
if "&choice"=="SDRAM_MISR_CTRL"
(
  per.view hwioreg.per "SDRAM_REGS,SDRAM_MISR_CTRL"
)
if "&choice"=="SDRAM_MISR_OUT0"
(
  per.view hwioreg.per "SDRAM_REGS,SDRAM_MISR_OUT0"
)
if "&choice"=="SDRAM_MISR_OUT1"
(
  per.view hwioreg.per "SDRAM_REGS,SDRAM_MISR_OUT1"
)
if "&choice"=="SDRAM_FPGA_CONTROLLER_CFG1"
(
  per.view hwioreg.per "SDRAM_REGS,SDRAM_FPGA_CONTROLLER_CFG1"
)
if "&choice"=="SDRAM_FPGA_CONTROLLER_CFG2"
(
  per.view hwioreg.per "SDRAM_REGS,SDRAM_FPGA_CONTROLLER_CFG2"
)
if "&choice"=="SDRAM_FPGA_CONTROLLER_CFG3"
(
  per.view hwioreg.per "SDRAM_REGS,SDRAM_FPGA_CONTROLLER_CFG3"
)
if "&choice"=="SDRAM_FPGA_CONTROLLER_CFG4"
(
  per.view hwioreg.per "SDRAM_REGS,SDRAM_FPGA_CONTROLLER_CFG4"
)
if "&choice"=="SDRAM_FPGA_CONTROLLER_CFG5"
(
  per.view hwioreg.per "SDRAM_REGS,SDRAM_FPGA_CONTROLLER_CFG5"
)
if "&choice"=="SLEEP0_RTC_ARM"
(
  per.view hwioreg.per "SLEEP_CTL,SLEEP0_RTC_ARM"
)
if "&choice"=="SLEEP1_RTC_ARM"
(
  per.view hwioreg.per "SLEEP_CTL,SLEEP1_RTC_ARM"
)
if "&choice"=="SLEEP2_RTC_ARM"
(
  per.view hwioreg.per "SLEEP_CTL,SLEEP2_RTC_ARM"
)
if "&choice"=="SLEEP0_MICRO_START"
(
  per.view hwioreg.per "SLEEP_CTL,SLEEP0_MICRO_START"
)
if "&choice"=="SLEEP1_MICRO_START"
(
  per.view hwioreg.per "SLEEP_CTL,SLEEP1_MICRO_START"
)
if "&choice"=="SLEEP2_MICRO_START"
(
  per.view hwioreg.per "SLEEP_CTL,SLEEP2_MICRO_START"
)
if "&choice"=="SLEEP0_FINE_TIME"
(
  per.view hwioreg.per "SLEEP_CTL,SLEEP0_FINE_TIME"
)
if "&choice"=="SLEEP1_FINE_TIME"
(
  per.view hwioreg.per "SLEEP_CTL,SLEEP1_FINE_TIME"
)
if "&choice"=="SLEEP2_FINE_TIME"
(
  per.view hwioreg.per "SLEEP_CTL,SLEEP2_FINE_TIME"
)
if "&choice"=="SLEEP0_COARSE_TIME"
(
  per.view hwioreg.per "SLEEP_CTL,SLEEP0_COARSE_TIME"
)
if "&choice"=="SLEEP1_COARSE_TIME"
(
  per.view hwioreg.per "SLEEP_CTL,SLEEP1_COARSE_TIME"
)
if "&choice"=="SLEEP2_COARSE_TIME"
(
  per.view hwioreg.per "SLEEP_CTL,SLEEP2_COARSE_TIME"
)
if "&choice"=="SLEEP0_COARSE_TIME_LATCH"
(
  per.view hwioreg.per "SLEEP_CTL,SLEEP0_COARSE_TIME_LATCH"
)
if "&choice"=="SLEEP1_COARSE_TIME_LATCH"
(
  per.view hwioreg.per "SLEEP_CTL,SLEEP1_COARSE_TIME_LATCH"
)
if "&choice"=="SLEEP2_COARSE_TIME_LATCH"
(
  per.view hwioreg.per "SLEEP_CTL,SLEEP2_COARSE_TIME_LATCH"
)
if "&choice"=="SLEEP0_WAKEUP_TIME"
(
  per.view hwioreg.per "SLEEP_CTL,SLEEP0_WAKEUP_TIME"
)
if "&choice"=="SLEEP1_WAKEUP_TIME"
(
  per.view hwioreg.per "SLEEP_CTL,SLEEP1_WAKEUP_TIME"
)
if "&choice"=="SLEEP2_WAKEUP_TIME"
(
  per.view hwioreg.per "SLEEP_CTL,SLEEP2_WAKEUP_TIME"
)
if "&choice"=="SLEEP0_WAKEUP_TIME_LATCH"
(
  per.view hwioreg.per "SLEEP_CTL,SLEEP0_WAKEUP_TIME_LATCH"
)
if "&choice"=="SLEEP1_WAKEUP_TIME_LATCH"
(
  per.view hwioreg.per "SLEEP_CTL,SLEEP1_WAKEUP_TIME_LATCH"
)
if "&choice"=="SLEEP2_WAKEUP_TIME_LATCH"
(
  per.view hwioreg.per "SLEEP_CTL,SLEEP2_WAKEUP_TIME_LATCH"
)
if "&choice"=="SLEEP0_FINE_COUNT_VAL"
(
  per.view hwioreg.per "SLEEP_CTL,SLEEP0_FINE_COUNT_VAL"
)
if "&choice"=="SLEEP1_FINE_COUNT_VAL"
(
  per.view hwioreg.per "SLEEP_CTL,SLEEP1_FINE_COUNT_VAL"
)
if "&choice"=="SLEEP2_FINE_COUNT_VAL"
(
  per.view hwioreg.per "SLEEP_CTL,SLEEP2_FINE_COUNT_VAL"
)
if "&choice"=="SLEEP0_COARSE_COUNT_VAL"
(
  per.view hwioreg.per "SLEEP_CTL,SLEEP0_COARSE_COUNT_VAL"
)
if "&choice"=="SLEEP1_COARSE_COUNT_VAL"
(
  per.view hwioreg.per "SLEEP_CTL,SLEEP1_COARSE_COUNT_VAL"
)
if "&choice"=="SLEEP2_COARSE_COUNT_VAL"
(
  per.view hwioreg.per "SLEEP_CTL,SLEEP2_COARSE_COUNT_VAL"
)
if "&choice"=="SLEEP0_STATUS"
(
  per.view hwioreg.per "SLEEP_CTL,SLEEP0_STATUS"
)
if "&choice"=="SLEEP1_STATUS"
(
  per.view hwioreg.per "SLEEP_CTL,SLEEP1_STATUS"
)
if "&choice"=="SLEEP2_STATUS"
(
  per.view hwioreg.per "SLEEP_CTL,SLEEP2_STATUS"
)
if "&choice"=="SLEEP0_MODEM_STATUS_ENABLE"
(
  per.view hwioreg.per "SLEEP_CTL,SLEEP0_MODEM_STATUS_ENABLE"
)
if "&choice"=="SLEEP1_MODEM_STATUS_ENABLE"
(
  per.view hwioreg.per "SLEEP_CTL,SLEEP1_MODEM_STATUS_ENABLE"
)
if "&choice"=="SLEEP2_MODEM_STATUS_ENABLE"
(
  per.view hwioreg.per "SLEEP_CTL,SLEEP2_MODEM_STATUS_ENABLE"
)
if "&choice"=="SLEEP0_INT_EN"
(
  per.view hwioreg.per "SLEEP_CTL,SLEEP0_INT_EN"
)
if "&choice"=="SLEEP1_INT_EN"
(
  per.view hwioreg.per "SLEEP_CTL,SLEEP1_INT_EN"
)
if "&choice"=="SLEEP2_INT_EN"
(
  per.view hwioreg.per "SLEEP_CTL,SLEEP2_INT_EN"
)
if "&choice"=="FEE_SLEEP_XTAL_COUNT"
(
  per.view hwioreg.per "SLEEP_CTL,FEE_SLEEP_XTAL_COUNT"
)
if "&choice"=="FEE_SLEEP_XTAL_FREQ_ERR"
(
  per.view hwioreg.per "SLEEP_CTL,FEE_SLEEP_XTAL_FREQ_ERR"
)
if "&choice"=="SSBI_WRAPPER_SSBI_CTL"
(
  per.view hwioreg.per "SSBI,SSBI_WRAPPER_SSBI_CTL"
)
if "&choice"=="SSBI_WRAPPER_SSBI_RESET"
(
  per.view hwioreg.per "SSBI,SSBI_WRAPPER_SSBI_RESET"
)
if "&choice"=="SSBI_WRAPPER_SSBI_CMD"
(
  per.view hwioreg.per "SSBI,SSBI_WRAPPER_SSBI_CMD"
)
if "&choice"=="SSBI_WRAPPER_SSBI_BYPASS"
(
  per.view hwioreg.per "SSBI,SSBI_WRAPPER_SSBI_BYPASS"
)
if "&choice"=="SSBI_WRAPPER_SSBI_RD"
(
  per.view hwioreg.per "SSBI,SSBI_WRAPPER_SSBI_RD"
)
if "&choice"=="SSBI_WRAPPER_SSBI_STATUS"
(
  per.view hwioreg.per "SSBI,SSBI_WRAPPER_SSBI_STATUS"
)
if "&choice"=="SSBI_WRAPPER_SSBI_PRIORITIES"
(
  per.view hwioreg.per "SSBI,SSBI_WRAPPER_SSBI_PRIORITIES"
)
if "&choice"=="SSBI_WRAPPER_SSBI_INTR_MASK"
(
  per.view hwioreg.per "SSBI,SSBI_WRAPPER_SSBI_INTR_MASK"
)
if "&choice"=="SSBI_WRAPPER_SSBI_INTR_CLEAR"
(
  per.view hwioreg.per "SSBI,SSBI_WRAPPER_SSBI_INTR_CLEAR"
)
if "&choice"=="SSBI_WRAPPER_SSBI_INTR_STATUS"
(
  per.view hwioreg.per "SSBI,SSBI_WRAPPER_SSBI_INTR_STATUS"
)
if "&choice"=="VD_RESET"
(
  per.view hwioreg.per "SVD,VD_RESET"
)
if "&choice"=="VD_MODE"
(
  per.view hwioreg.per "SVD,VD_MODE"
)
if "&choice"=="VD_POLY2IJ"
(
  per.view hwioreg.per "SVD,VD_POLY2IJ"
)
if "&choice"=="VD_POLY3IJ"
(
  per.view hwioreg.per "SVD,VD_POLY3IJ"
)
if "&choice"=="VD_POLY3K"
(
  per.view hwioreg.per "SVD,VD_POLY3K"
)
if "&choice"=="VD_POLY4IJ"
(
  per.view hwioreg.per "SVD,VD_POLY4IJ"
)
if "&choice"=="VD_POLY4KL"
(
  per.view hwioreg.per "SVD,VD_POLY4KL"
)
if "&choice"=="VD_TESTCON"
(
  per.view hwioreg.per "SVD,VD_TESTCON"
)
if "&choice"=="VD_TESTOUT"
(
  per.view hwioreg.per "SVD,VD_TESTOUT"
)
if "&choice"=="VD_TEST_MEM_SEL"
(
  per.view hwioreg.per "SVD,VD_TEST_MEM_SEL"
)
if "&choice"=="VD_TEST_MEM_ADDR"
(
  per.view hwioreg.per "SVD,VD_TEST_MEM_ADDR"
)
if "&choice"=="VD_TEST_MEM_WRITE"
(
  per.view hwioreg.per "SVD,VD_TEST_MEM_WRITE"
)
if "&choice"=="VD_TEST_MEM_READ0"
(
  per.view hwioreg.per "SVD,VD_TEST_MEM_READ0"
)
if "&choice"=="VD_TEST_MEM_READ1"
(
  per.view hwioreg.per "SVD,VD_TEST_MEM_READ1"
)
if "&choice"=="VD_TEST_MEM_DIN"
(
  per.view hwioreg.per "SVD,VD_TEST_MEM_DIN"
)
if "&choice"=="VD_HW_CLK_CTL"
(
  per.view hwioreg.per "SVD,VD_HW_CLK_CTL"
)
if "&choice"=="VD_MICRO_CLK_CTL"
(
  per.view hwioreg.per "SVD,VD_MICRO_CLK_CTL"
)
if "&choice"=="VD_CLK_STATUS"
(
  per.view hwioreg.per "SVD,VD_CLK_STATUS"
)
if "&choice"=="VD_SPARE_READ_REG0"
(
  per.view hwioreg.per "SVD,VD_SPARE_READ_REG0"
)
if "&choice"=="SYS_MPU_ENABLE"
(
  per.view hwioreg.per "SYS_MPU,SYS_MPU_ENABLE"
)
if "&choice"=="SYS_MPU_ERR_STATS"
(
  per.view hwioreg.per "SYS_MPU,SYS_MPU_ERR_STATS"
)
if "&choice"=="SYS_MPU_DEF_PART_PERM0"
(
  per.view hwioreg.per "SYS_MPU,SYS_MPU_DEF_PART_PERM0"
)
if "&choice"=="SYS_MPU_PART_START_ADDR0"
(
  per.view hwioreg.per "SYS_MPU,SYS_MPU_PART_START_ADDR0"
)
if "&choice"=="SYS_MPU_PART_START_ADDR1"
(
  per.view hwioreg.per "SYS_MPU,SYS_MPU_PART_START_ADDR1"
)
if "&choice"=="SYS_MPU_PART_START_ADDR2"
(
  per.view hwioreg.per "SYS_MPU,SYS_MPU_PART_START_ADDR2"
)
if "&choice"=="SYS_MPU_PART_START_ADDR3"
(
  per.view hwioreg.per "SYS_MPU,SYS_MPU_PART_START_ADDR3"
)
if "&choice"=="SYS_MPU_PART_END_ADDR0"
(
  per.view hwioreg.per "SYS_MPU,SYS_MPU_PART_END_ADDR0"
)
if "&choice"=="SYS_MPU_PART_END_ADDR1"
(
  per.view hwioreg.per "SYS_MPU,SYS_MPU_PART_END_ADDR1"
)
if "&choice"=="SYS_MPU_PART_END_ADDR2"
(
  per.view hwioreg.per "SYS_MPU,SYS_MPU_PART_END_ADDR2"
)
if "&choice"=="SYS_MPU_PART_END_ADDR3"
(
  per.view hwioreg.per "SYS_MPU,SYS_MPU_PART_END_ADDR3"
)
if "&choice"=="SYS_MPU_PART_PERM00"
(
  per.view hwioreg.per "SYS_MPU,SYS_MPU_PART_PERM00"
)
if "&choice"=="TD_ENERGY_METRIC"
(
  per.view hwioreg.per "TD,TD_ENERGY_METRIC"
)
if "&choice"=="TD_STATUS"
(
  per.view hwioreg.per "TD,TD_STATUS"
)
if "&choice"=="TD_TEST_MEM_SEL"
(
  per.view hwioreg.per "TD,TD_TEST_MEM_SEL"
)
if "&choice"=="TD_TEST_MEM_ADDR"
(
  per.view hwioreg.per "TD,TD_TEST_MEM_ADDR"
)
if "&choice"=="TD_TEST_MEM_WRITE"
(
  per.view hwioreg.per "TD,TD_TEST_MEM_WRITE"
)
if "&choice"=="TD_TEST_MEM_READ0"
(
  per.view hwioreg.per "TD,TD_TEST_MEM_READ0"
)
if "&choice"=="TD_TEST_MEM_READ1"
(
  per.view hwioreg.per "TD,TD_TEST_MEM_READ1"
)
if "&choice"=="TD_TEST_MEM_READ2"
(
  per.view hwioreg.per "TD,TD_TEST_MEM_READ2"
)
if "&choice"=="TD_TEST_MEM_DIN"
(
  per.view hwioreg.per "TD,TD_TEST_MEM_DIN"
)
if "&choice"=="HDR_DDI_CTL"
(
  per.view hwioreg.per "TD,HDR_DDI_CTL"
)
if "&choice"=="HDR_DDI_HOST"
(
  per.view hwioreg.per "TD,HDR_DDI_HOST"
)
if "&choice"=="TD_HW_CLK_CTL"
(
  per.view hwioreg.per "TD,TD_HW_CLK_CTL"
)
if "&choice"=="TD_MICRO_CLK_CTL"
(
  per.view hwioreg.per "TD,TD_MICRO_CLK_CTL"
)
if "&choice"=="TD_CLK_STATUS"
(
  per.view hwioreg.per "TD,TD_CLK_STATUS"
)
if "&choice"=="TD_MISC_CTL"
(
  per.view hwioreg.per "TD,TD_MISC_CTL"
)
if "&choice"=="TD_ONE_FIFTH_TAIL_PATTERN"
(
  per.view hwioreg.per "TD,TD_ONE_FIFTH_TAIL_PATTERN"
)
if "&choice"=="TD_TAIL_CFG"
(
  per.view hwioreg.per "TD,TD_TAIL_CFG"
)
if "&choice"=="TD_MODE_CTL"
(
  per.view hwioreg.per "TD,TD_MODE_CTL"
)
if "&choice"=="UART_DM_MR1"
(
  per.view hwioreg.per "TOP_UART,UART_DM_MR1"
)
if "&choice"=="UART_DM_MR2"
(
  per.view hwioreg.per "TOP_UART,UART_DM_MR2"
)
if "&choice"=="UART_DM_CSR"
(
  per.view hwioreg.per "TOP_UART,UART_DM_CSR"
)
if "&choice"=="UART_DM_TF"
(
  per.view hwioreg.per "TOP_UART,UART_DM_TF"
)
if "&choice"=="UART_DM_TF_2"
(
  per.view hwioreg.per "TOP_UART,UART_DM_TF_2"
)
if "&choice"=="UART_DM_TF_3"
(
  per.view hwioreg.per "TOP_UART,UART_DM_TF_3"
)
if "&choice"=="UART_DM_TF_4"
(
  per.view hwioreg.per "TOP_UART,UART_DM_TF_4"
)
if "&choice"=="UART_DM_CR"
(
  per.view hwioreg.per "TOP_UART,UART_DM_CR"
)
if "&choice"=="UART_DM_IMR"
(
  per.view hwioreg.per "TOP_UART,UART_DM_IMR"
)
if "&choice"=="UART_DM_IPR"
(
  per.view hwioreg.per "TOP_UART,UART_DM_IPR"
)
if "&choice"=="UART_DM_TFWR"
(
  per.view hwioreg.per "TOP_UART,UART_DM_TFWR"
)
if "&choice"=="UART_DM_RFWR"
(
  per.view hwioreg.per "TOP_UART,UART_DM_RFWR"
)
if "&choice"=="UART_DM_HCR"
(
  per.view hwioreg.per "TOP_UART,UART_DM_HCR"
)
if "&choice"=="UART_DM_DMRX"
(
  per.view hwioreg.per "TOP_UART,UART_DM_DMRX"
)
if "&choice"=="UART_DM_IRDA"
(
  per.view hwioreg.per "TOP_UART,UART_DM_IRDA"
)
if "&choice"=="UART_DM_DMEN"
(
  per.view hwioreg.per "TOP_UART,UART_DM_DMEN"
)
if "&choice"=="UART_DM_NO_CHARS_FOR_TX"
(
  per.view hwioreg.per "TOP_UART,UART_DM_NO_CHARS_FOR_TX"
)
if "&choice"=="UART_DM_BADR"
(
  per.view hwioreg.per "TOP_UART,UART_DM_BADR"
)
if "&choice"=="UART_DM_TESTSL"
(
  per.view hwioreg.per "TOP_UART,UART_DM_TESTSL"
)
if "&choice"=="UART_DM_MISR_MODE"
(
  per.view hwioreg.per "TOP_UART,UART_DM_MISR_MODE"
)
if "&choice"=="UART_DM_MISR_RESET"
(
  per.view hwioreg.per "TOP_UART,UART_DM_MISR_RESET"
)
if "&choice"=="UART_DM_MISR_EXPORT"
(
  per.view hwioreg.per "TOP_UART,UART_DM_MISR_EXPORT"
)
if "&choice"=="UART_DM_MISR_VAL"
(
  per.view hwioreg.per "TOP_UART,UART_DM_MISR_VAL"
)
if "&choice"=="UART_DM_SIM_CFG"
(
  per.view hwioreg.per "TOP_UART,UART_DM_SIM_CFG"
)
if "&choice"=="UART_DM_TEST_WR_ADDR"
(
  per.view hwioreg.per "TOP_UART,UART_DM_TEST_WR_ADDR"
)
if "&choice"=="UART_DM_TEST_WR_DATA"
(
  per.view hwioreg.per "TOP_UART,UART_DM_TEST_WR_DATA"
)
if "&choice"=="UART_DM_TEST_RD_ADDR"
(
  per.view hwioreg.per "TOP_UART,UART_DM_TEST_RD_ADDR"
)
if "&choice"=="UART_DM_SR"
(
  per.view hwioreg.per "TOP_UART,UART_DM_SR"
)
if "&choice"=="UART_DM_RF"
(
  per.view hwioreg.per "TOP_UART,UART_DM_RF"
)
if "&choice"=="UART_DM_RF_2"
(
  per.view hwioreg.per "TOP_UART,UART_DM_RF_2"
)
if "&choice"=="UART_DM_RF_3"
(
  per.view hwioreg.per "TOP_UART,UART_DM_RF_3"
)
if "&choice"=="UART_DM_RF_4"
(
  per.view hwioreg.per "TOP_UART,UART_DM_RF_4"
)
if "&choice"=="UART_DM_MISR"
(
  per.view hwioreg.per "TOP_UART,UART_DM_MISR"
)
if "&choice"=="UART_DM_ISR"
(
  per.view hwioreg.per "TOP_UART,UART_DM_ISR"
)
if "&choice"=="UART_DM_RX_TOTAL_SNAP"
(
  per.view hwioreg.per "TOP_UART,UART_DM_RX_TOTAL_SNAP"
)
if "&choice"=="UART_DM_TXFS"
(
  per.view hwioreg.per "TOP_UART,UART_DM_TXFS"
)
if "&choice"=="UART_DM_RXFS"
(
  per.view hwioreg.per "TOP_UART,UART_DM_RXFS"
)
if "&choice"=="UART_DM_TEST_RD_DATA"
(
  per.view hwioreg.per "TOP_UART,UART_DM_TEST_RD_DATA"
)
if "&choice"=="USB_OTG_HS_ID"
(
  per.view hwioreg.per "USB_OTG_HS,USB_OTG_HS_ID"
)
if "&choice"=="USB_OTG_HS_HWGENERAL"
(
  per.view hwioreg.per "USB_OTG_HS,USB_OTG_HS_HWGENERAL"
)
if "&choice"=="USB_OTG_HS_HWHOST"
(
  per.view hwioreg.per "USB_OTG_HS,USB_OTG_HS_HWHOST"
)
if "&choice"=="USB_OTG_HS_HWDEVICE"
(
  per.view hwioreg.per "USB_OTG_HS,USB_OTG_HS_HWDEVICE"
)
if "&choice"=="USB_OTG_HS_HWTXBUF"
(
  per.view hwioreg.per "USB_OTG_HS,USB_OTG_HS_HWTXBUF"
)
if "&choice"=="USB_OTG_HS_HWRXBUF"
(
  per.view hwioreg.per "USB_OTG_HS,USB_OTG_HS_HWRXBUF"
)
if "&choice"=="USB_OTG_HS_GPTIMER0LD"
(
  per.view hwioreg.per "USB_OTG_HS,USB_OTG_HS_GPTIMER0LD"
)
if "&choice"=="USB_OTG_HS_GPTIMER0CTRL"
(
  per.view hwioreg.per "USB_OTG_HS,USB_OTG_HS_GPTIMER0CTRL"
)
if "&choice"=="USB_OTG_HS_GPTIMER1LD"
(
  per.view hwioreg.per "USB_OTG_HS,USB_OTG_HS_GPTIMER1LD"
)
if "&choice"=="USB_OTG_HS_GPTIMER1CTRL"
(
  per.view hwioreg.per "USB_OTG_HS,USB_OTG_HS_GPTIMER1CTRL"
)
if "&choice"=="USB_OTG_HS_AHB_BURST"
(
  per.view hwioreg.per "USB_OTG_HS,USB_OTG_HS_AHB_BURST"
)
if "&choice"=="USB_OTG_HS_XTOR_STS"
(
  per.view hwioreg.per "USB_OTG_HS,USB_OTG_HS_XTOR_STS"
)
if "&choice"=="USB_OTG_HS_AHB_MODE"
(
  per.view hwioreg.per "USB_OTG_HS,USB_OTG_HS_AHB_MODE"
)
if "&choice"=="USB_OTG_HS_GEN_CONFIG"
(
  per.view hwioreg.per "USB_OTG_HS,USB_OTG_HS_GEN_CONFIG"
)
if "&choice"=="USB_OTG_HS_CAPLENGTH"
(
  per.view hwioreg.per "USB_OTG_HS,USB_OTG_HS_CAPLENGTH"
)
if "&choice"=="USB_OTG_HS_HCIVERSION"
(
  per.view hwioreg.per "USB_OTG_HS,USB_OTG_HS_HCIVERSION"
)
if "&choice"=="USB_OTG_HS_HCSPARAMS"
(
  per.view hwioreg.per "USB_OTG_HS,USB_OTG_HS_HCSPARAMS"
)
if "&choice"=="USB_OTG_HS_HCCPARAMS"
(
  per.view hwioreg.per "USB_OTG_HS,USB_OTG_HS_HCCPARAMS"
)
if "&choice"=="USB_OTG_HS_DCIVERSION"
(
  per.view hwioreg.per "USB_OTG_HS,USB_OTG_HS_DCIVERSION"
)
if "&choice"=="USB_OTG_HS_DCCPARAMS"
(
  per.view hwioreg.per "USB_OTG_HS,USB_OTG_HS_DCCPARAMS"
)
if "&choice"=="USB_OTG_HS_USBCMD"
(
  per.view hwioreg.per "USB_OTG_HS,USB_OTG_HS_USBCMD"
)
if "&choice"=="USB_OTG_HS_USBSTS"
(
  per.view hwioreg.per "USB_OTG_HS,USB_OTG_HS_USBSTS"
)
if "&choice"=="USB_OTG_HS_USBINTR"
(
  per.view hwioreg.per "USB_OTG_HS,USB_OTG_HS_USBINTR"
)
if "&choice"=="USB_OTG_HS_FRINDEX"
(
  per.view hwioreg.per "USB_OTG_HS,USB_OTG_HS_FRINDEX"
)
if "&choice"=="USB_OTG_HS_PERIODICLISTBASE"
(
  per.view hwioreg.per "USB_OTG_HS,USB_OTG_HS_PERIODICLISTBASE"
)
if "&choice"=="USB_OTG_HS_DEVICEADDR"
(
  per.view hwioreg.per "USB_OTG_HS,USB_OTG_HS_DEVICEADDR"
)
if "&choice"=="USB_OTG_HS_ASYNCLISTADDR"
(
  per.view hwioreg.per "USB_OTG_HS,USB_OTG_HS_ASYNCLISTADDR"
)
if "&choice"=="USB_OTG_HS_ENDPOINTLISTADDR"
(
  per.view hwioreg.per "USB_OTG_HS,USB_OTG_HS_ENDPOINTLISTADDR"
)
if "&choice"=="USB_OTG_HS_TTCTRL"
(
  per.view hwioreg.per "USB_OTG_HS,USB_OTG_HS_TTCTRL"
)
if "&choice"=="USB_OTG_HS_BURSTSIZE"
(
  per.view hwioreg.per "USB_OTG_HS,USB_OTG_HS_BURSTSIZE"
)
if "&choice"=="USB_OTG_HS_TXFILLTUNING"
(
  per.view hwioreg.per "USB_OTG_HS,USB_OTG_HS_TXFILLTUNING"
)
if "&choice"=="USB_OTG_HS_ULPI_VIEWPORT"
(
  per.view hwioreg.per "USB_OTG_HS,USB_OTG_HS_ULPI_VIEWPORT"
)
if "&choice"=="USB_OTG_HS_ENDPTNAK"
(
  per.view hwioreg.per "USB_OTG_HS,USB_OTG_HS_ENDPTNAK"
)
if "&choice"=="USB_OTG_HS_ENDPTNAKEN"
(
  per.view hwioreg.per "USB_OTG_HS,USB_OTG_HS_ENDPTNAKEN"
)
if "&choice"=="USB_OTG_HS_PORTSC"
(
  per.view hwioreg.per "USB_OTG_HS,USB_OTG_HS_PORTSC"
)
if "&choice"=="USB_OTG_HS_OTGSC"
(
  per.view hwioreg.per "USB_OTG_HS,USB_OTG_HS_OTGSC"
)
if "&choice"=="USB_OTG_HS_USBMODE"
(
  per.view hwioreg.per "USB_OTG_HS,USB_OTG_HS_USBMODE"
)
if "&choice"=="USB_OTG_HS_ENPDTSETUPSTAT"
(
  per.view hwioreg.per "USB_OTG_HS,USB_OTG_HS_ENPDTSETUPSTAT"
)
if "&choice"=="USB_OTG_HS_ENDPTPRIME"
(
  per.view hwioreg.per "USB_OTG_HS,USB_OTG_HS_ENDPTPRIME"
)
if "&choice"=="USB_OTG_HS_ENDPTFLUSH"
(
  per.view hwioreg.per "USB_OTG_HS,USB_OTG_HS_ENDPTFLUSH"
)
if "&choice"=="USB_OTG_HS_ENDPTSTAT"
(
  per.view hwioreg.per "USB_OTG_HS,USB_OTG_HS_ENDPTSTAT"
)
if "&choice"=="USB_OTG_HS_ENDPTCOMPLETE"
(
  per.view hwioreg.per "USB_OTG_HS,USB_OTG_HS_ENDPTCOMPLETE"
)
if "&choice"=="USB_OTG_HS_ENDPTCTRL0"
(
  per.view hwioreg.per "USB_OTG_HS,USB_OTG_HS_ENDPTCTRL0"
)
if "&choice"=="USB_OTG_HS_ENDPTCTRL1"
(
  per.view hwioreg.per "USB_OTG_HS,USB_OTG_HS_ENDPTCTRL1"
)
if "&choice"=="SLEEP_XTAL_TIMER_0_COUNT"
(
  per.view hwioreg.per "WDOG_SLP,SLEEP_XTAL_TIMER_0_COUNT"
)
if "&choice"=="SLEEP_XTAL_TIMER_1_COUNT"
(
  per.view hwioreg.per "WDOG_SLP,SLEEP_XTAL_TIMER_1_COUNT"
)
if "&choice"=="SLEEP_XTAL_TIMETICK_COUNT"
(
  per.view hwioreg.per "WDOG_SLP,SLEEP_XTAL_TIMETICK_COUNT"
)
if "&choice"=="WDOG_STATUS"
(
  per.view hwioreg.per "WDOG_SLP,WDOG_STATUS"
)
if "&choice"=="SLEEP_XTAL_TIMER_0_ENABLE"
(
  per.view hwioreg.per "WDOG_SLP,SLEEP_XTAL_TIMER_0_ENABLE"
)
if "&choice"=="SLEEP_XTAL_TIMER_1_ENABLE"
(
  per.view hwioreg.per "WDOG_SLP,SLEEP_XTAL_TIMER_1_ENABLE"
)
if "&choice"=="SLEEP_XTAL_TIMER_0_MATCH_VAL"
(
  per.view hwioreg.per "WDOG_SLP,SLEEP_XTAL_TIMER_0_MATCH_VAL"
)
if "&choice"=="SLEEP_XTAL_TIMER_1_MATCH_VAL"
(
  per.view hwioreg.per "WDOG_SLP,SLEEP_XTAL_TIMER_1_MATCH_VAL"
)
if "&choice"=="SLEEP_XTAL_TIMETICK_MATCH_VAL_STATUS"
(
  per.view hwioreg.per "WDOG_SLP,SLEEP_XTAL_TIMETICK_MATCH_VAL_STATUS"
)
if "&choice"=="SLEEP_XTAL_TIMETICK_MATCH_VAL"
(
  per.view hwioreg.per "WDOG_SLP,SLEEP_XTAL_TIMETICK_MATCH_VAL"
)
if "&choice"=="WDOG_EXPIRED_WIDTH"
(
  per.view hwioreg.per "WDOG_SLP,WDOG_EXPIRED_WIDTH"
)
if "&choice"=="WDOG_TEST_LOAD_STATUS"
(
  per.view hwioreg.per "WDOG_SLP,WDOG_TEST_LOAD_STATUS"
)
if "&choice"=="WDOG_TEST"
(
  per.view hwioreg.per "WDOG_SLP,WDOG_TEST"
)
&old_choice="&choice"
&choice=""

goto Enter_Choice

enddo

