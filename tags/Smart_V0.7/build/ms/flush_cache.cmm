;-----------------------------------------------------------------------------
; T32 SCRIPT
;                                                         \
;   flush_cache.cmm
;
; DESCRIPTION
;
;   Reads the ctype register of the MMU to determine each cache line size
;   and number.  It uses this information to "clean" each cache line.  This
;   is done because our processor doesn't appear to support "drain write 
;   buffer".  So this is a somewhat brute force method; although, it should 
;   work properly.
;   
;   The information for this operation is in the ARM Architecture Reference 
;   manual; Caches and Write Buffer chapter; CP15 Registers; Register 7:
;   cache functions.
;
;
; USAGE
;
;   do flush_cache
;
; ISSUES AND TODOS
;
;   1)  There are assumptions made in this script.  First, the cache type is
;   not processed.  Next, the unified cache bit is not processed.  Neither
;   should make a difference when determining the cache size nor flush
;   operation.  Lastly, the "M" bit used to determine associativity is
;   assumed to be '0'.  Only powers of 2 are supported in this script.
; 
; Copyright (c) 2002-2007 by QUALCOMM, Incorporated.  All Rights Reserved.
;----------------------------------------------------------------------------
;============================================================================
;
;                        EDIT HISTORY FOR MODULE
;
; $Header: //depot/asic/qsc1100/build/ms/cmm/flush_cache.cmm#1 $ $DateTime: 2007/10/25 15:24:48 $ $Author: milanp $
;
; when       who     what, where, why
; -------    ---     --------------------------------------------------------
; 03/15/06   ts      Removed PVCS header
; 03/13/06   ts      Initial creation
;============================================================================;
Entry

; local variable declarations
local &cache_type_reg
local &data_cache_size
local &data_cache_assoc
local &data_cache_len

local &loop_index_assoc
local &max_assoc_loop
local &loop_index_set
local &max_set_loop
local &data

print "Cleaning all Data cache..."

; 
; The cache type (ctype) register is defined in the ARM Architecture Reference
; manual.  It is defined as such:
; 
; |000|ctype|S|  dsize  |  isize  |
; | 3 |4bits|1| 12bits  | 12bits  |
;
; The data cache is the only cache of interest, so process off just those bits.
; Here is the definition of the 'size' fields:
; 0 0 0| size|assoc|M|len  |
;      |3bits|3bits|1|2bits|
;
; The bits of each field (except M) are masked below:
; Read the cache_type_register
&cache_type_reg=data.long(C15:0x100)
&data_cache_size=(&cache_type_reg&0x1c0000)>>0x12
&data_cache_assoc=(&cache_type_reg&0x38000)>>0xf
&data_cache_len=(&cache_type_reg&0x3000)>>0xc

; Determine maximum loop count
; 
; As defined in the ARM Architecture Reference manual, the associativity
; is 2 (not taking into account the 'M' bit) << (assoc-1) or simply:
; 1<<(assoc).  This is the number of "ways".
; Determine maximum loop counters
&max_assoc_loop=1<<(&data_cache_assoc)
;
; As defined in the ARM Architecture Reference manual, the number of sets
; are defined as 1<<(size + 6 - assoc - len).
&max_set_loop=1<<(&data_cache_size+6-&data_cache_assoc-&data_cache_len)
;
; These make up the cache size parameters used in the 'clean' command.
;

; Initialize the associativity loop index
&loop_index_assoc=0

; Flush each cache line

; Loop for each associativity
while &loop_index_assoc<&max_assoc_loop
(
  ; Initialize the set loop index
  &loop_index_set=0
  ; Loop for each set
  while &loop_index_set<&max_set_loop
  (
    ; Build index-set data for the command
    ;
    ; Back to the ARM Architecture Reference manual; Caches and Write Buffer
    ; chapter; CP15 Registers; Register 7: cache functions:
    ; The cache size parameters are used to determine the data for the 'clean'
    ; command.  
    ; The 'index' field is the associativity and is at the high part of the data 
    ; (32-assoc size).
    ; The 'set' field is selected set and is based upon the data cache line length:
    ; 'set'<<(line length +3)
    &data=(&loop_index_assoc<<(0x20-&data_cache_assoc))+(&loop_index_set<<(&data_cache_len+3))
    ; Flush the index-set cache
    d.s C15:0x2a7 %long &data
    ; Do next set
    &loop_index_set=&loop_index_set+0x1
  )
  ; I put this here because it wouldn't work otherwise.  I don't know why.
  wait 10.ms
  ; Do next associativity
  &loop_index_assoc=&loop_index_assoc+0x1
)

print "...done cleaning all Data cache"

ENDDO
