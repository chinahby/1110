;****************************************************************************
;**           setupHWIO.CMM                                              **
;**           This script sets up QSC11x0's HWIO Debug feature           **
;**           Expects globals &TARGET_TYPE, &BOOT_MODE, &SHADOW_MODE       **
;**           and others to be defined                                     **
;**                                                                        **
;**           Changes:                                                     **
;**           09-29-08   Ported to QSC11x0                                 **
;****************************************************************************

PATH ../../core/systemdrivers/hw/src
menu.REPROGRAM ../../core/systemdrivers/hw/src/hwioreg.men
