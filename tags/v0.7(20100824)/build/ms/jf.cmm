;============================================================================
; jf.cmm
;     Primary JTAG load script for Lauterbach JTAG Trace32.
;     This script is the primary interface for loading SURF development
;     platforms with DMSS software.
;
;     The syntax is do jf or do jf XXXX, where XXXX is the build ID.
;
;     Changes:
;     02-12-08  First version
;============================================================================

GLOBAL &ELFdir
GLOBAL &ELFname

ENTRY &ELFname

GLOBAL &BUILDMSdir
GLOBAL &TEMPBREAKname

&BUILDMSdir=OS.PPD()
&TEMPBREAKname=OS.TMPFILE()+".cmm"

; Dialog box to obtain a filename if one not provided on the command line

IF "&ELFname"==""
(
 local &filename
 dialog.file *.elf
 entry &filename
 &ELFname=STRING.CUT("&filename",-4)
)

&ELFdir=OS.FILE.PATH("&ELFname")
&ELFname=OS.FILE.NAME("&ELFname")

;
;Check for build id, make sure it is a NOR build
;2ND letter indicates NOR or Shadow which B or S respectively
;
local &memconf
IF "&ELFname"!=""
  (
    ;
    ; CHECK memory config now
    ;
    print "check memory config now"
    &memconf=STRING.CHAR("&ELFname",1)
    print "Memory Config: &memconf"
    IF CONV.CHAR(&memconf)=='S'
      (
        print "ERROR: Image is not for NOR"
        enddo
      )
    IF CONV.CHAR(&memconf)=='s'
      (
        print "ERROR: Image is not for NOR"
        enddo
      )
  )



;--------------------------------------------------------
; Go run the actual JFLASH
;--------------------------------------------------------
cd ../../tools/mjflash

do mjflash NOMENU &ELFname BIN

cd ../../build/ms

sys.jtagclock rtck
sys.cpu ARM926EJ
sys.up

;****************************************************************************
; Disys.jtagclock rtcksable the MMU so physical memory can be read/written
; data.load.elf will bus error if MMU no CR/M bit not disabled.
;****************************************************************************

local &reg
&reg=data.long(C15:0x1)
print "CR is &reg"
&reg=&reg&0xfffffffe
per.s C15:0x1 %LONG &reg
print "MMU disabled (CR set to &reg)"


print "Loading AMSS symbols..."

; Delete all previous symbols
y.delete

do ../../core/systemdrivers/hw/src/hwio.cmm

; Enable all clocks, enable = 1, disable = 0
DATA.SET HWIO_ARM_CLK_EN_REG_ADDR %long 0x003fffff

y.spath.reset
; mjflash now also download the symbol, so skip it
d.load.elf &ELFname.elf /nocode /noclear
;
y.spath.reset

do setupyspath.cmm
do setupwindows

;break.set 0xFFFF0000 /onchip ; break at reset address of Internal boot
;break.set 0x0 /onchip   ;  break at reset address

Break.SELect.Program ONCHIP

do setupHWIO.cmm
