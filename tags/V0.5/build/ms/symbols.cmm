
; 2008-12-01 17hr20min
; PEDRO register symbols

if (Y.EXIST(PEDRO))
(
   print "symbols.cmm existed !!!"
   enddo
)

print " Loading register symbols..."

 Y.CREATE.L   PEDRO                                                       0x00000014; dummy

 Y.CREATE.L   HWIO_RX_AGC0_RESET_ADDR                                     0x90000200
 Y.CREATE.L   RX_AGC0_RESET                                               0x90000200
 Y.CREATE.L   HWIO_RX_AGC1_RESET_ADDR                                     0x90000300
 Y.CREATE.L   RX_AGC1_RESET                                               0x90000300
 Y.CREATE.L   HWIO_RX_AGC0_MODE_SEL_ADDR                                  0x90000204
 Y.CREATE.L   RX_AGC0_MODE_SEL                                            0x90000204
 Y.CREATE.L   HWIO_RX_AGC1_MODE_SEL_ADDR                                  0x90000304
 Y.CREATE.L   RX_AGC1_MODE_SEL                                            0x90000304
 Y.CREATE.L   HWIO_RX_AGC0_LGLUT_LVAL_ADDR                                0x90000208
 Y.CREATE.L   RX_AGC0_LGLUT_LVAL                                          0x90000208
 Y.CREATE.L   HWIO_RX_AGC1_LGLUT_LVAL_ADDR                                0x90000308
 Y.CREATE.L   RX_AGC1_LGLUT_LVAL                                          0x90000308
 Y.CREATE.L   HWIO_RX_AGC0_LGLUT_HVAL_ADDR                                0x9000020C
 Y.CREATE.L   RX_AGC0_LGLUT_HVAL                                          0x9000020C
 Y.CREATE.L   HWIO_RX_AGC1_LGLUT_HVAL_ADDR                                0x9000030C
 Y.CREATE.L   RX_AGC1_LGLUT_HVAL                                          0x9000030C
 Y.CREATE.L   HWIO_RX_AGC0_GAIN_CTL_ADDR                                  0x90000210
 Y.CREATE.L   RX_AGC0_GAIN_CTL                                            0x90000210
 Y.CREATE.L   HWIO_RX_AGC1_GAIN_CTL_ADDR                                  0x90000310
 Y.CREATE.L   RX_AGC1_GAIN_CTL                                            0x90000310
 Y.CREATE.L   HWIO_RX_AGC0_LNA_CTL_ADDR                                   0x90000214
 Y.CREATE.L   RX_AGC0_LNA_CTL                                             0x90000214
 Y.CREATE.L   HWIO_RX_AGC1_LNA_CTL_ADDR                                   0x90000314
 Y.CREATE.L   RX_AGC1_LNA_CTL                                             0x90000314
 Y.CREATE.L   HWIO_RX_AGC0_LNA_DATA_ADDR                                  0x90000218
 Y.CREATE.L   RX_AGC0_LNA_DATA                                            0x90000218
 Y.CREATE.L   HWIO_RX_AGC1_LNA_DATA_ADDR                                  0x90000318
 Y.CREATE.L   RX_AGC1_LNA_DATA                                            0x90000318
 Y.CREATE.L   HWIO_RX_AGC0_VALUE_WR_ADDR                                  0x9000021C
 Y.CREATE.L   RX_AGC0_VALUE_WR                                            0x9000021C
 Y.CREATE.L   HWIO_RX_AGC1_VALUE_WR_ADDR                                  0x9000031C
 Y.CREATE.L   RX_AGC1_VALUE_WR                                            0x9000031C
 Y.CREATE.L   HWIO_RX_AGC0_LNA_FILT_WR_ADDR                               0x90000220
 Y.CREATE.L   RX_AGC0_LNA_FILT_WR                                         0x90000220
 Y.CREATE.L   HWIO_RX_AGC1_LNA_FILT_WR_ADDR                               0x90000320
 Y.CREATE.L   RX_AGC1_LNA_FILT_WR                                         0x90000320
 Y.CREATE.L   HWIO_RX_AGC0_DC_GAIN_ADDR                                   0x90000224
 Y.CREATE.L   RX_AGC0_DC_GAIN                                             0x90000224
 Y.CREATE.L   HWIO_RX_AGC1_DC_GAIN_ADDR                                   0x90000324
 Y.CREATE.L   RX_AGC1_DC_GAIN                                             0x90000324
 Y.CREATE.L   HWIO_RX_AGC0_VALUE_1_MIN_ADDR                               0x90000228
 Y.CREATE.L   RX_AGC0_VALUE_1_MIN                                         0x90000228
 Y.CREATE.L   HWIO_RX_AGC0_VALUE_2_MIN_ADDR                               0x9000022C
 Y.CREATE.L   RX_AGC0_VALUE_2_MIN                                         0x9000022C
 Y.CREATE.L   HWIO_RX_AGC0_VALUE_3_MIN_ADDR                               0x90000230
 Y.CREATE.L   RX_AGC0_VALUE_3_MIN                                         0x90000230
 Y.CREATE.L   HWIO_RX_AGC0_VALUE_4_MIN_ADDR                               0x90000234
 Y.CREATE.L   RX_AGC0_VALUE_4_MIN                                         0x90000234
 Y.CREATE.L   HWIO_RX_AGC1_VALUE_1_MIN_ADDR                               0x90000328
 Y.CREATE.L   RX_AGC1_VALUE_1_MIN                                         0x90000328
 Y.CREATE.L   HWIO_RX_AGC1_VALUE_2_MIN_ADDR                               0x9000032C
 Y.CREATE.L   RX_AGC1_VALUE_2_MIN                                         0x9000032C
 Y.CREATE.L   HWIO_RX_AGC1_VALUE_3_MIN_ADDR                               0x90000330
 Y.CREATE.L   RX_AGC1_VALUE_3_MIN                                         0x90000330
 Y.CREATE.L   HWIO_RX_AGC1_VALUE_4_MIN_ADDR                               0x90000334
 Y.CREATE.L   RX_AGC1_VALUE_4_MIN                                         0x90000334
 Y.CREATE.L   HWIO_RX_AGC0_VALUE_MAX_ADDR                                 0x90000238
 Y.CREATE.L   RX_AGC0_VALUE_MAX                                           0x90000238
 Y.CREATE.L   HWIO_RX_AGC1_VALUE_MAX_ADDR                                 0x90000338
 Y.CREATE.L   RX_AGC1_VALUE_MAX                                           0x90000338
 Y.CREATE.L   HWIO_RX_AGC0_IM_LEVEL1_ADDR                                 0x9000023C
 Y.CREATE.L   RX_AGC0_IM_LEVEL1                                           0x9000023C
 Y.CREATE.L   HWIO_RX_AGC0_IM_LEVEL2_ADDR                                 0x90000240
 Y.CREATE.L   RX_AGC0_IM_LEVEL2                                           0x90000240
 Y.CREATE.L   HWIO_RX_AGC0_IM_LEVEL3_ADDR                                 0x90000244
 Y.CREATE.L   RX_AGC0_IM_LEVEL3                                           0x90000244
 Y.CREATE.L   HWIO_RX_AGC0_IM_LEVEL4_ADDR                                 0x90000248
 Y.CREATE.L   RX_AGC0_IM_LEVEL4                                           0x90000248
 Y.CREATE.L   HWIO_RX_AGC1_IM_LEVEL1_ADDR                                 0x9000033C
 Y.CREATE.L   RX_AGC1_IM_LEVEL1                                           0x9000033C
 Y.CREATE.L   HWIO_RX_AGC1_IM_LEVEL2_ADDR                                 0x90000340
 Y.CREATE.L   RX_AGC1_IM_LEVEL2                                           0x90000340
 Y.CREATE.L   HWIO_RX_AGC1_IM_LEVEL3_ADDR                                 0x90000344
 Y.CREATE.L   RX_AGC1_IM_LEVEL3                                           0x90000344
 Y.CREATE.L   HWIO_RX_AGC1_IM_LEVEL4_ADDR                                 0x90000348
 Y.CREATE.L   RX_AGC1_IM_LEVEL4                                           0x90000348
 Y.CREATE.L   HWIO_RX_AGC0_LNA_1_FALL_ADDR                                0x9000024C
 Y.CREATE.L   RX_AGC0_LNA_1_FALL                                          0x9000024C
 Y.CREATE.L   HWIO_RX_AGC0_LNA_2_FALL_ADDR                                0x90000250
 Y.CREATE.L   RX_AGC0_LNA_2_FALL                                          0x90000250
 Y.CREATE.L   HWIO_RX_AGC0_LNA_3_FALL_ADDR                                0x90000254
 Y.CREATE.L   RX_AGC0_LNA_3_FALL                                          0x90000254
 Y.CREATE.L   HWIO_RX_AGC0_LNA_4_FALL_ADDR                                0x90000258
 Y.CREATE.L   RX_AGC0_LNA_4_FALL                                          0x90000258
 Y.CREATE.L   HWIO_RX_AGC1_LNA_1_FALL_ADDR                                0x9000034C
 Y.CREATE.L   RX_AGC1_LNA_1_FALL                                          0x9000034C
 Y.CREATE.L   HWIO_RX_AGC1_LNA_2_FALL_ADDR                                0x90000350
 Y.CREATE.L   RX_AGC1_LNA_2_FALL                                          0x90000350
 Y.CREATE.L   HWIO_RX_AGC1_LNA_3_FALL_ADDR                                0x90000354
 Y.CREATE.L   RX_AGC1_LNA_3_FALL                                          0x90000354
 Y.CREATE.L   HWIO_RX_AGC1_LNA_4_FALL_ADDR                                0x90000358
 Y.CREATE.L   RX_AGC1_LNA_4_FALL                                          0x90000358
 Y.CREATE.L   HWIO_RX_AGC0_LNA_1_RISE_ADDR                                0x9000025C
 Y.CREATE.L   RX_AGC0_LNA_1_RISE                                          0x9000025C
 Y.CREATE.L   HWIO_RX_AGC0_LNA_2_RISE_ADDR                                0x90000260
 Y.CREATE.L   RX_AGC0_LNA_2_RISE                                          0x90000260
 Y.CREATE.L   HWIO_RX_AGC0_LNA_3_RISE_ADDR                                0x90000264
 Y.CREATE.L   RX_AGC0_LNA_3_RISE                                          0x90000264
 Y.CREATE.L   HWIO_RX_AGC0_LNA_4_RISE_ADDR                                0x90000268
 Y.CREATE.L   RX_AGC0_LNA_4_RISE                                          0x90000268
 Y.CREATE.L   HWIO_RX_AGC1_LNA_1_RISE_ADDR                                0x9000035C
 Y.CREATE.L   RX_AGC1_LNA_1_RISE                                          0x9000035C
 Y.CREATE.L   HWIO_RX_AGC1_LNA_2_RISE_ADDR                                0x90000360
 Y.CREATE.L   RX_AGC1_LNA_2_RISE                                          0x90000360
 Y.CREATE.L   HWIO_RX_AGC1_LNA_3_RISE_ADDR                                0x90000364
 Y.CREATE.L   RX_AGC1_LNA_3_RISE                                          0x90000364
 Y.CREATE.L   HWIO_RX_AGC1_LNA_4_RISE_ADDR                                0x90000368
 Y.CREATE.L   RX_AGC1_LNA_4_RISE                                          0x90000368
 Y.CREATE.L   HWIO_RX_AGC0_LNA_1_OFFSET_ADDR                              0x9000026C
 Y.CREATE.L   RX_AGC0_LNA_1_OFFSET                                        0x9000026C
 Y.CREATE.L   HWIO_RX_AGC0_LNA_2_OFFSET_ADDR                              0x90000270
 Y.CREATE.L   RX_AGC0_LNA_2_OFFSET                                        0x90000270
 Y.CREATE.L   HWIO_RX_AGC0_LNA_3_OFFSET_ADDR                              0x90000274
 Y.CREATE.L   RX_AGC0_LNA_3_OFFSET                                        0x90000274
 Y.CREATE.L   HWIO_RX_AGC0_LNA_4_OFFSET_ADDR                              0x90000278
 Y.CREATE.L   RX_AGC0_LNA_4_OFFSET                                        0x90000278
 Y.CREATE.L   HWIO_RX_AGC1_LNA_1_OFFSET_ADDR                              0x9000036C
 Y.CREATE.L   RX_AGC1_LNA_1_OFFSET                                        0x9000036C
 Y.CREATE.L   HWIO_RX_AGC1_LNA_2_OFFSET_ADDR                              0x90000370
 Y.CREATE.L   RX_AGC1_LNA_2_OFFSET                                        0x90000370
 Y.CREATE.L   HWIO_RX_AGC1_LNA_3_OFFSET_ADDR                              0x90000374
 Y.CREATE.L   RX_AGC1_LNA_3_OFFSET                                        0x90000374
 Y.CREATE.L   HWIO_RX_AGC1_LNA_4_OFFSET_ADDR                              0x90000378
 Y.CREATE.L   RX_AGC1_LNA_4_OFFSET                                        0x90000378
 Y.CREATE.L   HWIO_RX_AGC0_LNA_BP_TIMER_0_ADDR                            0x9000027C
 Y.CREATE.L   RX_AGC0_LNA_BP_TIMER_0                                      0x9000027C
 Y.CREATE.L   HWIO_RX_AGC0_LNA_BP_TIMER_1_ADDR                            0x90000280
 Y.CREATE.L   RX_AGC0_LNA_BP_TIMER_1                                      0x90000280
 Y.CREATE.L   HWIO_RX_AGC0_LNA_BP_TIMER_2_ADDR                            0x90000284
 Y.CREATE.L   RX_AGC0_LNA_BP_TIMER_2                                      0x90000284
 Y.CREATE.L   HWIO_RX_AGC0_LNA_BP_TIMER_3_ADDR                            0x90000288
 Y.CREATE.L   RX_AGC0_LNA_BP_TIMER_3                                      0x90000288
 Y.CREATE.L   HWIO_RX_AGC1_LNA_BP_TIMER_0_ADDR                            0x9000037C
 Y.CREATE.L   RX_AGC1_LNA_BP_TIMER_0                                      0x9000037C
 Y.CREATE.L   HWIO_RX_AGC1_LNA_BP_TIMER_1_ADDR                            0x90000380
 Y.CREATE.L   RX_AGC1_LNA_BP_TIMER_1                                      0x90000380
 Y.CREATE.L   HWIO_RX_AGC1_LNA_BP_TIMER_2_ADDR                            0x90000384
 Y.CREATE.L   RX_AGC1_LNA_BP_TIMER_2                                      0x90000384
 Y.CREATE.L   HWIO_RX_AGC1_LNA_BP_TIMER_3_ADDR                            0x90000388
 Y.CREATE.L   RX_AGC1_LNA_BP_TIMER_3                                      0x90000388
 Y.CREATE.L   HWIO_RX_AGC0_LNA_NBP_TIMER_0_ADDR                           0x9000028C
 Y.CREATE.L   RX_AGC0_LNA_NBP_TIMER_0                                     0x9000028C
 Y.CREATE.L   HWIO_RX_AGC0_LNA_NBP_TIMER_1_ADDR                           0x90000290
 Y.CREATE.L   RX_AGC0_LNA_NBP_TIMER_1                                     0x90000290
 Y.CREATE.L   HWIO_RX_AGC0_LNA_NBP_TIMER_2_ADDR                           0x90000294
 Y.CREATE.L   RX_AGC0_LNA_NBP_TIMER_2                                     0x90000294
 Y.CREATE.L   HWIO_RX_AGC0_LNA_NBP_TIMER_3_ADDR                           0x90000298
 Y.CREATE.L   RX_AGC0_LNA_NBP_TIMER_3                                     0x90000298
 Y.CREATE.L   HWIO_RX_AGC1_LNA_NBP_TIMER_0_ADDR                           0x9000038C
 Y.CREATE.L   RX_AGC1_LNA_NBP_TIMER_0                                     0x9000038C
 Y.CREATE.L   HWIO_RX_AGC1_LNA_NBP_TIMER_1_ADDR                           0x90000390
 Y.CREATE.L   RX_AGC1_LNA_NBP_TIMER_1                                     0x90000390
 Y.CREATE.L   HWIO_RX_AGC1_LNA_NBP_TIMER_2_ADDR                           0x90000394
 Y.CREATE.L   RX_AGC1_LNA_NBP_TIMER_2                                     0x90000394
 Y.CREATE.L   HWIO_RX_AGC1_LNA_NBP_TIMER_3_ADDR                           0x90000398
 Y.CREATE.L   RX_AGC1_LNA_NBP_TIMER_3                                     0x90000398
 Y.CREATE.L   HWIO_RX_AGC0_LNA_RANGE_DELAY_ADDR                           0x9000029C
 Y.CREATE.L   RX_AGC0_LNA_RANGE_DELAY                                     0x9000029C
 Y.CREATE.L   HWIO_RX_AGC1_LNA_RANGE_DELAY_ADDR                           0x9000039C
 Y.CREATE.L   RX_AGC1_LNA_RANGE_DELAY                                     0x9000039C
 Y.CREATE.L   HWIO_RX_AGC0_SBI_CTL_ADDR                                   0x900002A0
 Y.CREATE.L   RX_AGC0_SBI_CTL                                             0x900002A0
 Y.CREATE.L   HWIO_RX_AGC1_SBI_CTL_ADDR                                   0x900003A0
 Y.CREATE.L   RX_AGC1_SBI_CTL                                             0x900003A0
 Y.CREATE.L   HWIO_RX_AGC0_SBI_ID_ADDR                                    0x900002A4
 Y.CREATE.L   RX_AGC0_SBI_ID                                              0x900002A4
 Y.CREATE.L   HWIO_RX_AGC1_SBI_ID_ADDR                                    0x900003A4
 Y.CREATE.L   RX_AGC1_SBI_ID                                              0x900003A4
 Y.CREATE.L   HWIO_RX_AGC0_SBI_ADDR_ADDR                                  0x900002A8
 Y.CREATE.L   RX_AGC0_SBI_ADDR                                            0x900002A8
 Y.CREATE.L   HWIO_RX_AGC1_SBI_ADDR_ADDR                                  0x900003A8
 Y.CREATE.L   RX_AGC1_SBI_ADDR                                            0x900003A8
 Y.CREATE.L   HWIO_RX_AGC0_SBI_DATA0_ADDR                                 0x900002AC
 Y.CREATE.L   RX_AGC0_SBI_DATA0                                           0x900002AC
 Y.CREATE.L   HWIO_RX_AGC1_SBI_DATA0_ADDR                                 0x900003AC
 Y.CREATE.L   RX_AGC1_SBI_DATA0                                           0x900003AC
 Y.CREATE.L   HWIO_RX_AGC0_SBI_DATA1_ADDR                                 0x900002B0
 Y.CREATE.L   RX_AGC0_SBI_DATA1                                           0x900002B0
 Y.CREATE.L   HWIO_RX_AGC1_SBI_DATA1_ADDR                                 0x900003B0
 Y.CREATE.L   RX_AGC1_SBI_DATA1                                           0x900003B0
 Y.CREATE.L   HWIO_RX_AGC0_VREF_DELAY_TIMER_ADDR                          0x900002B4
 Y.CREATE.L   RX_AGC0_VREF_DELAY_TIMER                                    0x900002B4
 Y.CREATE.L   HWIO_RX_AGC1_VREF_DELAY_TIMER_ADDR                          0x900003B4
 Y.CREATE.L   RX_AGC1_VREF_DELAY_TIMER                                    0x900003B4
 Y.CREATE.L   HWIO_RX_AGC0_VREF_VAL_ADDR                                  0x900002B8
 Y.CREATE.L   RX_AGC0_VREF_VAL                                            0x900002B8
 Y.CREATE.L   HWIO_RX_AGC1_VREF_VAL_ADDR                                  0x900003B8
 Y.CREATE.L   RX_AGC1_VREF_VAL                                            0x900003B8
 Y.CREATE.L   HWIO_RX_AGC0_TEST_CTL_ADDR                                  0x900002BC
 Y.CREATE.L   RX_AGC0_TEST_CTL                                            0x900002BC
 Y.CREATE.L   HWIO_RX_AGC1_TEST_CTL_ADDR                                  0x900003BC
 Y.CREATE.L   RX_AGC1_TEST_CTL                                            0x900003BC
 Y.CREATE.L   HWIO_RX_AGC0_1X_VALUE_RD_ADDR                               0x900002C0
 Y.CREATE.L   RX_AGC0_1X_VALUE_RD                                         0x900002C0
 Y.CREATE.L   HWIO_RX_AGC1_1X_VALUE_RD_ADDR                               0x900003C0
 Y.CREATE.L   RX_AGC1_1X_VALUE_RD                                         0x900003C0
 Y.CREATE.L   HWIO_RX_AGC0_HDR_VALUE_RD_ADDR                              0x900002C4
 Y.CREATE.L   RX_AGC0_HDR_VALUE_RD                                        0x900002C4
 Y.CREATE.L   HWIO_RX_AGC1_HDR_VALUE_RD_ADDR                              0x900003C4
 Y.CREATE.L   RX_AGC1_HDR_VALUE_RD                                        0x900003C4
 Y.CREATE.L   HWIO_RX_AGC0_1X_VGA_GAIN_RD_ADDR                            0x900002C8
 Y.CREATE.L   RX_AGC0_1X_VGA_GAIN_RD                                      0x900002C8
 Y.CREATE.L   HWIO_RX_AGC1_1X_VGA_GAIN_RD_ADDR                            0x900003C8
 Y.CREATE.L   RX_AGC1_1X_VGA_GAIN_RD                                      0x900003C8
 Y.CREATE.L   HWIO_RX_AGC0_HDR_VGA_GAIN_RD_ADDR                           0x900002CC
 Y.CREATE.L   RX_AGC0_HDR_VGA_GAIN_RD                                     0x900002CC
 Y.CREATE.L   HWIO_RX_AGC1_HDR_VGA_GAIN_RD_ADDR                           0x900003CC
 Y.CREATE.L   RX_AGC1_HDR_VGA_GAIN_RD                                     0x900003CC
 Y.CREATE.L   HWIO_RX_AGC0_LNA_FILT_RD_ADDR                               0x900002D0
 Y.CREATE.L   RX_AGC0_LNA_FILT_RD                                         0x900002D0
 Y.CREATE.L   HWIO_RX_AGC1_LNA_FILT_RD_ADDR                               0x900003D0
 Y.CREATE.L   RX_AGC1_LNA_FILT_RD                                         0x900003D0
 Y.CREATE.L   HWIO_RX_AGC0_LNA_RANGE_RD_ADDR                              0x900002D4
 Y.CREATE.L   RX_AGC0_LNA_RANGE_RD                                        0x900002D4
 Y.CREATE.L   HWIO_RX_AGC1_LNA_RANGE_RD_ADDR                              0x900003D4
 Y.CREATE.L   RX_AGC1_LNA_RANGE_RD                                        0x900003D4
 Y.CREATE.L   HWIO_CDMA_RTC_SYNC_ADDR                                     0x90000400
 Y.CREATE.L   CDMA_RTC_SYNC                                               0x90000400
 Y.CREATE.L   HWIO_RTC_CNT_1X_ADDR                                        0x90000404
 Y.CREATE.L   RTC_CNT_1X                                                  0x90000404
 Y.CREATE.L   HWIO_RTC_SLEEP_ADDR                                         0x90000408
 Y.CREATE.L   RTC_SLEEP                                                   0x90000408
 Y.CREATE.L   HWIO_RTC_OFFSET_ADDR                                        0x9000040C
 Y.CREATE.L   RTC_OFFSET                                                  0x9000040C
 Y.CREATE.L   HWIO_RTC_LOAD_ADDR                                          0x90000410
 Y.CREATE.L   RTC_LOAD                                                    0x90000410
 Y.CREATE.L   HWIO_RTC_CTL_ADDR                                           0x90000414
 Y.CREATE.L   RTC_CTL                                                     0x90000414
 Y.CREATE.L   HWIO_RTC_GP_COMPARE1_ADDR                                   0x90000418
 Y.CREATE.L   RTC_GP_COMPARE1                                             0x90000418
 Y.CREATE.L   HWIO_RTC_GP_COMPARE2_ADDR                                   0x9000041C
 Y.CREATE.L   RTC_GP_COMPARE2                                             0x9000041C
 Y.CREATE.L   HWIO_RTC_DIFF_1XHDR_ADDR                                    0x90000420
 Y.CREATE.L   RTC_DIFF_1XHDR                                              0x90000420
 Y.CREATE.L   HWIO_RTC_INT_ENABLE_ADDR                                    0x90000424
 Y.CREATE.L   RTC_INT_ENABLE                                              0x90000424
 Y.CREATE.L   HWIO_RTC_INT_CLEAR_ADDR                                     0x90000428
 Y.CREATE.L   RTC_INT_CLEAR                                               0x90000428
 Y.CREATE.L   HWIO_RTC_INT_STATUS_ADDR                                    0x9000042C
 Y.CREATE.L   RTC_INT_STATUS                                              0x9000042C
 Y.CREATE.L   HWIO_RTC_INT_SELECT_ADDR                                    0x90000430
 Y.CREATE.L   RTC_INT_SELECT                                              0x90000430
 Y.CREATE.L   HWIO_RTC_TTRANS_CTL_1XHDR_ADDR                              0x90000434
 Y.CREATE.L   RTC_TTRANS_CTL_1XHDR                                        0x90000434
 Y.CREATE.L   HWIO_RTC_DUMP_STATUS_1XHDR_ADDR                             0x90000438
 Y.CREATE.L   RTC_DUMP_STATUS_1XHDR                                       0x90000438
 Y.CREATE.L   HWIO_RTC_TTRANS_TRIG_1X_ADDR                                0x9000043C
 Y.CREATE.L   RTC_TTRANS_TRIG_1X                                          0x9000043C
 Y.CREATE.L   HWIO_RTC_TTRANS_TRIG_HDR_ADDR                               0x90000440
 Y.CREATE.L   RTC_TTRANS_TRIG_HDR                                         0x90000440
 Y.CREATE.L   HWIO_RTC_DUMP_1X_ADDR                                       0x90000444
 Y.CREATE.L   RTC_DUMP_1X                                                 0x90000444
 Y.CREATE.L   HWIO_RTC_DUMP_HDR_ADDR                                      0x90000448
 Y.CREATE.L   RTC_DUMP_HDR                                                0x90000448
 Y.CREATE.L   HWIO_UNUSED_GPS_RTC_CNT_ADDR                                0x90000500
 Y.CREATE.L   UNUSED_GPS_RTC_CNT                                          0x90000500
 Y.CREATE.L   HWIO_UNUSED_GPS_RTC_CTL_ADDR                                0x90000504
 Y.CREATE.L   UNUSED_GPS_RTC_CTL                                          0x90000504
 Y.CREATE.L   HWIO_UNUSED_GPS_RTC_DUMP_STATUS_ADDR                        0x90000508
 Y.CREATE.L   UNUSED_GPS_RTC_DUMP_STATUS                                  0x90000508
 Y.CREATE.L   HWIO_UNUSED_GPS_RTC_TRIG_ADDR                               0x9000050C
 Y.CREATE.L   UNUSED_GPS_RTC_TRIG                                         0x9000050C
 Y.CREATE.L   HWIO_UNUSED_GPS_RTC_LOAD_ADDR                               0x90000510
 Y.CREATE.L   UNUSED_GPS_RTC_LOAD                                         0x90000510
 Y.CREATE.L   HWIO_UNUSED_GPS_RTC_DUMP_ADDR                               0x90000514
 Y.CREATE.L   UNUSED_GPS_RTC_DUMP                                         0x90000514
 Y.CREATE.L   HWIO_UNUSED_GPS_RTC_COMP_ADDR                               0x90000518
 Y.CREATE.L   UNUSED_GPS_RTC_COMP                                         0x90000518
 Y.CREATE.L   HWIO_CDMA_SAMPSRV_0_CTL_ADDR                                0x90000600
 Y.CREATE.L   CDMA_SAMPSRV_0_CTL                                          0x90000600
 Y.CREATE.L   HWIO_CDMA_SAMPSRV_1_CTL_ADDR                                0x90000604
 Y.CREATE.L   CDMA_SAMPSRV_1_CTL                                          0x90000604
 Y.CREATE.L   HWIO_CDMA_SAMPSRV_0_MODE_ADDR                               0x90000608
 Y.CREATE.L   CDMA_SAMPSRV_0_MODE                                         0x90000608
 Y.CREATE.L   HWIO_CDMA_SAMPSRV_1_MODE_ADDR                               0x9000060C
 Y.CREATE.L   CDMA_SAMPSRV_1_MODE                                         0x9000060C
 Y.CREATE.L   HWIO_CDMA_SAMPSRV_TEST_RAM_WE_CTL_ADDR                      0x90000610
 Y.CREATE.L   CDMA_SAMPSRV_TEST_RAM_WE_CTL                                0x90000610
 Y.CREATE.L   HWIO_CDMA_SAMPSRV_TEST_RAM_ADDR_ADDR                        0x90000614
 Y.CREATE.L   CDMA_SAMPSRV_TEST_RAM_ADDR                                  0x90000614
 Y.CREATE.L   HWIO_CDMA_SAMPSRV_TEST_RAM_DATA_ADDR                        0x90000618
 Y.CREATE.L   CDMA_SAMPSRV_TEST_RAM_DATA                                  0x90000618
 Y.CREATE.L   HWIO_CDMA_SAMPSRV_0_LATEST_RTC_ADDR                         0x9000061C
 Y.CREATE.L   CDMA_SAMPSRV_0_LATEST_RTC                                   0x9000061C
 Y.CREATE.L   HWIO_CDMA_SAMPSRV_1_LATEST_RTC_ADDR                         0x90000620
 Y.CREATE.L   CDMA_SAMPSRV_1_LATEST_RTC                                   0x90000620
 Y.CREATE.L   HWIO_CDMA_PNSRV_ROM_BIST_MODE_ADDR                          0x90000624
 Y.CREATE.L   CDMA_PNSRV_ROM_BIST_MODE                                    0x90000624
 Y.CREATE.L   HWIO_CDMA_PNSRV_ROM_BIST_CMD_ADDR                           0x90000628
 Y.CREATE.L   CDMA_PNSRV_ROM_BIST_CMD                                     0x90000628
 Y.CREATE.L   HWIO_CDMA_PNSRV_ROM_BIST_STATUS_ADDR                        0x9000062C
 Y.CREATE.L   CDMA_PNSRV_ROM_BIST_STATUS                                  0x9000062C
 Y.CREATE.L   HWIO_CDMA_PNSRV_TEST_MODE_ADDR                              0x90000630
 Y.CREATE.L   CDMA_PNSRV_TEST_MODE                                        0x90000630
 Y.CREATE.L   HWIO_CDMA_PNSRV_TEST_MISR_RESET_ADDR                        0x90000634
 Y.CREATE.L   CDMA_PNSRV_TEST_MISR_RESET                                  0x90000634
 Y.CREATE.L   HWIO_CDMA_PNSRV_TEST_EXPORT_MISR_ADDR                       0x90000638
 Y.CREATE.L   CDMA_PNSRV_TEST_EXPORT_MISR                                 0x90000638
 Y.CREATE.L   HWIO_CDMA_PNSRV_TEST_MISR_CURR_VAL_ADDR                     0x9000063C
 Y.CREATE.L   CDMA_PNSRV_TEST_MISR_CURR_VAL                               0x9000063C
 Y.CREATE.L   HWIO_CDMA_SAMPSRV_CLK_DISABLE_ADDR                          0x90000640
 Y.CREATE.L   CDMA_SAMPSRV_CLK_DISABLE                                    0x90000640
 Y.CREATE.L   HWIO_CDMA_SAMPSRV_CLK_STATUS_ADDR                           0x90000644
 Y.CREATE.L   CDMA_SAMPSRV_CLK_STATUS                                     0x90000644
 Y.CREATE.L   HWIO_CDMA_SAMPSRV_CTL_SEL_ADDR                              0x90000648
 Y.CREATE.L   CDMA_SAMPSRV_CTL_SEL                                        0x90000648
 Y.CREATE.L   HWIO_DEM1X_RESET_ADDR                                       0x90000700
 Y.CREATE.L   DEM1X_RESET                                                 0x90000700
 Y.CREATE.L   HWIO_DEM1X_SYNC_ADDR                                        0x90000704
 Y.CREATE.L   DEM1X_SYNC                                                  0x90000704
 Y.CREATE.L   HWIO_DEM1X_LATCH_ADDR                                       0x90000708
 Y.CREATE.L   DEM1X_LATCH                                                 0x90000708
 Y.CREATE.L   HWIO_DEM1X_TRACKING_ADDR                                    0x9000070C
 Y.CREATE.L   DEM1X_TRACKING                                              0x9000070C
 Y.CREATE.L   HWIO_DEM1X_FRAME_OFFSET_ADDR                                0x90000710
 Y.CREATE.L   DEM1X_FRAME_OFFSET                                          0x90000710
 Y.CREATE.L   HWIO_DEM1X_FINGER_MERGE_ADDR                                0x90000714
 Y.CREATE.L   DEM1X_FINGER_MERGE                                          0x90000714
 Y.CREATE.L   HWIO_DEM1X_FINGER0_ADDR                                     0x90000718
 Y.CREATE.L   DEM1X_FINGER0                                               0x90000718
 Y.CREATE.L   HWIO_DEM1X_FINGER1_ADDR                                     0x9000071C
 Y.CREATE.L   DEM1X_FINGER1                                               0x9000071C
 Y.CREATE.L   HWIO_DEM1X_FINGER2_ADDR                                     0x90000720
 Y.CREATE.L   DEM1X_FINGER2                                               0x90000720
 Y.CREATE.L   HWIO_DEM1X_FINGER3_ADDR                                     0x90000724
 Y.CREATE.L   DEM1X_FINGER3                                               0x90000724
 Y.CREATE.L   HWIO_DEM1X_FINGER4_ADDR                                     0x90000728
 Y.CREATE.L   DEM1X_FINGER4                                               0x90000728
 Y.CREATE.L   HWIO_DEM1X_FINGER5_ADDR                                     0x9000072C
 Y.CREATE.L   DEM1X_FINGER5                                               0x9000072C
 Y.CREATE.L   HWIO_DEM1X_FINGER6_ADDR                                     0x90000730
 Y.CREATE.L   DEM1X_FINGER6                                               0x90000730
 Y.CREATE.L   HWIO_DEM1X_FINGER7_ADDR                                     0x90000734
 Y.CREATE.L   DEM1X_FINGER7                                               0x90000734
 Y.CREATE.L   HWIO_DEM1X_COMBINER_TIME_LOAD_ADDR                          0x90000738
 Y.CREATE.L   DEM1X_COMBINER_TIME_LOAD                                    0x90000738
 Y.CREATE.L   HWIO_DEM1X_ARM_COMBINER_SLAM_ADDR                           0x9000073C
 Y.CREATE.L   DEM1X_ARM_COMBINER_SLAM                                     0x9000073C
 Y.CREATE.L   HWIO_DEM1X_SLEW_COMBINER_TIME_ADDR                          0x90000740
 Y.CREATE.L   DEM1X_SLEW_COMBINER_TIME                                    0x90000740
 Y.CREATE.L   HWIO_DEM1X_LC_STATE_LOAD_LO_ADDR                            0x90000748
 Y.CREATE.L   DEM1X_LC_STATE_LOAD_LO                                      0x90000748
 Y.CREATE.L   HWIO_DEM1X_LC_STATE_LOAD_HI_ADDR                            0x9000074C
 Y.CREATE.L   DEM1X_LC_STATE_LOAD_HI                                      0x9000074C
 Y.CREATE.L   HWIO_DEM1X_ARM_LC_STATE_LOAD_ADDR                           0x90000750
 Y.CREATE.L   DEM1X_ARM_LC_STATE_LOAD                                     0x90000750
 Y.CREATE.L   HWIO_DEM1X_COMBINER_TIME_ADDR                               0x90000754
 Y.CREATE.L   DEM1X_COMBINER_TIME                                         0x90000754
 Y.CREATE.L   HWIO_DEM1X_FRAME_COUNT_ADDR                                 0x90000758
 Y.CREATE.L   DEM1X_FRAME_COUNT                                           0x90000758
 Y.CREATE.L   HWIO_DEM1X_LC_STATE_LO_ADDR                                 0x9000075C
 Y.CREATE.L   DEM1X_LC_STATE_LO                                           0x9000075C
 Y.CREATE.L   HWIO_DEM1X_LC_STATE_HI_ADDR                                 0x90000760
 Y.CREATE.L   DEM1X_LC_STATE_HI                                           0x90000760
 Y.CREATE.L   HWIO_DEM1X_TRAFFIC_REV_PWR_CTL_ADDR                         0x90000764
 Y.CREATE.L   DEM1X_TRAFFIC_REV_PWR_CTL                                   0x90000764
 Y.CREATE.L   HWIO_DEM1X_COMMON_REV_PWR_CTL_ADDR                          0x90000768
 Y.CREATE.L   DEM1X_COMMON_REV_PWR_CTL                                    0x90000768
 Y.CREATE.L   HWIO_DEM1X_COMMON_REV_PWR_CTL2_ADDR                         0x9000076C
 Y.CREATE.L   DEM1X_COMMON_REV_PWR_CTL2                                   0x9000076C
 Y.CREATE.L   HWIO_DEM1X_FWD_PWR_CTL_IMMED_ADDR                           0x90000770
 Y.CREATE.L   DEM1X_FWD_PWR_CTL_IMMED                                     0x90000770
 Y.CREATE.L   HWIO_DEM1X_FWD_PWR_CTL_FRAME_ADDR                           0x90000774
 Y.CREATE.L   DEM1X_FWD_PWR_CTL_FRAME                                     0x90000774
 Y.CREATE.L   HWIO_DEM1X_FWD_PWR_CTL_TIMING_ADDR                          0x90000778
 Y.CREATE.L   DEM1X_FWD_PWR_CTL_TIMING                                    0x90000778
 Y.CREATE.L   HWIO_DEM1X_BETA_TIMING_ADDR                                 0x9000077C
 Y.CREATE.L   DEM1X_BETA_TIMING                                           0x9000077C
 Y.CREATE.L   HWIO_DEM1X_TIME_INT1_ENABLE_ADDR                            0x90000784
 Y.CREATE.L   DEM1X_TIME_INT1_ENABLE                                      0x90000784
 Y.CREATE.L   HWIO_DEM1X_TIME_INT1_STATUS_ADDR                            0x90000788
 Y.CREATE.L   DEM1X_TIME_INT1_STATUS                                      0x90000788
 Y.CREATE.L   HWIO_DEM1X_TIME_INT1_CLEAR_ADDR                             0x9000078C
 Y.CREATE.L   DEM1X_TIME_INT1_CLEAR                                       0x9000078C
 Y.CREATE.L   HWIO_DEM1X_TIME_INT2_ENABLE_ADDR                            0x90000790
 Y.CREATE.L   DEM1X_TIME_INT2_ENABLE                                      0x90000790
 Y.CREATE.L   HWIO_DEM1X_TIME_INT2_STATUS_ADDR                            0x90000794
 Y.CREATE.L   DEM1X_TIME_INT2_STATUS                                      0x90000794
 Y.CREATE.L   HWIO_DEM1X_TIME_INT2_CLEAR_ADDR                             0x90000798
 Y.CREATE.L   DEM1X_TIME_INT2_CLEAR                                       0x90000798
 Y.CREATE.L   HWIO_DEM1X_CH0_LC_MASK_LO_IMMED_ADDR                        0x9000079C
 Y.CREATE.L   DEM1X_CH0_LC_MASK_LO_IMMED                                  0x9000079C
 Y.CREATE.L   HWIO_DEM1X_CH1_LC_MASK_LO_IMMED_ADDR                        0x900007A4
 Y.CREATE.L   DEM1X_CH1_LC_MASK_LO_IMMED                                  0x900007A4
 Y.CREATE.L   HWIO_DEM1X_CH2_LC_MASK_LO_IMMED_ADDR                        0x900007AC
 Y.CREATE.L   DEM1X_CH2_LC_MASK_LO_IMMED                                  0x900007AC
 Y.CREATE.L   HWIO_DEM1X_CH3_LC_MASK_LO_IMMED_ADDR                        0x900007B4
 Y.CREATE.L   DEM1X_CH3_LC_MASK_LO_IMMED                                  0x900007B4
 Y.CREATE.L   HWIO_DEM1X_CH4_LC_MASK_LO_IMMED_ADDR                        0x900007BC
 Y.CREATE.L   DEM1X_CH4_LC_MASK_LO_IMMED                                  0x900007BC
 Y.CREATE.L   HWIO_DEM1X_CH5_LC_MASK_LO_IMMED_ADDR                        0x900007C4
 Y.CREATE.L   DEM1X_CH5_LC_MASK_LO_IMMED                                  0x900007C4
 Y.CREATE.L   HWIO_DEM1X_CH6_LC_MASK_LO_IMMED_ADDR                        0x900007CC
 Y.CREATE.L   DEM1X_CH6_LC_MASK_LO_IMMED                                  0x900007CC
 Y.CREATE.L   HWIO_DEM1X_CH7_LC_MASK_LO_IMMED_ADDR                        0x900007D4
 Y.CREATE.L   DEM1X_CH7_LC_MASK_LO_IMMED                                  0x900007D4
 Y.CREATE.L   HWIO_DEM1X_CH8_LC_MASK_LO_IMMED_ADDR                        0x900007DC
 Y.CREATE.L   DEM1X_CH8_LC_MASK_LO_IMMED                                  0x900007DC
 Y.CREATE.L   HWIO_DEM1X_CH0_LC_MASK_HI_IMMED_ADDR                        0x900007A0
 Y.CREATE.L   DEM1X_CH0_LC_MASK_HI_IMMED                                  0x900007A0
 Y.CREATE.L   HWIO_DEM1X_CH1_LC_MASK_HI_IMMED_ADDR                        0x900007A8
 Y.CREATE.L   DEM1X_CH1_LC_MASK_HI_IMMED                                  0x900007A8
 Y.CREATE.L   HWIO_DEM1X_CH2_LC_MASK_HI_IMMED_ADDR                        0x900007B0
 Y.CREATE.L   DEM1X_CH2_LC_MASK_HI_IMMED                                  0x900007B0
 Y.CREATE.L   HWIO_DEM1X_CH3_LC_MASK_HI_IMMED_ADDR                        0x900007B8
 Y.CREATE.L   DEM1X_CH3_LC_MASK_HI_IMMED                                  0x900007B8
 Y.CREATE.L   HWIO_DEM1X_CH4_LC_MASK_HI_IMMED_ADDR                        0x900007C0
 Y.CREATE.L   DEM1X_CH4_LC_MASK_HI_IMMED                                  0x900007C0
 Y.CREATE.L   HWIO_DEM1X_CH5_LC_MASK_HI_IMMED_ADDR                        0x900007C8
 Y.CREATE.L   DEM1X_CH5_LC_MASK_HI_IMMED                                  0x900007C8
 Y.CREATE.L   HWIO_DEM1X_CH6_LC_MASK_HI_IMMED_ADDR                        0x900007D0
 Y.CREATE.L   DEM1X_CH6_LC_MASK_HI_IMMED                                  0x900007D0
 Y.CREATE.L   HWIO_DEM1X_CH7_LC_MASK_HI_IMMED_ADDR                        0x900007D8
 Y.CREATE.L   DEM1X_CH7_LC_MASK_HI_IMMED                                  0x900007D8
 Y.CREATE.L   HWIO_DEM1X_CH8_LC_MASK_HI_IMMED_ADDR                        0x900007E0
 Y.CREATE.L   DEM1X_CH8_LC_MASK_HI_IMMED                                  0x900007E0
 Y.CREATE.L   HWIO_DEM1X_CH0_LC_MASK_LO_SPN_ROLL_ADDR                     0x900007E4
 Y.CREATE.L   DEM1X_CH0_LC_MASK_LO_SPN_ROLL                               0x900007E4
 Y.CREATE.L   HWIO_DEM1X_CH1_LC_MASK_LO_SPN_ROLL_ADDR                     0x900007EC
 Y.CREATE.L   DEM1X_CH1_LC_MASK_LO_SPN_ROLL                               0x900007EC
 Y.CREATE.L   HWIO_DEM1X_CH2_LC_MASK_LO_SPN_ROLL_ADDR                     0x900007F4
 Y.CREATE.L   DEM1X_CH2_LC_MASK_LO_SPN_ROLL                               0x900007F4
 Y.CREATE.L   HWIO_DEM1X_CH3_LC_MASK_LO_SPN_ROLL_ADDR                     0x900007FC
 Y.CREATE.L   DEM1X_CH3_LC_MASK_LO_SPN_ROLL                               0x900007FC
 Y.CREATE.L   HWIO_DEM1X_CH4_LC_MASK_LO_SPN_ROLL_ADDR                     0x90000804
 Y.CREATE.L   DEM1X_CH4_LC_MASK_LO_SPN_ROLL                               0x90000804
 Y.CREATE.L   HWIO_DEM1X_CH5_LC_MASK_LO_SPN_ROLL_ADDR                     0x9000080C
 Y.CREATE.L   DEM1X_CH5_LC_MASK_LO_SPN_ROLL                               0x9000080C
 Y.CREATE.L   HWIO_DEM1X_CH6_LC_MASK_LO_SPN_ROLL_ADDR                     0x90000814
 Y.CREATE.L   DEM1X_CH6_LC_MASK_LO_SPN_ROLL                               0x90000814
 Y.CREATE.L   HWIO_DEM1X_CH7_LC_MASK_LO_SPN_ROLL_ADDR                     0x9000081C
 Y.CREATE.L   DEM1X_CH7_LC_MASK_LO_SPN_ROLL                               0x9000081C
 Y.CREATE.L   HWIO_DEM1X_CH8_LC_MASK_LO_SPN_ROLL_ADDR                     0x90000824
 Y.CREATE.L   DEM1X_CH8_LC_MASK_LO_SPN_ROLL                               0x90000824
 Y.CREATE.L   HWIO_DEM1X_CH0_LC_MASK_HI_SPN_ROLL_ADDR                     0x900007E8
 Y.CREATE.L   DEM1X_CH0_LC_MASK_HI_SPN_ROLL                               0x900007E8
 Y.CREATE.L   HWIO_DEM1X_CH1_LC_MASK_HI_SPN_ROLL_ADDR                     0x900007F0
 Y.CREATE.L   DEM1X_CH1_LC_MASK_HI_SPN_ROLL                               0x900007F0
 Y.CREATE.L   HWIO_DEM1X_CH2_LC_MASK_HI_SPN_ROLL_ADDR                     0x900007F8
 Y.CREATE.L   DEM1X_CH2_LC_MASK_HI_SPN_ROLL                               0x900007F8
 Y.CREATE.L   HWIO_DEM1X_CH3_LC_MASK_HI_SPN_ROLL_ADDR                     0x90000800
 Y.CREATE.L   DEM1X_CH3_LC_MASK_HI_SPN_ROLL                               0x90000800
 Y.CREATE.L   HWIO_DEM1X_CH4_LC_MASK_HI_SPN_ROLL_ADDR                     0x90000808
 Y.CREATE.L   DEM1X_CH4_LC_MASK_HI_SPN_ROLL                               0x90000808
 Y.CREATE.L   HWIO_DEM1X_CH5_LC_MASK_HI_SPN_ROLL_ADDR                     0x90000810
 Y.CREATE.L   DEM1X_CH5_LC_MASK_HI_SPN_ROLL                               0x90000810
 Y.CREATE.L   HWIO_DEM1X_CH6_LC_MASK_HI_SPN_ROLL_ADDR                     0x90000818
 Y.CREATE.L   DEM1X_CH6_LC_MASK_HI_SPN_ROLL                               0x90000818
 Y.CREATE.L   HWIO_DEM1X_CH7_LC_MASK_HI_SPN_ROLL_ADDR                     0x90000820
 Y.CREATE.L   DEM1X_CH7_LC_MASK_HI_SPN_ROLL                               0x90000820
 Y.CREATE.L   HWIO_DEM1X_CH8_LC_MASK_HI_SPN_ROLL_ADDR                     0x90000828
 Y.CREATE.L   DEM1X_CH8_LC_MASK_HI_SPN_ROLL                               0x90000828
 Y.CREATE.L   HWIO_DEM1X_COMBINER_CTL_ADDR                                0x9000082C
 Y.CREATE.L   DEM1X_COMBINER_CTL                                          0x9000082C
 Y.CREATE.L   HWIO_DEM1X_FW_CH_ENABLE_IMMED_ADDR                          0x90000830
 Y.CREATE.L   DEM1X_FW_CH_ENABLE_IMMED                                    0x90000830
 Y.CREATE.L   HWIO_DEM1X_FW_CH_ENABLE_FRAME_ADDR                          0x90000834
 Y.CREATE.L   DEM1X_FW_CH_ENABLE_FRAME                                    0x90000834
 Y.CREATE.L   HWIO_DEM1X_CHANNEL0_IMMED_ADDR                              0x90000838
 Y.CREATE.L   DEM1X_CHANNEL0_IMMED                                        0x90000838
 Y.CREATE.L   HWIO_DEM1X_CHANNEL0_FRAME_ADDR                              0x9000083C
 Y.CREATE.L   DEM1X_CHANNEL0_FRAME                                        0x9000083C
 Y.CREATE.L   HWIO_DEM1X_CHANNEL1_IMMED_ADDR                              0x90000840
 Y.CREATE.L   DEM1X_CHANNEL1_IMMED                                        0x90000840
 Y.CREATE.L   HWIO_DEM1X_CHANNEL1_FRAME_ADDR                              0x90000844
 Y.CREATE.L   DEM1X_CHANNEL1_FRAME                                        0x90000844
 Y.CREATE.L   HWIO_DEM1X_CHANNEL2_IMMED_ADDR                              0x90000848
 Y.CREATE.L   DEM1X_CHANNEL2_IMMED                                        0x90000848
 Y.CREATE.L   HWIO_DEM1X_CHANNEL2_FRAME_ADDR                              0x9000084C
 Y.CREATE.L   DEM1X_CHANNEL2_FRAME                                        0x9000084C
 Y.CREATE.L   HWIO_DEM1X_CHANNEL3_IMMED_ADDR                              0x90000850
 Y.CREATE.L   DEM1X_CHANNEL3_IMMED                                        0x90000850
 Y.CREATE.L   HWIO_DEM1X_CHANNEL3_FRAME_ADDR                              0x90000854
 Y.CREATE.L   DEM1X_CHANNEL3_FRAME                                        0x90000854
 Y.CREATE.L   HWIO_DEM1X_CHANNEL4_IMMED_ADDR                              0x90000858
 Y.CREATE.L   DEM1X_CHANNEL4_IMMED                                        0x90000858
 Y.CREATE.L   HWIO_DEM1X_CHANNEL4_FRAME_ADDR                              0x9000085C
 Y.CREATE.L   DEM1X_CHANNEL4_FRAME                                        0x9000085C
 Y.CREATE.L   HWIO_DEM1X_CHANNEL5_IMMED_ADDR                              0x90000860
 Y.CREATE.L   DEM1X_CHANNEL5_IMMED                                        0x90000860
 Y.CREATE.L   HWIO_DEM1X_CHANNEL5_FRAME_ADDR                              0x90000864
 Y.CREATE.L   DEM1X_CHANNEL5_FRAME                                        0x90000864
 Y.CREATE.L   HWIO_DEM1X_CHANNEL6_IMMED_ADDR                              0x90000868
 Y.CREATE.L   DEM1X_CHANNEL6_IMMED                                        0x90000868
 Y.CREATE.L   HWIO_DEM1X_CHANNEL6_FRAME_ADDR                              0x9000086C
 Y.CREATE.L   DEM1X_CHANNEL6_FRAME                                        0x9000086C
 Y.CREATE.L   HWIO_DEM1X_CHANNEL8_IMMED_ADDR                              0x90000870
 Y.CREATE.L   DEM1X_CHANNEL8_IMMED                                        0x90000870
 Y.CREATE.L   HWIO_DEM1X_CHANNEL8_FRAME_ADDR                              0x90000874
 Y.CREATE.L   DEM1X_CHANNEL8_FRAME                                        0x90000874
 Y.CREATE.L   HWIO_DEM1X_ACKCH_FINGER0_IMMED_ADDR                         0x90000878
 Y.CREATE.L   DEM1X_ACKCH_FINGER0_IMMED                                   0x90000878
 Y.CREATE.L   HWIO_DEM1X_ACKCH_FINGER1_IMMED_ADDR                         0x9000087C
 Y.CREATE.L   DEM1X_ACKCH_FINGER1_IMMED                                   0x9000087C
 Y.CREATE.L   HWIO_DEM1X_ACKCH_FINGER2_IMMED_ADDR                         0x90000880
 Y.CREATE.L   DEM1X_ACKCH_FINGER2_IMMED                                   0x90000880
 Y.CREATE.L   HWIO_DEM1X_ACKCH_FINGER3_IMMED_ADDR                         0x90000884
 Y.CREATE.L   DEM1X_ACKCH_FINGER3_IMMED                                   0x90000884
 Y.CREATE.L   HWIO_DEM1X_ACKCH_FINGER4_IMMED_ADDR                         0x90000888
 Y.CREATE.L   DEM1X_ACKCH_FINGER4_IMMED                                   0x90000888
 Y.CREATE.L   HWIO_DEM1X_ACKCH_FINGER5_IMMED_ADDR                         0x9000088C
 Y.CREATE.L   DEM1X_ACKCH_FINGER5_IMMED                                   0x9000088C
 Y.CREATE.L   HWIO_DEM1X_ACKCH_FINGER0_FRAME_ADDR                         0x90000890
 Y.CREATE.L   DEM1X_ACKCH_FINGER0_FRAME                                   0x90000890
 Y.CREATE.L   HWIO_DEM1X_ACKCH_FINGER1_FRAME_ADDR                         0x90000894
 Y.CREATE.L   DEM1X_ACKCH_FINGER1_FRAME                                   0x90000894
 Y.CREATE.L   HWIO_DEM1X_ACKCH_FINGER2_FRAME_ADDR                         0x90000898
 Y.CREATE.L   DEM1X_ACKCH_FINGER2_FRAME                                   0x90000898
 Y.CREATE.L   HWIO_DEM1X_ACKCH_FINGER3_FRAME_ADDR                         0x9000089C
 Y.CREATE.L   DEM1X_ACKCH_FINGER3_FRAME                                   0x9000089C
 Y.CREATE.L   HWIO_DEM1X_ACKCH_FINGER4_FRAME_ADDR                         0x900008A0
 Y.CREATE.L   DEM1X_ACKCH_FINGER4_FRAME                                   0x900008A0
 Y.CREATE.L   HWIO_DEM1X_ACKCH_FINGER5_FRAME_ADDR                         0x900008A4
 Y.CREATE.L   DEM1X_ACKCH_FINGER5_FRAME                                   0x900008A4
 Y.CREATE.L   HWIO_DEM1X_RCCH_CTL_ADDR                                    0x900008A8
 Y.CREATE.L   DEM1X_RCCH_CTL                                              0x900008A8
 Y.CREATE.L   HWIO_DEM1X_RCCH_CTL2_ADDR                                   0x900008AC
 Y.CREATE.L   DEM1X_RCCH_CTL2                                             0x900008AC
 Y.CREATE.L   HWIO_DEM1X_SYS_TIME_GP_COMPARE_ADDR                         0x900008B0
 Y.CREATE.L   DEM1X_SYS_TIME_GP_COMPARE                                   0x900008B0
 Y.CREATE.L   HWIO_DEM1X_OFFLINE_ADDR                                     0x900008B4
 Y.CREATE.L   DEM1X_OFFLINE                                               0x900008B4
 Y.CREATE.L   HWIO_DEM1X_REF_COUNT_ADDR                                   0x900008B8
 Y.CREATE.L   DEM1X_REF_COUNT                                             0x900008B8
 Y.CREATE.L   HWIO_DEM1X_RTC_ADJUST_ADDR                                  0x900008BC
 Y.CREATE.L   DEM1X_RTC_ADJUST                                            0x900008BC
 Y.CREATE.L   HWIO_DEM1X_RTF_CTL_SEL_ADDR                                 0x900008C0
 Y.CREATE.L   DEM1X_RTF_CTL_SEL                                           0x900008C0
 Y.CREATE.L   HWIO_DEM1X_LPN_ADV_ADDR                                     0x900008C4
 Y.CREATE.L   DEM1X_LPN_ADV                                               0x900008C4
 Y.CREATE.L   HWIO_DEM1X_FINGER_MERGE_F8_ADDR                             0x900008C8
 Y.CREATE.L   DEM1X_FINGER_MERGE_F8                                       0x900008C8
 Y.CREATE.L   HWIO_DEM1X_CX8_TEST_MODE_ADDR                               0x900008CC
 Y.CREATE.L   DEM1X_CX8_TEST_MODE                                         0x900008CC
 Y.CREATE.L   HWIO_DEM1X_CX8_TEST_MISR_RESET_ADDR                         0x900008D0
 Y.CREATE.L   DEM1X_CX8_TEST_MISR_RESET                                   0x900008D0
 Y.CREATE.L   HWIO_DEM1X_CX8_TEST_EXPORT_MISR_ADDR                        0x900008D4
 Y.CREATE.L   DEM1X_CX8_TEST_EXPORT_MISR                                  0x900008D4
 Y.CREATE.L   HWIO_DEM1X_CX8_TEST_CAPTURED_ADDR                           0x900008D8
 Y.CREATE.L   DEM1X_CX8_TEST_CAPTURED                                     0x900008D8
 Y.CREATE.L   HWIO_DEM1X_CX8_TEST_MISR_CURR_VAL_ADDR                      0x900008DC
 Y.CREATE.L   DEM1X_CX8_TEST_MISR_CURR_VAL                                0x900008DC
 Y.CREATE.L   HWIO_DEM1X_CX8_TEST_MISR_CAPT_VAL_ADDR                      0x900008E0
 Y.CREATE.L   DEM1X_CX8_TEST_MISR_CAPT_VAL                                0x900008E0
 Y.CREATE.L   HWIO_DEM1X_MICRO_CX8_CLK_CTL_ADDR                           0x900008E4
 Y.CREATE.L   DEM1X_MICRO_CX8_CLK_CTL                                     0x900008E4
 Y.CREATE.L   HWIO_DEM1X_CX8_CLK_STATUS_ADDR                              0x900008E8
 Y.CREATE.L   DEM1X_CX8_CLK_STATUS                                        0x900008E8
 Y.CREATE.L   HWIO_DEM1X_RXCX8_SPARE_READ_REG0_ADDR                       0x900008EC
 Y.CREATE.L   DEM1X_RXCX8_SPARE_READ_REG0                                 0x900008EC
 Y.CREATE.L   HWIO_DEM1X_RXCX8_SPARE_READ_REG1_ADDR                       0x900008F0
 Y.CREATE.L   DEM1X_RXCX8_SPARE_READ_REG1                                 0x900008F0
 Y.CREATE.L   HWIO_DEM1X_RXCX8_SPARE_READ_REG2_ADDR                       0x900008F4
 Y.CREATE.L   DEM1X_RXCX8_SPARE_READ_REG2                                 0x900008F4
 Y.CREATE.L   HWIO_DEM1X_RXCX8_SPARE_READ_REG3_ADDR                       0x900008F8
 Y.CREATE.L   DEM1X_RXCX8_SPARE_READ_REG3                                 0x900008F8
 Y.CREATE.L   HWIO_DEM1X_RXCX8WR_SPARE_READ_REG0_ADDR                     0x900008FC
 Y.CREATE.L   DEM1X_RXCX8WR_SPARE_READ_REG0                               0x900008FC
 Y.CREATE.L   HWIO_DEM1X_F0_PILOT_IMMED_ADDR                              0x90000900
 Y.CREATE.L   DEM1X_F0_PILOT_IMMED                                        0x90000900
 Y.CREATE.L   HWIO_DEM1X_F1_PILOT_IMMED_ADDR                              0x90000974
 Y.CREATE.L   DEM1X_F1_PILOT_IMMED                                        0x90000974
 Y.CREATE.L   HWIO_DEM1X_F2_PILOT_IMMED_ADDR                              0x900009E8
 Y.CREATE.L   DEM1X_F2_PILOT_IMMED                                        0x900009E8
 Y.CREATE.L   HWIO_DEM1X_F3_PILOT_IMMED_ADDR                              0x90000A5C
 Y.CREATE.L   DEM1X_F3_PILOT_IMMED                                        0x90000A5C
 Y.CREATE.L   HWIO_DEM1X_F4_PILOT_IMMED_ADDR                              0x90000AD0
 Y.CREATE.L   DEM1X_F4_PILOT_IMMED                                        0x90000AD0
 Y.CREATE.L   HWIO_DEM1X_F5_PILOT_IMMED_ADDR                              0x90000B44
 Y.CREATE.L   DEM1X_F5_PILOT_IMMED                                        0x90000B44
 Y.CREATE.L   HWIO_DEM1X_F6_PILOT_IMMED_ADDR                              0x90000BB8
 Y.CREATE.L   DEM1X_F6_PILOT_IMMED                                        0x90000BB8
 Y.CREATE.L   HWIO_DEM1X_F7_PILOT_IMMED_ADDR                              0x90000C2C
 Y.CREATE.L   DEM1X_F7_PILOT_IMMED                                        0x90000C2C
 Y.CREATE.L   HWIO_DEM1X_F0_DIVERSITY_IMMED_ADDR                          0x90000904
 Y.CREATE.L   DEM1X_F0_DIVERSITY_IMMED                                    0x90000904
 Y.CREATE.L   HWIO_DEM1X_F1_DIVERSITY_IMMED_ADDR                          0x90000978
 Y.CREATE.L   DEM1X_F1_DIVERSITY_IMMED                                    0x90000978
 Y.CREATE.L   HWIO_DEM1X_F2_DIVERSITY_IMMED_ADDR                          0x900009EC
 Y.CREATE.L   DEM1X_F2_DIVERSITY_IMMED                                    0x900009EC
 Y.CREATE.L   HWIO_DEM1X_F3_DIVERSITY_IMMED_ADDR                          0x90000A60
 Y.CREATE.L   DEM1X_F3_DIVERSITY_IMMED                                    0x90000A60
 Y.CREATE.L   HWIO_DEM1X_F4_DIVERSITY_IMMED_ADDR                          0x90000AD4
 Y.CREATE.L   DEM1X_F4_DIVERSITY_IMMED                                    0x90000AD4
 Y.CREATE.L   HWIO_DEM1X_F5_DIVERSITY_IMMED_ADDR                          0x90000B48
 Y.CREATE.L   DEM1X_F5_DIVERSITY_IMMED                                    0x90000B48
 Y.CREATE.L   HWIO_DEM1X_F6_DIVERSITY_IMMED_ADDR                          0x90000BBC
 Y.CREATE.L   DEM1X_F6_DIVERSITY_IMMED                                    0x90000BBC
 Y.CREATE.L   HWIO_DEM1X_F7_DIVERSITY_IMMED_ADDR                          0x90000C30
 Y.CREATE.L   DEM1X_F7_DIVERSITY_IMMED                                    0x90000C30
 Y.CREATE.L   HWIO_DEM1X_F0_WALSH_ACC0_IMMED_ADDR                         0x90000908
 Y.CREATE.L   DEM1X_F0_WALSH_ACC0_IMMED                                   0x90000908
 Y.CREATE.L   HWIO_DEM1X_F0_WALSH_ACC1_IMMED_ADDR                         0x9000090C
 Y.CREATE.L   DEM1X_F0_WALSH_ACC1_IMMED                                   0x9000090C
 Y.CREATE.L   HWIO_DEM1X_F0_WALSH_ACC2_IMMED_ADDR                         0x90000910
 Y.CREATE.L   DEM1X_F0_WALSH_ACC2_IMMED                                   0x90000910
 Y.CREATE.L   HWIO_DEM1X_F0_WALSH_ACC3_IMMED_ADDR                         0x90000914
 Y.CREATE.L   DEM1X_F0_WALSH_ACC3_IMMED                                   0x90000914
 Y.CREATE.L   HWIO_DEM1X_F0_WALSH_ACC4_IMMED_ADDR                         0x90000918
 Y.CREATE.L   DEM1X_F0_WALSH_ACC4_IMMED                                   0x90000918
 Y.CREATE.L   HWIO_DEM1X_F0_WALSH_ACC5_IMMED_ADDR                         0x9000091C
 Y.CREATE.L   DEM1X_F0_WALSH_ACC5_IMMED                                   0x9000091C
 Y.CREATE.L   HWIO_DEM1X_F0_WALSH_ACC6_IMMED_ADDR                         0x90000920
 Y.CREATE.L   DEM1X_F0_WALSH_ACC6_IMMED                                   0x90000920
 Y.CREATE.L   HWIO_DEM1X_F0_WALSH_ACC7_IMMED_ADDR                         0x90000924
 Y.CREATE.L   DEM1X_F0_WALSH_ACC7_IMMED                                   0x90000924
 Y.CREATE.L   HWIO_DEM1X_F0_WALSH_ACC8_IMMED_ADDR                         0x90000928
 Y.CREATE.L   DEM1X_F0_WALSH_ACC8_IMMED                                   0x90000928
 Y.CREATE.L   HWIO_DEM1X_F0_WALSH_ACC9_IMMED_ADDR                         0x9000092C
 Y.CREATE.L   DEM1X_F0_WALSH_ACC9_IMMED                                   0x9000092C
 Y.CREATE.L   HWIO_DEM1X_F0_WALSH_ACC10_IMMED_ADDR                        0x90000930
 Y.CREATE.L   DEM1X_F0_WALSH_ACC10_IMMED                                  0x90000930
 Y.CREATE.L   HWIO_DEM1X_F0_WALSH_ACC11_IMMED_ADDR                        0x90000934
 Y.CREATE.L   DEM1X_F0_WALSH_ACC11_IMMED                                  0x90000934
 Y.CREATE.L   HWIO_DEM1X_F0_WALSH_ACC12_IMMED_ADDR                        0x90000938
 Y.CREATE.L   DEM1X_F0_WALSH_ACC12_IMMED                                  0x90000938
 Y.CREATE.L   HWIO_DEM1X_F0_WALSH_ACC13_IMMED_ADDR                        0x9000093C
 Y.CREATE.L   DEM1X_F0_WALSH_ACC13_IMMED                                  0x9000093C
 Y.CREATE.L   HWIO_DEM1X_F1_WALSH_ACC0_IMMED_ADDR                         0x9000097C
 Y.CREATE.L   DEM1X_F1_WALSH_ACC0_IMMED                                   0x9000097C
 Y.CREATE.L   HWIO_DEM1X_F1_WALSH_ACC1_IMMED_ADDR                         0x90000980
 Y.CREATE.L   DEM1X_F1_WALSH_ACC1_IMMED                                   0x90000980
 Y.CREATE.L   HWIO_DEM1X_F1_WALSH_ACC2_IMMED_ADDR                         0x90000984
 Y.CREATE.L   DEM1X_F1_WALSH_ACC2_IMMED                                   0x90000984
 Y.CREATE.L   HWIO_DEM1X_F1_WALSH_ACC3_IMMED_ADDR                         0x90000988
 Y.CREATE.L   DEM1X_F1_WALSH_ACC3_IMMED                                   0x90000988
 Y.CREATE.L   HWIO_DEM1X_F1_WALSH_ACC4_IMMED_ADDR                         0x9000098C
 Y.CREATE.L   DEM1X_F1_WALSH_ACC4_IMMED                                   0x9000098C
 Y.CREATE.L   HWIO_DEM1X_F1_WALSH_ACC5_IMMED_ADDR                         0x90000990
 Y.CREATE.L   DEM1X_F1_WALSH_ACC5_IMMED                                   0x90000990
 Y.CREATE.L   HWIO_DEM1X_F1_WALSH_ACC6_IMMED_ADDR                         0x90000994
 Y.CREATE.L   DEM1X_F1_WALSH_ACC6_IMMED                                   0x90000994
 Y.CREATE.L   HWIO_DEM1X_F1_WALSH_ACC7_IMMED_ADDR                         0x90000998
 Y.CREATE.L   DEM1X_F1_WALSH_ACC7_IMMED                                   0x90000998
 Y.CREATE.L   HWIO_DEM1X_F1_WALSH_ACC8_IMMED_ADDR                         0x9000099C
 Y.CREATE.L   DEM1X_F1_WALSH_ACC8_IMMED                                   0x9000099C
 Y.CREATE.L   HWIO_DEM1X_F1_WALSH_ACC9_IMMED_ADDR                         0x900009A0
 Y.CREATE.L   DEM1X_F1_WALSH_ACC9_IMMED                                   0x900009A0
 Y.CREATE.L   HWIO_DEM1X_F1_WALSH_ACC10_IMMED_ADDR                        0x900009A4
 Y.CREATE.L   DEM1X_F1_WALSH_ACC10_IMMED                                  0x900009A4
 Y.CREATE.L   HWIO_DEM1X_F1_WALSH_ACC11_IMMED_ADDR                        0x900009A8
 Y.CREATE.L   DEM1X_F1_WALSH_ACC11_IMMED                                  0x900009A8
 Y.CREATE.L   HWIO_DEM1X_F1_WALSH_ACC12_IMMED_ADDR                        0x900009AC
 Y.CREATE.L   DEM1X_F1_WALSH_ACC12_IMMED                                  0x900009AC
 Y.CREATE.L   HWIO_DEM1X_F1_WALSH_ACC13_IMMED_ADDR                        0x900009B0
 Y.CREATE.L   DEM1X_F1_WALSH_ACC13_IMMED                                  0x900009B0
 Y.CREATE.L   HWIO_DEM1X_F2_WALSH_ACC0_IMMED_ADDR                         0x900009F0
 Y.CREATE.L   DEM1X_F2_WALSH_ACC0_IMMED                                   0x900009F0
 Y.CREATE.L   HWIO_DEM1X_F2_WALSH_ACC1_IMMED_ADDR                         0x900009F4
 Y.CREATE.L   DEM1X_F2_WALSH_ACC1_IMMED                                   0x900009F4
 Y.CREATE.L   HWIO_DEM1X_F2_WALSH_ACC2_IMMED_ADDR                         0x900009F8
 Y.CREATE.L   DEM1X_F2_WALSH_ACC2_IMMED                                   0x900009F8
 Y.CREATE.L   HWIO_DEM1X_F2_WALSH_ACC3_IMMED_ADDR                         0x900009FC
 Y.CREATE.L   DEM1X_F2_WALSH_ACC3_IMMED                                   0x900009FC
 Y.CREATE.L   HWIO_DEM1X_F2_WALSH_ACC4_IMMED_ADDR                         0x90000A00
 Y.CREATE.L   DEM1X_F2_WALSH_ACC4_IMMED                                   0x90000A00
 Y.CREATE.L   HWIO_DEM1X_F2_WALSH_ACC5_IMMED_ADDR                         0x90000A04
 Y.CREATE.L   DEM1X_F2_WALSH_ACC5_IMMED                                   0x90000A04
 Y.CREATE.L   HWIO_DEM1X_F2_WALSH_ACC6_IMMED_ADDR                         0x90000A08
 Y.CREATE.L   DEM1X_F2_WALSH_ACC6_IMMED                                   0x90000A08
 Y.CREATE.L   HWIO_DEM1X_F2_WALSH_ACC7_IMMED_ADDR                         0x90000A0C
 Y.CREATE.L   DEM1X_F2_WALSH_ACC7_IMMED                                   0x90000A0C
 Y.CREATE.L   HWIO_DEM1X_F2_WALSH_ACC8_IMMED_ADDR                         0x90000A10
 Y.CREATE.L   DEM1X_F2_WALSH_ACC8_IMMED                                   0x90000A10
 Y.CREATE.L   HWIO_DEM1X_F2_WALSH_ACC9_IMMED_ADDR                         0x90000A14
 Y.CREATE.L   DEM1X_F2_WALSH_ACC9_IMMED                                   0x90000A14
 Y.CREATE.L   HWIO_DEM1X_F2_WALSH_ACC10_IMMED_ADDR                        0x90000A18
 Y.CREATE.L   DEM1X_F2_WALSH_ACC10_IMMED                                  0x90000A18
 Y.CREATE.L   HWIO_DEM1X_F2_WALSH_ACC11_IMMED_ADDR                        0x90000A1C
 Y.CREATE.L   DEM1X_F2_WALSH_ACC11_IMMED                                  0x90000A1C
 Y.CREATE.L   HWIO_DEM1X_F2_WALSH_ACC12_IMMED_ADDR                        0x90000A20
 Y.CREATE.L   DEM1X_F2_WALSH_ACC12_IMMED                                  0x90000A20
 Y.CREATE.L   HWIO_DEM1X_F2_WALSH_ACC13_IMMED_ADDR                        0x90000A24
 Y.CREATE.L   DEM1X_F2_WALSH_ACC13_IMMED                                  0x90000A24
 Y.CREATE.L   HWIO_DEM1X_F3_WALSH_ACC0_IMMED_ADDR                         0x90000A64
 Y.CREATE.L   DEM1X_F3_WALSH_ACC0_IMMED                                   0x90000A64
 Y.CREATE.L   HWIO_DEM1X_F3_WALSH_ACC1_IMMED_ADDR                         0x90000A68
 Y.CREATE.L   DEM1X_F3_WALSH_ACC1_IMMED                                   0x90000A68
 Y.CREATE.L   HWIO_DEM1X_F3_WALSH_ACC2_IMMED_ADDR                         0x90000A6C
 Y.CREATE.L   DEM1X_F3_WALSH_ACC2_IMMED                                   0x90000A6C
 Y.CREATE.L   HWIO_DEM1X_F3_WALSH_ACC3_IMMED_ADDR                         0x90000A70
 Y.CREATE.L   DEM1X_F3_WALSH_ACC3_IMMED                                   0x90000A70
 Y.CREATE.L   HWIO_DEM1X_F3_WALSH_ACC4_IMMED_ADDR                         0x90000A74
 Y.CREATE.L   DEM1X_F3_WALSH_ACC4_IMMED                                   0x90000A74
 Y.CREATE.L   HWIO_DEM1X_F3_WALSH_ACC5_IMMED_ADDR                         0x90000A78
 Y.CREATE.L   DEM1X_F3_WALSH_ACC5_IMMED                                   0x90000A78
 Y.CREATE.L   HWIO_DEM1X_F3_WALSH_ACC6_IMMED_ADDR                         0x90000A7C
 Y.CREATE.L   DEM1X_F3_WALSH_ACC6_IMMED                                   0x90000A7C
 Y.CREATE.L   HWIO_DEM1X_F3_WALSH_ACC7_IMMED_ADDR                         0x90000A80
 Y.CREATE.L   DEM1X_F3_WALSH_ACC7_IMMED                                   0x90000A80
 Y.CREATE.L   HWIO_DEM1X_F3_WALSH_ACC8_IMMED_ADDR                         0x90000A84
 Y.CREATE.L   DEM1X_F3_WALSH_ACC8_IMMED                                   0x90000A84
 Y.CREATE.L   HWIO_DEM1X_F3_WALSH_ACC9_IMMED_ADDR                         0x90000A88
 Y.CREATE.L   DEM1X_F3_WALSH_ACC9_IMMED                                   0x90000A88
 Y.CREATE.L   HWIO_DEM1X_F3_WALSH_ACC10_IMMED_ADDR                        0x90000A8C
 Y.CREATE.L   DEM1X_F3_WALSH_ACC10_IMMED                                  0x90000A8C
 Y.CREATE.L   HWIO_DEM1X_F3_WALSH_ACC11_IMMED_ADDR                        0x90000A90
 Y.CREATE.L   DEM1X_F3_WALSH_ACC11_IMMED                                  0x90000A90
 Y.CREATE.L   HWIO_DEM1X_F3_WALSH_ACC12_IMMED_ADDR                        0x90000A94
 Y.CREATE.L   DEM1X_F3_WALSH_ACC12_IMMED                                  0x90000A94
 Y.CREATE.L   HWIO_DEM1X_F3_WALSH_ACC13_IMMED_ADDR                        0x90000A98
 Y.CREATE.L   DEM1X_F3_WALSH_ACC13_IMMED                                  0x90000A98
 Y.CREATE.L   HWIO_DEM1X_F4_WALSH_ACC0_IMMED_ADDR                         0x90000AD8
 Y.CREATE.L   DEM1X_F4_WALSH_ACC0_IMMED                                   0x90000AD8
 Y.CREATE.L   HWIO_DEM1X_F4_WALSH_ACC1_IMMED_ADDR                         0x90000ADC
 Y.CREATE.L   DEM1X_F4_WALSH_ACC1_IMMED                                   0x90000ADC
 Y.CREATE.L   HWIO_DEM1X_F4_WALSH_ACC2_IMMED_ADDR                         0x90000AE0
 Y.CREATE.L   DEM1X_F4_WALSH_ACC2_IMMED                                   0x90000AE0
 Y.CREATE.L   HWIO_DEM1X_F4_WALSH_ACC3_IMMED_ADDR                         0x90000AE4
 Y.CREATE.L   DEM1X_F4_WALSH_ACC3_IMMED                                   0x90000AE4
 Y.CREATE.L   HWIO_DEM1X_F4_WALSH_ACC4_IMMED_ADDR                         0x90000AE8
 Y.CREATE.L   DEM1X_F4_WALSH_ACC4_IMMED                                   0x90000AE8
 Y.CREATE.L   HWIO_DEM1X_F4_WALSH_ACC5_IMMED_ADDR                         0x90000AEC
 Y.CREATE.L   DEM1X_F4_WALSH_ACC5_IMMED                                   0x90000AEC
 Y.CREATE.L   HWIO_DEM1X_F4_WALSH_ACC6_IMMED_ADDR                         0x90000AF0
 Y.CREATE.L   DEM1X_F4_WALSH_ACC6_IMMED                                   0x90000AF0
 Y.CREATE.L   HWIO_DEM1X_F4_WALSH_ACC7_IMMED_ADDR                         0x90000AF4
 Y.CREATE.L   DEM1X_F4_WALSH_ACC7_IMMED                                   0x90000AF4
 Y.CREATE.L   HWIO_DEM1X_F4_WALSH_ACC8_IMMED_ADDR                         0x90000AF8
 Y.CREATE.L   DEM1X_F4_WALSH_ACC8_IMMED                                   0x90000AF8
 Y.CREATE.L   HWIO_DEM1X_F4_WALSH_ACC9_IMMED_ADDR                         0x90000AFC
 Y.CREATE.L   DEM1X_F4_WALSH_ACC9_IMMED                                   0x90000AFC
 Y.CREATE.L   HWIO_DEM1X_F4_WALSH_ACC10_IMMED_ADDR                        0x90000B00
 Y.CREATE.L   DEM1X_F4_WALSH_ACC10_IMMED                                  0x90000B00
 Y.CREATE.L   HWIO_DEM1X_F4_WALSH_ACC11_IMMED_ADDR                        0x90000B04
 Y.CREATE.L   DEM1X_F4_WALSH_ACC11_IMMED                                  0x90000B04
 Y.CREATE.L   HWIO_DEM1X_F4_WALSH_ACC12_IMMED_ADDR                        0x90000B08
 Y.CREATE.L   DEM1X_F4_WALSH_ACC12_IMMED                                  0x90000B08
 Y.CREATE.L   HWIO_DEM1X_F4_WALSH_ACC13_IMMED_ADDR                        0x90000B0C
 Y.CREATE.L   DEM1X_F4_WALSH_ACC13_IMMED                                  0x90000B0C
 Y.CREATE.L   HWIO_DEM1X_F5_WALSH_ACC0_IMMED_ADDR                         0x90000B4C
 Y.CREATE.L   DEM1X_F5_WALSH_ACC0_IMMED                                   0x90000B4C
 Y.CREATE.L   HWIO_DEM1X_F5_WALSH_ACC1_IMMED_ADDR                         0x90000B50
 Y.CREATE.L   DEM1X_F5_WALSH_ACC1_IMMED                                   0x90000B50
 Y.CREATE.L   HWIO_DEM1X_F5_WALSH_ACC2_IMMED_ADDR                         0x90000B54
 Y.CREATE.L   DEM1X_F5_WALSH_ACC2_IMMED                                   0x90000B54
 Y.CREATE.L   HWIO_DEM1X_F5_WALSH_ACC3_IMMED_ADDR                         0x90000B58
 Y.CREATE.L   DEM1X_F5_WALSH_ACC3_IMMED                                   0x90000B58
 Y.CREATE.L   HWIO_DEM1X_F5_WALSH_ACC4_IMMED_ADDR                         0x90000B5C
 Y.CREATE.L   DEM1X_F5_WALSH_ACC4_IMMED                                   0x90000B5C
 Y.CREATE.L   HWIO_DEM1X_F5_WALSH_ACC5_IMMED_ADDR                         0x90000B60
 Y.CREATE.L   DEM1X_F5_WALSH_ACC5_IMMED                                   0x90000B60
 Y.CREATE.L   HWIO_DEM1X_F5_WALSH_ACC6_IMMED_ADDR                         0x90000B64
 Y.CREATE.L   DEM1X_F5_WALSH_ACC6_IMMED                                   0x90000B64
 Y.CREATE.L   HWIO_DEM1X_F5_WALSH_ACC7_IMMED_ADDR                         0x90000B68
 Y.CREATE.L   DEM1X_F5_WALSH_ACC7_IMMED                                   0x90000B68
 Y.CREATE.L   HWIO_DEM1X_F5_WALSH_ACC8_IMMED_ADDR                         0x90000B6C
 Y.CREATE.L   DEM1X_F5_WALSH_ACC8_IMMED                                   0x90000B6C
 Y.CREATE.L   HWIO_DEM1X_F5_WALSH_ACC9_IMMED_ADDR                         0x90000B70
 Y.CREATE.L   DEM1X_F5_WALSH_ACC9_IMMED                                   0x90000B70
 Y.CREATE.L   HWIO_DEM1X_F5_WALSH_ACC10_IMMED_ADDR                        0x90000B74
 Y.CREATE.L   DEM1X_F5_WALSH_ACC10_IMMED                                  0x90000B74
 Y.CREATE.L   HWIO_DEM1X_F5_WALSH_ACC11_IMMED_ADDR                        0x90000B78
 Y.CREATE.L   DEM1X_F5_WALSH_ACC11_IMMED                                  0x90000B78
 Y.CREATE.L   HWIO_DEM1X_F5_WALSH_ACC12_IMMED_ADDR                        0x90000B7C
 Y.CREATE.L   DEM1X_F5_WALSH_ACC12_IMMED                                  0x90000B7C
 Y.CREATE.L   HWIO_DEM1X_F5_WALSH_ACC13_IMMED_ADDR                        0x90000B80
 Y.CREATE.L   DEM1X_F5_WALSH_ACC13_IMMED                                  0x90000B80
 Y.CREATE.L   HWIO_DEM1X_F6_WALSH_ACC0_IMMED_ADDR                         0x90000BC0
 Y.CREATE.L   DEM1X_F6_WALSH_ACC0_IMMED                                   0x90000BC0
 Y.CREATE.L   HWIO_DEM1X_F6_WALSH_ACC1_IMMED_ADDR                         0x90000BC4
 Y.CREATE.L   DEM1X_F6_WALSH_ACC1_IMMED                                   0x90000BC4
 Y.CREATE.L   HWIO_DEM1X_F6_WALSH_ACC2_IMMED_ADDR                         0x90000BC8
 Y.CREATE.L   DEM1X_F6_WALSH_ACC2_IMMED                                   0x90000BC8
 Y.CREATE.L   HWIO_DEM1X_F6_WALSH_ACC3_IMMED_ADDR                         0x90000BCC
 Y.CREATE.L   DEM1X_F6_WALSH_ACC3_IMMED                                   0x90000BCC
 Y.CREATE.L   HWIO_DEM1X_F6_WALSH_ACC4_IMMED_ADDR                         0x90000BD0
 Y.CREATE.L   DEM1X_F6_WALSH_ACC4_IMMED                                   0x90000BD0
 Y.CREATE.L   HWIO_DEM1X_F6_WALSH_ACC5_IMMED_ADDR                         0x90000BD4
 Y.CREATE.L   DEM1X_F6_WALSH_ACC5_IMMED                                   0x90000BD4
 Y.CREATE.L   HWIO_DEM1X_F6_WALSH_ACC6_IMMED_ADDR                         0x90000BD8
 Y.CREATE.L   DEM1X_F6_WALSH_ACC6_IMMED                                   0x90000BD8
 Y.CREATE.L   HWIO_DEM1X_F6_WALSH_ACC7_IMMED_ADDR                         0x90000BDC
 Y.CREATE.L   DEM1X_F6_WALSH_ACC7_IMMED                                   0x90000BDC
 Y.CREATE.L   HWIO_DEM1X_F6_WALSH_ACC8_IMMED_ADDR                         0x90000BE0
 Y.CREATE.L   DEM1X_F6_WALSH_ACC8_IMMED                                   0x90000BE0
 Y.CREATE.L   HWIO_DEM1X_F6_WALSH_ACC9_IMMED_ADDR                         0x90000BE4
 Y.CREATE.L   DEM1X_F6_WALSH_ACC9_IMMED                                   0x90000BE4
 Y.CREATE.L   HWIO_DEM1X_F6_WALSH_ACC10_IMMED_ADDR                        0x90000BE8
 Y.CREATE.L   DEM1X_F6_WALSH_ACC10_IMMED                                  0x90000BE8
 Y.CREATE.L   HWIO_DEM1X_F6_WALSH_ACC11_IMMED_ADDR                        0x90000BEC
 Y.CREATE.L   DEM1X_F6_WALSH_ACC11_IMMED                                  0x90000BEC
 Y.CREATE.L   HWIO_DEM1X_F6_WALSH_ACC12_IMMED_ADDR                        0x90000BF0
 Y.CREATE.L   DEM1X_F6_WALSH_ACC12_IMMED                                  0x90000BF0
 Y.CREATE.L   HWIO_DEM1X_F6_WALSH_ACC13_IMMED_ADDR                        0x90000BF4
 Y.CREATE.L   DEM1X_F6_WALSH_ACC13_IMMED                                  0x90000BF4
 Y.CREATE.L   HWIO_DEM1X_F7_WALSH_ACC0_IMMED_ADDR                         0x90000C34
 Y.CREATE.L   DEM1X_F7_WALSH_ACC0_IMMED                                   0x90000C34
 Y.CREATE.L   HWIO_DEM1X_F7_WALSH_ACC1_IMMED_ADDR                         0x90000C38
 Y.CREATE.L   DEM1X_F7_WALSH_ACC1_IMMED                                   0x90000C38
 Y.CREATE.L   HWIO_DEM1X_F7_WALSH_ACC2_IMMED_ADDR                         0x90000C3C
 Y.CREATE.L   DEM1X_F7_WALSH_ACC2_IMMED                                   0x90000C3C
 Y.CREATE.L   HWIO_DEM1X_F7_WALSH_ACC3_IMMED_ADDR                         0x90000C40
 Y.CREATE.L   DEM1X_F7_WALSH_ACC3_IMMED                                   0x90000C40
 Y.CREATE.L   HWIO_DEM1X_F7_WALSH_ACC4_IMMED_ADDR                         0x90000C44
 Y.CREATE.L   DEM1X_F7_WALSH_ACC4_IMMED                                   0x90000C44
 Y.CREATE.L   HWIO_DEM1X_F7_WALSH_ACC5_IMMED_ADDR                         0x90000C48
 Y.CREATE.L   DEM1X_F7_WALSH_ACC5_IMMED                                   0x90000C48
 Y.CREATE.L   HWIO_DEM1X_F7_WALSH_ACC6_IMMED_ADDR                         0x90000C4C
 Y.CREATE.L   DEM1X_F7_WALSH_ACC6_IMMED                                   0x90000C4C
 Y.CREATE.L   HWIO_DEM1X_F7_WALSH_ACC7_IMMED_ADDR                         0x90000C50
 Y.CREATE.L   DEM1X_F7_WALSH_ACC7_IMMED                                   0x90000C50
 Y.CREATE.L   HWIO_DEM1X_F7_WALSH_ACC8_IMMED_ADDR                         0x90000C54
 Y.CREATE.L   DEM1X_F7_WALSH_ACC8_IMMED                                   0x90000C54
 Y.CREATE.L   HWIO_DEM1X_F7_WALSH_ACC9_IMMED_ADDR                         0x90000C58
 Y.CREATE.L   DEM1X_F7_WALSH_ACC9_IMMED                                   0x90000C58
 Y.CREATE.L   HWIO_DEM1X_F7_WALSH_ACC10_IMMED_ADDR                        0x90000C5C
 Y.CREATE.L   DEM1X_F7_WALSH_ACC10_IMMED                                  0x90000C5C
 Y.CREATE.L   HWIO_DEM1X_F7_WALSH_ACC11_IMMED_ADDR                        0x90000C60
 Y.CREATE.L   DEM1X_F7_WALSH_ACC11_IMMED                                  0x90000C60
 Y.CREATE.L   HWIO_DEM1X_F7_WALSH_ACC12_IMMED_ADDR                        0x90000C64
 Y.CREATE.L   DEM1X_F7_WALSH_ACC12_IMMED                                  0x90000C64
 Y.CREATE.L   HWIO_DEM1X_F7_WALSH_ACC13_IMMED_ADDR                        0x90000C68
 Y.CREATE.L   DEM1X_F7_WALSH_ACC13_IMMED                                  0x90000C68
 Y.CREATE.L   HWIO_DEM1X_F0_WALSH_ACC0_FRAME_ADDR                         0x90000D08
 Y.CREATE.L   DEM1X_F0_WALSH_ACC0_FRAME                                   0x90000D08
 Y.CREATE.L   HWIO_DEM1X_F0_WALSH_ACC1_FRAME_ADDR                         0x90000D0C
 Y.CREATE.L   DEM1X_F0_WALSH_ACC1_FRAME                                   0x90000D0C
 Y.CREATE.L   HWIO_DEM1X_F0_WALSH_ACC2_FRAME_ADDR                         0x90000D10
 Y.CREATE.L   DEM1X_F0_WALSH_ACC2_FRAME                                   0x90000D10
 Y.CREATE.L   HWIO_DEM1X_F0_WALSH_ACC3_FRAME_ADDR                         0x90000D14
 Y.CREATE.L   DEM1X_F0_WALSH_ACC3_FRAME                                   0x90000D14
 Y.CREATE.L   HWIO_DEM1X_F0_WALSH_ACC4_FRAME_ADDR                         0x90000D18
 Y.CREATE.L   DEM1X_F0_WALSH_ACC4_FRAME                                   0x90000D18
 Y.CREATE.L   HWIO_DEM1X_F0_WALSH_ACC5_FRAME_ADDR                         0x90000D1C
 Y.CREATE.L   DEM1X_F0_WALSH_ACC5_FRAME                                   0x90000D1C
 Y.CREATE.L   HWIO_DEM1X_F0_WALSH_ACC6_FRAME_ADDR                         0x90000D20
 Y.CREATE.L   DEM1X_F0_WALSH_ACC6_FRAME                                   0x90000D20
 Y.CREATE.L   HWIO_DEM1X_F0_WALSH_ACC7_FRAME_ADDR                         0x90000D24
 Y.CREATE.L   DEM1X_F0_WALSH_ACC7_FRAME                                   0x90000D24
 Y.CREATE.L   HWIO_DEM1X_F0_WALSH_ACC8_FRAME_ADDR                         0x90000D28
 Y.CREATE.L   DEM1X_F0_WALSH_ACC8_FRAME                                   0x90000D28
 Y.CREATE.L   HWIO_DEM1X_F0_WALSH_ACC9_FRAME_ADDR                         0x90000D2C
 Y.CREATE.L   DEM1X_F0_WALSH_ACC9_FRAME                                   0x90000D2C
 Y.CREATE.L   HWIO_DEM1X_F0_WALSH_ACC10_FRAME_ADDR                        0x90000D30
 Y.CREATE.L   DEM1X_F0_WALSH_ACC10_FRAME                                  0x90000D30
 Y.CREATE.L   HWIO_DEM1X_F0_WALSH_ACC11_FRAME_ADDR                        0x90000D34
 Y.CREATE.L   DEM1X_F0_WALSH_ACC11_FRAME                                  0x90000D34
 Y.CREATE.L   HWIO_DEM1X_F0_WALSH_ACC12_FRAME_ADDR                        0x90000D38
 Y.CREATE.L   DEM1X_F0_WALSH_ACC12_FRAME                                  0x90000D38
 Y.CREATE.L   HWIO_DEM1X_F0_WALSH_ACC13_FRAME_ADDR                        0x90000D3C
 Y.CREATE.L   DEM1X_F0_WALSH_ACC13_FRAME                                  0x90000D3C
 Y.CREATE.L   HWIO_DEM1X_F1_WALSH_ACC0_FRAME_ADDR                         0x90000D7C
 Y.CREATE.L   DEM1X_F1_WALSH_ACC0_FRAME                                   0x90000D7C
 Y.CREATE.L   HWIO_DEM1X_F1_WALSH_ACC1_FRAME_ADDR                         0x90000D80
 Y.CREATE.L   DEM1X_F1_WALSH_ACC1_FRAME                                   0x90000D80
 Y.CREATE.L   HWIO_DEM1X_F1_WALSH_ACC2_FRAME_ADDR                         0x90000D84
 Y.CREATE.L   DEM1X_F1_WALSH_ACC2_FRAME                                   0x90000D84
 Y.CREATE.L   HWIO_DEM1X_F1_WALSH_ACC3_FRAME_ADDR                         0x90000D88
 Y.CREATE.L   DEM1X_F1_WALSH_ACC3_FRAME                                   0x90000D88
 Y.CREATE.L   HWIO_DEM1X_F1_WALSH_ACC4_FRAME_ADDR                         0x90000D8C
 Y.CREATE.L   DEM1X_F1_WALSH_ACC4_FRAME                                   0x90000D8C
 Y.CREATE.L   HWIO_DEM1X_F1_WALSH_ACC5_FRAME_ADDR                         0x90000D90
 Y.CREATE.L   DEM1X_F1_WALSH_ACC5_FRAME                                   0x90000D90
 Y.CREATE.L   HWIO_DEM1X_F1_WALSH_ACC6_FRAME_ADDR                         0x90000D94
 Y.CREATE.L   DEM1X_F1_WALSH_ACC6_FRAME                                   0x90000D94
 Y.CREATE.L   HWIO_DEM1X_F1_WALSH_ACC7_FRAME_ADDR                         0x90000D98
 Y.CREATE.L   DEM1X_F1_WALSH_ACC7_FRAME                                   0x90000D98
 Y.CREATE.L   HWIO_DEM1X_F1_WALSH_ACC8_FRAME_ADDR                         0x90000D9C
 Y.CREATE.L   DEM1X_F1_WALSH_ACC8_FRAME                                   0x90000D9C
 Y.CREATE.L   HWIO_DEM1X_F1_WALSH_ACC9_FRAME_ADDR                         0x90000DA0
 Y.CREATE.L   DEM1X_F1_WALSH_ACC9_FRAME                                   0x90000DA0
 Y.CREATE.L   HWIO_DEM1X_F1_WALSH_ACC10_FRAME_ADDR                        0x90000DA4
 Y.CREATE.L   DEM1X_F1_WALSH_ACC10_FRAME                                  0x90000DA4
 Y.CREATE.L   HWIO_DEM1X_F1_WALSH_ACC11_FRAME_ADDR                        0x90000DA8
 Y.CREATE.L   DEM1X_F1_WALSH_ACC11_FRAME                                  0x90000DA8
 Y.CREATE.L   HWIO_DEM1X_F1_WALSH_ACC12_FRAME_ADDR                        0x90000DAC
 Y.CREATE.L   DEM1X_F1_WALSH_ACC12_FRAME                                  0x90000DAC
 Y.CREATE.L   HWIO_DEM1X_F1_WALSH_ACC13_FRAME_ADDR                        0x90000DB0
 Y.CREATE.L   DEM1X_F1_WALSH_ACC13_FRAME                                  0x90000DB0
 Y.CREATE.L   HWIO_DEM1X_F2_WALSH_ACC0_FRAME_ADDR                         0x90000DF0
 Y.CREATE.L   DEM1X_F2_WALSH_ACC0_FRAME                                   0x90000DF0
 Y.CREATE.L   HWIO_DEM1X_F2_WALSH_ACC1_FRAME_ADDR                         0x90000DF4
 Y.CREATE.L   DEM1X_F2_WALSH_ACC1_FRAME                                   0x90000DF4
 Y.CREATE.L   HWIO_DEM1X_F2_WALSH_ACC2_FRAME_ADDR                         0x90000DF8
 Y.CREATE.L   DEM1X_F2_WALSH_ACC2_FRAME                                   0x90000DF8
 Y.CREATE.L   HWIO_DEM1X_F2_WALSH_ACC3_FRAME_ADDR                         0x90000DFC
 Y.CREATE.L   DEM1X_F2_WALSH_ACC3_FRAME                                   0x90000DFC
 Y.CREATE.L   HWIO_DEM1X_F2_WALSH_ACC4_FRAME_ADDR                         0x90000E00
 Y.CREATE.L   DEM1X_F2_WALSH_ACC4_FRAME                                   0x90000E00
 Y.CREATE.L   HWIO_DEM1X_F2_WALSH_ACC5_FRAME_ADDR                         0x90000E04
 Y.CREATE.L   DEM1X_F2_WALSH_ACC5_FRAME                                   0x90000E04
 Y.CREATE.L   HWIO_DEM1X_F2_WALSH_ACC6_FRAME_ADDR                         0x90000E08
 Y.CREATE.L   DEM1X_F2_WALSH_ACC6_FRAME                                   0x90000E08
 Y.CREATE.L   HWIO_DEM1X_F2_WALSH_ACC7_FRAME_ADDR                         0x90000E0C
 Y.CREATE.L   DEM1X_F2_WALSH_ACC7_FRAME                                   0x90000E0C
 Y.CREATE.L   HWIO_DEM1X_F2_WALSH_ACC8_FRAME_ADDR                         0x90000E10
 Y.CREATE.L   DEM1X_F2_WALSH_ACC8_FRAME                                   0x90000E10
 Y.CREATE.L   HWIO_DEM1X_F2_WALSH_ACC9_FRAME_ADDR                         0x90000E14
 Y.CREATE.L   DEM1X_F2_WALSH_ACC9_FRAME                                   0x90000E14
 Y.CREATE.L   HWIO_DEM1X_F2_WALSH_ACC10_FRAME_ADDR                        0x90000E18
 Y.CREATE.L   DEM1X_F2_WALSH_ACC10_FRAME                                  0x90000E18
 Y.CREATE.L   HWIO_DEM1X_F2_WALSH_ACC11_FRAME_ADDR                        0x90000E1C
 Y.CREATE.L   DEM1X_F2_WALSH_ACC11_FRAME                                  0x90000E1C
 Y.CREATE.L   HWIO_DEM1X_F2_WALSH_ACC12_FRAME_ADDR                        0x90000E20
 Y.CREATE.L   DEM1X_F2_WALSH_ACC12_FRAME                                  0x90000E20
 Y.CREATE.L   HWIO_DEM1X_F2_WALSH_ACC13_FRAME_ADDR                        0x90000E24
 Y.CREATE.L   DEM1X_F2_WALSH_ACC13_FRAME                                  0x90000E24
 Y.CREATE.L   HWIO_DEM1X_F3_WALSH_ACC0_FRAME_ADDR                         0x90000E64
 Y.CREATE.L   DEM1X_F3_WALSH_ACC0_FRAME                                   0x90000E64
 Y.CREATE.L   HWIO_DEM1X_F3_WALSH_ACC1_FRAME_ADDR                         0x90000E68
 Y.CREATE.L   DEM1X_F3_WALSH_ACC1_FRAME                                   0x90000E68
 Y.CREATE.L   HWIO_DEM1X_F3_WALSH_ACC2_FRAME_ADDR                         0x90000E6C
 Y.CREATE.L   DEM1X_F3_WALSH_ACC2_FRAME                                   0x90000E6C
 Y.CREATE.L   HWIO_DEM1X_F3_WALSH_ACC3_FRAME_ADDR                         0x90000E70
 Y.CREATE.L   DEM1X_F3_WALSH_ACC3_FRAME                                   0x90000E70
 Y.CREATE.L   HWIO_DEM1X_F3_WALSH_ACC4_FRAME_ADDR                         0x90000E74
 Y.CREATE.L   DEM1X_F3_WALSH_ACC4_FRAME                                   0x90000E74
 Y.CREATE.L   HWIO_DEM1X_F3_WALSH_ACC5_FRAME_ADDR                         0x90000E78
 Y.CREATE.L   DEM1X_F3_WALSH_ACC5_FRAME                                   0x90000E78
 Y.CREATE.L   HWIO_DEM1X_F3_WALSH_ACC6_FRAME_ADDR                         0x90000E7C
 Y.CREATE.L   DEM1X_F3_WALSH_ACC6_FRAME                                   0x90000E7C
 Y.CREATE.L   HWIO_DEM1X_F3_WALSH_ACC7_FRAME_ADDR                         0x90000E80
 Y.CREATE.L   DEM1X_F3_WALSH_ACC7_FRAME                                   0x90000E80
 Y.CREATE.L   HWIO_DEM1X_F3_WALSH_ACC8_FRAME_ADDR                         0x90000E84
 Y.CREATE.L   DEM1X_F3_WALSH_ACC8_FRAME                                   0x90000E84
 Y.CREATE.L   HWIO_DEM1X_F3_WALSH_ACC9_FRAME_ADDR                         0x90000E88
 Y.CREATE.L   DEM1X_F3_WALSH_ACC9_FRAME                                   0x90000E88
 Y.CREATE.L   HWIO_DEM1X_F3_WALSH_ACC10_FRAME_ADDR                        0x90000E8C
 Y.CREATE.L   DEM1X_F3_WALSH_ACC10_FRAME                                  0x90000E8C
 Y.CREATE.L   HWIO_DEM1X_F3_WALSH_ACC11_FRAME_ADDR                        0x90000E90
 Y.CREATE.L   DEM1X_F3_WALSH_ACC11_FRAME                                  0x90000E90
 Y.CREATE.L   HWIO_DEM1X_F3_WALSH_ACC12_FRAME_ADDR                        0x90000E94
 Y.CREATE.L   DEM1X_F3_WALSH_ACC12_FRAME                                  0x90000E94
 Y.CREATE.L   HWIO_DEM1X_F3_WALSH_ACC13_FRAME_ADDR                        0x90000E98
 Y.CREATE.L   DEM1X_F3_WALSH_ACC13_FRAME                                  0x90000E98
 Y.CREATE.L   HWIO_DEM1X_F4_WALSH_ACC0_FRAME_ADDR                         0x90000ED8
 Y.CREATE.L   DEM1X_F4_WALSH_ACC0_FRAME                                   0x90000ED8
 Y.CREATE.L   HWIO_DEM1X_F4_WALSH_ACC1_FRAME_ADDR                         0x90000EDC
 Y.CREATE.L   DEM1X_F4_WALSH_ACC1_FRAME                                   0x90000EDC
 Y.CREATE.L   HWIO_DEM1X_F4_WALSH_ACC2_FRAME_ADDR                         0x90000EE0
 Y.CREATE.L   DEM1X_F4_WALSH_ACC2_FRAME                                   0x90000EE0
 Y.CREATE.L   HWIO_DEM1X_F4_WALSH_ACC3_FRAME_ADDR                         0x90000EE4
 Y.CREATE.L   DEM1X_F4_WALSH_ACC3_FRAME                                   0x90000EE4
 Y.CREATE.L   HWIO_DEM1X_F4_WALSH_ACC4_FRAME_ADDR                         0x90000EE8
 Y.CREATE.L   DEM1X_F4_WALSH_ACC4_FRAME                                   0x90000EE8
 Y.CREATE.L   HWIO_DEM1X_F4_WALSH_ACC5_FRAME_ADDR                         0x90000EEC
 Y.CREATE.L   DEM1X_F4_WALSH_ACC5_FRAME                                   0x90000EEC
 Y.CREATE.L   HWIO_DEM1X_F4_WALSH_ACC6_FRAME_ADDR                         0x90000EF0
 Y.CREATE.L   DEM1X_F4_WALSH_ACC6_FRAME                                   0x90000EF0
 Y.CREATE.L   HWIO_DEM1X_F4_WALSH_ACC7_FRAME_ADDR                         0x90000EF4
 Y.CREATE.L   DEM1X_F4_WALSH_ACC7_FRAME                                   0x90000EF4
 Y.CREATE.L   HWIO_DEM1X_F4_WALSH_ACC8_FRAME_ADDR                         0x90000EF8
 Y.CREATE.L   DEM1X_F4_WALSH_ACC8_FRAME                                   0x90000EF8
 Y.CREATE.L   HWIO_DEM1X_F4_WALSH_ACC9_FRAME_ADDR                         0x90000EFC
 Y.CREATE.L   DEM1X_F4_WALSH_ACC9_FRAME                                   0x90000EFC
 Y.CREATE.L   HWIO_DEM1X_F4_WALSH_ACC10_FRAME_ADDR                        0x90000F00
 Y.CREATE.L   DEM1X_F4_WALSH_ACC10_FRAME                                  0x90000F00
 Y.CREATE.L   HWIO_DEM1X_F4_WALSH_ACC11_FRAME_ADDR                        0x90000F04
 Y.CREATE.L   DEM1X_F4_WALSH_ACC11_FRAME                                  0x90000F04
 Y.CREATE.L   HWIO_DEM1X_F4_WALSH_ACC12_FRAME_ADDR                        0x90000F08
 Y.CREATE.L   DEM1X_F4_WALSH_ACC12_FRAME                                  0x90000F08
 Y.CREATE.L   HWIO_DEM1X_F4_WALSH_ACC13_FRAME_ADDR                        0x90000F0C
 Y.CREATE.L   DEM1X_F4_WALSH_ACC13_FRAME                                  0x90000F0C
 Y.CREATE.L   HWIO_DEM1X_F5_WALSH_ACC0_FRAME_ADDR                         0x90000F4C
 Y.CREATE.L   DEM1X_F5_WALSH_ACC0_FRAME                                   0x90000F4C
 Y.CREATE.L   HWIO_DEM1X_F5_WALSH_ACC1_FRAME_ADDR                         0x90000F50
 Y.CREATE.L   DEM1X_F5_WALSH_ACC1_FRAME                                   0x90000F50
 Y.CREATE.L   HWIO_DEM1X_F5_WALSH_ACC2_FRAME_ADDR                         0x90000F54
 Y.CREATE.L   DEM1X_F5_WALSH_ACC2_FRAME                                   0x90000F54
 Y.CREATE.L   HWIO_DEM1X_F5_WALSH_ACC3_FRAME_ADDR                         0x90000F58
 Y.CREATE.L   DEM1X_F5_WALSH_ACC3_FRAME                                   0x90000F58
 Y.CREATE.L   HWIO_DEM1X_F5_WALSH_ACC4_FRAME_ADDR                         0x90000F5C
 Y.CREATE.L   DEM1X_F5_WALSH_ACC4_FRAME                                   0x90000F5C
 Y.CREATE.L   HWIO_DEM1X_F5_WALSH_ACC5_FRAME_ADDR                         0x90000F60
 Y.CREATE.L   DEM1X_F5_WALSH_ACC5_FRAME                                   0x90000F60
 Y.CREATE.L   HWIO_DEM1X_F5_WALSH_ACC6_FRAME_ADDR                         0x90000F64
 Y.CREATE.L   DEM1X_F5_WALSH_ACC6_FRAME                                   0x90000F64
 Y.CREATE.L   HWIO_DEM1X_F5_WALSH_ACC7_FRAME_ADDR                         0x90000F68
 Y.CREATE.L   DEM1X_F5_WALSH_ACC7_FRAME                                   0x90000F68
 Y.CREATE.L   HWIO_DEM1X_F5_WALSH_ACC8_FRAME_ADDR                         0x90000F6C
 Y.CREATE.L   DEM1X_F5_WALSH_ACC8_FRAME                                   0x90000F6C
 Y.CREATE.L   HWIO_DEM1X_F5_WALSH_ACC9_FRAME_ADDR                         0x90000F70
 Y.CREATE.L   DEM1X_F5_WALSH_ACC9_FRAME                                   0x90000F70
 Y.CREATE.L   HWIO_DEM1X_F5_WALSH_ACC10_FRAME_ADDR                        0x90000F74
 Y.CREATE.L   DEM1X_F5_WALSH_ACC10_FRAME                                  0x90000F74
 Y.CREATE.L   HWIO_DEM1X_F5_WALSH_ACC11_FRAME_ADDR                        0x90000F78
 Y.CREATE.L   DEM1X_F5_WALSH_ACC11_FRAME                                  0x90000F78
 Y.CREATE.L   HWIO_DEM1X_F5_WALSH_ACC12_FRAME_ADDR                        0x90000F7C
 Y.CREATE.L   DEM1X_F5_WALSH_ACC12_FRAME                                  0x90000F7C
 Y.CREATE.L   HWIO_DEM1X_F5_WALSH_ACC13_FRAME_ADDR                        0x90000F80
 Y.CREATE.L   DEM1X_F5_WALSH_ACC13_FRAME                                  0x90000F80
 Y.CREATE.L   HWIO_DEM1X_F6_WALSH_ACC0_FRAME_ADDR                         0x90000FC0
 Y.CREATE.L   DEM1X_F6_WALSH_ACC0_FRAME                                   0x90000FC0
 Y.CREATE.L   HWIO_DEM1X_F6_WALSH_ACC1_FRAME_ADDR                         0x90000FC4
 Y.CREATE.L   DEM1X_F6_WALSH_ACC1_FRAME                                   0x90000FC4
 Y.CREATE.L   HWIO_DEM1X_F6_WALSH_ACC2_FRAME_ADDR                         0x90000FC8
 Y.CREATE.L   DEM1X_F6_WALSH_ACC2_FRAME                                   0x90000FC8
 Y.CREATE.L   HWIO_DEM1X_F6_WALSH_ACC3_FRAME_ADDR                         0x90000FCC
 Y.CREATE.L   DEM1X_F6_WALSH_ACC3_FRAME                                   0x90000FCC
 Y.CREATE.L   HWIO_DEM1X_F6_WALSH_ACC4_FRAME_ADDR                         0x90000FD0
 Y.CREATE.L   DEM1X_F6_WALSH_ACC4_FRAME                                   0x90000FD0
 Y.CREATE.L   HWIO_DEM1X_F6_WALSH_ACC5_FRAME_ADDR                         0x90000FD4
 Y.CREATE.L   DEM1X_F6_WALSH_ACC5_FRAME                                   0x90000FD4
 Y.CREATE.L   HWIO_DEM1X_F6_WALSH_ACC6_FRAME_ADDR                         0x90000FD8
 Y.CREATE.L   DEM1X_F6_WALSH_ACC6_FRAME                                   0x90000FD8
 Y.CREATE.L   HWIO_DEM1X_F6_WALSH_ACC7_FRAME_ADDR                         0x90000FDC
 Y.CREATE.L   DEM1X_F6_WALSH_ACC7_FRAME                                   0x90000FDC
 Y.CREATE.L   HWIO_DEM1X_F6_WALSH_ACC8_FRAME_ADDR                         0x90000FE0
 Y.CREATE.L   DEM1X_F6_WALSH_ACC8_FRAME                                   0x90000FE0
 Y.CREATE.L   HWIO_DEM1X_F6_WALSH_ACC9_FRAME_ADDR                         0x90000FE4
 Y.CREATE.L   DEM1X_F6_WALSH_ACC9_FRAME                                   0x90000FE4
 Y.CREATE.L   HWIO_DEM1X_F6_WALSH_ACC10_FRAME_ADDR                        0x90000FE8
 Y.CREATE.L   DEM1X_F6_WALSH_ACC10_FRAME                                  0x90000FE8
 Y.CREATE.L   HWIO_DEM1X_F6_WALSH_ACC11_FRAME_ADDR                        0x90000FEC
 Y.CREATE.L   DEM1X_F6_WALSH_ACC11_FRAME                                  0x90000FEC
 Y.CREATE.L   HWIO_DEM1X_F6_WALSH_ACC12_FRAME_ADDR                        0x90000FF0
 Y.CREATE.L   DEM1X_F6_WALSH_ACC12_FRAME                                  0x90000FF0
 Y.CREATE.L   HWIO_DEM1X_F6_WALSH_ACC13_FRAME_ADDR                        0x90000FF4
 Y.CREATE.L   DEM1X_F6_WALSH_ACC13_FRAME                                  0x90000FF4
 Y.CREATE.L   HWIO_DEM1X_F7_WALSH_ACC0_FRAME_ADDR                         0x90001034
 Y.CREATE.L   DEM1X_F7_WALSH_ACC0_FRAME                                   0x90001034
 Y.CREATE.L   HWIO_DEM1X_F7_WALSH_ACC1_FRAME_ADDR                         0x90001038
 Y.CREATE.L   DEM1X_F7_WALSH_ACC1_FRAME                                   0x90001038
 Y.CREATE.L   HWIO_DEM1X_F7_WALSH_ACC2_FRAME_ADDR                         0x9000103C
 Y.CREATE.L   DEM1X_F7_WALSH_ACC2_FRAME                                   0x9000103C
 Y.CREATE.L   HWIO_DEM1X_F7_WALSH_ACC3_FRAME_ADDR                         0x90001040
 Y.CREATE.L   DEM1X_F7_WALSH_ACC3_FRAME                                   0x90001040
 Y.CREATE.L   HWIO_DEM1X_F7_WALSH_ACC4_FRAME_ADDR                         0x90001044
 Y.CREATE.L   DEM1X_F7_WALSH_ACC4_FRAME                                   0x90001044
 Y.CREATE.L   HWIO_DEM1X_F7_WALSH_ACC5_FRAME_ADDR                         0x90001048
 Y.CREATE.L   DEM1X_F7_WALSH_ACC5_FRAME                                   0x90001048
 Y.CREATE.L   HWIO_DEM1X_F7_WALSH_ACC6_FRAME_ADDR                         0x9000104C
 Y.CREATE.L   DEM1X_F7_WALSH_ACC6_FRAME                                   0x9000104C
 Y.CREATE.L   HWIO_DEM1X_F7_WALSH_ACC7_FRAME_ADDR                         0x90001050
 Y.CREATE.L   DEM1X_F7_WALSH_ACC7_FRAME                                   0x90001050
 Y.CREATE.L   HWIO_DEM1X_F7_WALSH_ACC8_FRAME_ADDR                         0x90001054
 Y.CREATE.L   DEM1X_F7_WALSH_ACC8_FRAME                                   0x90001054
 Y.CREATE.L   HWIO_DEM1X_F7_WALSH_ACC9_FRAME_ADDR                         0x90001058
 Y.CREATE.L   DEM1X_F7_WALSH_ACC9_FRAME                                   0x90001058
 Y.CREATE.L   HWIO_DEM1X_F7_WALSH_ACC10_FRAME_ADDR                        0x9000105C
 Y.CREATE.L   DEM1X_F7_WALSH_ACC10_FRAME                                  0x9000105C
 Y.CREATE.L   HWIO_DEM1X_F7_WALSH_ACC11_FRAME_ADDR                        0x90001060
 Y.CREATE.L   DEM1X_F7_WALSH_ACC11_FRAME                                  0x90001060
 Y.CREATE.L   HWIO_DEM1X_F7_WALSH_ACC12_FRAME_ADDR                        0x90001064
 Y.CREATE.L   DEM1X_F7_WALSH_ACC12_FRAME                                  0x90001064
 Y.CREATE.L   HWIO_DEM1X_F7_WALSH_ACC13_FRAME_ADDR                        0x90001068
 Y.CREATE.L   DEM1X_F7_WALSH_ACC13_FRAME                                  0x90001068
 Y.CREATE.L   HWIO_DEM1X_F0_HW_CH1_IMMED_ADDR                             0x90000940
 Y.CREATE.L   DEM1X_F0_HW_CH1_IMMED                                       0x90000940
 Y.CREATE.L   HWIO_DEM1X_F1_HW_CH1_IMMED_ADDR                             0x900009B4
 Y.CREATE.L   DEM1X_F1_HW_CH1_IMMED                                       0x900009B4
 Y.CREATE.L   HWIO_DEM1X_F2_HW_CH1_IMMED_ADDR                             0x90000A28
 Y.CREATE.L   DEM1X_F2_HW_CH1_IMMED                                       0x90000A28
 Y.CREATE.L   HWIO_DEM1X_F3_HW_CH1_IMMED_ADDR                             0x90000A9C
 Y.CREATE.L   DEM1X_F3_HW_CH1_IMMED                                       0x90000A9C
 Y.CREATE.L   HWIO_DEM1X_F4_HW_CH1_IMMED_ADDR                             0x90000B10
 Y.CREATE.L   DEM1X_F4_HW_CH1_IMMED                                       0x90000B10
 Y.CREATE.L   HWIO_DEM1X_F5_HW_CH1_IMMED_ADDR                             0x90000B84
 Y.CREATE.L   DEM1X_F5_HW_CH1_IMMED                                       0x90000B84
 Y.CREATE.L   HWIO_DEM1X_F6_HW_CH1_IMMED_ADDR                             0x90000BF8
 Y.CREATE.L   DEM1X_F6_HW_CH1_IMMED                                       0x90000BF8
 Y.CREATE.L   HWIO_DEM1X_F7_HW_CH1_IMMED_ADDR                             0x90000C6C
 Y.CREATE.L   DEM1X_F7_HW_CH1_IMMED                                       0x90000C6C
 Y.CREATE.L   HWIO_DEM1X_F0_HW_CH1_FRAME_ADDR                             0x90000D40
 Y.CREATE.L   DEM1X_F0_HW_CH1_FRAME                                       0x90000D40
 Y.CREATE.L   HWIO_DEM1X_F1_HW_CH1_FRAME_ADDR                             0x90000DB4
 Y.CREATE.L   DEM1X_F1_HW_CH1_FRAME                                       0x90000DB4
 Y.CREATE.L   HWIO_DEM1X_F2_HW_CH1_FRAME_ADDR                             0x90000E28
 Y.CREATE.L   DEM1X_F2_HW_CH1_FRAME                                       0x90000E28
 Y.CREATE.L   HWIO_DEM1X_F3_HW_CH1_FRAME_ADDR                             0x90000E9C
 Y.CREATE.L   DEM1X_F3_HW_CH1_FRAME                                       0x90000E9C
 Y.CREATE.L   HWIO_DEM1X_F4_HW_CH1_FRAME_ADDR                             0x90000F10
 Y.CREATE.L   DEM1X_F4_HW_CH1_FRAME                                       0x90000F10
 Y.CREATE.L   HWIO_DEM1X_F5_HW_CH1_FRAME_ADDR                             0x90000F84
 Y.CREATE.L   DEM1X_F5_HW_CH1_FRAME                                       0x90000F84
 Y.CREATE.L   HWIO_DEM1X_F6_HW_CH1_FRAME_ADDR                             0x90000FF8
 Y.CREATE.L   DEM1X_F6_HW_CH1_FRAME                                       0x90000FF8
 Y.CREATE.L   HWIO_DEM1X_F7_HW_CH1_FRAME_ADDR                             0x9000106C
 Y.CREATE.L   DEM1X_F7_HW_CH1_FRAME                                       0x9000106C
 Y.CREATE.L   HWIO_DEM1X_F0_HW_CH2_IMMED_ADDR                             0x90000944
 Y.CREATE.L   DEM1X_F0_HW_CH2_IMMED                                       0x90000944
 Y.CREATE.L   HWIO_DEM1X_F1_HW_CH2_IMMED_ADDR                             0x900009B8
 Y.CREATE.L   DEM1X_F1_HW_CH2_IMMED                                       0x900009B8
 Y.CREATE.L   HWIO_DEM1X_F2_HW_CH2_IMMED_ADDR                             0x90000A2C
 Y.CREATE.L   DEM1X_F2_HW_CH2_IMMED                                       0x90000A2C
 Y.CREATE.L   HWIO_DEM1X_F3_HW_CH2_IMMED_ADDR                             0x90000AA0
 Y.CREATE.L   DEM1X_F3_HW_CH2_IMMED                                       0x90000AA0
 Y.CREATE.L   HWIO_DEM1X_F4_HW_CH2_IMMED_ADDR                             0x90000B14
 Y.CREATE.L   DEM1X_F4_HW_CH2_IMMED                                       0x90000B14
 Y.CREATE.L   HWIO_DEM1X_F5_HW_CH2_IMMED_ADDR                             0x90000B88
 Y.CREATE.L   DEM1X_F5_HW_CH2_IMMED                                       0x90000B88
 Y.CREATE.L   HWIO_DEM1X_F6_HW_CH2_IMMED_ADDR                             0x90000BFC
 Y.CREATE.L   DEM1X_F6_HW_CH2_IMMED                                       0x90000BFC
 Y.CREATE.L   HWIO_DEM1X_F7_HW_CH2_IMMED_ADDR                             0x90000C70
 Y.CREATE.L   DEM1X_F7_HW_CH2_IMMED                                       0x90000C70
 Y.CREATE.L   HWIO_DEM1X_F0_HW_CH2_FRAME_ADDR                             0x90000D44
 Y.CREATE.L   DEM1X_F0_HW_CH2_FRAME                                       0x90000D44
 Y.CREATE.L   HWIO_DEM1X_F1_HW_CH2_FRAME_ADDR                             0x90000DB8
 Y.CREATE.L   DEM1X_F1_HW_CH2_FRAME                                       0x90000DB8
 Y.CREATE.L   HWIO_DEM1X_F2_HW_CH2_FRAME_ADDR                             0x90000E2C
 Y.CREATE.L   DEM1X_F2_HW_CH2_FRAME                                       0x90000E2C
 Y.CREATE.L   HWIO_DEM1X_F3_HW_CH2_FRAME_ADDR                             0x90000EA0
 Y.CREATE.L   DEM1X_F3_HW_CH2_FRAME                                       0x90000EA0
 Y.CREATE.L   HWIO_DEM1X_F4_HW_CH2_FRAME_ADDR                             0x90000F14
 Y.CREATE.L   DEM1X_F4_HW_CH2_FRAME                                       0x90000F14
 Y.CREATE.L   HWIO_DEM1X_F5_HW_CH2_FRAME_ADDR                             0x90000F88
 Y.CREATE.L   DEM1X_F5_HW_CH2_FRAME                                       0x90000F88
 Y.CREATE.L   HWIO_DEM1X_F6_HW_CH2_FRAME_ADDR                             0x90000FFC
 Y.CREATE.L   DEM1X_F6_HW_CH2_FRAME                                       0x90000FFC
 Y.CREATE.L   HWIO_DEM1X_F7_HW_CH2_FRAME_ADDR                             0x90001070
 Y.CREATE.L   DEM1X_F7_HW_CH2_FRAME                                       0x90001070
 Y.CREATE.L   HWIO_DEM1X_F0_HW_CH3_IMMED_ADDR                             0x90000948
 Y.CREATE.L   DEM1X_F0_HW_CH3_IMMED                                       0x90000948
 Y.CREATE.L   HWIO_DEM1X_F1_HW_CH3_IMMED_ADDR                             0x900009BC
 Y.CREATE.L   DEM1X_F1_HW_CH3_IMMED                                       0x900009BC
 Y.CREATE.L   HWIO_DEM1X_F2_HW_CH3_IMMED_ADDR                             0x90000A30
 Y.CREATE.L   DEM1X_F2_HW_CH3_IMMED                                       0x90000A30
 Y.CREATE.L   HWIO_DEM1X_F3_HW_CH3_IMMED_ADDR                             0x90000AA4
 Y.CREATE.L   DEM1X_F3_HW_CH3_IMMED                                       0x90000AA4
 Y.CREATE.L   HWIO_DEM1X_F4_HW_CH3_IMMED_ADDR                             0x90000B18
 Y.CREATE.L   DEM1X_F4_HW_CH3_IMMED                                       0x90000B18
 Y.CREATE.L   HWIO_DEM1X_F5_HW_CH3_IMMED_ADDR                             0x90000B8C
 Y.CREATE.L   DEM1X_F5_HW_CH3_IMMED                                       0x90000B8C
 Y.CREATE.L   HWIO_DEM1X_F6_HW_CH3_IMMED_ADDR                             0x90000C00
 Y.CREATE.L   DEM1X_F6_HW_CH3_IMMED                                       0x90000C00
 Y.CREATE.L   HWIO_DEM1X_F7_HW_CH3_IMMED_ADDR                             0x90000C74
 Y.CREATE.L   DEM1X_F7_HW_CH3_IMMED                                       0x90000C74
 Y.CREATE.L   HWIO_DEM1X_F0_HW_CH3_FRAME_ADDR                             0x90000D48
 Y.CREATE.L   DEM1X_F0_HW_CH3_FRAME                                       0x90000D48
 Y.CREATE.L   HWIO_DEM1X_F1_HW_CH3_FRAME_ADDR                             0x90000DBC
 Y.CREATE.L   DEM1X_F1_HW_CH3_FRAME                                       0x90000DBC
 Y.CREATE.L   HWIO_DEM1X_F2_HW_CH3_FRAME_ADDR                             0x90000E30
 Y.CREATE.L   DEM1X_F2_HW_CH3_FRAME                                       0x90000E30
 Y.CREATE.L   HWIO_DEM1X_F3_HW_CH3_FRAME_ADDR                             0x90000EA4
 Y.CREATE.L   DEM1X_F3_HW_CH3_FRAME                                       0x90000EA4
 Y.CREATE.L   HWIO_DEM1X_F4_HW_CH3_FRAME_ADDR                             0x90000F18
 Y.CREATE.L   DEM1X_F4_HW_CH3_FRAME                                       0x90000F18
 Y.CREATE.L   HWIO_DEM1X_F5_HW_CH3_FRAME_ADDR                             0x90000F8C
 Y.CREATE.L   DEM1X_F5_HW_CH3_FRAME                                       0x90000F8C
 Y.CREATE.L   HWIO_DEM1X_F6_HW_CH3_FRAME_ADDR                             0x90001000
 Y.CREATE.L   DEM1X_F6_HW_CH3_FRAME                                       0x90001000
 Y.CREATE.L   HWIO_DEM1X_F7_HW_CH3_FRAME_ADDR                             0x90001074
 Y.CREATE.L   DEM1X_F7_HW_CH3_FRAME                                       0x90001074
 Y.CREATE.L   HWIO_DEM1X_F0_WALSH_ACC14_IMMED_ADDR                        0x9000094C
 Y.CREATE.L   DEM1X_F0_WALSH_ACC14_IMMED                                  0x9000094C
 Y.CREATE.L   HWIO_DEM1X_F0_WALSH_ACC15_IMMED_ADDR                        0x90000950
 Y.CREATE.L   DEM1X_F0_WALSH_ACC15_IMMED                                  0x90000950
 Y.CREATE.L   HWIO_DEM1X_F0_WALSH_ACC16_IMMED_ADDR                        0x90000954
 Y.CREATE.L   DEM1X_F0_WALSH_ACC16_IMMED                                  0x90000954
 Y.CREATE.L   HWIO_DEM1X_F0_WALSH_ACC17_IMMED_ADDR                        0x90000958
 Y.CREATE.L   DEM1X_F0_WALSH_ACC17_IMMED                                  0x90000958
 Y.CREATE.L   HWIO_DEM1X_F0_WALSH_ACC18_IMMED_ADDR                        0x9000095C
 Y.CREATE.L   DEM1X_F0_WALSH_ACC18_IMMED                                  0x9000095C
 Y.CREATE.L   HWIO_DEM1X_F0_WALSH_ACC19_IMMED_ADDR                        0x90000960
 Y.CREATE.L   DEM1X_F0_WALSH_ACC19_IMMED                                  0x90000960
 Y.CREATE.L   HWIO_DEM1X_F0_WALSH_ACC20_IMMED_ADDR                        0x90000964
 Y.CREATE.L   DEM1X_F0_WALSH_ACC20_IMMED                                  0x90000964
 Y.CREATE.L   HWIO_DEM1X_F0_WALSH_ACC21_IMMED_ADDR                        0x90000968
 Y.CREATE.L   DEM1X_F0_WALSH_ACC21_IMMED                                  0x90000968
 Y.CREATE.L   HWIO_DEM1X_F1_WALSH_ACC14_IMMED_ADDR                        0x900009C0
 Y.CREATE.L   DEM1X_F1_WALSH_ACC14_IMMED                                  0x900009C0
 Y.CREATE.L   HWIO_DEM1X_F1_WALSH_ACC15_IMMED_ADDR                        0x900009C4
 Y.CREATE.L   DEM1X_F1_WALSH_ACC15_IMMED                                  0x900009C4
 Y.CREATE.L   HWIO_DEM1X_F1_WALSH_ACC16_IMMED_ADDR                        0x900009C8
 Y.CREATE.L   DEM1X_F1_WALSH_ACC16_IMMED                                  0x900009C8
 Y.CREATE.L   HWIO_DEM1X_F1_WALSH_ACC17_IMMED_ADDR                        0x900009CC
 Y.CREATE.L   DEM1X_F1_WALSH_ACC17_IMMED                                  0x900009CC
 Y.CREATE.L   HWIO_DEM1X_F1_WALSH_ACC18_IMMED_ADDR                        0x900009D0
 Y.CREATE.L   DEM1X_F1_WALSH_ACC18_IMMED                                  0x900009D0
 Y.CREATE.L   HWIO_DEM1X_F1_WALSH_ACC19_IMMED_ADDR                        0x900009D4
 Y.CREATE.L   DEM1X_F1_WALSH_ACC19_IMMED                                  0x900009D4
 Y.CREATE.L   HWIO_DEM1X_F1_WALSH_ACC20_IMMED_ADDR                        0x900009D8
 Y.CREATE.L   DEM1X_F1_WALSH_ACC20_IMMED                                  0x900009D8
 Y.CREATE.L   HWIO_DEM1X_F1_WALSH_ACC21_IMMED_ADDR                        0x900009DC
 Y.CREATE.L   DEM1X_F1_WALSH_ACC21_IMMED                                  0x900009DC
 Y.CREATE.L   HWIO_DEM1X_F2_WALSH_ACC14_IMMED_ADDR                        0x90000A34
 Y.CREATE.L   DEM1X_F2_WALSH_ACC14_IMMED                                  0x90000A34
 Y.CREATE.L   HWIO_DEM1X_F2_WALSH_ACC15_IMMED_ADDR                        0x90000A38
 Y.CREATE.L   DEM1X_F2_WALSH_ACC15_IMMED                                  0x90000A38
 Y.CREATE.L   HWIO_DEM1X_F2_WALSH_ACC16_IMMED_ADDR                        0x90000A3C
 Y.CREATE.L   DEM1X_F2_WALSH_ACC16_IMMED                                  0x90000A3C
 Y.CREATE.L   HWIO_DEM1X_F2_WALSH_ACC17_IMMED_ADDR                        0x90000A40
 Y.CREATE.L   DEM1X_F2_WALSH_ACC17_IMMED                                  0x90000A40
 Y.CREATE.L   HWIO_DEM1X_F2_WALSH_ACC18_IMMED_ADDR                        0x90000A44
 Y.CREATE.L   DEM1X_F2_WALSH_ACC18_IMMED                                  0x90000A44
 Y.CREATE.L   HWIO_DEM1X_F2_WALSH_ACC19_IMMED_ADDR                        0x90000A48
 Y.CREATE.L   DEM1X_F2_WALSH_ACC19_IMMED                                  0x90000A48
 Y.CREATE.L   HWIO_DEM1X_F2_WALSH_ACC20_IMMED_ADDR                        0x90000A4C
 Y.CREATE.L   DEM1X_F2_WALSH_ACC20_IMMED                                  0x90000A4C
 Y.CREATE.L   HWIO_DEM1X_F2_WALSH_ACC21_IMMED_ADDR                        0x90000A50
 Y.CREATE.L   DEM1X_F2_WALSH_ACC21_IMMED                                  0x90000A50
 Y.CREATE.L   HWIO_DEM1X_F3_WALSH_ACC14_IMMED_ADDR                        0x90000AA8
 Y.CREATE.L   DEM1X_F3_WALSH_ACC14_IMMED                                  0x90000AA8
 Y.CREATE.L   HWIO_DEM1X_F3_WALSH_ACC15_IMMED_ADDR                        0x90000AAC
 Y.CREATE.L   DEM1X_F3_WALSH_ACC15_IMMED                                  0x90000AAC
 Y.CREATE.L   HWIO_DEM1X_F3_WALSH_ACC16_IMMED_ADDR                        0x90000AB0
 Y.CREATE.L   DEM1X_F3_WALSH_ACC16_IMMED                                  0x90000AB0
 Y.CREATE.L   HWIO_DEM1X_F3_WALSH_ACC17_IMMED_ADDR                        0x90000AB4
 Y.CREATE.L   DEM1X_F3_WALSH_ACC17_IMMED                                  0x90000AB4
 Y.CREATE.L   HWIO_DEM1X_F3_WALSH_ACC18_IMMED_ADDR                        0x90000AB8
 Y.CREATE.L   DEM1X_F3_WALSH_ACC18_IMMED                                  0x90000AB8
 Y.CREATE.L   HWIO_DEM1X_F3_WALSH_ACC19_IMMED_ADDR                        0x90000ABC
 Y.CREATE.L   DEM1X_F3_WALSH_ACC19_IMMED                                  0x90000ABC
 Y.CREATE.L   HWIO_DEM1X_F3_WALSH_ACC20_IMMED_ADDR                        0x90000AC0
 Y.CREATE.L   DEM1X_F3_WALSH_ACC20_IMMED                                  0x90000AC0
 Y.CREATE.L   HWIO_DEM1X_F3_WALSH_ACC21_IMMED_ADDR                        0x90000AC4
 Y.CREATE.L   DEM1X_F3_WALSH_ACC21_IMMED                                  0x90000AC4
 Y.CREATE.L   HWIO_DEM1X_F4_WALSH_ACC14_IMMED_ADDR                        0x90000B1C
 Y.CREATE.L   DEM1X_F4_WALSH_ACC14_IMMED                                  0x90000B1C
 Y.CREATE.L   HWIO_DEM1X_F4_WALSH_ACC15_IMMED_ADDR                        0x90000B20
 Y.CREATE.L   DEM1X_F4_WALSH_ACC15_IMMED                                  0x90000B20
 Y.CREATE.L   HWIO_DEM1X_F4_WALSH_ACC16_IMMED_ADDR                        0x90000B24
 Y.CREATE.L   DEM1X_F4_WALSH_ACC16_IMMED                                  0x90000B24
 Y.CREATE.L   HWIO_DEM1X_F4_WALSH_ACC17_IMMED_ADDR                        0x90000B28
 Y.CREATE.L   DEM1X_F4_WALSH_ACC17_IMMED                                  0x90000B28
 Y.CREATE.L   HWIO_DEM1X_F4_WALSH_ACC18_IMMED_ADDR                        0x90000B2C
 Y.CREATE.L   DEM1X_F4_WALSH_ACC18_IMMED                                  0x90000B2C
 Y.CREATE.L   HWIO_DEM1X_F4_WALSH_ACC19_IMMED_ADDR                        0x90000B30
 Y.CREATE.L   DEM1X_F4_WALSH_ACC19_IMMED                                  0x90000B30
 Y.CREATE.L   HWIO_DEM1X_F4_WALSH_ACC20_IMMED_ADDR                        0x90000B34
 Y.CREATE.L   DEM1X_F4_WALSH_ACC20_IMMED                                  0x90000B34
 Y.CREATE.L   HWIO_DEM1X_F4_WALSH_ACC21_IMMED_ADDR                        0x90000B38
 Y.CREATE.L   DEM1X_F4_WALSH_ACC21_IMMED                                  0x90000B38
 Y.CREATE.L   HWIO_DEM1X_F5_WALSH_ACC14_IMMED_ADDR                        0x90000B90
 Y.CREATE.L   DEM1X_F5_WALSH_ACC14_IMMED                                  0x90000B90
 Y.CREATE.L   HWIO_DEM1X_F5_WALSH_ACC15_IMMED_ADDR                        0x90000B94
 Y.CREATE.L   DEM1X_F5_WALSH_ACC15_IMMED                                  0x90000B94
 Y.CREATE.L   HWIO_DEM1X_F5_WALSH_ACC16_IMMED_ADDR                        0x90000B98
 Y.CREATE.L   DEM1X_F5_WALSH_ACC16_IMMED                                  0x90000B98
 Y.CREATE.L   HWIO_DEM1X_F5_WALSH_ACC17_IMMED_ADDR                        0x90000B9C
 Y.CREATE.L   DEM1X_F5_WALSH_ACC17_IMMED                                  0x90000B9C
 Y.CREATE.L   HWIO_DEM1X_F5_WALSH_ACC18_IMMED_ADDR                        0x90000BA0
 Y.CREATE.L   DEM1X_F5_WALSH_ACC18_IMMED                                  0x90000BA0
 Y.CREATE.L   HWIO_DEM1X_F5_WALSH_ACC19_IMMED_ADDR                        0x90000BA4
 Y.CREATE.L   DEM1X_F5_WALSH_ACC19_IMMED                                  0x90000BA4
 Y.CREATE.L   HWIO_DEM1X_F5_WALSH_ACC20_IMMED_ADDR                        0x90000BA8
 Y.CREATE.L   DEM1X_F5_WALSH_ACC20_IMMED                                  0x90000BA8
 Y.CREATE.L   HWIO_DEM1X_F5_WALSH_ACC21_IMMED_ADDR                        0x90000BAC
 Y.CREATE.L   DEM1X_F5_WALSH_ACC21_IMMED                                  0x90000BAC
 Y.CREATE.L   HWIO_DEM1X_F6_WALSH_ACC14_IMMED_ADDR                        0x90000C04
 Y.CREATE.L   DEM1X_F6_WALSH_ACC14_IMMED                                  0x90000C04
 Y.CREATE.L   HWIO_DEM1X_F6_WALSH_ACC15_IMMED_ADDR                        0x90000C08
 Y.CREATE.L   DEM1X_F6_WALSH_ACC15_IMMED                                  0x90000C08
 Y.CREATE.L   HWIO_DEM1X_F6_WALSH_ACC16_IMMED_ADDR                        0x90000C0C
 Y.CREATE.L   DEM1X_F6_WALSH_ACC16_IMMED                                  0x90000C0C
 Y.CREATE.L   HWIO_DEM1X_F6_WALSH_ACC17_IMMED_ADDR                        0x90000C10
 Y.CREATE.L   DEM1X_F6_WALSH_ACC17_IMMED                                  0x90000C10
 Y.CREATE.L   HWIO_DEM1X_F6_WALSH_ACC18_IMMED_ADDR                        0x90000C14
 Y.CREATE.L   DEM1X_F6_WALSH_ACC18_IMMED                                  0x90000C14
 Y.CREATE.L   HWIO_DEM1X_F6_WALSH_ACC19_IMMED_ADDR                        0x90000C18
 Y.CREATE.L   DEM1X_F6_WALSH_ACC19_IMMED                                  0x90000C18
 Y.CREATE.L   HWIO_DEM1X_F6_WALSH_ACC20_IMMED_ADDR                        0x90000C1C
 Y.CREATE.L   DEM1X_F6_WALSH_ACC20_IMMED                                  0x90000C1C
 Y.CREATE.L   HWIO_DEM1X_F6_WALSH_ACC21_IMMED_ADDR                        0x90000C20
 Y.CREATE.L   DEM1X_F6_WALSH_ACC21_IMMED                                  0x90000C20
 Y.CREATE.L   HWIO_DEM1X_F7_WALSH_ACC14_IMMED_ADDR                        0x90000C78
 Y.CREATE.L   DEM1X_F7_WALSH_ACC14_IMMED                                  0x90000C78
 Y.CREATE.L   HWIO_DEM1X_F7_WALSH_ACC15_IMMED_ADDR                        0x90000C7C
 Y.CREATE.L   DEM1X_F7_WALSH_ACC15_IMMED                                  0x90000C7C
 Y.CREATE.L   HWIO_DEM1X_F7_WALSH_ACC16_IMMED_ADDR                        0x90000C80
 Y.CREATE.L   DEM1X_F7_WALSH_ACC16_IMMED                                  0x90000C80
 Y.CREATE.L   HWIO_DEM1X_F7_WALSH_ACC17_IMMED_ADDR                        0x90000C84
 Y.CREATE.L   DEM1X_F7_WALSH_ACC17_IMMED                                  0x90000C84
 Y.CREATE.L   HWIO_DEM1X_F7_WALSH_ACC18_IMMED_ADDR                        0x90000C88
 Y.CREATE.L   DEM1X_F7_WALSH_ACC18_IMMED                                  0x90000C88
 Y.CREATE.L   HWIO_DEM1X_F7_WALSH_ACC19_IMMED_ADDR                        0x90000C8C
 Y.CREATE.L   DEM1X_F7_WALSH_ACC19_IMMED                                  0x90000C8C
 Y.CREATE.L   HWIO_DEM1X_F7_WALSH_ACC20_IMMED_ADDR                        0x90000C90
 Y.CREATE.L   DEM1X_F7_WALSH_ACC20_IMMED                                  0x90000C90
 Y.CREATE.L   HWIO_DEM1X_F7_WALSH_ACC21_IMMED_ADDR                        0x90000C94
 Y.CREATE.L   DEM1X_F7_WALSH_ACC21_IMMED                                  0x90000C94
 Y.CREATE.L   HWIO_DEM1X_F0_WALSH_ACC14_FRAME_ADDR                        0x90000D4C
 Y.CREATE.L   DEM1X_F0_WALSH_ACC14_FRAME                                  0x90000D4C
 Y.CREATE.L   HWIO_DEM1X_F0_WALSH_ACC15_FRAME_ADDR                        0x90000D50
 Y.CREATE.L   DEM1X_F0_WALSH_ACC15_FRAME                                  0x90000D50
 Y.CREATE.L   HWIO_DEM1X_F0_WALSH_ACC16_FRAME_ADDR                        0x90000D54
 Y.CREATE.L   DEM1X_F0_WALSH_ACC16_FRAME                                  0x90000D54
 Y.CREATE.L   HWIO_DEM1X_F0_WALSH_ACC17_FRAME_ADDR                        0x90000D58
 Y.CREATE.L   DEM1X_F0_WALSH_ACC17_FRAME                                  0x90000D58
 Y.CREATE.L   HWIO_DEM1X_F0_WALSH_ACC18_FRAME_ADDR                        0x90000D5C
 Y.CREATE.L   DEM1X_F0_WALSH_ACC18_FRAME                                  0x90000D5C
 Y.CREATE.L   HWIO_DEM1X_F0_WALSH_ACC19_FRAME_ADDR                        0x90000D60
 Y.CREATE.L   DEM1X_F0_WALSH_ACC19_FRAME                                  0x90000D60
 Y.CREATE.L   HWIO_DEM1X_F0_WALSH_ACC20_FRAME_ADDR                        0x90000D64
 Y.CREATE.L   DEM1X_F0_WALSH_ACC20_FRAME                                  0x90000D64
 Y.CREATE.L   HWIO_DEM1X_F0_WALSH_ACC21_FRAME_ADDR                        0x90000D68
 Y.CREATE.L   DEM1X_F0_WALSH_ACC21_FRAME                                  0x90000D68
 Y.CREATE.L   HWIO_DEM1X_F1_WALSH_ACC14_FRAME_ADDR                        0x90000DC0
 Y.CREATE.L   DEM1X_F1_WALSH_ACC14_FRAME                                  0x90000DC0
 Y.CREATE.L   HWIO_DEM1X_F1_WALSH_ACC15_FRAME_ADDR                        0x90000DC4
 Y.CREATE.L   DEM1X_F1_WALSH_ACC15_FRAME                                  0x90000DC4
 Y.CREATE.L   HWIO_DEM1X_F1_WALSH_ACC16_FRAME_ADDR                        0x90000DC8
 Y.CREATE.L   DEM1X_F1_WALSH_ACC16_FRAME                                  0x90000DC8
 Y.CREATE.L   HWIO_DEM1X_F1_WALSH_ACC17_FRAME_ADDR                        0x90000DCC
 Y.CREATE.L   DEM1X_F1_WALSH_ACC17_FRAME                                  0x90000DCC
 Y.CREATE.L   HWIO_DEM1X_F1_WALSH_ACC18_FRAME_ADDR                        0x90000DD0
 Y.CREATE.L   DEM1X_F1_WALSH_ACC18_FRAME                                  0x90000DD0
 Y.CREATE.L   HWIO_DEM1X_F1_WALSH_ACC19_FRAME_ADDR                        0x90000DD4
 Y.CREATE.L   DEM1X_F1_WALSH_ACC19_FRAME                                  0x90000DD4
 Y.CREATE.L   HWIO_DEM1X_F1_WALSH_ACC20_FRAME_ADDR                        0x90000DD8
 Y.CREATE.L   DEM1X_F1_WALSH_ACC20_FRAME                                  0x90000DD8
 Y.CREATE.L   HWIO_DEM1X_F1_WALSH_ACC21_FRAME_ADDR                        0x90000DDC
 Y.CREATE.L   DEM1X_F1_WALSH_ACC21_FRAME                                  0x90000DDC
 Y.CREATE.L   HWIO_DEM1X_F2_WALSH_ACC14_FRAME_ADDR                        0x90000E34
 Y.CREATE.L   DEM1X_F2_WALSH_ACC14_FRAME                                  0x90000E34
 Y.CREATE.L   HWIO_DEM1X_F2_WALSH_ACC15_FRAME_ADDR                        0x90000E38
 Y.CREATE.L   DEM1X_F2_WALSH_ACC15_FRAME                                  0x90000E38
 Y.CREATE.L   HWIO_DEM1X_F2_WALSH_ACC16_FRAME_ADDR                        0x90000E3C
 Y.CREATE.L   DEM1X_F2_WALSH_ACC16_FRAME                                  0x90000E3C
 Y.CREATE.L   HWIO_DEM1X_F2_WALSH_ACC17_FRAME_ADDR                        0x90000E40
 Y.CREATE.L   DEM1X_F2_WALSH_ACC17_FRAME                                  0x90000E40
 Y.CREATE.L   HWIO_DEM1X_F2_WALSH_ACC18_FRAME_ADDR                        0x90000E44
 Y.CREATE.L   DEM1X_F2_WALSH_ACC18_FRAME                                  0x90000E44
 Y.CREATE.L   HWIO_DEM1X_F2_WALSH_ACC19_FRAME_ADDR                        0x90000E48
 Y.CREATE.L   DEM1X_F2_WALSH_ACC19_FRAME                                  0x90000E48
 Y.CREATE.L   HWIO_DEM1X_F2_WALSH_ACC20_FRAME_ADDR                        0x90000E4C
 Y.CREATE.L   DEM1X_F2_WALSH_ACC20_FRAME                                  0x90000E4C
 Y.CREATE.L   HWIO_DEM1X_F2_WALSH_ACC21_FRAME_ADDR                        0x90000E50
 Y.CREATE.L   DEM1X_F2_WALSH_ACC21_FRAME                                  0x90000E50
 Y.CREATE.L   HWIO_DEM1X_F3_WALSH_ACC14_FRAME_ADDR                        0x90000EA8
 Y.CREATE.L   DEM1X_F3_WALSH_ACC14_FRAME                                  0x90000EA8
 Y.CREATE.L   HWIO_DEM1X_F3_WALSH_ACC15_FRAME_ADDR                        0x90000EAC
 Y.CREATE.L   DEM1X_F3_WALSH_ACC15_FRAME                                  0x90000EAC
 Y.CREATE.L   HWIO_DEM1X_F3_WALSH_ACC16_FRAME_ADDR                        0x90000EB0
 Y.CREATE.L   DEM1X_F3_WALSH_ACC16_FRAME                                  0x90000EB0
 Y.CREATE.L   HWIO_DEM1X_F3_WALSH_ACC17_FRAME_ADDR                        0x90000EB4
 Y.CREATE.L   DEM1X_F3_WALSH_ACC17_FRAME                                  0x90000EB4
 Y.CREATE.L   HWIO_DEM1X_F3_WALSH_ACC18_FRAME_ADDR                        0x90000EB8
 Y.CREATE.L   DEM1X_F3_WALSH_ACC18_FRAME                                  0x90000EB8
 Y.CREATE.L   HWIO_DEM1X_F3_WALSH_ACC19_FRAME_ADDR                        0x90000EBC
 Y.CREATE.L   DEM1X_F3_WALSH_ACC19_FRAME                                  0x90000EBC
 Y.CREATE.L   HWIO_DEM1X_F3_WALSH_ACC20_FRAME_ADDR                        0x90000EC0
 Y.CREATE.L   DEM1X_F3_WALSH_ACC20_FRAME                                  0x90000EC0
 Y.CREATE.L   HWIO_DEM1X_F3_WALSH_ACC21_FRAME_ADDR                        0x90000EC4
 Y.CREATE.L   DEM1X_F3_WALSH_ACC21_FRAME                                  0x90000EC4
 Y.CREATE.L   HWIO_DEM1X_F4_WALSH_ACC14_FRAME_ADDR                        0x90000F1C
 Y.CREATE.L   DEM1X_F4_WALSH_ACC14_FRAME                                  0x90000F1C
 Y.CREATE.L   HWIO_DEM1X_F4_WALSH_ACC15_FRAME_ADDR                        0x90000F20
 Y.CREATE.L   DEM1X_F4_WALSH_ACC15_FRAME                                  0x90000F20
 Y.CREATE.L   HWIO_DEM1X_F4_WALSH_ACC16_FRAME_ADDR                        0x90000F24
 Y.CREATE.L   DEM1X_F4_WALSH_ACC16_FRAME                                  0x90000F24
 Y.CREATE.L   HWIO_DEM1X_F4_WALSH_ACC17_FRAME_ADDR                        0x90000F28
 Y.CREATE.L   DEM1X_F4_WALSH_ACC17_FRAME                                  0x90000F28
 Y.CREATE.L   HWIO_DEM1X_F4_WALSH_ACC18_FRAME_ADDR                        0x90000F2C
 Y.CREATE.L   DEM1X_F4_WALSH_ACC18_FRAME                                  0x90000F2C
 Y.CREATE.L   HWIO_DEM1X_F4_WALSH_ACC19_FRAME_ADDR                        0x90000F30
 Y.CREATE.L   DEM1X_F4_WALSH_ACC19_FRAME                                  0x90000F30
 Y.CREATE.L   HWIO_DEM1X_F4_WALSH_ACC20_FRAME_ADDR                        0x90000F34
 Y.CREATE.L   DEM1X_F4_WALSH_ACC20_FRAME                                  0x90000F34
 Y.CREATE.L   HWIO_DEM1X_F4_WALSH_ACC21_FRAME_ADDR                        0x90000F38
 Y.CREATE.L   DEM1X_F4_WALSH_ACC21_FRAME                                  0x90000F38
 Y.CREATE.L   HWIO_DEM1X_F5_WALSH_ACC14_FRAME_ADDR                        0x90000F90
 Y.CREATE.L   DEM1X_F5_WALSH_ACC14_FRAME                                  0x90000F90
 Y.CREATE.L   HWIO_DEM1X_F5_WALSH_ACC15_FRAME_ADDR                        0x90000F94
 Y.CREATE.L   DEM1X_F5_WALSH_ACC15_FRAME                                  0x90000F94
 Y.CREATE.L   HWIO_DEM1X_F5_WALSH_ACC16_FRAME_ADDR                        0x90000F98
 Y.CREATE.L   DEM1X_F5_WALSH_ACC16_FRAME                                  0x90000F98
 Y.CREATE.L   HWIO_DEM1X_F5_WALSH_ACC17_FRAME_ADDR                        0x90000F9C
 Y.CREATE.L   DEM1X_F5_WALSH_ACC17_FRAME                                  0x90000F9C
 Y.CREATE.L   HWIO_DEM1X_F5_WALSH_ACC18_FRAME_ADDR                        0x90000FA0
 Y.CREATE.L   DEM1X_F5_WALSH_ACC18_FRAME                                  0x90000FA0
 Y.CREATE.L   HWIO_DEM1X_F5_WALSH_ACC19_FRAME_ADDR                        0x90000FA4
 Y.CREATE.L   DEM1X_F5_WALSH_ACC19_FRAME                                  0x90000FA4
 Y.CREATE.L   HWIO_DEM1X_F5_WALSH_ACC20_FRAME_ADDR                        0x90000FA8
 Y.CREATE.L   DEM1X_F5_WALSH_ACC20_FRAME                                  0x90000FA8
 Y.CREATE.L   HWIO_DEM1X_F5_WALSH_ACC21_FRAME_ADDR                        0x90000FAC
 Y.CREATE.L   DEM1X_F5_WALSH_ACC21_FRAME                                  0x90000FAC
 Y.CREATE.L   HWIO_DEM1X_F6_WALSH_ACC14_FRAME_ADDR                        0x90001004
 Y.CREATE.L   DEM1X_F6_WALSH_ACC14_FRAME                                  0x90001004
 Y.CREATE.L   HWIO_DEM1X_F6_WALSH_ACC15_FRAME_ADDR                        0x90001008
 Y.CREATE.L   DEM1X_F6_WALSH_ACC15_FRAME                                  0x90001008
 Y.CREATE.L   HWIO_DEM1X_F6_WALSH_ACC16_FRAME_ADDR                        0x9000100C
 Y.CREATE.L   DEM1X_F6_WALSH_ACC16_FRAME                                  0x9000100C
 Y.CREATE.L   HWIO_DEM1X_F6_WALSH_ACC17_FRAME_ADDR                        0x90001010
 Y.CREATE.L   DEM1X_F6_WALSH_ACC17_FRAME                                  0x90001010
 Y.CREATE.L   HWIO_DEM1X_F6_WALSH_ACC18_FRAME_ADDR                        0x90001014
 Y.CREATE.L   DEM1X_F6_WALSH_ACC18_FRAME                                  0x90001014
 Y.CREATE.L   HWIO_DEM1X_F6_WALSH_ACC19_FRAME_ADDR                        0x90001018
 Y.CREATE.L   DEM1X_F6_WALSH_ACC19_FRAME                                  0x90001018
 Y.CREATE.L   HWIO_DEM1X_F6_WALSH_ACC20_FRAME_ADDR                        0x9000101C
 Y.CREATE.L   DEM1X_F6_WALSH_ACC20_FRAME                                  0x9000101C
 Y.CREATE.L   HWIO_DEM1X_F6_WALSH_ACC21_FRAME_ADDR                        0x90001020
 Y.CREATE.L   DEM1X_F6_WALSH_ACC21_FRAME                                  0x90001020
 Y.CREATE.L   HWIO_DEM1X_F7_WALSH_ACC14_FRAME_ADDR                        0x90001078
 Y.CREATE.L   DEM1X_F7_WALSH_ACC14_FRAME                                  0x90001078
 Y.CREATE.L   HWIO_DEM1X_F7_WALSH_ACC15_FRAME_ADDR                        0x9000107C
 Y.CREATE.L   DEM1X_F7_WALSH_ACC15_FRAME                                  0x9000107C
 Y.CREATE.L   HWIO_DEM1X_F7_WALSH_ACC16_FRAME_ADDR                        0x90001080
 Y.CREATE.L   DEM1X_F7_WALSH_ACC16_FRAME                                  0x90001080
 Y.CREATE.L   HWIO_DEM1X_F7_WALSH_ACC17_FRAME_ADDR                        0x90001084
 Y.CREATE.L   DEM1X_F7_WALSH_ACC17_FRAME                                  0x90001084
 Y.CREATE.L   HWIO_DEM1X_F7_WALSH_ACC18_FRAME_ADDR                        0x90001088
 Y.CREATE.L   DEM1X_F7_WALSH_ACC18_FRAME                                  0x90001088
 Y.CREATE.L   HWIO_DEM1X_F7_WALSH_ACC19_FRAME_ADDR                        0x9000108C
 Y.CREATE.L   DEM1X_F7_WALSH_ACC19_FRAME                                  0x9000108C
 Y.CREATE.L   HWIO_DEM1X_F7_WALSH_ACC20_FRAME_ADDR                        0x90001090
 Y.CREATE.L   DEM1X_F7_WALSH_ACC20_FRAME                                  0x90001090
 Y.CREATE.L   HWIO_DEM1X_F7_WALSH_ACC21_FRAME_ADDR                        0x90001094
 Y.CREATE.L   DEM1X_F7_WALSH_ACC21_FRAME                                  0x90001094
 Y.CREATE.L   HWIO_DEM1X_F0_HW_CH4_IMMED_ADDR                             0x9000096C
 Y.CREATE.L   DEM1X_F0_HW_CH4_IMMED                                       0x9000096C
 Y.CREATE.L   HWIO_DEM1X_F1_HW_CH4_IMMED_ADDR                             0x900009E0
 Y.CREATE.L   DEM1X_F1_HW_CH4_IMMED                                       0x900009E0
 Y.CREATE.L   HWIO_DEM1X_F2_HW_CH4_IMMED_ADDR                             0x90000A54
 Y.CREATE.L   DEM1X_F2_HW_CH4_IMMED                                       0x90000A54
 Y.CREATE.L   HWIO_DEM1X_F3_HW_CH4_IMMED_ADDR                             0x90000AC8
 Y.CREATE.L   DEM1X_F3_HW_CH4_IMMED                                       0x90000AC8
 Y.CREATE.L   HWIO_DEM1X_F4_HW_CH4_IMMED_ADDR                             0x90000B3C
 Y.CREATE.L   DEM1X_F4_HW_CH4_IMMED                                       0x90000B3C
 Y.CREATE.L   HWIO_DEM1X_F5_HW_CH4_IMMED_ADDR                             0x90000BB0
 Y.CREATE.L   DEM1X_F5_HW_CH4_IMMED                                       0x90000BB0
 Y.CREATE.L   HWIO_DEM1X_F6_HW_CH4_IMMED_ADDR                             0x90000C24
 Y.CREATE.L   DEM1X_F6_HW_CH4_IMMED                                       0x90000C24
 Y.CREATE.L   HWIO_DEM1X_F7_HW_CH4_IMMED_ADDR                             0x90000C98
 Y.CREATE.L   DEM1X_F7_HW_CH4_IMMED                                       0x90000C98
 Y.CREATE.L   HWIO_DEM1X_F0_HW_CH4_FRAME_ADDR                             0x90000D6C
 Y.CREATE.L   DEM1X_F0_HW_CH4_FRAME                                       0x90000D6C
 Y.CREATE.L   HWIO_DEM1X_F1_HW_CH4_FRAME_ADDR                             0x90000DE0
 Y.CREATE.L   DEM1X_F1_HW_CH4_FRAME                                       0x90000DE0
 Y.CREATE.L   HWIO_DEM1X_F2_HW_CH4_FRAME_ADDR                             0x90000E54
 Y.CREATE.L   DEM1X_F2_HW_CH4_FRAME                                       0x90000E54
 Y.CREATE.L   HWIO_DEM1X_F3_HW_CH4_FRAME_ADDR                             0x90000EC8
 Y.CREATE.L   DEM1X_F3_HW_CH4_FRAME                                       0x90000EC8
 Y.CREATE.L   HWIO_DEM1X_F4_HW_CH4_FRAME_ADDR                             0x90000F3C
 Y.CREATE.L   DEM1X_F4_HW_CH4_FRAME                                       0x90000F3C
 Y.CREATE.L   HWIO_DEM1X_F5_HW_CH4_FRAME_ADDR                             0x90000FB0
 Y.CREATE.L   DEM1X_F5_HW_CH4_FRAME                                       0x90000FB0
 Y.CREATE.L   HWIO_DEM1X_F6_HW_CH4_FRAME_ADDR                             0x90001024
 Y.CREATE.L   DEM1X_F6_HW_CH4_FRAME                                       0x90001024
 Y.CREATE.L   HWIO_DEM1X_F7_HW_CH4_FRAME_ADDR                             0x90001098
 Y.CREATE.L   DEM1X_F7_HW_CH4_FRAME                                       0x90001098
 Y.CREATE.L   HWIO_DEM1X_F0_HW_CH5_IMMED_ADDR                             0x90000970
 Y.CREATE.L   DEM1X_F0_HW_CH5_IMMED                                       0x90000970
 Y.CREATE.L   HWIO_DEM1X_F1_HW_CH5_IMMED_ADDR                             0x900009E4
 Y.CREATE.L   DEM1X_F1_HW_CH5_IMMED                                       0x900009E4
 Y.CREATE.L   HWIO_DEM1X_F2_HW_CH5_IMMED_ADDR                             0x90000A58
 Y.CREATE.L   DEM1X_F2_HW_CH5_IMMED                                       0x90000A58
 Y.CREATE.L   HWIO_DEM1X_F3_HW_CH5_IMMED_ADDR                             0x90000ACC
 Y.CREATE.L   DEM1X_F3_HW_CH5_IMMED                                       0x90000ACC
 Y.CREATE.L   HWIO_DEM1X_F4_HW_CH5_IMMED_ADDR                             0x90000B40
 Y.CREATE.L   DEM1X_F4_HW_CH5_IMMED                                       0x90000B40
 Y.CREATE.L   HWIO_DEM1X_F5_HW_CH5_IMMED_ADDR                             0x90000BB4
 Y.CREATE.L   DEM1X_F5_HW_CH5_IMMED                                       0x90000BB4
 Y.CREATE.L   HWIO_DEM1X_F6_HW_CH5_IMMED_ADDR                             0x90000C28
 Y.CREATE.L   DEM1X_F6_HW_CH5_IMMED                                       0x90000C28
 Y.CREATE.L   HWIO_DEM1X_F7_HW_CH5_IMMED_ADDR                             0x90000C9C
 Y.CREATE.L   DEM1X_F7_HW_CH5_IMMED                                       0x90000C9C
 Y.CREATE.L   HWIO_DEM1X_F0_HW_CH5_FRAME_ADDR                             0x90000D70
 Y.CREATE.L   DEM1X_F0_HW_CH5_FRAME                                       0x90000D70
 Y.CREATE.L   HWIO_DEM1X_F1_HW_CH5_FRAME_ADDR                             0x90000DE4
 Y.CREATE.L   DEM1X_F1_HW_CH5_FRAME                                       0x90000DE4
 Y.CREATE.L   HWIO_DEM1X_F2_HW_CH5_FRAME_ADDR                             0x90000E58
 Y.CREATE.L   DEM1X_F2_HW_CH5_FRAME                                       0x90000E58
 Y.CREATE.L   HWIO_DEM1X_F3_HW_CH5_FRAME_ADDR                             0x90000ECC
 Y.CREATE.L   DEM1X_F3_HW_CH5_FRAME                                       0x90000ECC
 Y.CREATE.L   HWIO_DEM1X_F4_HW_CH5_FRAME_ADDR                             0x90000F40
 Y.CREATE.L   DEM1X_F4_HW_CH5_FRAME                                       0x90000F40
 Y.CREATE.L   HWIO_DEM1X_F5_HW_CH5_FRAME_ADDR                             0x90000FB4
 Y.CREATE.L   DEM1X_F5_HW_CH5_FRAME                                       0x90000FB4
 Y.CREATE.L   HWIO_DEM1X_F6_HW_CH5_FRAME_ADDR                             0x90001028
 Y.CREATE.L   DEM1X_F6_HW_CH5_FRAME                                       0x90001028
 Y.CREATE.L   HWIO_DEM1X_F7_HW_CH5_FRAME_ADDR                             0x9000109C
 Y.CREATE.L   DEM1X_F7_HW_CH5_FRAME                                       0x9000109C
 Y.CREATE.L   HWIO_DEM1X_FFE_TEST_ADDR                                    0x90000CA0
 Y.CREATE.L   DEM1X_FFE_TEST                                              0x90000CA0
 Y.CREATE.L   HWIO_DEM1X_FFE_TEST_MODE_ADDR                               0x90000CA4
 Y.CREATE.L   DEM1X_FFE_TEST_MODE                                         0x90000CA4
 Y.CREATE.L   HWIO_DEM1X_FFE_TEST_MISR_RESET_ADDR                         0x90000CA8
 Y.CREATE.L   DEM1X_FFE_TEST_MISR_RESET                                   0x90000CA8
 Y.CREATE.L   HWIO_DEM1X_FFE_TEST_EXPORT_MISR_ADDR                        0x90000CAC
 Y.CREATE.L   DEM1X_FFE_TEST_EXPORT_MISR                                  0x90000CAC
 Y.CREATE.L   HWIO_DEM1X_FFE_TEST_CAPTURED_ADDR                           0x90000CB0
 Y.CREATE.L   DEM1X_FFE_TEST_CAPTURED                                     0x90000CB0
 Y.CREATE.L   HWIO_DEM1X_FFE_TEST_MISR_CURR_VAL_ADDR                      0x90000CB4
 Y.CREATE.L   DEM1X_FFE_TEST_MISR_CURR_VAL                                0x90000CB4
 Y.CREATE.L   HWIO_DEM1X_FFE_TEST_MISR_CAPT_VAL_ADDR                      0x90000CB8
 Y.CREATE.L   DEM1X_FFE_TEST_MISR_CAPT_VAL                                0x90000CB8
 Y.CREATE.L   HWIO_DEM1X_TEST_MEM_SEL_ADDR                                0x90000CBC
 Y.CREATE.L   DEM1X_TEST_MEM_SEL                                          0x90000CBC
 Y.CREATE.L   HWIO_DEM1X_TEST_MEM_ADDR_ADDR                               0x90000CC0
 Y.CREATE.L   DEM1X_TEST_MEM_ADDR                                         0x90000CC0
 Y.CREATE.L   HWIO_DEM1X_TEST_MEM_WRITE_ADDR                              0x90000CC4
 Y.CREATE.L   DEM1X_TEST_MEM_WRITE                                        0x90000CC4
 Y.CREATE.L   HWIO_DEM1X_TEST_MEM_READ0_ADDR                              0x90000CC8
 Y.CREATE.L   DEM1X_TEST_MEM_READ0                                        0x90000CC8
 Y.CREATE.L   HWIO_DEM1X_HW_OFFLINE_CLK_CTL_ADDR                          0x90000CCC
 Y.CREATE.L   DEM1X_HW_OFFLINE_CLK_CTL                                    0x90000CCC
 Y.CREATE.L   HWIO_DEM1X_MICRO_OFFLINE_CLK_CTL_ADDR                       0x90000CD0
 Y.CREATE.L   DEM1X_MICRO_OFFLINE_CLK_CTL                                 0x90000CD0
 Y.CREATE.L   HWIO_DEM1X_OFFLINE_CLK_STATUS_ADDR                          0x90000CD4
 Y.CREATE.L   DEM1X_OFFLINE_CLK_STATUS                                    0x90000CD4
 Y.CREATE.L   HWIO_DEM1X_OFFLINE_SPARE_READ_REG0_ADDR                     0x90000CD8
 Y.CREATE.L   DEM1X_OFFLINE_SPARE_READ_REG0                               0x90000CD8
 Y.CREATE.L   HWIO_DEM1X_OFFLINE_SPARE_READ_REG1_ADDR                     0x90000CDC
 Y.CREATE.L   DEM1X_OFFLINE_SPARE_READ_REG1                               0x90000CDC
 Y.CREATE.L   HWIO_DEM1X_FFE_CONFIG_SPARE_READ_REG0_ADDR                  0x90000CE0
 Y.CREATE.L   DEM1X_FFE_CONFIG_SPARE_READ_REG0                            0x90000CE0
 Y.CREATE.L   HWIO_DEM1X_FFE_RESULTS_SPARE_READ_REG0_ADDR                 0x90000CE4
 Y.CREATE.L   DEM1X_FFE_RESULTS_SPARE_READ_REG0                           0x90000CE4
 Y.CREATE.L   HWIO_DEM1X_FFE_ENGINE_SPARE_READ_REG0_ADDR                  0x90000CE8
 Y.CREATE.L   DEM1X_FFE_ENGINE_SPARE_READ_REG0                            0x90000CE8
 Y.CREATE.L   HWIO_DEM1X_FFE_ENGINE_SPARE_READ_REG1_ADDR                  0x90000CEC
 Y.CREATE.L   DEM1X_FFE_ENGINE_SPARE_READ_REG1                            0x90000CEC
 Y.CREATE.L   HWIO_TD_RESET_ADDR                                          0x90001100
 Y.CREATE.L   TD_RESET                                                    0x90001100
 Y.CREATE.L   HWIO_TD_ENERGY_METRIC_ADDR                                  0x90001104
 Y.CREATE.L   TD_ENERGY_METRIC                                            0x90001104
 Y.CREATE.L   HWIO_TD_STATUS_ADDR                                         0x90001108
 Y.CREATE.L   TD_STATUS                                                   0x90001108
 Y.CREATE.L   HWIO_TD_TEST_MEM_SEL_ADDR                                   0x9000110C
 Y.CREATE.L   TD_TEST_MEM_SEL                                             0x9000110C
 Y.CREATE.L   HWIO_TD_TEST_MEM_ADDR_ADDR                                  0x90001110
 Y.CREATE.L   TD_TEST_MEM_ADDR                                            0x90001110
 Y.CREATE.L   HWIO_TD_TEST_MEM_WRITE_ADDR                                 0x90001114
 Y.CREATE.L   TD_TEST_MEM_WRITE                                           0x90001114
 Y.CREATE.L   HWIO_TD_TEST_MEM_READ0_ADDR                                 0x9000111C
 Y.CREATE.L   TD_TEST_MEM_READ0                                           0x9000111C
 Y.CREATE.L   HWIO_TD_TEST_MEM_READ1_ADDR                                 0x90001120
 Y.CREATE.L   TD_TEST_MEM_READ1                                           0x90001120
 Y.CREATE.L   HWIO_TD_TEST_MEM_READ2_ADDR                                 0x90001124
 Y.CREATE.L   TD_TEST_MEM_READ2                                           0x90001124
 Y.CREATE.L   HWIO_TD_TEST_MEM_DIN_ADDR                                   0x90001128
 Y.CREATE.L   TD_TEST_MEM_DIN                                             0x90001128
 Y.CREATE.L   HWIO_HDR_DDI_CTL_ADDR                                       0x9000112C
 Y.CREATE.L   HDR_DDI_CTL                                                 0x9000112C
 Y.CREATE.L   HWIO_HDR_DDI_HOST_ADDR                                      0x90001130
 Y.CREATE.L   HDR_DDI_HOST                                                0x90001130
 Y.CREATE.L   HWIO_TD_HW_CLK_CTL_ADDR                                     0x90001134
 Y.CREATE.L   TD_HW_CLK_CTL                                               0x90001134
 Y.CREATE.L   HWIO_TD_MICRO_CLK_CTL_ADDR                                  0x90001138
 Y.CREATE.L   TD_MICRO_CLK_CTL                                            0x90001138
 Y.CREATE.L   HWIO_TD_CLK_STATUS_ADDR                                     0x9000113C
 Y.CREATE.L   TD_CLK_STATUS                                               0x9000113C
 Y.CREATE.L   HWIO_TD_MISC_CTL_ADDR                                       0x90001140
 Y.CREATE.L   TD_MISC_CTL                                                 0x90001140
 Y.CREATE.L   HWIO_TD_ONE_FIFTH_TAIL_PATTERN_ADDR                         0x90001144
 Y.CREATE.L   TD_ONE_FIFTH_TAIL_PATTERN                                   0x90001144
 Y.CREATE.L   HWIO_TD_TAIL_CFG_ADDR                                       0x90001148
 Y.CREATE.L   TD_TAIL_CFG                                                 0x90001148
 Y.CREATE.L   HWIO_TD_MODE_CTL_ADDR                                       0x9000114C
 Y.CREATE.L   TD_MODE_CTL                                                 0x9000114C
 Y.CREATE.L   HWIO_VD_RESET_ADDR                                          0x90001200
 Y.CREATE.L   VD_RESET                                                    0x90001200
 Y.CREATE.L   HWIO_VD_MODE_ADDR                                           0x90001204
 Y.CREATE.L   VD_MODE                                                     0x90001204
 Y.CREATE.L   HWIO_VD_POLY2IJ_ADDR                                        0x90001208
 Y.CREATE.L   VD_POLY2IJ                                                  0x90001208
 Y.CREATE.L   HWIO_VD_POLY3IJ_ADDR                                        0x9000120C
 Y.CREATE.L   VD_POLY3IJ                                                  0x9000120C
 Y.CREATE.L   HWIO_VD_POLY3K_ADDR                                         0x90001210
 Y.CREATE.L   VD_POLY3K                                                   0x90001210
 Y.CREATE.L   HWIO_VD_POLY4IJ_ADDR                                        0x90001214
 Y.CREATE.L   VD_POLY4IJ                                                  0x90001214
 Y.CREATE.L   HWIO_VD_POLY4KL_ADDR                                        0x90001218
 Y.CREATE.L   VD_POLY4KL                                                  0x90001218
 Y.CREATE.L   HWIO_VD_TESTCON_ADDR                                        0x9000121C
 Y.CREATE.L   VD_TESTCON                                                  0x9000121C
 Y.CREATE.L   HWIO_VD_TESTOUT_ADDR                                        0x90001220
 Y.CREATE.L   VD_TESTOUT                                                  0x90001220
 Y.CREATE.L   HWIO_VD_TEST_MEM_SEL_ADDR                                   0x90001224
 Y.CREATE.L   VD_TEST_MEM_SEL                                             0x90001224
 Y.CREATE.L   HWIO_VD_TEST_MEM_ADDR_ADDR                                  0x90001228
 Y.CREATE.L   VD_TEST_MEM_ADDR                                            0x90001228
 Y.CREATE.L   HWIO_VD_TEST_MEM_WRITE_ADDR                                 0x9000122C
 Y.CREATE.L   VD_TEST_MEM_WRITE                                           0x9000122C
 Y.CREATE.L   HWIO_VD_TEST_MEM_READ0_ADDR                                 0x90001230
 Y.CREATE.L   VD_TEST_MEM_READ0                                           0x90001230
 Y.CREATE.L   HWIO_VD_TEST_MEM_READ1_ADDR                                 0x90001234
 Y.CREATE.L   VD_TEST_MEM_READ1                                           0x90001234
 Y.CREATE.L   HWIO_VD_TEST_MEM_DIN_ADDR                                   0x90001238
 Y.CREATE.L   VD_TEST_MEM_DIN                                             0x90001238
 Y.CREATE.L   HWIO_VD_HW_CLK_CTL_ADDR                                     0x9000123C
 Y.CREATE.L   VD_HW_CLK_CTL                                               0x9000123C
 Y.CREATE.L   HWIO_VD_MICRO_CLK_CTL_ADDR                                  0x90001240
 Y.CREATE.L   VD_MICRO_CLK_CTL                                            0x90001240
 Y.CREATE.L   HWIO_VD_CLK_STATUS_ADDR                                     0x90001244
 Y.CREATE.L   VD_CLK_STATUS                                               0x90001244
 Y.CREATE.L   HWIO_VD_SPARE_READ_REG0_ADDR                                0x90001248
 Y.CREATE.L   VD_SPARE_READ_REG0                                          0x90001248
 Y.CREATE.L   HWIO_DECOB_RESET_ADDR                                       0x90001300
 Y.CREATE.L   DECOB_RESET                                                 0x90001300
 Y.CREATE.L   HWIO_DECOB_BURST_IF_ACCESS_ADDR                             0x90001304
 Y.CREATE.L   DECOB_BURST_IF_ACCESS                                       0x90001304
 Y.CREATE.L   HWIO_DECOB_LONG_BUFFER_ADDR_ADDR                            0x90001308
 Y.CREATE.L   DECOB_LONG_BUFFER_ADDR                                      0x90001308
 Y.CREATE.L   HWIO_DECOB_LONG_BUFFER_DATA_ADDR                            0x9000130C
 Y.CREATE.L   DECOB_LONG_BUFFER_DATA                                      0x9000130C
 Y.CREATE.L   HWIO_DECOB_SHORT_BUFFER_ADDR_ADDR                           0x90001310
 Y.CREATE.L   DECOB_SHORT_BUFFER_ADDR                                     0x90001310
 Y.CREATE.L   HWIO_DECOB_SHORT_BUFFER_DATA_ADDR                           0x90001314
 Y.CREATE.L   DECOB_SHORT_BUFFER_DATA                                     0x90001314
 Y.CREATE.L   HWIO_DECOB_LONG_BUFFER_HUNT_CHAR_ADDR                       0x90001320
 Y.CREATE.L   DECOB_LONG_BUFFER_HUNT_CHAR                                 0x90001320
 Y.CREATE.L   HWIO_DECOB_LONG_BUFFER_DEBUG_WR_ADDR_ADDR                   0x90001330
 Y.CREATE.L   DECOB_LONG_BUFFER_DEBUG_WR_ADDR                             0x90001330
 Y.CREATE.L   HWIO_DECOB_LONG_BUFFER_DEBUG_RD_ADDR_ADDR                   0x90001334
 Y.CREATE.L   DECOB_LONG_BUFFER_DEBUG_RD_ADDR                             0x90001334
 Y.CREATE.L   HWIO_DECOB_PDCCH_0_DATA_RD0_ADDR                            0x90001340
 Y.CREATE.L   DECOB_PDCCH_0_DATA_RD0                                      0x90001340
 Y.CREATE.L   HWIO_DECOB_PDCCH_0_DATA_RD1_ADDR                            0x90001344
 Y.CREATE.L   DECOB_PDCCH_0_DATA_RD1                                      0x90001344
 Y.CREATE.L   HWIO_DECOB_PDCCH_0_DATA_RD2_ADDR                            0x90001348
 Y.CREATE.L   DECOB_PDCCH_0_DATA_RD2                                      0x90001348
 Y.CREATE.L   HWIO_DECOB_PDCCH_1_DATA_RD0_ADDR                            0x9000134C
 Y.CREATE.L   DECOB_PDCCH_1_DATA_RD0                                      0x9000134C
 Y.CREATE.L   HWIO_DECOB_PDCCH_1_DATA_RD1_ADDR                            0x90001350
 Y.CREATE.L   DECOB_PDCCH_1_DATA_RD1                                      0x90001350
 Y.CREATE.L   HWIO_DECOB_PDCCH_1_DATA_RD2_ADDR                            0x90001354
 Y.CREATE.L   DECOB_PDCCH_1_DATA_RD2                                      0x90001354
 Y.CREATE.L   HWIO_DECOB_PDCCH_0_STATUS_RD0_ADDR                          0x90001358
 Y.CREATE.L   DECOB_PDCCH_0_STATUS_RD0                                    0x90001358
 Y.CREATE.L   HWIO_DECOB_PDCCH_0_STATUS_RD1_ADDR                          0x9000135C
 Y.CREATE.L   DECOB_PDCCH_0_STATUS_RD1                                    0x9000135C
 Y.CREATE.L   HWIO_DECOB_PDCCH_0_STATUS_RD2_ADDR                          0x90001360
 Y.CREATE.L   DECOB_PDCCH_0_STATUS_RD2                                    0x90001360
 Y.CREATE.L   HWIO_DECOB_PDCCH_1_STATUS_RD0_ADDR                          0x90001364
 Y.CREATE.L   DECOB_PDCCH_1_STATUS_RD0                                    0x90001364
 Y.CREATE.L   HWIO_DECOB_PDCCH_1_STATUS_RD1_ADDR                          0x90001368
 Y.CREATE.L   DECOB_PDCCH_1_STATUS_RD1                                    0x90001368
 Y.CREATE.L   HWIO_DECOB_PDCCH_1_STATUS_RD2_ADDR                          0x9000136C
 Y.CREATE.L   DECOB_PDCCH_1_STATUS_RD2                                    0x9000136C
 Y.CREATE.L   HWIO_DECOB_GCH_0_DATA_RD_ADDR                               0x90001370
 Y.CREATE.L   DECOB_GCH_0_DATA_RD                                         0x90001370
 Y.CREATE.L   HWIO_DECOB_GCH_1_DATA_RD_ADDR                               0x90001374
 Y.CREATE.L   DECOB_GCH_1_DATA_RD                                         0x90001374
 Y.CREATE.L   HWIO_DECOB_GCH_0_STATUS_RD_ADDR                             0x90001378
 Y.CREATE.L   DECOB_GCH_0_STATUS_RD                                       0x90001378
 Y.CREATE.L   HWIO_DECOB_GCH_1_STATUS_RD_ADDR                             0x9000137C
 Y.CREATE.L   DECOB_GCH_1_STATUS_RD                                       0x9000137C
 Y.CREATE.L   HWIO_DECOB_TEST_CTL_ADDR                                    0x90001380
 Y.CREATE.L   DECOB_TEST_CTL                                              0x90001380
 Y.CREATE.L   HWIO_DECOB_HW_CLK_CTL_ADDR                                  0x90001384
 Y.CREATE.L   DECOB_HW_CLK_CTL                                            0x90001384
 Y.CREATE.L   HWIO_DECOB_MICRO_CLK_CTL_ADDR                               0x90001388
 Y.CREATE.L   DECOB_MICRO_CLK_CTL                                         0x90001388
 Y.CREATE.L   HWIO_DECOB_CLK_STATUS_ADDR                                  0x9000138C
 Y.CREATE.L   DECOB_CLK_STATUS                                            0x9000138C
 Y.CREATE.L   HWIO_DECOB_CLK_SPARE_READ_REG0_ADDR                         0x90001390
 Y.CREATE.L   DECOB_CLK_SPARE_READ_REG0                                   0x90001390
 Y.CREATE.L   HWIO_MOD_MODE_ADDR                                          0x90001400
 Y.CREATE.L   MOD_MODE                                                    0x90001400
 Y.CREATE.L   HWIO_MOD_RESET_ADDR                                         0x90001404
 Y.CREATE.L   MOD_RESET                                                   0x90001404
 Y.CREATE.L   HWIO_I_PN_STATE_0_ADDR                                      0x90001408
 Y.CREATE.L   I_PN_STATE_0                                                0x90001408
 Y.CREATE.L   HWIO_I_PN_STATE_1_ADDR                                      0x9000140C
 Y.CREATE.L   I_PN_STATE_1                                                0x9000140C
 Y.CREATE.L   HWIO_Q_PN_STATE_0_ADDR                                      0x90001410
 Y.CREATE.L   Q_PN_STATE_0                                                0x90001410
 Y.CREATE.L   HWIO_Q_PN_STATE_1_ADDR                                      0x90001414
 Y.CREATE.L   Q_PN_STATE_1                                                0x90001414
 Y.CREATE.L   HWIO_U_PN_STATE_0_ADDR                                      0x90001418
 Y.CREATE.L   U_PN_STATE_0                                                0x90001418
 Y.CREATE.L   HWIO_U_PN_STATE_1_ADDR                                      0x9000141C
 Y.CREATE.L   U_PN_STATE_1                                                0x9000141C
 Y.CREATE.L   HWIO_U_PN_STATE_2_ADDR                                      0x90001420
 Y.CREATE.L   U_PN_STATE_2                                                0x90001420
 Y.CREATE.L   HWIO_U_PN_STATE_3_ADDR                                      0x90001424
 Y.CREATE.L   U_PN_STATE_3                                                0x90001424
 Y.CREATE.L   HWIO_U_PN_STATE_4_ADDR                                      0x90001428
 Y.CREATE.L   U_PN_STATE_4                                                0x90001428
 Y.CREATE.L   HWIO_U_PN_STATE_5_ADDR                                      0x9000142C
 Y.CREATE.L   U_PN_STATE_5                                                0x9000142C
 Y.CREATE.L   HWIO_U_PN_MASK_0_ADDR                                       0x90001430
 Y.CREATE.L   U_PN_MASK_0                                                 0x90001430
 Y.CREATE.L   HWIO_U_PN_MASK_1_ADDR                                       0x90001434
 Y.CREATE.L   U_PN_MASK_1                                                 0x90001434
 Y.CREATE.L   HWIO_U_PN_MASK_2_ADDR                                       0x90001438
 Y.CREATE.L   U_PN_MASK_2                                                 0x90001438
 Y.CREATE.L   HWIO_U_PN_MASK_3_ADDR                                       0x9000143C
 Y.CREATE.L   U_PN_MASK_3                                                 0x9000143C
 Y.CREATE.L   HWIO_U_PN_MASK_4_ADDR                                       0x90001440
 Y.CREATE.L   U_PN_MASK_4                                                 0x90001440
 Y.CREATE.L   HWIO_U_PN_MASK_5_ADDR                                       0x90001444
 Y.CREATE.L   U_PN_MASK_5                                                 0x90001444
 Y.CREATE.L   HWIO_FRAME_OFF_ADDR                                         0x90001448
 Y.CREATE.L   FRAME_OFF                                                   0x90001448
 Y.CREATE.L   HWIO_MOD_STMR_MODIFIER_0_ADDR                               0x9000144C
 Y.CREATE.L   MOD_STMR_MODIFIER_0                                         0x9000144C
 Y.CREATE.L   HWIO_MOD_STMR_MODIFIER_1_ADDR                               0x90001450
 Y.CREATE.L   MOD_STMR_MODIFIER_1                                         0x90001450
 Y.CREATE.L   HWIO_MOD_STMR_CMD_ADDR                                      0x90001454
 Y.CREATE.L   MOD_STMR_CMD                                                0x90001454
 Y.CREATE.L   HWIO_TX_PCG_INT_ENABLE_ADDR                                 0x90001458
 Y.CREATE.L   TX_PCG_INT_ENABLE                                           0x90001458
 Y.CREATE.L   HWIO_TX_PCG_INT_CLEAR_ADDR                                  0x9000145C
 Y.CREATE.L   TX_PCG_INT_CLEAR                                            0x9000145C
 Y.CREATE.L   HWIO_TX_PCG_INT_STATUS_ADDR                                 0x90001460
 Y.CREATE.L   TX_PCG_INT_STATUS                                           0x90001460
 Y.CREATE.L   HWIO_MOD_TX_TIME_LATCH_ADDR                                 0x900014E8
 Y.CREATE.L   MOD_TX_TIME_LATCH                                           0x900014E8
 Y.CREATE.L   HWIO_MOD_TX_TIME_RD_ADDR                                    0x900014EC
 Y.CREATE.L   MOD_TX_TIME_RD                                              0x900014EC
 Y.CREATE.L   HWIO_MOD_CH1_TIMING_CTL_ADDR                                0x90001464
 Y.CREATE.L   MOD_CH1_TIMING_CTL                                          0x90001464
 Y.CREATE.L   HWIO_MOD_CH2_TIMING_CTL_ADDR                                0x90001468
 Y.CREATE.L   MOD_CH2_TIMING_CTL                                          0x90001468
 Y.CREATE.L   HWIO_MOD_CH3_TIMING_CTL_ADDR                                0x9000146C
 Y.CREATE.L   MOD_CH3_TIMING_CTL                                          0x9000146C
 Y.CREATE.L   HWIO_MOD_WCOVER_SEL_ADDR                                    0x90001470
 Y.CREATE.L   MOD_WCOVER_SEL                                              0x90001470
 Y.CREATE.L   HWIO_MOD_CH1_ENC_CTL_ADDR                                   0x90001474
 Y.CREATE.L   MOD_CH1_ENC_CTL                                             0x90001474
 Y.CREATE.L   HWIO_MOD_CH1_CRC_POLY_ADDR                                  0x90001478
 Y.CREATE.L   MOD_CH1_CRC_POLY                                            0x90001478
 Y.CREATE.L   HWIO_MOD_CH1_PUNCT_PATN_1_ADDR                              0x9000147C
 Y.CREATE.L   MOD_CH1_PUNCT_PATN_1                                        0x9000147C
 Y.CREATE.L   HWIO_MOD_CH1_PUNCT_PATN_0_ADDR                              0x90001480
 Y.CREATE.L   MOD_CH1_PUNCT_PATN_0                                        0x90001480
 Y.CREATE.L   HWIO_MOD_CH2_ENC_CTL_0_ADDR                                 0x90001484
 Y.CREATE.L   MOD_CH2_ENC_CTL_0                                           0x90001484
 Y.CREATE.L   HWIO_MOD_CH2_ENC_CTL_1_ADDR                                 0x90001488
 Y.CREATE.L   MOD_CH2_ENC_CTL_1                                           0x90001488
 Y.CREATE.L   HWIO_MOD_CH2_CRC_POLY_ADDR                                  0x9000148C
 Y.CREATE.L   MOD_CH2_CRC_POLY                                            0x9000148C
 Y.CREATE.L   HWIO_MOD_CH2_PUNCT_PATN_1_ADDR                              0x90001490
 Y.CREATE.L   MOD_CH2_PUNCT_PATN_1                                        0x90001490
 Y.CREATE.L   HWIO_MOD_CH2_PUNCT_PATN_0_ADDR                              0x90001494
 Y.CREATE.L   MOD_CH2_PUNCT_PATN_0                                        0x90001494
 Y.CREATE.L   HWIO_MOD_CH3_ENC_CTL_0_ADDR                                 0x90001498
 Y.CREATE.L   MOD_CH3_ENC_CTL_0                                           0x90001498
 Y.CREATE.L   HWIO_MOD_CH3_ENC_CTL_1_ADDR                                 0x9000149C
 Y.CREATE.L   MOD_CH3_ENC_CTL_1                                           0x9000149C
 Y.CREATE.L   HWIO_MOD_CH3_CRC_POLY_ADDR                                  0x900014A0
 Y.CREATE.L   MOD_CH3_CRC_POLY                                            0x900014A0
 Y.CREATE.L   HWIO_MOD_CH3_PUNCT_PATN_1_ADDR                              0x900014A4
 Y.CREATE.L   MOD_CH3_PUNCT_PATN_1                                        0x900014A4
 Y.CREATE.L   HWIO_MOD_CH3_PUNCT_PATN_0_ADDR                              0x900014A8
 Y.CREATE.L   MOD_CH3_PUNCT_PATN_0                                        0x900014A8
 Y.CREATE.L   HWIO_MOD_SCH_LTU_CTL_ADDR                                   0x900014AC
 Y.CREATE.L   MOD_SCH_LTU_CTL                                             0x900014AC
 Y.CREATE.L   HWIO_MOD_MISC_CTL_ADDR                                      0x900014B0
 Y.CREATE.L   MOD_MISC_CTL                                                0x900014B0
 Y.CREATE.L   HWIO_MOD_ROTATOR_MAP_ADDR                                   0x900014B4
 Y.CREATE.L   MOD_ROTATOR_MAP                                             0x900014B4
 Y.CREATE.L   HWIO_MOD_WSYM_STATE_ADDR                                    0x900014B8
 Y.CREATE.L   MOD_WSYM_STATE                                              0x900014B8
 Y.CREATE.L   HWIO_TX_VERY_EARLY_FRAME_CTL_ADDR                           0x900014BC
 Y.CREATE.L   TX_VERY_EARLY_FRAME_CTL                                     0x900014BC
 Y.CREATE.L   HWIO_TX_2_EARLY_PCG_CTL_ADDR                                0x900014C0
 Y.CREATE.L   TX_2_EARLY_PCG_CTL                                          0x900014C0
 Y.CREATE.L   HWIO_MOD_PICH_PCBIT_DATA_ADDR                               0x900014C4
 Y.CREATE.L   MOD_PICH_PCBIT_DATA                                         0x900014C4
 Y.CREATE.L   HWIO_MOD_PICH_PCBIT_MASK_ADDR                               0x900014C8
 Y.CREATE.L   MOD_PICH_PCBIT_MASK                                         0x900014C8
 Y.CREATE.L   HWIO_MOD_STATUS_ADDR                                        0x900014CC
 Y.CREATE.L   MOD_STATUS                                                  0x900014CC
 Y.CREATE.L   HWIO_MASK_DATA_ADDR                                         0x900014D0
 Y.CREATE.L   MASK_DATA                                                   0x900014D0
 Y.CREATE.L   HWIO_PA_PUNCT_FRAME_DIS_ADDR                                0x900014D4
 Y.CREATE.L   PA_PUNCT_FRAME_DIS                                          0x900014D4
 Y.CREATE.L   HWIO_PA_WARMUP_ADDR                                         0x900014D8
 Y.CREATE.L   PA_WARMUP                                                   0x900014D8
 Y.CREATE.L   HWIO_TX_WARMUP_ADDR                                         0x900014DC
 Y.CREATE.L   TX_WARMUP                                                   0x900014DC
 Y.CREATE.L   HWIO_MOD_TEST_CTL_ADDR                                      0x900014F0
 Y.CREATE.L   MOD_TEST_CTL                                                0x900014F0
 Y.CREATE.L   HWIO_TX_I_CLK_ADDR                                          0x900014F4
 Y.CREATE.L   TX_I_CLK                                                    0x900014F4
 Y.CREATE.L   HWIO_MOD_CLK_CTL_ADDR                                       0x900014F8
 Y.CREATE.L   MOD_CLK_CTL                                                 0x900014F8
 Y.CREATE.L   HWIO_TX_DATA_TEST_ADDR                                      0x900014FC
 Y.CREATE.L   TX_DATA_TEST                                                0x900014FC
 Y.CREATE.L   HWIO_TX_Q_DATA_TEST_ADDR                                    0x90001500
 Y.CREATE.L   TX_Q_DATA_TEST                                              0x90001500
 Y.CREATE.L   HWIO_MOD_TEST_POINT_SEL_ADDR                                0x90001504
 Y.CREATE.L   MOD_TEST_POINT_SEL                                          0x90001504
 Y.CREATE.L   HWIO_MOD_TEST_POINT_DIN_ADDR                                0x90001508
 Y.CREATE.L   MOD_TEST_POINT_DIN                                          0x90001508
 Y.CREATE.L   HWIO_MOD_TEST_MISR_RESET_ADDR                               0x9000150C
 Y.CREATE.L   MOD_TEST_MISR_RESET                                         0x9000150C
 Y.CREATE.L   HWIO_MOD_TEST_MODE_ADDR                                     0x90001510
 Y.CREATE.L   MOD_TEST_MODE                                               0x90001510
 Y.CREATE.L   HWIO_MOD_TEST_EXPORT_MISR_ADDR                              0x90001514
 Y.CREATE.L   MOD_TEST_EXPORT_MISR                                        0x90001514
 Y.CREATE.L   HWIO_MOD_TEST_MISR_EN_ADDR                                  0x90001518
 Y.CREATE.L   MOD_TEST_MISR_EN                                            0x90001518
 Y.CREATE.L   HWIO_MOD_TEST_MISR_CTL_ADDR                                 0x9000151C
 Y.CREATE.L   MOD_TEST_MISR_CTL                                           0x9000151C
 Y.CREATE.L   HWIO_MOD_TEST_MISR_DLY_ADDR                                 0x90001520
 Y.CREATE.L   MOD_TEST_MISR_DLY                                           0x90001520
 Y.CREATE.L   HWIO_MOD_TEST_CURR_MISR_VAL_ADDR                            0x90001524
 Y.CREATE.L   MOD_TEST_CURR_MISR_VAL                                      0x90001524
 Y.CREATE.L   HWIO_MOD_PDCH_TIMING_CTL_ADDR                               0x90001550
 Y.CREATE.L   MOD_PDCH_TIMING_CTL                                         0x90001550
 Y.CREATE.L   HWIO_MOD_PDCH_CTL_ADDR                                      0x90001554
 Y.CREATE.L   MOD_PDCH_CTL                                                0x90001554
 Y.CREATE.L   HWIO_MOD_PDCCH_CTL_ADDR                                     0x90001570
 Y.CREATE.L   MOD_PDCCH_CTL                                               0x90001570
 Y.CREATE.L   HWIO_MOD_SPICH_CTL_ADDR                                     0x90001574
 Y.CREATE.L   MOD_SPICH_CTL                                               0x90001574
 Y.CREATE.L   HWIO_MOD_VAR_GAIN_SHIFT_DLY_ADDR                            0x90001578
 Y.CREATE.L   MOD_VAR_GAIN_SHIFT_DLY                                      0x90001578
 Y.CREATE.L   HWIO_REVMOD_PN_LONG_STATE_0_ADDR                            0x90001580
 Y.CREATE.L   REVMOD_PN_LONG_STATE_0                                      0x90001580
 Y.CREATE.L   HWIO_REVMOD_PN_LONG_STATE_1_ADDR                            0x90001584
 Y.CREATE.L   REVMOD_PN_LONG_STATE_1                                      0x90001584
 Y.CREATE.L   HWIO_REVMOD_PN_LONG_STATE_2_ADDR                            0x90001588
 Y.CREATE.L   REVMOD_PN_LONG_STATE_2                                      0x90001588
 Y.CREATE.L   HWIO_REVMOD_PN_I_LONG_MASK_0_ADDR                           0x9000158C
 Y.CREATE.L   REVMOD_PN_I_LONG_MASK_0                                     0x9000158C
 Y.CREATE.L   HWIO_REVMOD_PN_I_LONG_MASK_1_ADDR                           0x90001590
 Y.CREATE.L   REVMOD_PN_I_LONG_MASK_1                                     0x90001590
 Y.CREATE.L   HWIO_REVMOD_PN_I_LONG_MASK_2_ADDR                           0x90001594
 Y.CREATE.L   REVMOD_PN_I_LONG_MASK_2                                     0x90001594
 Y.CREATE.L   HWIO_REVMOD_PN_Q_LONG_MASK_0_ADDR                           0x90001598
 Y.CREATE.L   REVMOD_PN_Q_LONG_MASK_0                                     0x90001598
 Y.CREATE.L   HWIO_REVMOD_PN_Q_LONG_MASK_1_ADDR                           0x9000159C
 Y.CREATE.L   REVMOD_PN_Q_LONG_MASK_1                                     0x9000159C
 Y.CREATE.L   HWIO_REVMOD_PN_Q_LONG_MASK_2_ADDR                           0x900015A0
 Y.CREATE.L   REVMOD_PN_Q_LONG_MASK_2                                     0x900015A0
 Y.CREATE.L   HWIO_REVMOD_PN_CTL_ADDR                                     0x900015A4
 Y.CREATE.L   REVMOD_PN_CTL                                               0x900015A4
 Y.CREATE.L   HWIO_REVMOD_FRAME_OFFSET_ADDR                               0x900015A8
 Y.CREATE.L   REVMOD_FRAME_OFFSET                                         0x900015A8
 Y.CREATE.L   HWIO_REVMOD_TIME_STAMP_CTL_ADDR                             0x900015AC
 Y.CREATE.L   REVMOD_TIME_STAMP_CTL                                       0x900015AC
 Y.CREATE.L   HWIO_REVMOD_TIME_STAMP_ADDR                                 0x900015B0
 Y.CREATE.L   REVMOD_TIME_STAMP                                           0x900015B0
 Y.CREATE.L   HWIO_REVMOD_TIME_STAMP2_ADDR                                0x900015B4
 Y.CREATE.L   REVMOD_TIME_STAMP2                                          0x900015B4
 Y.CREATE.L   HWIO_REVMOD_FRM_CNT_OFFSET_ADDR                             0x900015B8
 Y.CREATE.L   REVMOD_FRM_CNT_OFFSET                                       0x900015B8
 Y.CREATE.L   HWIO_REVMOD_FRM_CNT_OFFSET_CTL_ADDR                         0x900015BC
 Y.CREATE.L   REVMOD_FRM_CNT_OFFSET_CTL                                   0x900015BC
 Y.CREATE.L   HWIO_REVMOD_TX_TIME_LATCH_ADDR                              0x900015C0
 Y.CREATE.L   REVMOD_TX_TIME_LATCH                                        0x900015C0
 Y.CREATE.L   HWIO_REVMOD_TX_TIME_RD_ADDR                                 0x900015C4
 Y.CREATE.L   REVMOD_TX_TIME_RD                                           0x900015C4
 Y.CREATE.L   HWIO_REVMOD_FRAME_INT_OFFSET_ADDR                           0x900015C8
 Y.CREATE.L   REVMOD_FRAME_INT_OFFSET                                     0x900015C8
 Y.CREATE.L   HWIO_REVMOD_ENC_RATE_ADDR                                   0x900015CC
 Y.CREATE.L   REVMOD_ENC_RATE                                             0x900015CC
 Y.CREATE.L   HWIO_REVMOD_EDI_CONTROL_ADDR                                0x900015D0
 Y.CREATE.L   REVMOD_EDI_CONTROL                                          0x900015D0
 Y.CREATE.L   HWIO_REVMOD_TENC_CTL_ADDR                                   0x900015D4
 Y.CREATE.L   REVMOD_TENC_CTL                                             0x900015D4
 Y.CREATE.L   HWIO_REVMOD_TENC_STATUS_ADDR                                0x900015D8
 Y.CREATE.L   REVMOD_TENC_STATUS                                          0x900015D8
 Y.CREATE.L   HWIO_REVMOD_INBUF_STATUS_ADDR                               0x900015DC
 Y.CREATE.L   REVMOD_INBUF_STATUS                                         0x900015DC
 Y.CREATE.L   HWIO_REVMOD_OUTBUF_STATUS_ADDR                              0x900015E0
 Y.CREATE.L   REVMOD_OUTBUF_STATUS                                        0x900015E0
 Y.CREATE.L   HWIO_REVMOD_RRI_REQUEST_ADDR                                0x900015E4
 Y.CREATE.L   REVMOD_RRI_REQUEST                                          0x900015E4
 Y.CREATE.L   HWIO_REVMOD_MOD_CTL_ADDR                                    0x900015E8
 Y.CREATE.L   REVMOD_MOD_CTL                                              0x900015E8
 Y.CREATE.L   HWIO_REVMOD_ENC_MODE_ADDR                                   0x900015EC
 Y.CREATE.L   REVMOD_ENC_MODE                                             0x900015EC
 Y.CREATE.L   HWIO_REVMOD_PA_CTL_ADDR                                     0x900015F0
 Y.CREATE.L   REVMOD_PA_CTL                                               0x900015F0
 Y.CREATE.L   HWIO_REVMOD_PA_WARMUP_ADDR                                  0x900015F4
 Y.CREATE.L   REVMOD_PA_WARMUP                                            0x900015F4
 Y.CREATE.L   HWIO_REVMOD_TX_WARMUP_ADDR                                  0x900015F8
 Y.CREATE.L   REVMOD_TX_WARMUP                                            0x900015F8
 Y.CREATE.L   HWIO_TX_AGC_CTL_ADDR                                        0x90001620
 Y.CREATE.L   TX_AGC_CTL                                                  0x90001620
 Y.CREATE.L   HWIO_TX_AGC_CTL2_ADDR                                       0x90001624
 Y.CREATE.L   TX_AGC_CTL2                                                 0x90001624
 Y.CREATE.L   HWIO_TX_AGC_RESET_ADDR                                      0x90001628
 Y.CREATE.L   TX_AGC_RESET                                                0x90001628
 Y.CREATE.L   HWIO_AGC_TEST_CTL_ADDR                                      0x9000162C
 Y.CREATE.L   AGC_TEST_CTL                                                0x9000162C
 Y.CREATE.L   HWIO_AGC_TX_MASK_DATA_SEL_ADDR                              0x90001630
 Y.CREATE.L   AGC_TX_MASK_DATA_SEL                                        0x90001630
 Y.CREATE.L   HWIO_AGC_TX_RCCCH_FRAME_DELAY_ADDR                          0x90001634
 Y.CREATE.L   AGC_TX_RCCCH_FRAME_DELAY                                    0x90001634
 Y.CREATE.L   HWIO_PA_R_MAP_ADDR                                          0x90001638
 Y.CREATE.L   PA_R_MAP                                                    0x90001638
 Y.CREATE.L   HWIO_PA_R_TIMER_ADDR                                        0x9000163C
 Y.CREATE.L   PA_R_TIMER                                                  0x9000163C
 Y.CREATE.L   HWIO_PA_R1_FALL_ADDR                                        0x90001640
 Y.CREATE.L   PA_R1_FALL                                                  0x90001640
 Y.CREATE.L   HWIO_PA_R1_RISE_ADDR                                        0x90001644
 Y.CREATE.L   PA_R1_RISE                                                  0x90001644
 Y.CREATE.L   HWIO_PA_R2_FALL_ADDR                                        0x90001648
 Y.CREATE.L   PA_R2_FALL                                                  0x90001648
 Y.CREATE.L   HWIO_PA_R2_RISE_ADDR                                        0x9000164C
 Y.CREATE.L   PA_R2_RISE                                                  0x9000164C
 Y.CREATE.L   HWIO_PA_R3_FALL_ADDR                                        0x90001650
 Y.CREATE.L   PA_R3_FALL                                                  0x90001650
 Y.CREATE.L   HWIO_PA_R3_RISE_ADDR                                        0x90001654
 Y.CREATE.L   PA_R3_RISE                                                  0x90001654
 Y.CREATE.L   HWIO_PA_S0_OFFSET_ADDR                                      0x90001658
 Y.CREATE.L   PA_S0_OFFSET                                                0x90001658
 Y.CREATE.L   HWIO_PA_S1_OFFSET_ADDR                                      0x9000165C
 Y.CREATE.L   PA_S1_OFFSET                                                0x9000165C
 Y.CREATE.L   HWIO_PA_S2_OFFSET_ADDR                                      0x90001660
 Y.CREATE.L   PA_S2_OFFSET                                                0x90001660
 Y.CREATE.L   HWIO_PA_S3_OFFSET_ADDR                                      0x90001664
 Y.CREATE.L   PA_S3_OFFSET                                                0x90001664
 Y.CREATE.L   HWIO_PA_WARMUP_TIMER_ADDR                                   0x90001668
 Y.CREATE.L   PA_WARMUP_TIMER                                             0x90001668
 Y.CREATE.L   HWIO_RAS_RAM_WR_ADDR_RESET_ADDR                             0x9000166C
 Y.CREATE.L   RAS_RAM_WR_ADDR_RESET                                       0x9000166C
 Y.CREATE.L   HWIO_RAS_RAM_DATA_ADDR                                      0x90001670
 Y.CREATE.L   RAS_RAM_DATA                                                0x90001670
 Y.CREATE.L   HWIO_SUBPCG_PA_WARMUP_DELAY_ADDR                            0x90001674
 Y.CREATE.L   SUBPCG_PA_WARMUP_DELAY                                      0x90001674
 Y.CREATE.L   HWIO_TX_ALIGN_DELAY_ADDR                                    0x90001678
 Y.CREATE.L   TX_ALIGN_DELAY                                              0x90001678
 Y.CREATE.L   HWIO_TX_ATTEN_LIMIT_WR_ADDR                                 0x9000167C
 Y.CREATE.L   TX_ATTEN_LIMIT_WR                                           0x9000167C
 Y.CREATE.L   HWIO_TX_GAIN_ADJ_WR_ADDR                                    0x90001680
 Y.CREATE.L   TX_GAIN_ADJ_WR                                              0x90001680
 Y.CREATE.L   HWIO_TX_GAIN_LIMIT_WR_ADDR                                  0x90001684
 Y.CREATE.L   TX_GAIN_LIMIT_WR                                            0x90001684
 Y.CREATE.L   HWIO_TX_GAIN_CTL_LATCH_ADDR                                 0x90001688
 Y.CREATE.L   TX_GAIN_CTL_LATCH                                           0x90001688
 Y.CREATE.L   HWIO_TX_OPEN_LOOP_WR_ADDR                                   0x9000168C
 Y.CREATE.L   TX_OPEN_LOOP_WR                                             0x9000168C
 Y.CREATE.L   HWIO_TX_PDM_DELAY_VAL_ADDR                                  0x90001690
 Y.CREATE.L   TX_PDM_DELAY_VAL                                            0x90001690
 Y.CREATE.L   HWIO_VERY_EARLY_FRAME_DELAY_REG_ADDR                        0x90001698
 Y.CREATE.L   VERY_EARLY_FRAME_DELAY_REG                                  0x90001698
 Y.CREATE.L   HWIO_TX_AGC_TEST_POINT_SEL_ADDR                             0x9000169C
 Y.CREATE.L   TX_AGC_TEST_POINT_SEL                                       0x9000169C
 Y.CREATE.L   HWIO_TX_AGC_TEST_POINT_DIN_ADDR                             0x900016A0
 Y.CREATE.L   TX_AGC_TEST_POINT_DIN                                       0x900016A0
 Y.CREATE.L   HWIO_TX_PA_RD_ADDR                                          0x900016A4
 Y.CREATE.L   TX_PA_RD                                                    0x900016A4
 Y.CREATE.L   HWIO_RATCHET_BIT_DIS_ADDR                                   0x900016A8
 Y.CREATE.L   RATCHET_BIT_DIS                                             0x900016A8
 Y.CREATE.L   HWIO_TX_AGC_ADJ_RD_ADDR                                     0x900016AC
 Y.CREATE.L   TX_AGC_ADJ_RD                                               0x900016AC
 Y.CREATE.L   HWIO_TX_GAIN_ADJ_RD_ADDR                                    0x900016B0
 Y.CREATE.L   TX_GAIN_ADJ_RD                                              0x900016B0
 Y.CREATE.L   HWIO_TX_GAIN_CTL_RD_ADDR                                    0x900016B4
 Y.CREATE.L   TX_GAIN_CTL_RD                                              0x900016B4
 Y.CREATE.L   HWIO_TX_OPEN_LOOP_RD_ADDR                                   0x900016B8
 Y.CREATE.L   TX_OPEN_LOOP_RD                                             0x900016B8
 Y.CREATE.L   HWIO_MOD_PA_ON_CTL_ADDR                                     0x900016C0
 Y.CREATE.L   MOD_PA_ON_CTL                                               0x900016C0
 Y.CREATE.L   HWIO_MOD_TX_AGC_ADJ_CTL_ADDR                                0x900016C8
 Y.CREATE.L   MOD_TX_AGC_ADJ_CTL                                          0x900016C8
 Y.CREATE.L   HWIO_MOD_TX_AGC_ADJ_ADDR                                    0x900016CC
 Y.CREATE.L   MOD_TX_AGC_ADJ                                              0x900016CC
 Y.CREATE.L   HWIO_MOD_TX_AGC_ODRIVE_DLY_ADDR                             0x900016D0
 Y.CREATE.L   MOD_TX_AGC_ODRIVE_DLY                                       0x900016D0
 Y.CREATE.L   HWIO_MOD_HW_CLK_CTL_ADDR                                    0x900016D4
 Y.CREATE.L   MOD_HW_CLK_CTL                                              0x900016D4
 Y.CREATE.L   HWIO_MOD_MICRO_CLK_CTL_ADDR                                 0x900016D8
 Y.CREATE.L   MOD_MICRO_CLK_CTL                                           0x900016D8
 Y.CREATE.L   HWIO_MOD_CLK_STATUS_ADDR                                    0x900016DC
 Y.CREATE.L   MOD_CLK_STATUS                                              0x900016DC
 Y.CREATE.L   HWIO_MOD_TX_SLOT_INT_STATUS_ADDR                            0x900016E0
 Y.CREATE.L   MOD_TX_SLOT_INT_STATUS                                      0x900016E0
 Y.CREATE.L   HWIO_MOD_TX_SLOT_INT_CLR_ADDR                               0x900016E4
 Y.CREATE.L   MOD_TX_SLOT_INT_CLR                                         0x900016E4
 Y.CREATE.L   HWIO_MOD_TX_SLOT_INT_EN_ADDR                                0x900016E8
 Y.CREATE.L   MOD_TX_SLOT_INT_EN                                          0x900016E8
 Y.CREATE.L   HWIO_MOD_TX_FR_INT_STATUS_ADDR                              0x900016EC
 Y.CREATE.L   MOD_TX_FR_INT_STATUS                                        0x900016EC
 Y.CREATE.L   HWIO_MOD_TX_FR_INT_CLR_ADDR                                 0x900016F0
 Y.CREATE.L   MOD_TX_FR_INT_CLR                                           0x900016F0
 Y.CREATE.L   HWIO_MOD_TX_FR_INT_EN_ADDR                                  0x900016F4
 Y.CREATE.L   MOD_TX_FR_INT_EN                                            0x900016F4
 Y.CREATE.L   HWIO_MOD_TXCX8_SPARE_READ_REG_0_ADDR                        0x90001700
 Y.CREATE.L   MOD_TXCX8_SPARE_READ_REG_0                                  0x90001700
 Y.CREATE.L   HWIO_MOD_TXCX8_SPARE_READ_REG_1_ADDR                        0x90001704
 Y.CREATE.L   MOD_TXCX8_SPARE_READ_REG_1                                  0x90001704
 Y.CREATE.L   HWIO_MOD_TXCX8_SPARE_READ_REG_2_ADDR                        0x90001708
 Y.CREATE.L   MOD_TXCX8_SPARE_READ_REG_2                                  0x90001708
 Y.CREATE.L   HWIO_MOD_TXCX8_SPARE_READ_REG_3_ADDR                        0x9000170C
 Y.CREATE.L   MOD_TXCX8_SPARE_READ_REG_3                                  0x9000170C
 Y.CREATE.L   HWIO_FL_SYM_BUFF_MODE_ADDR                                  0x90001800
 Y.CREATE.L   FL_SYM_BUFF_MODE                                            0x90001800
 Y.CREATE.L   HWIO_FL_SYM_BUFF_CLK_CTL_ADDR                               0x90001804
 Y.CREATE.L   FL_SYM_BUFF_CLK_CTL                                         0x90001804
 Y.CREATE.L   HWIO_FL_SYM_BUFF_CLK_OVERRIDE_ADDR                          0x90001808
 Y.CREATE.L   FL_SYM_BUFF_CLK_OVERRIDE                                    0x90001808
 Y.CREATE.L   HWIO_FL_SYM_BUFF_CLK_STATUS_RD_ADDR                         0x9000180C
 Y.CREATE.L   FL_SYM_BUFF_CLK_STATUS_RD                                   0x9000180C
 Y.CREATE.L   HWIO_FL_SYM_BUFF_MEM_CMD_ADDR                               0x90001810
 Y.CREATE.L   FL_SYM_BUFF_MEM_CMD                                         0x90001810
 Y.CREATE.L   HWIO_FL_SYM_BUFF_MEM_RD_ADDR                                0x90001814
 Y.CREATE.L   FL_SYM_BUFF_MEM_RD                                          0x90001814
 Y.CREATE.L   HWIO_MOD_ERAM_DATA_ADDR                                     0x90002000
 Y.CREATE.L   MOD_ERAM_DATA                                               0x90002000
 Y.CREATE.L   HWIO_MOD_ERAM_DATA_CTL_ADDR                                 0x90002908
 Y.CREATE.L   MOD_ERAM_DATA_CTL                                           0x90002908
 Y.CREATE.L   HWIO_MOD_ERAM_WR_DONE_ADDR                                  0x9000290C
 Y.CREATE.L   MOD_ERAM_WR_DONE                                            0x9000290C
 Y.CREATE.L   HWIO_MOD_ERAM_RESERVED_BITS_ADDR                            0x90002910
 Y.CREATE.L   MOD_ERAM_RESERVED_BITS                                      0x90002910
 Y.CREATE.L   HWIO_MOD_TEST_MEM_MODE_ADDR                                 0x90002914
 Y.CREATE.L   MOD_TEST_MEM_MODE                                           0x90002914
 Y.CREATE.L   HWIO_MOD_TEST_MEM_SEL_ADDR                                  0x90002918
 Y.CREATE.L   MOD_TEST_MEM_SEL                                            0x90002918
 Y.CREATE.L   HWIO_MOD_TEST_MEM_ADDR_ADDR                                 0x9000291C
 Y.CREATE.L   MOD_TEST_MEM_ADDR                                           0x9000291C
 Y.CREATE.L   HWIO_MOD_TEST_MEM_DATA_ADDR                                 0x90002920
 Y.CREATE.L   MOD_TEST_MEM_DATA                                           0x90002920
 Y.CREATE.L   HWIO_MOD_TXCX16_SPARE_READ_REG_0_ADDR                       0x90002924
 Y.CREATE.L   MOD_TXCX16_SPARE_READ_REG_0                                 0x90002924
 Y.CREATE.L   HWIO_MOD_TXCX16_SPARE_READ_REG_1_ADDR                       0x90002928
 Y.CREATE.L   MOD_TXCX16_SPARE_READ_REG_1                                 0x90002928
 Y.CREATE.L   HWIO_EMU_RX_FPGA_VERSION_RD_ADDR                            0x90003000
 Y.CREATE.L   EMU_RX_FPGA_VERSION_RD                                      0x90003000
 Y.CREATE.L   HWIO_EMU_TX_FPGA_VERSION_RD_ADDR                            0x90003100
 Y.CREATE.L   EMU_TX_FPGA_VERSION_RD                                      0x90003100
 Y.CREATE.L   HWIO_EMU_TX_SYSTEM_MODE_ADDR                                0x90003104
 Y.CREATE.L   EMU_TX_SYSTEM_MODE                                          0x90003104
 Y.CREATE.L   HWIO_EMU_TX_GPIO_WR_ADDR                                    0x90003108
 Y.CREATE.L   EMU_TX_GPIO_WR                                              0x90003108
 Y.CREATE.L   HWIO_EMU_TX_GPIO_STATUS_RD_ADDR                             0x9000310C
 Y.CREATE.L   EMU_TX_GPIO_STATUS_RD                                       0x9000310C
 Y.CREATE.L   HWIO_EMU_TX_GPIO_OE_ADDR                                    0x90003110
 Y.CREATE.L   EMU_TX_GPIO_OE                                              0x90003110
 Y.CREATE.L   HWIO_EMU_PA_ON_CTL_ADDR                                     0x90003114
 Y.CREATE.L   EMU_PA_ON_CTL                                               0x90003114
 Y.CREATE.L   HWIO_EMU_PA_ON_STATUS_RD_ADDR                               0x90003118
 Y.CREATE.L   EMU_PA_ON_STATUS_RD                                         0x90003118
 Y.CREATE.L   HWIO_EMU_TDEC_FPGA_VERSION_RD_ADDR                          0x90003200
 Y.CREATE.L   EMU_TDEC_FPGA_VERSION_RD                                    0x90003200
 Y.CREATE.L   HWIO_EMU_TDEC_DBG_BUS_RD_ADDR                               0x90003204
 Y.CREATE.L   EMU_TDEC_DBG_BUS_RD                                         0x90003204
 Y.CREATE.L   HWIO_EMU_TDEC_DSP_PC_RD_ADDR                                0x90003208
 Y.CREATE.L   EMU_TDEC_DSP_PC_RD                                          0x90003208
 Y.CREATE.L   HWIO_EMU_TDEC_DSP_XMEMC_SIG_RD_ADDR                         0x9000320C
 Y.CREATE.L   EMU_TDEC_DSP_XMEMC_SIG_RD                                   0x9000320C
 Y.CREATE.L   HWIO_EMU_ANT_RAM_ADDR_VAL_ADDR                              0x90003300
 Y.CREATE.L   EMU_ANT_RAM_ADDR_VAL                                        0x90003300
 Y.CREATE.L   HWIO_EMU_ANT_RAM_DATA_ADDR                                  0x90003304
 Y.CREATE.L   EMU_ANT_RAM_DATA                                            0x90003304
 Y.CREATE.L   HWIO_EMU_ANT_RAM_RTCMATCH_ADDR                              0x90003308
 Y.CREATE.L   EMU_ANT_RAM_RTCMATCH                                        0x90003308
 Y.CREATE.L   HWIO_EMU_ANT_RAM_CTL_ADDR                                   0x9000330C
 Y.CREATE.L   EMU_ANT_RAM_CTL                                             0x9000330C
 Y.CREATE.L   HWIO_EMU_ANT_RAM_DEBUG_CTL_ADDR                             0x90003310
 Y.CREATE.L   EMU_ANT_RAM_DEBUG_CTL                                       0x90003310
 Y.CREATE.L   HWIO_EMU_ANT_RAM_GPO_ADDR                                   0x90003314
 Y.CREATE.L   EMU_ANT_RAM_GPO                                             0x90003314
 Y.CREATE.L   HWIO_EMU_ANT_RAM_DEBUG2_CTL_ADDR                            0x90003318
 Y.CREATE.L   EMU_ANT_RAM_DEBUG2_CTL                                      0x90003318
 Y.CREATE.L   HWIO_EMU_RXFPGA_RESET_CMD_ADDR                              0x9000331C
 Y.CREATE.L   EMU_RXFPGA_RESET_CMD                                        0x9000331C
 Y.CREATE.L   HWIO_EMU_RXFPGA_MODE_SEL_ADDR                               0x90003320
 Y.CREATE.L   EMU_RXFPGA_MODE_SEL                                         0x90003320
 Y.CREATE.L   HWIO_EMU_QDSP_CTL_ADDR_ADDR                                 0x90003324
 Y.CREATE.L   EMU_QDSP_CTL_ADDR                                           0x90003324
 Y.CREATE.L   HWIO_EMU_QDSP_PC_DEBIG_ADDR                                 0x90003328
 Y.CREATE.L   EMU_QDSP_PC_DEBIG                                           0x90003328
 Y.CREATE.L   HWIO_EMU_USB_CTL_ADDR                                       0x9000332C
 Y.CREATE.L   EMU_USB_CTL                                                 0x9000332C
 Y.CREATE.L   HWIO_EMU_USB_DET_ADDR                                       0x90003330
 Y.CREATE.L   EMU_USB_DET                                                 0x90003330
 Y.CREATE.L   HWIO_UNUSED_PB_RESET_ADDR                                   0x90003400
 Y.CREATE.L   UNUSED_PB_RESET                                             0x90003400
 Y.CREATE.L   HWIO_UNUSED_PB_HW_CLK_CTL_ADDR                              0x90003404
 Y.CREATE.L   UNUSED_PB_HW_CLK_CTL                                        0x90003404
 Y.CREATE.L   HWIO_UNUSED_PB_MICRO_CLK_CTL_ADDR                           0x90003408
 Y.CREATE.L   UNUSED_PB_MICRO_CLK_CTL                                     0x90003408
 Y.CREATE.L   HWIO_UNUSED_PB_CLK_STATUS_ADDR                              0x9000340C
 Y.CREATE.L   UNUSED_PB_CLK_STATUS                                        0x9000340C
 Y.CREATE.L   HWIO_UNUSED_PB_MEM_CTL_ADDR                                 0x90003410
 Y.CREATE.L   UNUSED_PB_MEM_CTL                                           0x90003410
 Y.CREATE.L   HWIO_UNUSED_PB_MEM_ADDR_ADDR                                0x90003414
 Y.CREATE.L   UNUSED_PB_MEM_ADDR                                          0x90003414
 Y.CREATE.L   HWIO_UNUSED_PB_MEM_DATA_ADDR                                0x90003418
 Y.CREATE.L   UNUSED_PB_MEM_DATA                                          0x90003418
 Y.CREATE.L   HWIO_QLIC_MTI_CTL_ADDR                                      0x90003500
 Y.CREATE.L   QLIC_MTI_CTL                                                0x90003500
 Y.CREATE.L   HWIO_QLIC_FERAM0_WORD0_ADDR                                 0x90003504
 Y.CREATE.L   QLIC_FERAM0_WORD0                                           0x90003504
 Y.CREATE.L   HWIO_QLIC_FERAM0_WORD1_ADDR                                 0x90003508
 Y.CREATE.L   QLIC_FERAM0_WORD1                                           0x90003508
 Y.CREATE.L   HWIO_QLIC_FERAM1_WORD0_ADDR                                 0x9000350C
 Y.CREATE.L   QLIC_FERAM1_WORD0                                           0x9000350C
 Y.CREATE.L   HWIO_QLIC_FERAM1_WORD1_ADDR                                 0x90003510
 Y.CREATE.L   QLIC_FERAM1_WORD1                                           0x90003510
 Y.CREATE.L   HWIO_QLIC_OMGRAM_WORD0_ADDR                                 0x90003514
 Y.CREATE.L   QLIC_OMGRAM_WORD0                                           0x90003514
 Y.CREATE.L   HWIO_QLIC_OMGRAM_WORD1_ADDR                                 0x90003518
 Y.CREATE.L   QLIC_OMGRAM_WORD1                                           0x90003518
 Y.CREATE.L   HWIO_QLIC_SECRAM_WORD0_ADDR                                 0x9000351C
 Y.CREATE.L   QLIC_SECRAM_WORD0                                           0x9000351C
 Y.CREATE.L   HWIO_QLIC_SECRAM_WORD1_ADDR                                 0x90003520
 Y.CREATE.L   QLIC_SECRAM_WORD1                                           0x90003520
 Y.CREATE.L   HWIO_QLIC_COMBRAM0_WORD0_ADDR                               0x90003524
 Y.CREATE.L   QLIC_COMBRAM0_WORD0                                         0x90003524
 Y.CREATE.L   HWIO_QLIC_COMBRAM0_WORD1_ADDR                               0x90003528
 Y.CREATE.L   QLIC_COMBRAM0_WORD1                                         0x90003528
 Y.CREATE.L   HWIO_QLIC_COMBRAM0_WORD2_ADDR                               0x9000352C
 Y.CREATE.L   QLIC_COMBRAM0_WORD2                                         0x9000352C
 Y.CREATE.L   HWIO_QLIC_COMBRAM1_WORD0_ADDR                               0x90003530
 Y.CREATE.L   QLIC_COMBRAM1_WORD0                                         0x90003530
 Y.CREATE.L   HWIO_QLIC_COMBRAM1_WORD1_ADDR                               0x90003534
 Y.CREATE.L   QLIC_COMBRAM1_WORD1                                         0x90003534
 Y.CREATE.L   HWIO_QLIC_COMBRAM1_WORD2_ADDR                               0x90003538
 Y.CREATE.L   QLIC_COMBRAM1_WORD2                                         0x90003538
 Y.CREATE.L   HWIO_QLIC_CGC_TASK_STATE_ARM_ADDR                           0x9000353C
 Y.CREATE.L   QLIC_CGC_TASK_STATE_ARM                                     0x9000353C
 Y.CREATE.L   HWIO_QLIC_TESTBUS_ARM_ADDR                                  0x9000354C
 Y.CREATE.L   QLIC_TESTBUS_ARM                                            0x9000354C
 Y.CREATE.L   HWIO_RXF_SRC0_RESET_ADDR                                    0x90003600
 Y.CREATE.L   RXF_SRC0_RESET                                              0x90003600
 Y.CREATE.L   HWIO_RXF_SRC1_RESET_ADDR                                    0x90003680
 Y.CREATE.L   RXF_SRC1_RESET                                              0x90003680
 Y.CREATE.L   HWIO_RXF_SRC0_CTL_ADDR                                      0x90003604
 Y.CREATE.L   RXF_SRC0_CTL                                                0x90003604
 Y.CREATE.L   HWIO_RXF_SRC1_CTL_ADDR                                      0x90003684
 Y.CREATE.L   RXF_SRC1_CTL                                                0x90003684
 Y.CREATE.L   HWIO_RXF_SRC0_PHASE_DEL_ADDR                                0x90003608
 Y.CREATE.L   RXF_SRC0_PHASE_DEL                                          0x90003608
 Y.CREATE.L   HWIO_RXF_SRC1_PHASE_DEL_ADDR                                0x90003688
 Y.CREATE.L   RXF_SRC1_PHASE_DEL                                          0x90003688
 Y.CREATE.L   HWIO_RXF_SRC0_LNA_S0_PHASE_OFFSET_ADDR                      0x9000360C
 Y.CREATE.L   RXF_SRC0_LNA_S0_PHASE_OFFSET                                0x9000360C
 Y.CREATE.L   HWIO_RXF_SRC1_LNA_S0_PHASE_OFFSET_ADDR                      0x9000368C
 Y.CREATE.L   RXF_SRC1_LNA_S0_PHASE_OFFSET                                0x9000368C
 Y.CREATE.L   HWIO_RXF_SRC0_LNA_S1_PHASE_OFFSET_ADDR                      0x90003610
 Y.CREATE.L   RXF_SRC0_LNA_S1_PHASE_OFFSET                                0x90003610
 Y.CREATE.L   HWIO_RXF_SRC1_LNA_S1_PHASE_OFFSET_ADDR                      0x90003690
 Y.CREATE.L   RXF_SRC1_LNA_S1_PHASE_OFFSET                                0x90003690
 Y.CREATE.L   HWIO_RXF_SRC0_LNA_S2_PHASE_OFFSET_ADDR                      0x90003614
 Y.CREATE.L   RXF_SRC0_LNA_S2_PHASE_OFFSET                                0x90003614
 Y.CREATE.L   HWIO_RXF_SRC1_LNA_S2_PHASE_OFFSET_ADDR                      0x90003694
 Y.CREATE.L   RXF_SRC1_LNA_S2_PHASE_OFFSET                                0x90003694
 Y.CREATE.L   HWIO_RXF_SRC0_LNA_S3_PHASE_OFFSET_ADDR                      0x90003618
 Y.CREATE.L   RXF_SRC0_LNA_S3_PHASE_OFFSET                                0x90003618
 Y.CREATE.L   HWIO_RXF_SRC1_LNA_S3_PHASE_OFFSET_ADDR                      0x90003698
 Y.CREATE.L   RXF_SRC1_LNA_S3_PHASE_OFFSET                                0x90003698
 Y.CREATE.L   HWIO_RXF_SRC0_LNA_S4_PHASE_OFFSET_ADDR                      0x9000361C
 Y.CREATE.L   RXF_SRC0_LNA_S4_PHASE_OFFSET                                0x9000361C
 Y.CREATE.L   HWIO_RXF_SRC1_LNA_S4_PHASE_OFFSET_ADDR                      0x9000369C
 Y.CREATE.L   RXF_SRC1_LNA_S4_PHASE_OFFSET                                0x9000369C
 Y.CREATE.L   HWIO_RXF_SRC0_BBF_NOTCH0_PARAMS_ADDR                        0x90003624
 Y.CREATE.L   RXF_SRC0_BBF_NOTCH0_PARAMS                                  0x90003624
 Y.CREATE.L   HWIO_RXF_SRC1_BBF_NOTCH0_PARAMS_ADDR                        0x900036A4
 Y.CREATE.L   RXF_SRC1_BBF_NOTCH0_PARAMS                                  0x900036A4
 Y.CREATE.L   HWIO_RXF_SRC0_BBF_NOTCH1_PARAMS_ADDR                        0x90003628
 Y.CREATE.L   RXF_SRC0_BBF_NOTCH1_PARAMS                                  0x90003628
 Y.CREATE.L   HWIO_RXF_SRC1_BBF_NOTCH1_PARAMS_ADDR                        0x900036A8
 Y.CREATE.L   RXF_SRC1_BBF_NOTCH1_PARAMS                                  0x900036A8
 Y.CREATE.L   HWIO_RXF_SRC0_BBF_NOTCH2_PARAMS_ADDR                        0x9000362C
 Y.CREATE.L   RXF_SRC0_BBF_NOTCH2_PARAMS                                  0x9000362C
 Y.CREATE.L   HWIO_RXF_SRC1_BBF_NOTCH2_PARAMS_ADDR                        0x900036AC
 Y.CREATE.L   RXF_SRC1_BBF_NOTCH2_PARAMS                                  0x900036AC
 Y.CREATE.L   HWIO_RXF_SRC0_MIS_COMP_A_COEFF_ADDR                         0x90003630
 Y.CREATE.L   RXF_SRC0_MIS_COMP_A_COEFF                                   0x90003630
 Y.CREATE.L   HWIO_RXF_SRC1_MIS_COMP_A_COEFF_ADDR                         0x900036B0
 Y.CREATE.L   RXF_SRC1_MIS_COMP_A_COEFF                                   0x900036B0
 Y.CREATE.L   HWIO_RXF_SRC0_MIS_COMP_B_COEFF_ADDR                         0x90003634
 Y.CREATE.L   RXF_SRC0_MIS_COMP_B_COEFF                                   0x90003634
 Y.CREATE.L   HWIO_RXF_SRC1_MIS_COMP_B_COEFF_ADDR                         0x900036B4
 Y.CREATE.L   RXF_SRC1_MIS_COMP_B_COEFF                                   0x900036B4
 Y.CREATE.L   HWIO_RXF_SRC0_RESAMP_PHASE_MAP0_ADDR                        0x90003638
 Y.CREATE.L   RXF_SRC0_RESAMP_PHASE_MAP0                                  0x90003638
 Y.CREATE.L   HWIO_RXF_SRC1_RESAMP_PHASE_MAP0_ADDR                        0x900036B8
 Y.CREATE.L   RXF_SRC1_RESAMP_PHASE_MAP0                                  0x900036B8
 Y.CREATE.L   HWIO_RXF_SRC0_RESAMP_PHASE_MAP1_ADDR                        0x9000363C
 Y.CREATE.L   RXF_SRC0_RESAMP_PHASE_MAP1                                  0x9000363C
 Y.CREATE.L   HWIO_RXF_SRC1_RESAMP_PHASE_MAP1_ADDR                        0x900036BC
 Y.CREATE.L   RXF_SRC1_RESAMP_PHASE_MAP1                                  0x900036BC
 Y.CREATE.L   HWIO_RXF_SRC0_RESAMP_PHASE_MAP2_ADDR                        0x90003640
 Y.CREATE.L   RXF_SRC0_RESAMP_PHASE_MAP2                                  0x90003640
 Y.CREATE.L   HWIO_RXF_SRC1_RESAMP_PHASE_MAP2_ADDR                        0x900036C0
 Y.CREATE.L   RXF_SRC1_RESAMP_PHASE_MAP2                                  0x900036C0
 Y.CREATE.L   HWIO_RXF_SRC0_RESAMP_PHASE_MAP3_ADDR                        0x90003644
 Y.CREATE.L   RXF_SRC0_RESAMP_PHASE_MAP3                                  0x90003644
 Y.CREATE.L   HWIO_RXF_SRC1_RESAMP_PHASE_MAP3_ADDR                        0x900036C4
 Y.CREATE.L   RXF_SRC1_RESAMP_PHASE_MAP3                                  0x900036C4
 Y.CREATE.L   HWIO_RXF_SRC0_RESAMP_END_CNT_ADDR                           0x90003648
 Y.CREATE.L   RXF_SRC0_RESAMP_END_CNT                                     0x90003648
 Y.CREATE.L   HWIO_RXF_SRC1_RESAMP_END_CNT_ADDR                           0x900036C8
 Y.CREATE.L   RXF_SRC1_RESAMP_END_CNT                                     0x900036C8
 Y.CREATE.L   HWIO_RXF_SRC0_DVGA_PARAMS_ADDR                              0x9000364C
 Y.CREATE.L   RXF_SRC0_DVGA_PARAMS                                        0x9000364C
 Y.CREATE.L   HWIO_RXF_SRC1_DVGA_PARAMS_ADDR                              0x900036CC
 Y.CREATE.L   RXF_SRC1_DVGA_PARAMS                                        0x900036CC
 Y.CREATE.L   HWIO_RXF_SRC0_TEST_BUS_SEL_ADDR                             0x90003650
 Y.CREATE.L   RXF_SRC0_TEST_BUS_SEL                                       0x90003650
 Y.CREATE.L   HWIO_RXF_SRC1_TEST_BUS_SEL_ADDR                             0x900036D0
 Y.CREATE.L   RXF_SRC1_TEST_BUS_SEL                                       0x900036D0
 Y.CREATE.L   HWIO_RXF_SRC0_CXN_CLK_STATUS_ADDR                           0x90003654
 Y.CREATE.L   RXF_SRC0_CXN_CLK_STATUS                                     0x90003654
 Y.CREATE.L   HWIO_RXF_SRC1_CXN_CLK_STATUS_ADDR                           0x900036D4
 Y.CREATE.L   RXF_SRC1_CXN_CLK_STATUS                                     0x900036D4
 Y.CREATE.L   HWIO_DINT_RESET_ADDR                                        0x90003800
 Y.CREATE.L   DINT_RESET                                                  0x90003800
 Y.CREATE.L   HWIO_DINT_CFG_ADDR                                          0x90003804
 Y.CREATE.L   DINT_CFG                                                    0x90003804
 Y.CREATE.L   HWIO_DINT_CH0_CFG_ADDR                                      0x90003808
 Y.CREATE.L   DINT_CH0_CFG                                                0x90003808
 Y.CREATE.L   HWIO_DINT_CH1_CFG_ADDR                                      0x9000380C
 Y.CREATE.L   DINT_CH1_CFG                                                0x9000380C
 Y.CREATE.L   HWIO_DINT_CH2_CFG_ADDR                                      0x90003810
 Y.CREATE.L   DINT_CH2_CFG                                                0x90003810
 Y.CREATE.L   HWIO_DINT_CH3_CFG_ADDR                                      0x90003814
 Y.CREATE.L   DINT_CH3_CFG                                                0x90003814
 Y.CREATE.L   HWIO_TD_BLOCK_SIZE_ADDR                                     0x90003818
 Y.CREATE.L   TD_BLOCK_SIZE                                               0x90003818
 Y.CREATE.L   HWIO_TD_INTLV_CFG_LO_ADDR                                   0x9000381C
 Y.CREATE.L   TD_INTLV_CFG_LO                                             0x9000381C
 Y.CREATE.L   HWIO_TD_INTLV_CFG_HI_ADDR                                   0x90003820
 Y.CREATE.L   TD_INTLV_CFG_HI                                             0x90003820
 Y.CREATE.L   HWIO_TD_INTLV_SIZE_LO_ADDR                                  0x90003824
 Y.CREATE.L   TD_INTLV_SIZE_LO                                            0x90003824
 Y.CREATE.L   HWIO_TD_INTLV_SIZE_HI_ADDR                                  0x90003828
 Y.CREATE.L   TD_INTLV_SIZE_HI                                            0x90003828
 Y.CREATE.L   HWIO_TD_PUNCT_LO_ADDR                                       0x9000382C
 Y.CREATE.L   TD_PUNCT_LO                                                 0x9000382C
 Y.CREATE.L   HWIO_TD_PUNCT_HI_ADDR                                       0x90003830
 Y.CREATE.L   TD_PUNCT_HI                                                 0x90003830
 Y.CREATE.L   HWIO_TD_PARAMS_LO_ADDR                                      0x90003834
 Y.CREATE.L   TD_PARAMS_LO                                                0x90003834
 Y.CREATE.L   HWIO_TD_PARAMS_HI_ADDR                                      0x90003838
 Y.CREATE.L   TD_PARAMS_HI                                                0x90003838
 Y.CREATE.L   HWIO_DINT_PKT_OFFSET_ADDR                                   0x9000383C
 Y.CREATE.L   DINT_PKT_OFFSET                                             0x9000383C
 Y.CREATE.L   HWIO_DINT_PKT_CFG_ADDR                                      0x90003840
 Y.CREATE.L   DINT_PKT_CFG                                                0x90003840
 Y.CREATE.L   HWIO_DINT_TASK_OFFSET_ADDR                                  0x90003844
 Y.CREATE.L   DINT_TASK_OFFSET                                            0x90003844
 Y.CREATE.L   HWIO_DINT_TASK_LIST_ADDR                                    0x90003848
 Y.CREATE.L   DINT_TASK_LIST                                              0x90003848
 Y.CREATE.L   HWIO_TST_SYNC_DINT_ADDR                                     0x9000384C
 Y.CREATE.L   TST_SYNC_DINT                                               0x9000384C
 Y.CREATE.L   HWIO_TST_CH0_SYMS_ADDR                                      0x90003850
 Y.CREATE.L   TST_CH0_SYMS                                                0x90003850
 Y.CREATE.L   HWIO_TST_CH1_SYMS_ADDR                                      0x90003854
 Y.CREATE.L   TST_CH1_SYMS                                                0x90003854
 Y.CREATE.L   HWIO_TST_CH2_SYMS_ADDR                                      0x90003858
 Y.CREATE.L   TST_CH2_SYMS                                                0x90003858
 Y.CREATE.L   HWIO_TST_SEQ_PROC_PHASE_ADDR                                0x9000385C
 Y.CREATE.L   TST_SEQ_PROC_PHASE                                          0x9000385C
 Y.CREATE.L   HWIO_TST_SEL_DINT_ADDR                                      0x90003860
 Y.CREATE.L   TST_SEL_DINT                                                0x90003860
 Y.CREATE.L   HWIO_DINT_OTD_CFG_ADDR                                      0x90003864
 Y.CREATE.L   DINT_OTD_CFG                                                0x90003864
 Y.CREATE.L   HWIO_TD_MIN_LLR_THRESH_ADDR                                 0x90003868
 Y.CREATE.L   TD_MIN_LLR_THRESH                                           0x90003868
 Y.CREATE.L   HWIO_TD_INTLV_LEN_X2_ADDR                                   0x9000386C
 Y.CREATE.L   TD_INTLV_LEN_X2                                             0x9000386C
 Y.CREATE.L   HWIO_TD_INTLV_LEN_X4_ADDR                                   0x90003870
 Y.CREATE.L   TD_INTLV_LEN_X4                                             0x90003870
 Y.CREATE.L   HWIO_TD_INTLV_LEN_X8_ADDR                                   0x90003874
 Y.CREATE.L   TD_INTLV_LEN_X8                                             0x90003874
 Y.CREATE.L   HWIO_TD_NUM_SLWIN_X2_ADDR                                   0x90003878
 Y.CREATE.L   TD_NUM_SLWIN_X2                                             0x90003878
 Y.CREATE.L   HWIO_TD_NUM_SLWIN_X4_ADDR                                   0x9000387C
 Y.CREATE.L   TD_NUM_SLWIN_X4                                             0x9000387C
 Y.CREATE.L   HWIO_TD_NUM_SLWIN_X8_ADDR                                   0x90003880
 Y.CREATE.L   TD_NUM_SLWIN_X8                                             0x90003880
 Y.CREATE.L   HWIO_DINT_GCH_CFG0_ADDR                                     0x90003884
 Y.CREATE.L   DINT_GCH_CFG0                                               0x90003884
 Y.CREATE.L   HWIO_DINT_GCH_CFG1_ADDR                                     0x90003888
 Y.CREATE.L   DINT_GCH_CFG1                                               0x90003888
 Y.CREATE.L   HWIO_DINT_GCH_CFG2_ADDR                                     0x9000388C
 Y.CREATE.L   DINT_GCH_CFG2                                               0x9000388C
 Y.CREATE.L   HWIO_DINT_GCH_CFG3_ADDR                                     0x90003890
 Y.CREATE.L   DINT_GCH_CFG3                                               0x90003890
 Y.CREATE.L   HWIO_DINT_PDCCH_CFG_ADDR                                    0x90003894
 Y.CREATE.L   DINT_PDCCH_CFG                                              0x90003894
 Y.CREATE.L   HWIO_DINT_PDCCH_HYP0_CFG0_ADDR                              0x90003898
 Y.CREATE.L   DINT_PDCCH_HYP0_CFG0                                        0x90003898
 Y.CREATE.L   HWIO_DINT_PDCCH_HYP1_CFG0_ADDR                              0x9000389C
 Y.CREATE.L   DINT_PDCCH_HYP1_CFG0                                        0x9000389C
 Y.CREATE.L   HWIO_DINT_PDCCH_HYP2_CFG0_ADDR                              0x900038A0
 Y.CREATE.L   DINT_PDCCH_HYP2_CFG0                                        0x900038A0
 Y.CREATE.L   HWIO_DINT_PDCCH_HYP0_CFG1_ADDR                              0x900038A4
 Y.CREATE.L   DINT_PDCCH_HYP0_CFG1                                        0x900038A4
 Y.CREATE.L   HWIO_DINT_PDCCH_HYP1_CFG1_ADDR                              0x900038A8
 Y.CREATE.L   DINT_PDCCH_HYP1_CFG1                                        0x900038A8
 Y.CREATE.L   HWIO_DINT_PDCCH_HYP2_CFG1_ADDR                              0x900038AC
 Y.CREATE.L   DINT_PDCCH_HYP2_CFG1                                        0x900038AC
 Y.CREATE.L   HWIO_DINT_TEST_MEM_SEL_ADDR                                 0x900038B0
 Y.CREATE.L   DINT_TEST_MEM_SEL                                           0x900038B0
 Y.CREATE.L   HWIO_DINT_TEST_MEM_ADDR_ADDR                                0x900038B4
 Y.CREATE.L   DINT_TEST_MEM_ADDR                                          0x900038B4
 Y.CREATE.L   HWIO_DINT_TEST_MEM_WRITE_ADDR                               0x900038B8
 Y.CREATE.L   DINT_TEST_MEM_WRITE                                         0x900038B8
 Y.CREATE.L   HWIO_DINT_TEST_MEM_READ0_ADDR                               0x900038BC
 Y.CREATE.L   DINT_TEST_MEM_READ0                                         0x900038BC
 Y.CREATE.L   HWIO_TST_PDCCH_TASK_ADDR                                    0x900038C0
 Y.CREATE.L   TST_PDCCH_TASK                                              0x900038C0
 Y.CREATE.L   HWIO_TST_SYS_TIME_ADDR                                      0x900038C4
 Y.CREATE.L   TST_SYS_TIME                                                0x900038C4
 Y.CREATE.L   HWIO_DEINT_DBG_BUS_CTL_ADDR                                 0x900038C8
 Y.CREATE.L   DEINT_DBG_BUS_CTL                                           0x900038C8
 Y.CREATE.L   HWIO_DEINT_CLK_SPARE_READ_REG0_ADDR                         0x900038CC
 Y.CREATE.L   DEINT_CLK_SPARE_READ_REG0                                   0x900038CC
 Y.CREATE.L   HWIO_DEINT_CLK_SPARE_READ_REG1_ADDR                         0x900038D0
 Y.CREATE.L   DEINT_CLK_SPARE_READ_REG1                                   0x900038D0
 Y.CREATE.L   HWIO_DEINT_HW_CLK_CTL_ADDR                                  0x900038D4
 Y.CREATE.L   DEINT_HW_CLK_CTL                                            0x900038D4
 Y.CREATE.L   HWIO_DEINT_MICRO_CLK_CTL_ADDR                               0x900038D8
 Y.CREATE.L   DEINT_MICRO_CLK_CTL                                         0x900038D8
 Y.CREATE.L   HWIO_DEINT_CLK_STATUS_ADDR                                  0x900038DC
 Y.CREATE.L   DEINT_CLK_STATUS                                            0x900038DC
 Y.CREATE.L   HWIO_DEC_DONE_INT_STATUS_ADDR                               0x900038E0
 Y.CREATE.L   DEC_DONE_INT_STATUS                                         0x900038E0
 Y.CREATE.L   HWIO_DEINT_TASK_STATUS_ADDR                                 0x90003800
 Y.CREATE.L   DEINT_TASK_STATUS                                           0x90003800
 Y.CREATE.L   HWIO_DEINT_FRMHYP_STATUS_ADDR                               0x90003804
 Y.CREATE.L   DEINT_FRMHYP_STATUS                                         0x90003804
 Y.CREATE.L   HWIO_DINT_VD_RD_ADDR_ADDR                                   0x9000382C
 Y.CREATE.L   DINT_VD_RD_ADDR                                             0x9000382C
 Y.CREATE.L   HWIO_DINT_TD_WR_ADDR_ADDR                                   0x9000384C
 Y.CREATE.L   DINT_TD_WR_ADDR                                             0x9000384C
 Y.CREATE.L   HWIO_MODEM_QMEMBIST_CLK_ENA_ADDR                            0x90003900
 Y.CREATE.L   MODEM_QMEMBIST_CLK_ENA                                      0x90003900
 Y.CREATE.L   HWIO_MODEM_QMEMBIST_IO_CFG_ADDR                             0x90003904
 Y.CREATE.L   MODEM_QMEMBIST_IO_CFG                                       0x90003904
 Y.CREATE.L   HWIO_MODEM_QMEMBIST_RESET_ADDR                              0x90003908
 Y.CREATE.L   MODEM_QMEMBIST_RESET                                        0x90003908
 Y.CREATE.L   HWIO_MODEM_QMEMBIST_FA_SEQUENCER_SEL_ADDR                   0x9000390C
 Y.CREATE.L   MODEM_QMEMBIST_FA_SEQUENCER_SEL                             0x9000390C
 Y.CREATE.L   HWIO_MODEM_QMEMBIST_EMBEDDED_ALG_CFG_ADDR                   0x90003910
 Y.CREATE.L   MODEM_QMEMBIST_EMBEDDED_ALG_CFG                             0x90003910
 Y.CREATE.L   HWIO_MODEM_QMEMBIST_USR_CMD_DESTINATION_ADDR                0x90003914
 Y.CREATE.L   MODEM_QMEMBIST_USR_CMD_DESTINATION                          0x90003914
 Y.CREATE.L   HWIO_MODEM_QMEMBIST_USR_CMD_CFG_ADDR                        0x90003918
 Y.CREATE.L   MODEM_QMEMBIST_USR_CMD_CFG                                  0x90003918
 Y.CREATE.L   HWIO_MODEM_QMEMBIST_TEST_TRIGGER_ADDR                       0x9000391C
 Y.CREATE.L   MODEM_QMEMBIST_TEST_TRIGGER                                 0x9000391C
 Y.CREATE.L   HWIO_MODEM_QMEMBIST_TEST_STATUS_ADDR                        0x90003920
 Y.CREATE.L   MODEM_QMEMBIST_TEST_STATUS                                  0x90003920
 Y.CREATE.L   HWIO_MODEM_QMEMBIST_TESTED0_ADDR                            0x90003924
 Y.CREATE.L   MODEM_QMEMBIST_TESTED0                                      0x90003924
 Y.CREATE.L   HWIO_MODEM_QMEMBIST_TESTED1_ADDR                            0x90003928
 Y.CREATE.L   MODEM_QMEMBIST_TESTED1                                      0x90003928
 Y.CREATE.L   HWIO_MODEM_QMEMBIST_TESTED2_ADDR                            0x9000392C
 Y.CREATE.L   MODEM_QMEMBIST_TESTED2                                      0x9000392C
 Y.CREATE.L   HWIO_MODEM_QMEMBIST_TESTED3_ADDR                            0x90003930
 Y.CREATE.L   MODEM_QMEMBIST_TESTED3                                      0x90003930
 Y.CREATE.L   HWIO_MODEM_QMEMBIST_FAILED0_ADDR                            0x90003934
 Y.CREATE.L   MODEM_QMEMBIST_FAILED0                                      0x90003934
 Y.CREATE.L   HWIO_MODEM_QMEMBIST_FAILED1_ADDR                            0x90003938
 Y.CREATE.L   MODEM_QMEMBIST_FAILED1                                      0x90003938
 Y.CREATE.L   HWIO_MODEM_QMEMBIST_FAILED2_ADDR                            0x9000393C
 Y.CREATE.L   MODEM_QMEMBIST_FAILED2                                      0x9000393C
 Y.CREATE.L   HWIO_MODEM_QMEMBIST_FAILED3_ADDR                            0x90003940
 Y.CREATE.L   MODEM_QMEMBIST_FAILED3                                      0x90003940
 Y.CREATE.L   HWIO_MODEM_QMEMBIST_RAM_FAIL_MAP_ADDR                       0x90003944
 Y.CREATE.L   MODEM_QMEMBIST_RAM_FAIL_MAP                                 0x90003944
 Y.CREATE.L   HWIO_MODEM_QMEMBIST_CLKOFF0_ADDR                            0x90003948
 Y.CREATE.L   MODEM_QMEMBIST_CLKOFF0                                      0x90003948
 Y.CREATE.L   HWIO_MODEM_QMEMBIST_CLKOFF1_ADDR                            0x9000394C
 Y.CREATE.L   MODEM_QMEMBIST_CLKOFF1                                      0x9000394C
 Y.CREATE.L   HWIO_MODEM_QMEMBIST_CLKOFF2_ADDR                            0x90003950
 Y.CREATE.L   MODEM_QMEMBIST_CLKOFF2                                      0x90003950
 Y.CREATE.L   HWIO_MODEM_QMEMBIST_CLKOFF3_ADDR                            0x90003954
 Y.CREATE.L   MODEM_QMEMBIST_CLKOFF3                                      0x90003954
 Y.CREATE.L   HWIO_MODEM_CLK_HALT_ADDR                                    0x90004000
 Y.CREATE.L   MODEM_CLK_HALT                                              0x90004000
 Y.CREATE.L   HWIO_MODEM_CLK_HALT_2_ADDR                                  0x90004004
 Y.CREATE.L   MODEM_CLK_HALT_2                                            0x90004004
 Y.CREATE.L   HWIO_MODEM_CLK_RESET_ADDR                                   0x90004008
 Y.CREATE.L   MODEM_CLK_RESET                                             0x90004008
 Y.CREATE.L   HWIO_MODEM_CLK_RESET_2_ADDR                                 0x9000400C
 Y.CREATE.L   MODEM_CLK_RESET_2                                           0x9000400C
 Y.CREATE.L   HWIO_MODEM_CLK_INV_ADDR                                     0x90004010
 Y.CREATE.L   MODEM_CLK_INV                                               0x90004010
 Y.CREATE.L   HWIO_MODEM_CLK_INV_2_ADDR                                   0x90004014
 Y.CREATE.L   MODEM_CLK_INV_2                                             0x90004014
 Y.CREATE.L   HWIO_MODEM_RXF_SAMP_REF_CLK_CTL_ADDR                        0x90004018
 Y.CREATE.L   MODEM_RXF_SAMP_REF_CLK_CTL                                  0x90004018
 Y.CREATE.L   HWIO_MODEM_IN_N_OUT_CLK_CTL_ADDR                            0x9000401C
 Y.CREATE.L   MODEM_IN_N_OUT_CLK_CTL                                      0x9000401C
 Y.CREATE.L   HWIO_MODEM_MF_CHIPXN_CLK_CTL_ADDR                           0x90004020
 Y.CREATE.L   MODEM_MF_CHIPXN_CLK_CTL                                     0x90004020
 Y.CREATE.L   HWIO_MODEM_CHIPXN_CLK_CTL_ADDR                              0x90004024
 Y.CREATE.L   MODEM_CHIPXN_CLK_CTL                                        0x90004024
 Y.CREATE.L   HWIO_MODEM_OFFLINE_MNCNTR_M_ADDR                            0x90004028
 Y.CREATE.L   MODEM_OFFLINE_MNCNTR_M                                      0x90004028
 Y.CREATE.L   HWIO_MODEM_OFFLINE_MNCNTR_NOT_2D_ADDR                       0x9000402C
 Y.CREATE.L   MODEM_OFFLINE_MNCNTR_NOT_2D                                 0x9000402C
 Y.CREATE.L   HWIO_MODEM_OFFLINE_MNCNTR_NOT_N_M_ADDR                      0x90004030
 Y.CREATE.L   MODEM_OFFLINE_MNCNTR_NOT_N_M                                0x90004030
 Y.CREATE.L   HWIO_MODEM_OFFLINE_CLK_CTL_ADDR                             0x90004034
 Y.CREATE.L   MODEM_OFFLINE_CLK_CTL                                       0x90004034
 Y.CREATE.L   HWIO_MODEM_GACC_MNCNTR_M_ADDR                               0x90004038
 Y.CREATE.L   MODEM_GACC_MNCNTR_M                                         0x90004038
 Y.CREATE.L   HWIO_MODEM_GACC_MNCNTR_NOT_2D_ADDR                          0x9000403C
 Y.CREATE.L   MODEM_GACC_MNCNTR_NOT_2D                                    0x9000403C
 Y.CREATE.L   HWIO_MODEM_GACC_MNCNTR_NOT_N_M_ADDR                         0x90004040
 Y.CREATE.L   MODEM_GACC_MNCNTR_NOT_N_M                                   0x90004040
 Y.CREATE.L   HWIO_MODEM_GACC_CLK_CTL_ADDR                                0x90004044
 Y.CREATE.L   MODEM_GACC_CLK_CTL                                          0x90004044
 Y.CREATE.L   HWIO_MODEM_GPS_CLK_CTL_ADDR                                 0x90004048
 Y.CREATE.L   MODEM_GPS_CLK_CTL                                           0x90004048
 Y.CREATE.L   HWIO_MODEM_GPS_MNCNTR_M_ADDR                                0x9000404C
 Y.CREATE.L   MODEM_GPS_MNCNTR_M                                          0x9000404C
 Y.CREATE.L   HWIO_MODEM_GPS_MNCNTR_NOT_2D_ADDR                           0x90004050
 Y.CREATE.L   MODEM_GPS_MNCNTR_NOT_2D                                     0x90004050
 Y.CREATE.L   HWIO_MODEM_GPS_MNCNTR_NOT_N_M_ADDR                          0x90004054
 Y.CREATE.L   MODEM_GPS_MNCNTR_NOT_N_M                                    0x90004054
 Y.CREATE.L   HWIO_MODEM_F9_CLK_CTL_ADDR                                  0x90004058
 Y.CREATE.L   MODEM_F9_CLK_CTL                                            0x90004058
 Y.CREATE.L   HWIO_MODEM_EDGE_CLK_CTL_ADDR                                0x9000405C
 Y.CREATE.L   MODEM_EDGE_CLK_CTL                                          0x9000405C
 Y.CREATE.L   HWIO_MODEM_EDGE_MNCNTR_M_ADDR                               0x90004060
 Y.CREATE.L   MODEM_EDGE_MNCNTR_M                                         0x90004060
 Y.CREATE.L   HWIO_MODEM_EDGE_MNCNTR_NOT_2D_ADDR                          0x90004064
 Y.CREATE.L   MODEM_EDGE_MNCNTR_NOT_2D                                    0x90004064
 Y.CREATE.L   HWIO_MODEM_EDGE_MNCNTR_NOT_N_M_ADDR                         0x90004068
 Y.CREATE.L   MODEM_EDGE_MNCNTR_NOT_N_M                                   0x90004068
 Y.CREATE.L   HWIO_MODEM_WCDMA_CHIPXN_MNCTNR_UPDATE_ADDR                  0x9000406C
 Y.CREATE.L   MODEM_WCDMA_CHIPXN_MNCTNR_UPDATE                            0x9000406C
 Y.CREATE.L   HWIO_MODEM_WEB_CLK_CTL_ADDR                                 0x9000408C
 Y.CREATE.L   MODEM_WEB_CLK_CTL                                           0x9000408C
 Y.CREATE.L   HWIO_MODEM_CHIPXN_CLK_MISC_CTL_ADDR                         0x90004090
 Y.CREATE.L   MODEM_CHIPXN_CLK_MISC_CTL                                   0x90004090
 Y.CREATE.L   HWIO_MODEM_CLK_MISC_CTL_ADDR                                0x90004094
 Y.CREATE.L   MODEM_CLK_MISC_CTL                                          0x90004094
 Y.CREATE.L   HWIO_MODEM_CLK_MISC_CTL_2_ADDR                              0x90004098
 Y.CREATE.L   MODEM_CLK_MISC_CTL_2                                        0x90004098
 Y.CREATE.L   HWIO_MODEM_CLK_MDSP_FS_CTL_ADDR                             0x9000409C
 Y.CREATE.L   MODEM_CLK_MDSP_FS_CTL                                       0x9000409C
 Y.CREATE.L   HWIO_MODEM_CLK_STATUS_RD_ADDR                               0x900040A0
 Y.CREATE.L   MODEM_CLK_STATUS_RD                                         0x900040A0
 Y.CREATE.L   HWIO_MODEM_CLK_STATUS_RD_2_ADDR                             0x900040A4
 Y.CREATE.L   MODEM_CLK_STATUS_RD_2                                       0x900040A4
 Y.CREATE.L   HWIO_MODEM_CLK_TEST_ADDR                                    0x900040A8
 Y.CREATE.L   MODEM_CLK_TEST                                              0x900040A8
 Y.CREATE.L   HWIO_MODEM_CLK_TEST_2_ADDR                                  0x900040AC
 Y.CREATE.L   MODEM_CLK_TEST_2                                            0x900040AC
 Y.CREATE.L   HWIO_MODEM_CDMA_CHIPXN_MNCNTR_M_ADDR                        0x900040B0
 Y.CREATE.L   MODEM_CDMA_CHIPXN_MNCNTR_M                                  0x900040B0
 Y.CREATE.L   HWIO_MODEM_CDMA_CHIPXN_MNCNTR_NOT_2D_ADDR                   0x900040B4
 Y.CREATE.L   MODEM_CDMA_CHIPXN_MNCNTR_NOT_2D                             0x900040B4
 Y.CREATE.L   HWIO_MODEM_CDMA_CHIPXN_MNCNTR_NOT_N_M_ADDR                  0x900040B8
 Y.CREATE.L   MODEM_CDMA_CHIPXN_MNCNTR_NOT_N_M                            0x900040B8
 Y.CREATE.L   HWIO_MODEM_CDMA_CHIPXN_MNCTNR_UPDATE_ADDR                   0x900040BC
 Y.CREATE.L   MODEM_CDMA_CHIPXN_MNCTNR_UPDATE                             0x900040BC
 Y.CREATE.L   HWIO_MODEM_WCDMA_CHIPXN_MNCNTR_M_ADDR                       0x900040C0
 Y.CREATE.L   MODEM_WCDMA_CHIPXN_MNCNTR_M                                 0x900040C0
 Y.CREATE.L   HWIO_MODEM_WCDMA_CHIPXN_MNCNTR_NOT_2D_ADDR                  0x900040C4
 Y.CREATE.L   MODEM_WCDMA_CHIPXN_MNCNTR_NOT_2D                            0x900040C4
 Y.CREATE.L   HWIO_MODEM_WCDMA_CHIPXN_MNCNTR_NOT_N_M_ADDR                 0x900040C8
 Y.CREATE.L   MODEM_WCDMA_CHIPXN_MNCNTR_NOT_N_M                           0x900040C8
 Y.CREATE.L   HWIO_MODEM_GPS_MNCNTR_UPDATE_ADDR                           0x900040CC
 Y.CREATE.L   MODEM_GPS_MNCNTR_UPDATE                                     0x900040CC
 Y.CREATE.L   HWIO_MDSP_MNCNTR_MD_ADDR                                    0x900040D0
 Y.CREATE.L   MDSP_MNCNTR_MD                                              0x900040D0
 Y.CREATE.L   HWIO_MDSP_MNCNTR_NS_ADDR                                    0x900040D4
 Y.CREATE.L   MDSP_MNCNTR_NS                                              0x900040D4
 Y.CREATE.L   HWIO_MDSP_ACTIVE_MD_RD_ADDR                                 0x900040D8
 Y.CREATE.L   MDSP_ACTIVE_MD_RD                                           0x900040D8
 Y.CREATE.L   HWIO_MDSP_ACTIVE_NS_RD_ADDR                                 0x900040DC
 Y.CREATE.L   MDSP_ACTIVE_NS_RD                                           0x900040DC
 Y.CREATE.L   HWIO_MDSP_CLK_SWITCH_ADDR                                   0x900040E0
 Y.CREATE.L   MDSP_CLK_SWITCH                                             0x900040E0
 Y.CREATE.L   HWIO_MODEM_CLK_DYN_SW_BYPASS_ADDR                           0x900040E4
 Y.CREATE.L   MODEM_CLK_DYN_SW_BYPASS                                     0x900040E4
 Y.CREATE.L   HWIO_MODEM_CLK_DYN_SW_SPARE_READ_REG0_ADDR                  0x900040E8
 Y.CREATE.L   MODEM_CLK_DYN_SW_SPARE_READ_REG0                            0x900040E8
 Y.CREATE.L   HWIO_MODEM_CDXO_CTL_ADDR                                    0x900040EC
 Y.CREATE.L   MODEM_CDXO_CTL                                              0x900040EC
 Y.CREATE.L   HWIO_MODEM_CDXO_Y_CUT_CNTR_CTL_ADDR                         0x900040F0
 Y.CREATE.L   MODEM_CDXO_Y_CUT_CNTR_CTL                                   0x900040F0
 Y.CREATE.L   HWIO_MODEM_CDXO_AT_CUT_CNTR_ADDR                            0x900040F4
 Y.CREATE.L   MODEM_CDXO_AT_CUT_CNTR                                      0x900040F4
 Y.CREATE.L   HWIO_MODEM_CLK_SSBI_CLK_CTL_ADDR                            0x900040F8
 Y.CREATE.L   MODEM_CLK_SSBI_CLK_CTL                                      0x900040F8
 Y.CREATE.L   HWIO_MODEM_EDGE_SWC_CNT_ADDR                                0x900040FC
 Y.CREATE.L   MODEM_EDGE_SWC_CNT                                          0x900040FC
 Y.CREATE.L   HWIO_SLEEP0_RTC_ARM_ADDR                                    0x90004200
 Y.CREATE.L   SLEEP0_RTC_ARM                                              0x90004200
 Y.CREATE.L   HWIO_SLEEP1_RTC_ARM_ADDR                                    0x90004244
 Y.CREATE.L   SLEEP1_RTC_ARM                                              0x90004244
 Y.CREATE.L   HWIO_SLEEP2_RTC_ARM_ADDR                                    0x90004288
 Y.CREATE.L   SLEEP2_RTC_ARM                                              0x90004288
 Y.CREATE.L   HWIO_SLEEP0_MICRO_START_ADDR                                0x90004204
 Y.CREATE.L   SLEEP0_MICRO_START                                          0x90004204
 Y.CREATE.L   HWIO_SLEEP1_MICRO_START_ADDR                                0x90004248
 Y.CREATE.L   SLEEP1_MICRO_START                                          0x90004248
 Y.CREATE.L   HWIO_SLEEP2_MICRO_START_ADDR                                0x9000428C
 Y.CREATE.L   SLEEP2_MICRO_START                                          0x9000428C
 Y.CREATE.L   HWIO_SLEEP0_FINE_TIME_ADDR                                  0x90004208
 Y.CREATE.L   SLEEP0_FINE_TIME                                            0x90004208
 Y.CREATE.L   HWIO_SLEEP1_FINE_TIME_ADDR                                  0x9000424C
 Y.CREATE.L   SLEEP1_FINE_TIME                                            0x9000424C
 Y.CREATE.L   HWIO_SLEEP2_FINE_TIME_ADDR                                  0x90004290
 Y.CREATE.L   SLEEP2_FINE_TIME                                            0x90004290
 Y.CREATE.L   HWIO_SLEEP0_COARSE_TIME_ADDR                                0x9000420C
 Y.CREATE.L   SLEEP0_COARSE_TIME                                          0x9000420C
 Y.CREATE.L   HWIO_SLEEP1_COARSE_TIME_ADDR                                0x90004250
 Y.CREATE.L   SLEEP1_COARSE_TIME                                          0x90004250
 Y.CREATE.L   HWIO_SLEEP2_COARSE_TIME_ADDR                                0x90004294
 Y.CREATE.L   SLEEP2_COARSE_TIME                                          0x90004294
 Y.CREATE.L   HWIO_SLEEP0_COARSE_TIME_LATCH_ADDR                          0x90004210
 Y.CREATE.L   SLEEP0_COARSE_TIME_LATCH                                    0x90004210
 Y.CREATE.L   HWIO_SLEEP1_COARSE_TIME_LATCH_ADDR                          0x90004254
 Y.CREATE.L   SLEEP1_COARSE_TIME_LATCH                                    0x90004254
 Y.CREATE.L   HWIO_SLEEP2_COARSE_TIME_LATCH_ADDR                          0x90004298
 Y.CREATE.L   SLEEP2_COARSE_TIME_LATCH                                    0x90004298
 Y.CREATE.L   HWIO_SLEEP0_WAKEUP_TIME_ADDR                                0x90004214
 Y.CREATE.L   SLEEP0_WAKEUP_TIME                                          0x90004214
 Y.CREATE.L   HWIO_SLEEP1_WAKEUP_TIME_ADDR                                0x90004258
 Y.CREATE.L   SLEEP1_WAKEUP_TIME                                          0x90004258
 Y.CREATE.L   HWIO_SLEEP2_WAKEUP_TIME_ADDR                                0x9000429C
 Y.CREATE.L   SLEEP2_WAKEUP_TIME                                          0x9000429C
 Y.CREATE.L   HWIO_SLEEP0_WAKEUP_TIME_LATCH_ADDR                          0x90004218
 Y.CREATE.L   SLEEP0_WAKEUP_TIME_LATCH                                    0x90004218
 Y.CREATE.L   HWIO_SLEEP1_WAKEUP_TIME_LATCH_ADDR                          0x9000425C
 Y.CREATE.L   SLEEP1_WAKEUP_TIME_LATCH                                    0x9000425C
 Y.CREATE.L   HWIO_SLEEP2_WAKEUP_TIME_LATCH_ADDR                          0x900042A0
 Y.CREATE.L   SLEEP2_WAKEUP_TIME_LATCH                                    0x900042A0
 Y.CREATE.L   HWIO_SLEEP0_FINE_COUNT_VAL_ADDR                             0x9000421C
 Y.CREATE.L   SLEEP0_FINE_COUNT_VAL                                       0x9000421C
 Y.CREATE.L   HWIO_SLEEP1_FINE_COUNT_VAL_ADDR                             0x90004260
 Y.CREATE.L   SLEEP1_FINE_COUNT_VAL                                       0x90004260
 Y.CREATE.L   HWIO_SLEEP2_FINE_COUNT_VAL_ADDR                             0x900042A4
 Y.CREATE.L   SLEEP2_FINE_COUNT_VAL                                       0x900042A4
 Y.CREATE.L   HWIO_SLEEP0_COARSE_COUNT_VAL_ADDR                           0x90004220
 Y.CREATE.L   SLEEP0_COARSE_COUNT_VAL                                     0x90004220
 Y.CREATE.L   HWIO_SLEEP1_COARSE_COUNT_VAL_ADDR                           0x90004264
 Y.CREATE.L   SLEEP1_COARSE_COUNT_VAL                                     0x90004264
 Y.CREATE.L   HWIO_SLEEP2_COARSE_COUNT_VAL_ADDR                           0x900042A8
 Y.CREATE.L   SLEEP2_COARSE_COUNT_VAL                                     0x900042A8
 Y.CREATE.L   HWIO_SLEEP0_STATUS_ADDR                                     0x90004224
 Y.CREATE.L   SLEEP0_STATUS                                               0x90004224
 Y.CREATE.L   HWIO_SLEEP1_STATUS_ADDR                                     0x90004268
 Y.CREATE.L   SLEEP1_STATUS                                               0x90004268
 Y.CREATE.L   HWIO_SLEEP2_STATUS_ADDR                                     0x900042AC
 Y.CREATE.L   SLEEP2_STATUS                                               0x900042AC
 Y.CREATE.L   HWIO_SLEEP0_MODEM_STATUS_ENABLE_ADDR                        0x9000422C
 Y.CREATE.L   SLEEP0_MODEM_STATUS_ENABLE                                  0x9000422C
 Y.CREATE.L   HWIO_SLEEP1_MODEM_STATUS_ENABLE_ADDR                        0x90004270
 Y.CREATE.L   SLEEP1_MODEM_STATUS_ENABLE                                  0x90004270
 Y.CREATE.L   HWIO_SLEEP2_MODEM_STATUS_ENABLE_ADDR                        0x900042B4
 Y.CREATE.L   SLEEP2_MODEM_STATUS_ENABLE                                  0x900042B4
 Y.CREATE.L   HWIO_SLEEP0_INT_EN_ADDR                                     0x90004230
 Y.CREATE.L   SLEEP0_INT_EN                                               0x90004230
 Y.CREATE.L   HWIO_SLEEP1_INT_EN_ADDR                                     0x90004274
 Y.CREATE.L   SLEEP1_INT_EN                                               0x90004274
 Y.CREATE.L   HWIO_SLEEP2_INT_EN_ADDR                                     0x900042B8
 Y.CREATE.L   SLEEP2_INT_EN                                               0x900042B8
 Y.CREATE.L   HWIO_FEE_SLEEP_XTAL_COUNT_ADDR                              0x900042BC
 Y.CREATE.L   FEE_SLEEP_XTAL_COUNT                                        0x900042BC
 Y.CREATE.L   HWIO_FEE_SLEEP_XTAL_FREQ_ERR_ADDR                           0x900042C0
 Y.CREATE.L   FEE_SLEEP_XTAL_FREQ_ERR                                     0x900042C0
 Y.CREATE.L   HWIO_MODEM_SBI0_CLK_EN_ADDR                                 0x90004500
 Y.CREATE.L   MODEM_SBI0_CLK_EN                                           0x90004500
 Y.CREATE.L   HWIO_MODEM_SBI1_CLK_EN_ADDR                                 0x90004540
 Y.CREATE.L   MODEM_SBI1_CLK_EN                                           0x90004540
 Y.CREATE.L   HWIO_MODEM_SBI0_CGC_HW_EN_ADDR                              0x90004504
 Y.CREATE.L   MODEM_SBI0_CGC_HW_EN                                        0x90004504
 Y.CREATE.L   HWIO_MODEM_SBI1_CGC_HW_EN_ADDR                              0x90004544
 Y.CREATE.L   MODEM_SBI1_CGC_HW_EN                                        0x90004544
 Y.CREATE.L   HWIO_MODEM_SBI0_CLK_CTL_ADDR                                0x90004508
 Y.CREATE.L   MODEM_SBI0_CLK_CTL                                          0x90004508
 Y.CREATE.L   HWIO_MODEM_SBI1_CLK_CTL_ADDR                                0x90004548
 Y.CREATE.L   MODEM_SBI1_CLK_CTL                                          0x90004548
 Y.CREATE.L   HWIO_MODEM_SBI0_CTL_ADDR                                    0x9000450C
 Y.CREATE.L   MODEM_SBI0_CTL                                              0x9000450C
 Y.CREATE.L   HWIO_MODEM_SBI1_CTL_ADDR                                    0x9000454C
 Y.CREATE.L   MODEM_SBI1_CTL                                              0x9000454C
 Y.CREATE.L   HWIO_MODEM_SBI0_BYPASS_WR_ADDR                              0x90004510
 Y.CREATE.L   MODEM_SBI0_BYPASS_WR                                        0x90004510
 Y.CREATE.L   HWIO_MODEM_SBI1_BYPASS_WR_ADDR                              0x90004550
 Y.CREATE.L   MODEM_SBI1_BYPASS_WR                                        0x90004550
 Y.CREATE.L   HWIO_MODEM_SBI0_WR_ADDR                                     0x90004514
 Y.CREATE.L   MODEM_SBI0_WR                                               0x90004514
 Y.CREATE.L   HWIO_MODEM_SBI1_WR_ADDR                                     0x90004554
 Y.CREATE.L   MODEM_SBI1_WR                                               0x90004554
 Y.CREATE.L   HWIO_MODEM_SBI0_START_CTL_ADDR                              0x90004518
 Y.CREATE.L   MODEM_SBI0_START_CTL                                        0x90004518
 Y.CREATE.L   HWIO_MODEM_SBI1_START_CTL_ADDR                              0x90004558
 Y.CREATE.L   MODEM_SBI1_START_CTL                                        0x90004558
 Y.CREATE.L   HWIO_MODEM_SBI0_SECOND_IDCODE_ADDR                          0x9000451C
 Y.CREATE.L   MODEM_SBI0_SECOND_IDCODE                                    0x9000451C
 Y.CREATE.L   HWIO_MODEM_SBI1_SECOND_IDCODE_ADDR                          0x9000455C
 Y.CREATE.L   MODEM_SBI1_SECOND_IDCODE                                    0x9000455C
 Y.CREATE.L   HWIO_MODEM_SBI0_STATUS_ADDR                                 0x90004524
 Y.CREATE.L   MODEM_SBI0_STATUS                                           0x90004524
 Y.CREATE.L   HWIO_MODEM_SBI1_STATUS_ADDR                                 0x90004564
 Y.CREATE.L   MODEM_SBI1_STATUS                                           0x90004564
 Y.CREATE.L   HWIO_MODEM_SBI0_BYPASS_RD_ADDR                              0x90004528
 Y.CREATE.L   MODEM_SBI0_BYPASS_RD                                        0x90004528
 Y.CREATE.L   HWIO_MODEM_SBI1_BYPASS_RD_ADDR                              0x90004568
 Y.CREATE.L   MODEM_SBI1_BYPASS_RD                                        0x90004568
 Y.CREATE.L   HWIO_MODEM_SBI0_RD_ADDR                                     0x9000452C
 Y.CREATE.L   MODEM_SBI0_RD                                               0x9000452C
 Y.CREATE.L   HWIO_MODEM_SBI1_RD_ADDR                                     0x9000456C
 Y.CREATE.L   MODEM_SBI1_RD                                               0x9000456C
 Y.CREATE.L   HWIO_MODEM_SBI0_RD1_ADDR                                    0x90004530
 Y.CREATE.L   MODEM_SBI0_RD1                                              0x90004530
 Y.CREATE.L   HWIO_MODEM_SBI1_RD1_ADDR                                    0x90004570
 Y.CREATE.L   MODEM_SBI1_RD1                                              0x90004570
 Y.CREATE.L   HWIO_MODEM_SBI0_RD2_ADDR                                    0x90004534
 Y.CREATE.L   MODEM_SBI0_RD2                                              0x90004534
 Y.CREATE.L   HWIO_MODEM_SBI1_RD2_ADDR                                    0x90004574
 Y.CREATE.L   MODEM_SBI1_RD2                                              0x90004574
 Y.CREATE.L   HWIO_MODEM_SSBI0_CLK_EN_ADDR                                0x900045E0
 Y.CREATE.L   MODEM_SSBI0_CLK_EN                                          0x900045E0
 Y.CREATE.L   HWIO_MODEM_SSBI1_CLK_EN_ADDR                                0x900045E4
 Y.CREATE.L   MODEM_SSBI1_CLK_EN                                          0x900045E4
 Y.CREATE.L   HWIO_MODEM_SSBI2_CLK_EN_ADDR                                0x900045E8
 Y.CREATE.L   MODEM_SSBI2_CLK_EN                                          0x900045E8
 Y.CREATE.L   HWIO_MODEM_SSBI0_CGC_HW_EN_ADDR                             0x900045F0
 Y.CREATE.L   MODEM_SSBI0_CGC_HW_EN                                       0x900045F0
 Y.CREATE.L   HWIO_MODEM_SSBI1_CGC_HW_EN_ADDR                             0x900045F4
 Y.CREATE.L   MODEM_SSBI1_CGC_HW_EN                                       0x900045F4
 Y.CREATE.L   HWIO_MODEM_SSBI2_CGC_HW_EN_ADDR                             0x900045F8
 Y.CREATE.L   MODEM_SSBI2_CGC_HW_EN                                       0x900045F8
 Y.CREATE.L   HWIO_MODEM_SSBI0_CTL_ADDR                                   0x90004580
 Y.CREATE.L   MODEM_SSBI0_CTL                                             0x90004580
 Y.CREATE.L   HWIO_MODEM_SSBI1_CTL_ADDR                                   0x900045A0
 Y.CREATE.L   MODEM_SSBI1_CTL                                             0x900045A0
 Y.CREATE.L   HWIO_MODEM_SSBI2_CTL_ADDR                                   0x900045C0
 Y.CREATE.L   MODEM_SSBI2_CTL                                             0x900045C0
 Y.CREATE.L   HWIO_MODEM_SSBI0_RESET_ADDR                                 0x90004584
 Y.CREATE.L   MODEM_SSBI0_RESET                                           0x90004584
 Y.CREATE.L   HWIO_MODEM_SSBI1_RESET_ADDR                                 0x900045A4
 Y.CREATE.L   MODEM_SSBI1_RESET                                           0x900045A4
 Y.CREATE.L   HWIO_MODEM_SSBI2_RESET_ADDR                                 0x900045C4
 Y.CREATE.L   MODEM_SSBI2_RESET                                           0x900045C4
 Y.CREATE.L   HWIO_MODEM_SSBI0_CMD_ADDR                                   0x90004588
 Y.CREATE.L   MODEM_SSBI0_CMD                                             0x90004588
 Y.CREATE.L   HWIO_MODEM_SSBI1_CMD_ADDR                                   0x900045A8
 Y.CREATE.L   MODEM_SSBI1_CMD                                             0x900045A8
 Y.CREATE.L   HWIO_MODEM_SSBI2_CMD_ADDR                                   0x900045C8
 Y.CREATE.L   MODEM_SSBI2_CMD                                             0x900045C8
 Y.CREATE.L   HWIO_MODEM_SSBI0_BYPASS_ADDR                                0x9000458C
 Y.CREATE.L   MODEM_SSBI0_BYPASS                                          0x9000458C
 Y.CREATE.L   HWIO_MODEM_SSBI1_BYPASS_ADDR                                0x900045AC
 Y.CREATE.L   MODEM_SSBI1_BYPASS                                          0x900045AC
 Y.CREATE.L   HWIO_MODEM_SSBI2_BYPASS_ADDR                                0x900045CC
 Y.CREATE.L   MODEM_SSBI2_BYPASS                                          0x900045CC
 Y.CREATE.L   HWIO_MODEM_SSBI0_PRIORITIES_ADDR                            0x90004598
 Y.CREATE.L   MODEM_SSBI0_PRIORITIES                                      0x90004598
 Y.CREATE.L   HWIO_MODEM_SSBI1_PRIORITIES_ADDR                            0x900045B8
 Y.CREATE.L   MODEM_SSBI1_PRIORITIES                                      0x900045B8
 Y.CREATE.L   HWIO_MODEM_SSBI2_PRIORITIES_ADDR                            0x900045D8
 Y.CREATE.L   MODEM_SSBI2_PRIORITIES                                      0x900045D8
 Y.CREATE.L   HWIO_MODEM_SSBI0_RD_ADDR                                    0x90004590
 Y.CREATE.L   MODEM_SSBI0_RD                                              0x90004590
 Y.CREATE.L   HWIO_MODEM_SSBI1_RD_ADDR                                    0x900045B0
 Y.CREATE.L   MODEM_SSBI1_RD                                              0x900045B0
 Y.CREATE.L   HWIO_MODEM_SSBI2_RD_ADDR                                    0x900045D0
 Y.CREATE.L   MODEM_SSBI2_RD                                              0x900045D0
 Y.CREATE.L   HWIO_MODEM_SSBI0_STATUS_ADDR                                0x90004594
 Y.CREATE.L   MODEM_SSBI0_STATUS                                          0x90004594
 Y.CREATE.L   HWIO_MODEM_SSBI1_STATUS_ADDR                                0x900045B4
 Y.CREATE.L   MODEM_SSBI1_STATUS                                          0x900045B4
 Y.CREATE.L   HWIO_MODEM_SSBI2_STATUS_ADDR                                0x900045D4
 Y.CREATE.L   MODEM_SSBI2_STATUS                                          0x900045D4
 Y.CREATE.L   HWIO_MODEM_SBI_PIN_CFG_ADDR                                 0x90004600
 Y.CREATE.L   MODEM_SBI_PIN_CFG                                           0x90004600
 Y.CREATE.L   HWIO_MODEM_SBI_INOUT_CONFIG_ADDR                            0x90004604
 Y.CREATE.L   MODEM_SBI_INOUT_CONFIG                                      0x90004604
 Y.CREATE.L   HWIO_MODEM_SBI_RXF_AGC_CONFIG_ADDR                          0x90004608
 Y.CREATE.L   MODEM_SBI_RXF_AGC_CONFIG                                    0x90004608
 Y.CREATE.L   HWIO_MODEM_SBI_INTR_MASK_ADDR                               0x9000460C
 Y.CREATE.L   MODEM_SBI_INTR_MASK                                         0x9000460C
 Y.CREATE.L   HWIO_MODEM_SBI_INTR_CLEAR_ADDR                              0x90004610
 Y.CREATE.L   MODEM_SBI_INTR_CLEAR                                        0x90004610
 Y.CREATE.L   HWIO_MODEM_SBI_INTR_STATUS_ADDR                             0x90004614
 Y.CREATE.L   MODEM_SBI_INTR_STATUS                                       0x90004614
 Y.CREATE.L   HWIO_MODEM_SBI_BUGFIX_DISABLE_ADDR                          0x90004618
 Y.CREATE.L   MODEM_SBI_BUGFIX_DISABLE                                    0x90004618
 Y.CREATE.L   HWIO_MODEM_SBI_EXT_SSBI_CLK_FORCE_ON_ADDR                   0x9000461C
 Y.CREATE.L   MODEM_SBI_EXT_SSBI_CLK_FORCE_ON                             0x9000461C
 Y.CREATE.L   HWIO_MODEM_SBI_EXT_SSBI_CLK_DLY_ADDR                        0x90004620
 Y.CREATE.L   MODEM_SBI_EXT_SSBI_CLK_DLY                                  0x90004620
 Y.CREATE.L   HWIO_MODEM_HW_REV_RD_ADDR                                   0x90004800
 Y.CREATE.L   MODEM_HW_REV_RD                                             0x90004800
 Y.CREATE.L   HWIO_BT_SLP_CTL_CMD_ADDR                                    0x90004804
 Y.CREATE.L   BT_SLP_CTL_CMD                                              0x90004804
 Y.CREATE.L   HWIO_MODEM_MISC_CFG0_ADDR                                   0x90004808
 Y.CREATE.L   MODEM_MISC_CFG0                                             0x90004808
 Y.CREATE.L   HWIO_MODEM_MISC_CFG1_ADDR                                   0x9000480C
 Y.CREATE.L   MODEM_MISC_CFG1                                             0x9000480C
 Y.CREATE.L   HWIO_MODEM_MISC_CFG2_ADDR                                   0x90004810
 Y.CREATE.L   MODEM_MISC_CFG2                                             0x90004810
 Y.CREATE.L   HWIO_MODEM_TX_DAC_SLEEP_ADDR                                0x90004814
 Y.CREATE.L   MODEM_TX_DAC_SLEEP                                          0x90004814
 Y.CREATE.L   HWIO_MODEM_DBG_BUS_OUT_GATING_ADDR                          0x90004818
 Y.CREATE.L   MODEM_DBG_BUS_OUT_GATING                                    0x90004818
 Y.CREATE.L   HWIO_SAMPLING_RESET_ADDR                                    0x9000481C
 Y.CREATE.L   SAMPLING_RESET                                              0x9000481C
 Y.CREATE.L   HWIO_MODEM_WEB_SPARE_READ_REG0_ADDR                         0x90004820
 Y.CREATE.L   MODEM_WEB_SPARE_READ_REG0                                   0x90004820
 Y.CREATE.L   HWIO_MODEM_GENERIC_CTL_REG_ADDR                             0x90004824
 Y.CREATE.L   MODEM_GENERIC_CTL_REG                                       0x90004824
 Y.CREATE.L   HWIO_MODEM_BRIDGE_TIMEOUT_CFG_ADDR                          0x90004828
 Y.CREATE.L   MODEM_BRIDGE_TIMEOUT_CFG                                    0x90004828
 Y.CREATE.L   HWIO_MODEM_PA_ON_STATUS_ADDR                                0x9000482C
 Y.CREATE.L   MODEM_PA_ON_STATUS                                          0x9000482C
 Y.CREATE.L   HWIO_MODEM_PA_ON_CTL_ADDR                                   0x90004830
 Y.CREATE.L   MODEM_PA_ON_CTL                                             0x90004830
 Y.CREATE.L   HWIO_MODEM_PA_ON_PROTECTION_ADDR                            0x90004834
 Y.CREATE.L   MODEM_PA_ON_PROTECTION                                      0x90004834
 Y.CREATE.L   HWIO_MDM_SEC_DOMAIN_CFG_ADDR                                0x90004838
 Y.CREATE.L   MDM_SEC_DOMAIN_CFG                                          0x90004838
 Y.CREATE.L   HWIO_MODEM_WEB_DBG_BUS_SEL_ADDR                             0x9000483C
 Y.CREATE.L   MODEM_WEB_DBG_BUS_SEL                                       0x9000483C
 Y.CREATE.L   HWIO_MODEM_OUTPORT_OVERRIDE0_ADDR                           0x90004840
 Y.CREATE.L   MODEM_OUTPORT_OVERRIDE0                                     0x90004840
 Y.CREATE.L   HWIO_MODEM_OUTPORT_OVERRIDE1_ADDR                           0x90004844
 Y.CREATE.L   MODEM_OUTPORT_OVERRIDE1                                     0x90004844
 Y.CREATE.L   HWIO_MODEM_OUTPORT_OVERRIDE2_ADDR                           0x90004848
 Y.CREATE.L   MODEM_OUTPORT_OVERRIDE2                                     0x90004848
 Y.CREATE.L   HWIO_MODEM_OUTPORT_OVERRIDE3_ADDR                           0x9000484C
 Y.CREATE.L   MODEM_OUTPORT_OVERRIDE3                                     0x9000484C
 Y.CREATE.L   HWIO_MODEM_OUTPORT_OVERRIDE4_ADDR                           0x90004850
 Y.CREATE.L   MODEM_OUTPORT_OVERRIDE4                                     0x90004850
 Y.CREATE.L   HWIO_MODEM_OUTPORT_OVERRIDE5_ADDR                           0x90004854
 Y.CREATE.L   MODEM_OUTPORT_OVERRIDE5                                     0x90004854
 Y.CREATE.L   HWIO_MODEM_OUTPORT_OVERRIDE_EN_ADDR                         0x90004858
 Y.CREATE.L   MODEM_OUTPORT_OVERRIDE_EN                                   0x90004858
 Y.CREATE.L   HWIO_MODEM_INPORT_RD_DATA0_ADDR                             0x9000485C
 Y.CREATE.L   MODEM_INPORT_RD_DATA0                                       0x9000485C
 Y.CREATE.L   HWIO_MODEM_INPORT_RD_DATA1_ADDR                             0x90004860
 Y.CREATE.L   MODEM_INPORT_RD_DATA1                                       0x90004860
 Y.CREATE.L   HWIO_MODEM_INPORT_RD_DATA2_ADDR                             0x90004864
 Y.CREATE.L   MODEM_INPORT_RD_DATA2                                       0x90004864
 Y.CREATE.L   HWIO_AGC_CARRIER_FREQ_ERR_ADDR                              0x90004868
 Y.CREATE.L   AGC_CARRIER_FREQ_ERR                                        0x90004868
 Y.CREATE.L   HWIO_AGC_FREQ_COMB_CTL_ADDR                                 0x9000486C
 Y.CREATE.L   AGC_FREQ_COMB_CTL                                           0x9000486C
 Y.CREATE.L   HWIO_RXF_SRC0_BBF_COEF0_ADDR                                0x90004B00
 Y.CREATE.L   RXF_SRC0_BBF_COEF0                                          0x90004B00
 Y.CREATE.L   HWIO_RXF_SRC1_BBF_COEF0_ADDR                                0x90004C00
 Y.CREATE.L   RXF_SRC1_BBF_COEF0                                          0x90004C00
 Y.CREATE.L   HWIO_RXF_SRC0_BBF_COEF1_ADDR                                0x90004B04
 Y.CREATE.L   RXF_SRC0_BBF_COEF1                                          0x90004B04
 Y.CREATE.L   HWIO_RXF_SRC1_BBF_COEF1_ADDR                                0x90004C04
 Y.CREATE.L   RXF_SRC1_BBF_COEF1                                          0x90004C04
 Y.CREATE.L   HWIO_RXF_SRC0_BBF_COEF_NOTCH0_ADDR                          0x90004B08
 Y.CREATE.L   RXF_SRC0_BBF_COEF_NOTCH0                                    0x90004B08
 Y.CREATE.L   HWIO_RXF_SRC1_BBF_COEF_NOTCH0_ADDR                          0x90004C08
 Y.CREATE.L   RXF_SRC1_BBF_COEF_NOTCH0                                    0x90004C08
 Y.CREATE.L   HWIO_RXF_SRC0_BBF_COEF_NOTCH1_ADDR                          0x90004B0C
 Y.CREATE.L   RXF_SRC0_BBF_COEF_NOTCH1                                    0x90004B0C
 Y.CREATE.L   HWIO_RXF_SRC1_BBF_COEF_NOTCH1_ADDR                          0x90004C0C
 Y.CREATE.L   RXF_SRC1_BBF_COEF_NOTCH1                                    0x90004C0C
 Y.CREATE.L   HWIO_RXF_SRC0_BBF_COEF_NOTCH2_ADDR                          0x90004B10
 Y.CREATE.L   RXF_SRC0_BBF_COEF_NOTCH2                                    0x90004B10
 Y.CREATE.L   HWIO_RXF_SRC1_BBF_COEF_NOTCH2_ADDR                          0x90004C10
 Y.CREATE.L   RXF_SRC1_BBF_COEF_NOTCH2                                    0x90004C10
 Y.CREATE.L   HWIO_RXF_SRC0_OFFSET_CTL_ADDR                               0x90004B14
 Y.CREATE.L   RXF_SRC0_OFFSET_CTL                                         0x90004B14
 Y.CREATE.L   HWIO_RXF_SRC1_OFFSET_CTL_ADDR                               0x90004C14
 Y.CREATE.L   RXF_SRC1_OFFSET_CTL                                         0x90004C14
 Y.CREATE.L   HWIO_RXF_SRC0_DACC_CTL_ADDR                                 0x90004B18
 Y.CREATE.L   RXF_SRC0_DACC_CTL                                           0x90004B18
 Y.CREATE.L   HWIO_RXF_SRC1_DACC_CTL_ADDR                                 0x90004C18
 Y.CREATE.L   RXF_SRC1_DACC_CTL                                           0x90004C18
 Y.CREATE.L   HWIO_RXF_SRC0_FG_IOFFSET_ADDR                               0x90004B1C
 Y.CREATE.L   RXF_SRC0_FG_IOFFSET                                         0x90004B1C
 Y.CREATE.L   HWIO_RXF_SRC1_FG_IOFFSET_ADDR                               0x90004C1C
 Y.CREATE.L   RXF_SRC1_FG_IOFFSET                                         0x90004C1C
 Y.CREATE.L   HWIO_RXF_SRC0_FG_QOFFSET_ADDR                               0x90004B20
 Y.CREATE.L   RXF_SRC0_FG_QOFFSET                                         0x90004B20
 Y.CREATE.L   HWIO_RXF_SRC1_FG_QOFFSET_ADDR                               0x90004C20
 Y.CREATE.L   RXF_SRC1_FG_QOFFSET                                         0x90004C20
 Y.CREATE.L   HWIO_RXF_SRC0_DC_IOFFSET_ADJ_ADDR                           0x90004B24
 Y.CREATE.L   RXF_SRC0_DC_IOFFSET_ADJ                                     0x90004B24
 Y.CREATE.L   HWIO_RXF_SRC1_DC_IOFFSET_ADJ_ADDR                           0x90004C24
 Y.CREATE.L   RXF_SRC1_DC_IOFFSET_ADJ                                     0x90004C24
 Y.CREATE.L   HWIO_RXF_SRC0_DC_QOFFSET_ADJ_ADDR                           0x90004B28
 Y.CREATE.L   RXF_SRC0_DC_QOFFSET_ADJ                                     0x90004B28
 Y.CREATE.L   HWIO_RXF_SRC1_DC_QOFFSET_ADJ_ADDR                           0x90004C28
 Y.CREATE.L   RXF_SRC1_DC_QOFFSET_ADJ                                     0x90004C28
 Y.CREATE.L   HWIO_RXF_SRC0_DACC_ACQ_TIMER_ADDR                           0x90004B2C
 Y.CREATE.L   RXF_SRC0_DACC_ACQ_TIMER                                     0x90004B2C
 Y.CREATE.L   HWIO_RXF_SRC1_DACC_ACQ_TIMER_ADDR                           0x90004C2C
 Y.CREATE.L   RXF_SRC1_DACC_ACQ_TIMER                                     0x90004C2C
 Y.CREATE.L   HWIO_RXF_SRC0_DACC_TRC_TIMER_ADDR                           0x90004B30
 Y.CREATE.L   RXF_SRC0_DACC_TRC_TIMER                                     0x90004B30
 Y.CREATE.L   HWIO_RXF_SRC1_DACC_TRC_TIMER_ADDR                           0x90004C30
 Y.CREATE.L   RXF_SRC1_DACC_TRC_TIMER                                     0x90004C30
 Y.CREATE.L   HWIO_RXF_SRC0_DACC_CLR_TIMER_ADDR                           0x90004B34
 Y.CREATE.L   RXF_SRC0_DACC_CLR_TIMER                                     0x90004B34
 Y.CREATE.L   HWIO_RXF_SRC1_DACC_CLR_TIMER_ADDR                           0x90004C34
 Y.CREATE.L   RXF_SRC1_DACC_CLR_TIMER                                     0x90004C34
 Y.CREATE.L   HWIO_RXF_SRC0_DACC_EST_THRESH_ADDR                          0x90004B38
 Y.CREATE.L   RXF_SRC0_DACC_EST_THRESH                                    0x90004B38
 Y.CREATE.L   HWIO_RXF_SRC1_DACC_EST_THRESH_ADDR                          0x90004C38
 Y.CREATE.L   RXF_SRC1_DACC_EST_THRESH                                    0x90004C38
 Y.CREATE.L   HWIO_RXF_SRC0_DACC_EST_IOFFSET_ADDR                         0x90004B3C
 Y.CREATE.L   RXF_SRC0_DACC_EST_IOFFSET                                   0x90004B3C
 Y.CREATE.L   HWIO_RXF_SRC1_DACC_EST_IOFFSET_ADDR                         0x90004C3C
 Y.CREATE.L   RXF_SRC1_DACC_EST_IOFFSET                                   0x90004C3C
 Y.CREATE.L   HWIO_RXF_SRC0_DACC_EST_QOFFSET_ADDR                         0x90004B40
 Y.CREATE.L   RXF_SRC0_DACC_EST_QOFFSET                                   0x90004B40
 Y.CREATE.L   HWIO_RXF_SRC1_DACC_EST_QOFFSET_ADDR                         0x90004C40
 Y.CREATE.L   RXF_SRC1_DACC_EST_QOFFSET                                   0x90004C40
 Y.CREATE.L   HWIO_RXF_SRC0_DACC_IACCUM0_ADDR                             0x90004B44
 Y.CREATE.L   RXF_SRC0_DACC_IACCUM0                                       0x90004B44
 Y.CREATE.L   HWIO_RXF_SRC1_DACC_IACCUM0_ADDR                             0x90004C44
 Y.CREATE.L   RXF_SRC1_DACC_IACCUM0                                       0x90004C44
 Y.CREATE.L   HWIO_RXF_SRC0_DACC_IACCUM1_ADDR                             0x90004B48
 Y.CREATE.L   RXF_SRC0_DACC_IACCUM1                                       0x90004B48
 Y.CREATE.L   HWIO_RXF_SRC1_DACC_IACCUM1_ADDR                             0x90004C48
 Y.CREATE.L   RXF_SRC1_DACC_IACCUM1                                       0x90004C48
 Y.CREATE.L   HWIO_RXF_SRC0_DACC_IACCUM2_ADDR                             0x90004B4C
 Y.CREATE.L   RXF_SRC0_DACC_IACCUM2                                       0x90004B4C
 Y.CREATE.L   HWIO_RXF_SRC1_DACC_IACCUM2_ADDR                             0x90004C4C
 Y.CREATE.L   RXF_SRC1_DACC_IACCUM2                                       0x90004C4C
 Y.CREATE.L   HWIO_RXF_SRC0_DACC_IACCUM3_ADDR                             0x90004B50
 Y.CREATE.L   RXF_SRC0_DACC_IACCUM3                                       0x90004B50
 Y.CREATE.L   HWIO_RXF_SRC1_DACC_IACCUM3_ADDR                             0x90004C50
 Y.CREATE.L   RXF_SRC1_DACC_IACCUM3                                       0x90004C50
 Y.CREATE.L   HWIO_RXF_SRC0_DACC_IACCUM4_ADDR                             0x90004B54
 Y.CREATE.L   RXF_SRC0_DACC_IACCUM4                                       0x90004B54
 Y.CREATE.L   HWIO_RXF_SRC1_DACC_IACCUM4_ADDR                             0x90004C54
 Y.CREATE.L   RXF_SRC1_DACC_IACCUM4                                       0x90004C54
 Y.CREATE.L   HWIO_RXF_SRC0_DACC_QACCUM0_ADDR                             0x90004B58
 Y.CREATE.L   RXF_SRC0_DACC_QACCUM0                                       0x90004B58
 Y.CREATE.L   HWIO_RXF_SRC1_DACC_QACCUM0_ADDR                             0x90004C58
 Y.CREATE.L   RXF_SRC1_DACC_QACCUM0                                       0x90004C58
 Y.CREATE.L   HWIO_RXF_SRC0_DACC_QACCUM1_ADDR                             0x90004B5C
 Y.CREATE.L   RXF_SRC0_DACC_QACCUM1                                       0x90004B5C
 Y.CREATE.L   HWIO_RXF_SRC1_DACC_QACCUM1_ADDR                             0x90004C5C
 Y.CREATE.L   RXF_SRC1_DACC_QACCUM1                                       0x90004C5C
 Y.CREATE.L   HWIO_RXF_SRC0_DACC_QACCUM2_ADDR                             0x90004B60
 Y.CREATE.L   RXF_SRC0_DACC_QACCUM2                                       0x90004B60
 Y.CREATE.L   HWIO_RXF_SRC1_DACC_QACCUM2_ADDR                             0x90004C60
 Y.CREATE.L   RXF_SRC1_DACC_QACCUM2                                       0x90004C60
 Y.CREATE.L   HWIO_RXF_SRC0_DACC_QACCUM3_ADDR                             0x90004B64
 Y.CREATE.L   RXF_SRC0_DACC_QACCUM3                                       0x90004B64
 Y.CREATE.L   HWIO_RXF_SRC1_DACC_QACCUM3_ADDR                             0x90004C64
 Y.CREATE.L   RXF_SRC1_DACC_QACCUM3                                       0x90004C64
 Y.CREATE.L   HWIO_RXF_SRC0_DACC_QACCUM4_ADDR                             0x90004B68
 Y.CREATE.L   RXF_SRC0_DACC_QACCUM4                                       0x90004B68
 Y.CREATE.L   HWIO_RXF_SRC1_DACC_QACCUM4_ADDR                             0x90004C68
 Y.CREATE.L   RXF_SRC1_DACC_QACCUM4                                       0x90004C68
 Y.CREATE.L   HWIO_RXF_SRC0_MICRO_DACC_UPDATE_ADDR                        0x90004B6C
 Y.CREATE.L   RXF_SRC0_MICRO_DACC_UPDATE                                  0x90004B6C
 Y.CREATE.L   HWIO_RXF_SRC1_MICRO_DACC_UPDATE_ADDR                        0x90004C6C
 Y.CREATE.L   RXF_SRC1_MICRO_DACC_UPDATE                                  0x90004C6C
 Y.CREATE.L   HWIO_RXF_SRC0_DACC_SSBI_INFO_ADDR                           0x90004B70
 Y.CREATE.L   RXF_SRC0_DACC_SSBI_INFO                                     0x90004B70
 Y.CREATE.L   HWIO_RXF_SRC1_DACC_SSBI_INFO_ADDR                           0x90004C70
 Y.CREATE.L   RXF_SRC1_DACC_SSBI_INFO                                     0x90004C70
 Y.CREATE.L   HWIO_RXF_SRC0_DACC_GAIN_MULT_ADDR                           0x90004B74
 Y.CREATE.L   RXF_SRC0_DACC_GAIN_MULT                                     0x90004B74
 Y.CREATE.L   HWIO_RXF_SRC1_DACC_GAIN_MULT_ADDR                           0x90004C74
 Y.CREATE.L   RXF_SRC1_DACC_GAIN_MULT                                     0x90004C74
 Y.CREATE.L   HWIO_RXF_SRC0_NOTCH_CFG_ADDR                                0x90004B78
 Y.CREATE.L   RXF_SRC0_NOTCH_CFG                                          0x90004B78
 Y.CREATE.L   HWIO_RXF_SRC1_NOTCH_CFG_ADDR                                0x90004C78
 Y.CREATE.L   RXF_SRC1_NOTCH_CFG                                          0x90004C78
 Y.CREATE.L   HWIO_RXF_SRC0_MICRO_SYNC_CMD_ADDR                           0x90004B7C
 Y.CREATE.L   RXF_SRC0_MICRO_SYNC_CMD                                     0x90004B7C
 Y.CREATE.L   HWIO_RXF_SRC1_MICRO_SYNC_CMD_ADDR                           0x90004C7C
 Y.CREATE.L   RXF_SRC1_MICRO_SYNC_CMD                                     0x90004C7C
 Y.CREATE.L   HWIO_RXF_SRC0_ARM_IRQ_STATUS_ADDR                           0x90004B80
 Y.CREATE.L   RXF_SRC0_ARM_IRQ_STATUS                                     0x90004B80
 Y.CREATE.L   HWIO_RXF_SRC1_ARM_IRQ_STATUS_ADDR                           0x90004B90
 Y.CREATE.L   RXF_SRC1_ARM_IRQ_STATUS                                     0x90004B90
 Y.CREATE.L   HWIO_UNUSED_MICRO_GSM_TIME_RD_ADDR                          0x90005000
 Y.CREATE.L   UNUSED_MICRO_GSM_TIME_RD                                    0x90005000
 Y.CREATE.L   HWIO_UNUSED_MICRO_IRQ_CONFIG_RW_ADDR                        0x90005004
 Y.CREATE.L   UNUSED_MICRO_IRQ_CONFIG_RW                                  0x90005004
 Y.CREATE.L   HWIO_UNUSED_GSM_TIME_LOAD_CTL_CMD_ADDR                      0x90005008
 Y.CREATE.L   UNUSED_GSM_TIME_LOAD_CTL_CMD                                0x90005008
 Y.CREATE.L   HWIO_UNUSED_GSM_TIME_TC_ADJ_CMD_ADDR                        0x9000500C
 Y.CREATE.L   UNUSED_GSM_TIME_TC_ADJ_CMD                                  0x9000500C
 Y.CREATE.L   HWIO_UNUSED_VFR_IRQ_ALIGN_CMD_ADDR                          0x90005010
 Y.CREATE.L   UNUSED_VFR_IRQ_ALIGN_CMD                                    0x90005010
 Y.CREATE.L   HWIO_UNUSED_ENABLE_GSTMR_DURING_SLEEP_ADDR                  0x90005014
 Y.CREATE.L   UNUSED_ENABLE_GSTMR_DURING_SLEEP                            0x90005014
 Y.CREATE.L   HWIO_UNUSED_GO_TO_SLEEP_CMD_ADDR                            0x90005018
 Y.CREATE.L   UNUSED_GO_TO_SLEEP_CMD                                      0x90005018
 Y.CREATE.L   HWIO_UNUSED_GSM_CORE_MICRO_RESET_REG_ADDR                   0x9000501C
 Y.CREATE.L   UNUSED_GSM_CORE_MICRO_RESET_REG                             0x9000501C
 Y.CREATE.L   HWIO_UNUSED_TEST_PT_CTL_RW_ADDR                             0x90005020
 Y.CREATE.L   UNUSED_TEST_PT_CTL_RW                                       0x90005020
 Y.CREATE.L   HWIO_UNUSED_GSM_DSP_WR_CLK_CTL_ADDR                         0x90005024
 Y.CREATE.L   UNUSED_GSM_DSP_WR_CLK_CTL                                   0x90005024
 Y.CREATE.L   HWIO_UNUSED_GSM_HYPERFRAME_LOAD_CTL_CMD_ADDR                0x90005028
 Y.CREATE.L   UNUSED_GSM_HYPERFRAME_LOAD_CTL_CMD                          0x90005028
 Y.CREATE.L   HWIO_UNUSED_GSM_FRAME_COUNT_RD_ADDR                         0x9000502C
 Y.CREATE.L   UNUSED_GSM_FRAME_COUNT_RD                                   0x9000502C
 Y.CREATE.L   HWIO_UNUSED_EDGE_CGC_ENA_ADDR                               0x90005030
 Y.CREATE.L   UNUSED_EDGE_CGC_ENA                                         0x90005030
 Y.CREATE.L   HWIO_UNUSED_GSM_TIME_SYNC_CTL_ADDR                          0x90005034
 Y.CREATE.L   UNUSED_GSM_TIME_SYNC_CTL                                    0x90005034
 Y.CREATE.L   HWIO_UNUSED_GSM_TIME_ON_LINE_ADDR                           0x90005038
 Y.CREATE.L   UNUSED_GSM_TIME_ON_LINE                                     0x90005038
 Y.CREATE.L   HWIO_UNUSED_GSM_WCDMA_SYNC_TIME_ADDR                        0x9000503C
 Y.CREATE.L   UNUSED_GSM_WCDMA_SYNC_TIME                                  0x9000503C
 Y.CREATE.L   HWIO_UNUSED_GSM_GPS_SYNC_TIME_ADDR                          0x90005040
 Y.CREATE.L   UNUSED_GSM_GPS_SYNC_TIME                                    0x90005040
 Y.CREATE.L   HWIO_UNUSED_GEA_CONFIG_0_ADDR                               0x90005044
 Y.CREATE.L   UNUSED_GEA_CONFIG_0                                         0x90005044
 Y.CREATE.L   HWIO_UNUSED_GEA_INPUT_ADDR                                  0x90005048
 Y.CREATE.L   UNUSED_GEA_INPUT                                            0x90005048
 Y.CREATE.L   HWIO_UNUSED_GEA_KC_0_ADDR                                   0x9000504C
 Y.CREATE.L   UNUSED_GEA_KC_0                                             0x9000504C
 Y.CREATE.L   HWIO_UNUSED_GEA_KC_1_ADDR                                   0x90005050
 Y.CREATE.L   UNUSED_GEA_KC_1                                             0x90005050
 Y.CREATE.L   HWIO_UNUSED_GEA_KC_2_ADDR                                   0x90005054
 Y.CREATE.L   UNUSED_GEA_KC_2                                             0x90005054
 Y.CREATE.L   HWIO_UNUSED_GEA_KC_3_ADDR                                   0x90005058
 Y.CREATE.L   UNUSED_GEA_KC_3                                             0x90005058
 Y.CREATE.L   HWIO_UNUSED_GEA34_KS_LENGTH_ADDR                            0x9000505C
 Y.CREATE.L   UNUSED_GEA34_KS_LENGTH                                      0x9000505C
 Y.CREATE.L   HWIO_UNUSED_GEA34_STATUS_ADDR                               0x90005060
 Y.CREATE.L   UNUSED_GEA34_STATUS                                         0x90005060
 Y.CREATE.L   HWIO_UNUSED_GEA34_KEY_STRM_DOUT_ADDR                        0x90005064
 Y.CREATE.L   UNUSED_GEA34_KEY_STRM_DOUT                                  0x90005064
 Y.CREATE.L   HWIO_UNUSED_AMBA_KEY_STRM_WORD0_RD_ADDR                     0x90005068
 Y.CREATE.L   UNUSED_AMBA_KEY_STRM_WORD0_RD                               0x90005068
 Y.CREATE.L   HWIO_UNUSED_AMBA_KEY_STRM_WORD1_RD_ADDR                     0x9000506C
 Y.CREATE.L   UNUSED_AMBA_KEY_STRM_WORD1_RD                               0x9000506C
 Y.CREATE.L   HWIO_UNUSED_AMBA_KEY_STRM_WORD2_RD_ADDR                     0x90005070
 Y.CREATE.L   UNUSED_AMBA_KEY_STRM_WORD2_RD                               0x90005070
 Y.CREATE.L   HWIO_UNUSED_AMBA_KEY_STRM_WORD3_RD_ADDR                     0x90005074
 Y.CREATE.L   UNUSED_AMBA_KEY_STRM_WORD3_RD                               0x90005074
 Y.CREATE.L   HWIO_UNUSED_AMBA_KEY_STRM_WORD4_RD_ADDR                     0x90005078
 Y.CREATE.L   UNUSED_AMBA_KEY_STRM_WORD4_RD                               0x90005078
 Y.CREATE.L   HWIO_UNUSED_AMBA_KEY_STRM_WORD5_RD_ADDR                     0x9000507C
 Y.CREATE.L   UNUSED_AMBA_KEY_STRM_WORD5_RD                               0x9000507C
 Y.CREATE.L   HWIO_UNUSED_AMBA_KEY_STRM_WORD6_RD_ADDR                     0x90005080
 Y.CREATE.L   UNUSED_AMBA_KEY_STRM_WORD6_RD                               0x90005080
 Y.CREATE.L   HWIO_UNUSED_AMBA_KEY_STRM_WORD7_RD_ADDR                     0x90005084
 Y.CREATE.L   UNUSED_AMBA_KEY_STRM_WORD7_RD                               0x90005084
 Y.CREATE.L   HWIO_UNUSED_AMBA_KEY_STRM_STATUS_ADDR                       0x90005088
 Y.CREATE.L   UNUSED_AMBA_KEY_STRM_STATUS                                 0x90005088
 Y.CREATE.L   HWIO_UNUSED_AFIVE12_CONFIG_0_ADDR                           0x9000508C
 Y.CREATE.L   UNUSED_AFIVE12_CONFIG_0                                     0x9000508C
 Y.CREATE.L   HWIO_UNUSED_AFIVE12_INPUT_ADDR                              0x90005090
 Y.CREATE.L   UNUSED_AFIVE12_INPUT                                        0x90005090
 Y.CREATE.L   HWIO_UNUSED_AFIVE12_KC_0_ADDR                               0x90005094
 Y.CREATE.L   UNUSED_AFIVE12_KC_0                                         0x90005094
 Y.CREATE.L   HWIO_UNUSED_AFIVE12_KC_1_ADDR                               0x90005098
 Y.CREATE.L   UNUSED_AFIVE12_KC_1                                         0x90005098
 Y.CREATE.L   HWIO_UNUSED_AFIVE_KEY_STRM_WORD0_RD_ADDR                    0x900050A0
 Y.CREATE.L   UNUSED_AFIVE_KEY_STRM_WORD0_RD                              0x900050A0
 Y.CREATE.L   HWIO_UNUSED_AFIVE_KEY_STRM_WORD1_RD_ADDR                    0x900050A4
 Y.CREATE.L   UNUSED_AFIVE_KEY_STRM_WORD1_RD                              0x900050A4
 Y.CREATE.L   HWIO_UNUSED_AFIVE_KEY_STRM_WORD2_RD_ADDR                    0x900050A8
 Y.CREATE.L   UNUSED_AFIVE_KEY_STRM_WORD2_RD                              0x900050A8
 Y.CREATE.L   HWIO_UNUSED_AFIVE_KEY_STRM_WORD3_RD_ADDR                    0x900050AC
 Y.CREATE.L   UNUSED_AFIVE_KEY_STRM_WORD3_RD                              0x900050AC
 Y.CREATE.L   HWIO_UNUSED_AFIVE_KEY_STRM_WORD4_RD_ADDR                    0x900050B0
 Y.CREATE.L   UNUSED_AFIVE_KEY_STRM_WORD4_RD                              0x900050B0
 Y.CREATE.L   HWIO_UNUSED_AFIVE_KEY_STRM_WORD5_RD_ADDR                    0x900050B4
 Y.CREATE.L   UNUSED_AFIVE_KEY_STRM_WORD5_RD                              0x900050B4
 Y.CREATE.L   HWIO_UNUSED_AFIVE_KEY_STRM_WORD6_RD_ADDR                    0x900050B8
 Y.CREATE.L   UNUSED_AFIVE_KEY_STRM_WORD6_RD                              0x900050B8
 Y.CREATE.L   HWIO_UNUSED_AFIVE_KEY_STRM_WORD7_RD_ADDR                    0x900050BC
 Y.CREATE.L   UNUSED_AFIVE_KEY_STRM_WORD7_RD                              0x900050BC
 Y.CREATE.L   HWIO_UNUSED_AFIVE_KEY_STRM_WORD8_RD_ADDR                    0x900050C0
 Y.CREATE.L   UNUSED_AFIVE_KEY_STRM_WORD8_RD                              0x900050C0
 Y.CREATE.L   HWIO_UNUSED_AFIVE_KEY_STRM_WORD9_RD_ADDR                    0x900050C4
 Y.CREATE.L   UNUSED_AFIVE_KEY_STRM_WORD9_RD                              0x900050C4
 Y.CREATE.L   HWIO_UNUSED_AFIVE_KEY_STRM_WORD10_RD_ADDR                   0x900050C8
 Y.CREATE.L   UNUSED_AFIVE_KEY_STRM_WORD10_RD                             0x900050C8
 Y.CREATE.L   HWIO_UNUSED_ENCRYPT_MICRO_IRQ_CONFIG_ADDR                   0x900050CC
 Y.CREATE.L   UNUSED_ENCRYPT_MICRO_IRQ_CONFIG                             0x900050CC
 Y.CREATE.L   HWIO_UNUSED_ENCRYPT_MICRO_IRQ_STATUS_ADDR                   0x900050D0
 Y.CREATE.L   UNUSED_ENCRYPT_MICRO_IRQ_STATUS                             0x900050D0
 Y.CREATE.L   HWIO_UNUSED_PADAC_DIN_TEST_ADDR                             0x900050D4
 Y.CREATE.L   UNUSED_PADAC_DIN_TEST                                       0x900050D4
 Y.CREATE.L   HWIO_UNUSED_RXF_GPF_RESET_ADDR                              0x9000A100
 Y.CREATE.L   UNUSED_RXF_GPF_RESET                                        0x9000A100
 Y.CREATE.L   HWIO_UNUSED_RXF_GPF_CTL_ADDR                                0x9000A104
 Y.CREATE.L   UNUSED_RXF_GPF_CTL                                          0x9000A104
 Y.CREATE.L   HWIO_UNUSED_RXF_GPF_RESAMP_PHASE_MAP0_ADDR                  0x9000A108
 Y.CREATE.L   UNUSED_RXF_GPF_RESAMP_PHASE_MAP0                            0x9000A108
 Y.CREATE.L   HWIO_UNUSED_RXF_GPF_RESAMP_PHASE_MAP1_ADDR                  0x9000A10C
 Y.CREATE.L   UNUSED_RXF_GPF_RESAMP_PHASE_MAP1                            0x9000A10C
 Y.CREATE.L   HWIO_UNUSED_RXF_GPF_RESAMP_PHASE_MAP2_ADDR                  0x9000A110
 Y.CREATE.L   UNUSED_RXF_GPF_RESAMP_PHASE_MAP2                            0x9000A110
 Y.CREATE.L   HWIO_UNUSED_RXF_GPF_RESAMP_PHASE_MAP3_ADDR                  0x9000A114
 Y.CREATE.L   UNUSED_RXF_GPF_RESAMP_PHASE_MAP3                            0x9000A114
 Y.CREATE.L   HWIO_UNUSED_RXF_GPF_RESAMP_END_CNT_ADDR                     0x9000A118
 Y.CREATE.L   UNUSED_RXF_GPF_RESAMP_END_CNT                               0x9000A118
 Y.CREATE.L   HWIO_UNUSED_RXF_GPF_COEF_ADDR                               0x9000A11C
 Y.CREATE.L   UNUSED_RXF_GPF_COEF                                         0x9000A11C
 Y.CREATE.L   HWIO_UNUSED_RXF_GPF_COEF_NOTCH0_ADDR                        0x9000A120
 Y.CREATE.L   UNUSED_RXF_GPF_COEF_NOTCH0                                  0x9000A120
 Y.CREATE.L   HWIO_UNUSED_RXF_GPF_COEF_NOTCH1_ADDR                        0x9000A124
 Y.CREATE.L   UNUSED_RXF_GPF_COEF_NOTCH1                                  0x9000A124
 Y.CREATE.L   HWIO_UNUSED_RXF_GPF_NOTCH_NBIT_ADDR                         0x9000A128
 Y.CREATE.L   UNUSED_RXF_GPF_NOTCH_NBIT                                   0x9000A128
 Y.CREATE.L   HWIO_UNUSED_RXF_GPF_TEST_BUS_SEL_ADDR                       0x9000A12C
 Y.CREATE.L   UNUSED_RXF_GPF_TEST_BUS_SEL                                 0x9000A12C
 Y.CREATE.L   HWIO_UNUSED_RXF_GPF_MICRO_DC_OFFSET_ADDR                    0x9000A130
 Y.CREATE.L   UNUSED_RXF_GPF_MICRO_DC_OFFSET                              0x9000A130
 Y.CREATE.L   HWIO_UNUSED_RXF_GPF_CLK_STATUS_ADDR                         0x9000A134
 Y.CREATE.L   UNUSED_RXF_GPF_CLK_STATUS                                   0x9000A134
 Y.CREATE.L   HWIO_UNUSED_TS_MODE_ADDR                                    0x9000A200
 Y.CREATE.L   UNUSED_TS_MODE                                              0x9000A200
 Y.CREATE.L   HWIO_UNUSED_TS_FREQL_ADDR                                   0x9000A204
 Y.CREATE.L   UNUSED_TS_FREQL                                             0x9000A204
 Y.CREATE.L   HWIO_UNUSED_TS_FREQH_ADDR                                   0x9000A208
 Y.CREATE.L   UNUSED_TS_FREQH                                             0x9000A208
 Y.CREATE.L   HWIO_UNUSED_TS_TIME_SLIP_ADDR                               0x9000A20C
 Y.CREATE.L   UNUSED_TS_TIME_SLIP                                         0x9000A20C
 Y.CREATE.L   HWIO_UNUSED_TS_DATA_ADDR                                    0x9000A210
 Y.CREATE.L   UNUSED_TS_DATA                                              0x9000A210
 Y.CREATE.L   HWIO_UNUSED_TS_NOISE_PHASE_ADDR                             0x9000A214
 Y.CREATE.L   UNUSED_TS_NOISE_PHASE                                       0x9000A214
 Y.CREATE.L   HWIO_UNUSED_TS_CODE_SEED_ADDR                               0x9000A218
 Y.CREATE.L   UNUSED_TS_CODE_SEED                                         0x9000A218
 Y.CREATE.L   HWIO_UNUSED_TS_PARAMS_ADDR                                  0x9000A21C
 Y.CREATE.L   UNUSED_TS_PARAMS                                            0x9000A21C
 Y.CREATE.L   HWIO_UNUSED_BC_MODE_ADDR                                    0x9000A240
 Y.CREATE.L   UNUSED_BC_MODE                                              0x9000A240
 Y.CREATE.L   HWIO_UNUSED_BC_CONFIG_ADDR                                  0x9000A244
 Y.CREATE.L   UNUSED_BC_CONFIG                                            0x9000A244
 Y.CREATE.L   HWIO_UNUSED_BC_OFFSETI_ADDR                                 0x9000A248
 Y.CREATE.L   UNUSED_BC_OFFSETI                                           0x9000A248
 Y.CREATE.L   HWIO_UNUSED_BP_OFFSETQ_ADDR                                 0x9000A24C
 Y.CREATE.L   UNUSED_BP_OFFSETQ                                           0x9000A24C
 Y.CREATE.L   HWIO_UNUSED_BC_EQCOEF1_ADDR                                 0x9000A250
 Y.CREATE.L   UNUSED_BC_EQCOEF1                                           0x9000A250
 Y.CREATE.L   HWIO_UNUSED_BC_EQCOEF2_ADDR                                 0x9000A254
 Y.CREATE.L   UNUSED_BC_EQCOEF2                                           0x9000A254
 Y.CREATE.L   HWIO_UNUSED_BC_FREQL_ADDR                                   0x9000A258
 Y.CREATE.L   UNUSED_BC_FREQL                                             0x9000A258
 Y.CREATE.L   HWIO_UNUSED_BC_FREQM_ADDR                                   0x9000A25C
 Y.CREATE.L   UNUSED_BC_FREQM                                             0x9000A25C
 Y.CREATE.L   HWIO_UNUSED_BC_DELTAFREQ_ADDR                               0x9000A260
 Y.CREATE.L   UNUSED_BC_DELTAFREQ                                         0x9000A260
 Y.CREATE.L   HWIO_UNUSED_BC_THRESHOLD_ADDR                               0x9000A264
 Y.CREATE.L   UNUSED_BC_THRESHOLD                                         0x9000A264
 Y.CREATE.L   HWIO_UNUSED_BC_CONFIG2_ADDR                                 0x9000A268
 Y.CREATE.L   UNUSED_BC_CONFIG2                                           0x9000A268
 Y.CREATE.L   HWIO_UNUSED_BC_MEAN_MON_I_ADDR                              0x9000A26C
 Y.CREATE.L   UNUSED_BC_MEAN_MON_I                                        0x9000A26C
 Y.CREATE.L   HWIO_UNUSED_BC_MEAN_MON_Q_ADDR                              0x9000A270
 Y.CREATE.L   UNUSED_BC_MEAN_MON_Q                                        0x9000A270
 Y.CREATE.L   HWIO_UNUSED_BC_AMPL_MON_I_ADDR                              0x9000A274
 Y.CREATE.L   UNUSED_BC_AMPL_MON_I                                        0x9000A274
 Y.CREATE.L   HWIO_UNUSED_BC_AMPL_MON_Q_ADDR                              0x9000A278
 Y.CREATE.L   UNUSED_BC_AMPL_MON_Q                                        0x9000A278
 Y.CREATE.L   HWIO_UNUSED_BC_BLANK_MON_ADDR                               0x9000A27C
 Y.CREATE.L   UNUSED_BC_BLANK_MON                                         0x9000A27C
 Y.CREATE.L   HWIO_UNUSED_SM_0_ADDR                                       0x9000A280
 Y.CREATE.L   UNUSED_SM_0                                                 0x9000A280
 Y.CREATE.L   HWIO_UNUSED_SM_1_ADDR                                       0x9000A284
 Y.CREATE.L   UNUSED_SM_1                                                 0x9000A284
 Y.CREATE.L   HWIO_UNUSED_SM_2_ADDR                                       0x9000A288
 Y.CREATE.L   UNUSED_SM_2                                                 0x9000A288
 Y.CREATE.L   HWIO_UNUSED_SM_3_ADDR                                       0x9000A28C
 Y.CREATE.L   UNUSED_SM_3                                                 0x9000A28C
 Y.CREATE.L   HWIO_UNUSED_SM_4_ADDR                                       0x9000A290
 Y.CREATE.L   UNUSED_SM_4                                                 0x9000A290
 Y.CREATE.L   HWIO_UNUSED_SM_5_ADDR                                       0x9000A294
 Y.CREATE.L   UNUSED_SM_5                                                 0x9000A294
 Y.CREATE.L   HWIO_UNUSED_SM_6_ADDR                                       0x9000A298
 Y.CREATE.L   UNUSED_SM_6                                                 0x9000A298
 Y.CREATE.L   HWIO_UNUSED_SM_7_ADDR                                       0x9000A29C
 Y.CREATE.L   UNUSED_SM_7                                                 0x9000A29C
 Y.CREATE.L   HWIO_UNUSED_SM_8_ADDR                                       0x9000A2A0
 Y.CREATE.L   UNUSED_SM_8                                                 0x9000A2A0
 Y.CREATE.L   HWIO_UNUSED_SM_9_ADDR                                       0x9000A2A4
 Y.CREATE.L   UNUSED_SM_9                                                 0x9000A2A4
 Y.CREATE.L   HWIO_UNUSED_SM_10_ADDR                                      0x9000A2A8
 Y.CREATE.L   UNUSED_SM_10                                                0x9000A2A8
 Y.CREATE.L   HWIO_UNUSED_SM_11_ADDR                                      0x9000A2AC
 Y.CREATE.L   UNUSED_SM_11                                                0x9000A2AC
 Y.CREATE.L   HWIO_UNUSED_SM_12_ADDR                                      0x9000A2B0
 Y.CREATE.L   UNUSED_SM_12                                                0x9000A2B0
 Y.CREATE.L   HWIO_UNUSED_SM_13_ADDR                                      0x9000A2B4
 Y.CREATE.L   UNUSED_SM_13                                                0x9000A2B4
 Y.CREATE.L   HWIO_UNUSED_SM_14_ADDR                                      0x9000A2B8
 Y.CREATE.L   UNUSED_SM_14                                                0x9000A2B8
 Y.CREATE.L   HWIO_UNUSED_SM_15_ADDR                                      0x9000A2BC
 Y.CREATE.L   UNUSED_SM_15                                                0x9000A2BC
 Y.CREATE.L   HWIO_UNUSED_TX_TRBLK_PARAM_TRCH0_ADDR                       0x9000B000
 Y.CREATE.L   UNUSED_TX_TRBLK_PARAM_TRCH0                                 0x9000B000
 Y.CREATE.L   HWIO_UNUSED_TX_TRBLK_PARAM_TRCH1_ADDR                       0x9000B004
 Y.CREATE.L   UNUSED_TX_TRBLK_PARAM_TRCH1                                 0x9000B004
 Y.CREATE.L   HWIO_UNUSED_TX_TRBLK_PARAM_TRCH2_ADDR                       0x9000B008
 Y.CREATE.L   UNUSED_TX_TRBLK_PARAM_TRCH2                                 0x9000B008
 Y.CREATE.L   HWIO_UNUSED_TX_TRBLK_PARAM_TRCH3_ADDR                       0x9000B00C
 Y.CREATE.L   UNUSED_TX_TRBLK_PARAM_TRCH3                                 0x9000B00C
 Y.CREATE.L   HWIO_UNUSED_TX_TRBLK_PARAM_TRCH4_ADDR                       0x9000B010
 Y.CREATE.L   UNUSED_TX_TRBLK_PARAM_TRCH4                                 0x9000B010
 Y.CREATE.L   HWIO_UNUSED_TX_TRBLK_PARAM_TRCH5_ADDR                       0x9000B014
 Y.CREATE.L   UNUSED_TX_TRBLK_PARAM_TRCH5                                 0x9000B014
 Y.CREATE.L   HWIO_UNUSED_TX_TRBLK_PARAM_TRCH6_ADDR                       0x9000B018
 Y.CREATE.L   UNUSED_TX_TRBLK_PARAM_TRCH6                                 0x9000B018
 Y.CREATE.L   HWIO_UNUSED_TX_TRBLK_PARAM_TRCH7_ADDR                       0x9000B01C
 Y.CREATE.L   UNUSED_TX_TRBLK_PARAM_TRCH7                                 0x9000B01C
 Y.CREATE.L   HWIO_UNUSED_TX_ERAMB_ADDR_TRCH0_ADDR                        0x9000B020
 Y.CREATE.L   UNUSED_TX_ERAMB_ADDR_TRCH0                                  0x9000B020
 Y.CREATE.L   HWIO_UNUSED_TX_ERAMB_ADDR_TRCH1_ADDR                        0x9000B024
 Y.CREATE.L   UNUSED_TX_ERAMB_ADDR_TRCH1                                  0x9000B024
 Y.CREATE.L   HWIO_UNUSED_TX_ERAMB_ADDR_TRCH2_ADDR                        0x9000B028
 Y.CREATE.L   UNUSED_TX_ERAMB_ADDR_TRCH2                                  0x9000B028
 Y.CREATE.L   HWIO_UNUSED_TX_ERAMB_ADDR_TRCH3_ADDR                        0x9000B02C
 Y.CREATE.L   UNUSED_TX_ERAMB_ADDR_TRCH3                                  0x9000B02C
 Y.CREATE.L   HWIO_UNUSED_TX_ERAMB_ADDR_TRCH4_ADDR                        0x9000B030
 Y.CREATE.L   UNUSED_TX_ERAMB_ADDR_TRCH4                                  0x9000B030
 Y.CREATE.L   HWIO_UNUSED_TX_ERAMB_ADDR_TRCH5_ADDR                        0x9000B034
 Y.CREATE.L   UNUSED_TX_ERAMB_ADDR_TRCH5                                  0x9000B034
 Y.CREATE.L   HWIO_UNUSED_TX_ERAMB_ADDR_TRCH6_ADDR                        0x9000B038
 Y.CREATE.L   UNUSED_TX_ERAMB_ADDR_TRCH6                                  0x9000B038
 Y.CREATE.L   HWIO_UNUSED_TX_ERAMB_ADDR_TRCH7_ADDR                        0x9000B03C
 Y.CREATE.L   UNUSED_TX_ERAMB_ADDR_TRCH7                                  0x9000B03C
 Y.CREATE.L   HWIO_UNUSED_TX_CODING_PARAM_TRCH0_ADDR                      0x9000B040
 Y.CREATE.L   UNUSED_TX_CODING_PARAM_TRCH0                                0x9000B040
 Y.CREATE.L   HWIO_UNUSED_TX_CODING_PARAM_TRCH1_ADDR                      0x9000B044
 Y.CREATE.L   UNUSED_TX_CODING_PARAM_TRCH1                                0x9000B044
 Y.CREATE.L   HWIO_UNUSED_TX_CODING_PARAM_TRCH2_ADDR                      0x9000B048
 Y.CREATE.L   UNUSED_TX_CODING_PARAM_TRCH2                                0x9000B048
 Y.CREATE.L   HWIO_UNUSED_TX_CODING_PARAM_TRCH3_ADDR                      0x9000B04C
 Y.CREATE.L   UNUSED_TX_CODING_PARAM_TRCH3                                0x9000B04C
 Y.CREATE.L   HWIO_UNUSED_TX_CODING_PARAM_TRCH4_ADDR                      0x9000B050
 Y.CREATE.L   UNUSED_TX_CODING_PARAM_TRCH4                                0x9000B050
 Y.CREATE.L   HWIO_UNUSED_TX_CODING_PARAM_TRCH5_ADDR                      0x9000B054
 Y.CREATE.L   UNUSED_TX_CODING_PARAM_TRCH5                                0x9000B054
 Y.CREATE.L   HWIO_UNUSED_TX_CODING_PARAM_TRCH6_ADDR                      0x9000B058
 Y.CREATE.L   UNUSED_TX_CODING_PARAM_TRCH6                                0x9000B058
 Y.CREATE.L   HWIO_UNUSED_TX_CODING_PARAM_TRCH7_ADDR                      0x9000B05C
 Y.CREATE.L   UNUSED_TX_CODING_PARAM_TRCH7                                0x9000B05C
 Y.CREATE.L   HWIO_UNUSED_TX_CODE_SEG_SIZE_TRCH0_ADDR                     0x9000B060
 Y.CREATE.L   UNUSED_TX_CODE_SEG_SIZE_TRCH0                               0x9000B060
 Y.CREATE.L   HWIO_UNUSED_TX_CODE_SEG_SIZE_TRCH1_ADDR                     0x9000B064
 Y.CREATE.L   UNUSED_TX_CODE_SEG_SIZE_TRCH1                               0x9000B064
 Y.CREATE.L   HWIO_UNUSED_TX_CODE_SEG_SIZE_TRCH2_ADDR                     0x9000B068
 Y.CREATE.L   UNUSED_TX_CODE_SEG_SIZE_TRCH2                               0x9000B068
 Y.CREATE.L   HWIO_UNUSED_TX_CODE_SEG_SIZE_TRCH3_ADDR                     0x9000B06C
 Y.CREATE.L   UNUSED_TX_CODE_SEG_SIZE_TRCH3                               0x9000B06C
 Y.CREATE.L   HWIO_UNUSED_TX_CODE_SEG_SIZE_TRCH4_ADDR                     0x9000B070
 Y.CREATE.L   UNUSED_TX_CODE_SEG_SIZE_TRCH4                               0x9000B070
 Y.CREATE.L   HWIO_UNUSED_TX_CODE_SEG_SIZE_TRCH5_ADDR                     0x9000B074
 Y.CREATE.L   UNUSED_TX_CODE_SEG_SIZE_TRCH5                               0x9000B074
 Y.CREATE.L   HWIO_UNUSED_TX_CODE_SEG_SIZE_TRCH6_ADDR                     0x9000B078
 Y.CREATE.L   UNUSED_TX_CODE_SEG_SIZE_TRCH6                               0x9000B078
 Y.CREATE.L   HWIO_UNUSED_TX_CODE_SEG_SIZE_TRCH7_ADDR                     0x9000B07C
 Y.CREATE.L   UNUSED_TX_CODE_SEG_SIZE_TRCH7                               0x9000B07C
 Y.CREATE.L   HWIO_UNUSED_TX_RM_EINI_TRCH0_ADDR                           0x9000B080
 Y.CREATE.L   UNUSED_TX_RM_EINI_TRCH0                                     0x9000B080
 Y.CREATE.L   HWIO_UNUSED_TX_RM_EINI_TRCH1_ADDR                           0x9000B084
 Y.CREATE.L   UNUSED_TX_RM_EINI_TRCH1                                     0x9000B084
 Y.CREATE.L   HWIO_UNUSED_TX_RM_EINI_TRCH2_ADDR                           0x9000B088
 Y.CREATE.L   UNUSED_TX_RM_EINI_TRCH2                                     0x9000B088
 Y.CREATE.L   HWIO_UNUSED_TX_RM_EINI_TRCH3_ADDR                           0x9000B08C
 Y.CREATE.L   UNUSED_TX_RM_EINI_TRCH3                                     0x9000B08C
 Y.CREATE.L   HWIO_UNUSED_TX_RM_EINI_TRCH4_ADDR                           0x9000B090
 Y.CREATE.L   UNUSED_TX_RM_EINI_TRCH4                                     0x9000B090
 Y.CREATE.L   HWIO_UNUSED_TX_RM_EINI_TRCH5_ADDR                           0x9000B094
 Y.CREATE.L   UNUSED_TX_RM_EINI_TRCH5                                     0x9000B094
 Y.CREATE.L   HWIO_UNUSED_TX_RM_EINI_TRCH6_ADDR                           0x9000B098
 Y.CREATE.L   UNUSED_TX_RM_EINI_TRCH6                                     0x9000B098
 Y.CREATE.L   HWIO_UNUSED_TX_RM_EINI_TRCH7_ADDR                           0x9000B09C
 Y.CREATE.L   UNUSED_TX_RM_EINI_TRCH7                                     0x9000B09C
 Y.CREATE.L   HWIO_UNUSED_TX_RM_EMINUS_TRCH0_ADDR                         0x9000B0A0
 Y.CREATE.L   UNUSED_TX_RM_EMINUS_TRCH0                                   0x9000B0A0
 Y.CREATE.L   HWIO_UNUSED_TX_RM_EMINUS_TRCH1_ADDR                         0x9000B0A4
 Y.CREATE.L   UNUSED_TX_RM_EMINUS_TRCH1                                   0x9000B0A4
 Y.CREATE.L   HWIO_UNUSED_TX_RM_EMINUS_TRCH2_ADDR                         0x9000B0A8
 Y.CREATE.L   UNUSED_TX_RM_EMINUS_TRCH2                                   0x9000B0A8
 Y.CREATE.L   HWIO_UNUSED_TX_RM_EMINUS_TRCH3_ADDR                         0x9000B0AC
 Y.CREATE.L   UNUSED_TX_RM_EMINUS_TRCH3                                   0x9000B0AC
 Y.CREATE.L   HWIO_UNUSED_TX_RM_EMINUS_TRCH4_ADDR                         0x9000B0B0
 Y.CREATE.L   UNUSED_TX_RM_EMINUS_TRCH4                                   0x9000B0B0
 Y.CREATE.L   HWIO_UNUSED_TX_RM_EMINUS_TRCH5_ADDR                         0x9000B0B4
 Y.CREATE.L   UNUSED_TX_RM_EMINUS_TRCH5                                   0x9000B0B4
 Y.CREATE.L   HWIO_UNUSED_TX_RM_EMINUS_TRCH6_ADDR                         0x9000B0B8
 Y.CREATE.L   UNUSED_TX_RM_EMINUS_TRCH6                                   0x9000B0B8
 Y.CREATE.L   HWIO_UNUSED_TX_RM_EMINUS_TRCH7_ADDR                         0x9000B0BC
 Y.CREATE.L   UNUSED_TX_RM_EMINUS_TRCH7                                   0x9000B0BC
 Y.CREATE.L   HWIO_UNUSED_TX_RM_EPLUS_TRCH0_ADDR                          0x9000B0C0
 Y.CREATE.L   UNUSED_TX_RM_EPLUS_TRCH0                                    0x9000B0C0
 Y.CREATE.L   HWIO_UNUSED_TX_RM_EPLUS_TRCH1_ADDR                          0x9000B0C4
 Y.CREATE.L   UNUSED_TX_RM_EPLUS_TRCH1                                    0x9000B0C4
 Y.CREATE.L   HWIO_UNUSED_TX_RM_EPLUS_TRCH2_ADDR                          0x9000B0C8
 Y.CREATE.L   UNUSED_TX_RM_EPLUS_TRCH2                                    0x9000B0C8
 Y.CREATE.L   HWIO_UNUSED_TX_RM_EPLUS_TRCH3_ADDR                          0x9000B0CC
 Y.CREATE.L   UNUSED_TX_RM_EPLUS_TRCH3                                    0x9000B0CC
 Y.CREATE.L   HWIO_UNUSED_TX_RM_EPLUS_TRCH4_ADDR                          0x9000B0D0
 Y.CREATE.L   UNUSED_TX_RM_EPLUS_TRCH4                                    0x9000B0D0
 Y.CREATE.L   HWIO_UNUSED_TX_RM_EPLUS_TRCH5_ADDR                          0x9000B0D4
 Y.CREATE.L   UNUSED_TX_RM_EPLUS_TRCH5                                    0x9000B0D4
 Y.CREATE.L   HWIO_UNUSED_TX_RM_EPLUS_TRCH6_ADDR                          0x9000B0D8
 Y.CREATE.L   UNUSED_TX_RM_EPLUS_TRCH6                                    0x9000B0D8
 Y.CREATE.L   HWIO_UNUSED_TX_RM_EPLUS_TRCH7_ADDR                          0x9000B0DC
 Y.CREATE.L   UNUSED_TX_RM_EPLUS_TRCH7                                    0x9000B0DC
 Y.CREATE.L   HWIO_UNUSED_TX_TURBO_INTLV_PARAM0_TRCH0_ADDR                0x9000B0E0
 Y.CREATE.L   UNUSED_TX_TURBO_INTLV_PARAM0_TRCH0                          0x9000B0E0
 Y.CREATE.L   HWIO_UNUSED_TX_TURBO_INTLV_PARAM0_TRCH1_ADDR                0x9000B0E4
 Y.CREATE.L   UNUSED_TX_TURBO_INTLV_PARAM0_TRCH1                          0x9000B0E4
 Y.CREATE.L   HWIO_UNUSED_TX_TURBO_INTLV_PARAM0_TRCH2_ADDR                0x9000B0E8
 Y.CREATE.L   UNUSED_TX_TURBO_INTLV_PARAM0_TRCH2                          0x9000B0E8
 Y.CREATE.L   HWIO_UNUSED_TX_TURBO_INTLV_PARAM0_TRCH3_ADDR                0x9000B0EC
 Y.CREATE.L   UNUSED_TX_TURBO_INTLV_PARAM0_TRCH3                          0x9000B0EC
 Y.CREATE.L   HWIO_UNUSED_TX_TURBO_INTLV_PARAM0_TRCH4_ADDR                0x9000B0F0
 Y.CREATE.L   UNUSED_TX_TURBO_INTLV_PARAM0_TRCH4                          0x9000B0F0
 Y.CREATE.L   HWIO_UNUSED_TX_TURBO_INTLV_PARAM0_TRCH5_ADDR                0x9000B0F4
 Y.CREATE.L   UNUSED_TX_TURBO_INTLV_PARAM0_TRCH5                          0x9000B0F4
 Y.CREATE.L   HWIO_UNUSED_TX_TURBO_INTLV_PARAM0_TRCH6_ADDR                0x9000B0F8
 Y.CREATE.L   UNUSED_TX_TURBO_INTLV_PARAM0_TRCH6                          0x9000B0F8
 Y.CREATE.L   HWIO_UNUSED_TX_TURBO_INTLV_PARAM0_TRCH7_ADDR                0x9000B0FC
 Y.CREATE.L   UNUSED_TX_TURBO_INTLV_PARAM0_TRCH7                          0x9000B0FC
 Y.CREATE.L   HWIO_UNUSED_TX_TURBO_INTLV_PARAM1_TRCH0_ADDR                0x9000B100
 Y.CREATE.L   UNUSED_TX_TURBO_INTLV_PARAM1_TRCH0                          0x9000B100
 Y.CREATE.L   HWIO_UNUSED_TX_TURBO_INTLV_PARAM1_TRCH1_ADDR                0x9000B104
 Y.CREATE.L   UNUSED_TX_TURBO_INTLV_PARAM1_TRCH1                          0x9000B104
 Y.CREATE.L   HWIO_UNUSED_TX_TURBO_INTLV_PARAM1_TRCH2_ADDR                0x9000B108
 Y.CREATE.L   UNUSED_TX_TURBO_INTLV_PARAM1_TRCH2                          0x9000B108
 Y.CREATE.L   HWIO_UNUSED_TX_TURBO_INTLV_PARAM1_TRCH3_ADDR                0x9000B10C
 Y.CREATE.L   UNUSED_TX_TURBO_INTLV_PARAM1_TRCH3                          0x9000B10C
 Y.CREATE.L   HWIO_UNUSED_TX_TURBO_INTLV_PARAM1_TRCH4_ADDR                0x9000B110
 Y.CREATE.L   UNUSED_TX_TURBO_INTLV_PARAM1_TRCH4                          0x9000B110
 Y.CREATE.L   HWIO_UNUSED_TX_TURBO_INTLV_PARAM1_TRCH5_ADDR                0x9000B114
 Y.CREATE.L   UNUSED_TX_TURBO_INTLV_PARAM1_TRCH5                          0x9000B114
 Y.CREATE.L   HWIO_UNUSED_TX_TURBO_INTLV_PARAM1_TRCH6_ADDR                0x9000B118
 Y.CREATE.L   UNUSED_TX_TURBO_INTLV_PARAM1_TRCH6                          0x9000B118
 Y.CREATE.L   HWIO_UNUSED_TX_TURBO_INTLV_PARAM1_TRCH7_ADDR                0x9000B11C
 Y.CREATE.L   UNUSED_TX_TURBO_INTLV_PARAM1_TRCH7                          0x9000B11C
 Y.CREATE.L   HWIO_UNUSED_TX_TRCH_MUX_ORDER_ADDR                          0x9000B120
 Y.CREATE.L   UNUSED_TX_TRCH_MUX_ORDER                                    0x9000B120
 Y.CREATE.L   HWIO_UNUSED_TX_RESET_ADDR                                   0x9000B124
 Y.CREATE.L   UNUSED_TX_RESET                                             0x9000B124
 Y.CREATE.L   HWIO_UNUSED_TX_PHASE_ACC_RESET_ADDR                         0x9000B128
 Y.CREATE.L   UNUSED_TX_PHASE_ACC_RESET                                   0x9000B128
 Y.CREATE.L   HWIO_UNUSED_TX_ENC_TIMING_CTL_ADDR                          0x9000B12C
 Y.CREATE.L   UNUSED_TX_ENC_TIMING_CTL                                    0x9000B12C
 Y.CREATE.L   HWIO_UNUSED_TX_ERAM_AB_TRCHS_ADDR                           0x9000B130
 Y.CREATE.L   UNUSED_TX_ERAM_AB_TRCHS                                     0x9000B130
 Y.CREATE.L   HWIO_UNUSED_TX_ERAMA_INIT_ADDR                              0x9000B134
 Y.CREATE.L   UNUSED_TX_ERAMA_INIT                                        0x9000B134
 Y.CREATE.L   HWIO_UNUSED_TX_DPDCH_OVSF_NUM_ADDR                          0x9000B138
 Y.CREATE.L   UNUSED_TX_DPDCH_OVSF_NUM                                    0x9000B138
 Y.CREATE.L   HWIO_UNUSED_TX_DATA_SPR_FACTOR_ADDR                         0x9000B13C
 Y.CREATE.L   UNUSED_TX_DATA_SPR_FACTOR                                   0x9000B13C
 Y.CREATE.L   HWIO_UNUSED_TX_SCR_CODE_INIT_ADDR                           0x9000B140
 Y.CREATE.L   UNUSED_TX_SCR_CODE_INIT                                     0x9000B140
 Y.CREATE.L   HWIO_UNUSED_TX_BETA_GAIN_0_ADDR                             0x9000B144
 Y.CREATE.L   UNUSED_TX_BETA_GAIN_0                                       0x9000B144
 Y.CREATE.L   HWIO_UNUSED_TX_BETA_GAIN_1_ADDR                             0x9000B148
 Y.CREATE.L   UNUSED_TX_BETA_GAIN_1                                       0x9000B148
 Y.CREATE.L   HWIO_UNUSED_TX_PHY_CH_TYPE_ADDR                             0x9000B14C
 Y.CREATE.L   UNUSED_TX_PHY_CH_TYPE                                       0x9000B14C
 Y.CREATE.L   HWIO_UNUSED_TX_GENERAL_CTL_ADDR                             0x9000B150
 Y.CREATE.L   UNUSED_TX_GENERAL_CTL                                       0x9000B150
 Y.CREATE.L   HWIO_UNUSED_TX_ROT_ANGLE_0_CTL_ADDR                         0x9000B154
 Y.CREATE.L   UNUSED_TX_ROT_ANGLE_0_CTL                                   0x9000B154
 Y.CREATE.L   HWIO_UNUSED_TX_ROT_ANGLE_1_CTL_ADDR                         0x9000B158
 Y.CREATE.L   UNUSED_TX_ROT_ANGLE_1_CTL                                   0x9000B158
 Y.CREATE.L   HWIO_UNUSED_TX_TEST_CTL_ADDR                                0x9000B15C
 Y.CREATE.L   UNUSED_TX_TEST_CTL                                          0x9000B15C
 Y.CREATE.L   HWIO_UNUSED_TX_ERAMA_DATA_END_ADDR                          0x9000B83C
 Y.CREATE.L   UNUSED_TX_ERAMA_DATA_END                                    0x9000B83C
 Y.CREATE.L   HWIO_UNUSED_TX_CIPHER_CK0_0_ADDR                            0x9000B840
 Y.CREATE.L   UNUSED_TX_CIPHER_CK0_0                                      0x9000B840
 Y.CREATE.L   HWIO_UNUSED_TX_CIPHER_CK0_1_ADDR                            0x9000B844
 Y.CREATE.L   UNUSED_TX_CIPHER_CK0_1                                      0x9000B844
 Y.CREATE.L   HWIO_UNUSED_TX_CIPHER_CK0_2_ADDR                            0x9000B848
 Y.CREATE.L   UNUSED_TX_CIPHER_CK0_2                                      0x9000B848
 Y.CREATE.L   HWIO_UNUSED_TX_CIPHER_CK0_3_ADDR                            0x9000B84C
 Y.CREATE.L   UNUSED_TX_CIPHER_CK0_3                                      0x9000B84C
 Y.CREATE.L   HWIO_UNUSED_TX_CIPHER_CK1_0_ADDR                            0x9000B850
 Y.CREATE.L   UNUSED_TX_CIPHER_CK1_0                                      0x9000B850
 Y.CREATE.L   HWIO_UNUSED_TX_CIPHER_CK1_1_ADDR                            0x9000B854
 Y.CREATE.L   UNUSED_TX_CIPHER_CK1_1                                      0x9000B854
 Y.CREATE.L   HWIO_UNUSED_TX_CIPHER_CK1_2_ADDR                            0x9000B858
 Y.CREATE.L   UNUSED_TX_CIPHER_CK1_2                                      0x9000B858
 Y.CREATE.L   HWIO_UNUSED_TX_CIPHER_CK1_3_ADDR                            0x9000B85C
 Y.CREATE.L   UNUSED_TX_CIPHER_CK1_3                                      0x9000B85C
 Y.CREATE.L   HWIO_UNUSED_TX_CIPHER_CK2_0_ADDR                            0x9000B860
 Y.CREATE.L   UNUSED_TX_CIPHER_CK2_0                                      0x9000B860
 Y.CREATE.L   HWIO_UNUSED_TX_CIPHER_CK2_1_ADDR                            0x9000B864
 Y.CREATE.L   UNUSED_TX_CIPHER_CK2_1                                      0x9000B864
 Y.CREATE.L   HWIO_UNUSED_TX_CIPHER_CK2_2_ADDR                            0x9000B868
 Y.CREATE.L   UNUSED_TX_CIPHER_CK2_2                                      0x9000B868
 Y.CREATE.L   HWIO_UNUSED_TX_CIPHER_CK2_3_ADDR                            0x9000B86C
 Y.CREATE.L   UNUSED_TX_CIPHER_CK2_3                                      0x9000B86C
 Y.CREATE.L   HWIO_UNUSED_TX_CIPHER_CK3_0_ADDR                            0x9000B870
 Y.CREATE.L   UNUSED_TX_CIPHER_CK3_0                                      0x9000B870
 Y.CREATE.L   HWIO_UNUSED_TX_CIPHER_CK3_1_ADDR                            0x9000B874
 Y.CREATE.L   UNUSED_TX_CIPHER_CK3_1                                      0x9000B874
 Y.CREATE.L   HWIO_UNUSED_TX_CIPHER_CK3_2_ADDR                            0x9000B878
 Y.CREATE.L   UNUSED_TX_CIPHER_CK3_2                                      0x9000B878
 Y.CREATE.L   HWIO_UNUSED_TX_CIPHER_CK3_3_ADDR                            0x9000B87C
 Y.CREATE.L   UNUSED_TX_CIPHER_CK3_3                                      0x9000B87C
 Y.CREATE.L   HWIO_UNUSED_TX_CIPHER_CK4_0_ADDR                            0x9000B880
 Y.CREATE.L   UNUSED_TX_CIPHER_CK4_0                                      0x9000B880
 Y.CREATE.L   HWIO_UNUSED_TX_CIPHER_CK4_1_ADDR                            0x9000B884
 Y.CREATE.L   UNUSED_TX_CIPHER_CK4_1                                      0x9000B884
 Y.CREATE.L   HWIO_UNUSED_TX_CIPHER_CK4_2_ADDR                            0x9000B888
 Y.CREATE.L   UNUSED_TX_CIPHER_CK4_2                                      0x9000B888
 Y.CREATE.L   HWIO_UNUSED_TX_CIPHER_CK4_3_ADDR                            0x9000B88C
 Y.CREATE.L   UNUSED_TX_CIPHER_CK4_3                                      0x9000B88C
 Y.CREATE.L   HWIO_UNUSED_TX_CIPHER_CK5_0_ADDR                            0x9000B890
 Y.CREATE.L   UNUSED_TX_CIPHER_CK5_0                                      0x9000B890
 Y.CREATE.L   HWIO_UNUSED_TX_CIPHER_CK5_1_ADDR                            0x9000B894
 Y.CREATE.L   UNUSED_TX_CIPHER_CK5_1                                      0x9000B894
 Y.CREATE.L   HWIO_UNUSED_TX_CIPHER_CK5_2_ADDR                            0x9000B898
 Y.CREATE.L   UNUSED_TX_CIPHER_CK5_2                                      0x9000B898
 Y.CREATE.L   HWIO_UNUSED_TX_CIPHER_CK5_3_ADDR                            0x9000B89C
 Y.CREATE.L   UNUSED_TX_CIPHER_CK5_3                                      0x9000B89C
 Y.CREATE.L   HWIO_UNUSED_TX_FILLER_POLARITY_ADDR                         0x9000B8A0
 Y.CREATE.L   UNUSED_TX_FILLER_POLARITY                                   0x9000B8A0
 Y.CREATE.L   HWIO_UNUSED_TX_STATUS_ADDR                                  0x9000B8A4
 Y.CREATE.L   UNUSED_TX_STATUS                                            0x9000B8A4
 Y.CREATE.L   HWIO_UNUSED_TX_HW_CLK_CTL_ADDR                              0x9000B8A8
 Y.CREATE.L   UNUSED_TX_HW_CLK_CTL                                        0x9000B8A8
 Y.CREATE.L   HWIO_UNUSED_TX_ARM_CLK_CTL_ADDR                             0x9000B8AC
 Y.CREATE.L   UNUSED_TX_ARM_CLK_CTL                                       0x9000B8AC
 Y.CREATE.L   HWIO_UNUSED_TX_CLK_STATUS_ADDR                              0x9000B8B0
 Y.CREATE.L   UNUSED_TX_CLK_STATUS                                        0x9000B8B0
 Y.CREATE.L   HWIO_UNUSED_TX_HSDPCCH_OVSF_NUM_ADDR                        0x9000B8B4
 Y.CREATE.L   UNUSED_TX_HSDPCCH_OVSF_NUM                                  0x9000B8B4
 Y.CREATE.L   HWIO_UNUSED_TX_VAR_GAIN_SHIFT_DLY_ADDR                      0x9000B8B8
 Y.CREATE.L   UNUSED_TX_VAR_GAIN_SHIFT_DLY                                0x9000B8B8
 Y.CREATE.L   HWIO_UNUSED_TX_BETA_GAIN_GROUP_DLY_ADDR                     0x9000B8BC
 Y.CREATE.L   UNUSED_TX_BETA_GAIN_GROUP_DLY                               0x9000B8BC
 Y.CREATE.L   HWIO_UNUSED_TX_EUL_ERAM_MEMORY_BANK_ADDR                    0x9000B8C0
 Y.CREATE.L   UNUSED_TX_EUL_ERAM_MEMORY_BANK                              0x9000B8C0
 Y.CREATE.L   HWIO_UNUSED_TX_EUL_ERAM_INIT_ADDR                           0x9000B8C4
 Y.CREATE.L   UNUSED_TX_EUL_ERAM_INIT                                     0x9000B8C4
 Y.CREATE.L   HWIO_UNUSED_TX_EUL_ERAM_DATA_END_ADDR                       0x9000C884
 Y.CREATE.L   UNUSED_TX_EUL_ERAM_DATA_END                                 0x9000C884
 Y.CREATE.L   HWIO_UNUSED_TX_EUL_ERAM_CTRL_INIT_ADDR                      0x9000C888
 Y.CREATE.L   UNUSED_TX_EUL_ERAM_CTRL_INIT                                0x9000C888
 Y.CREATE.L   HWIO_UNUSED_TX_EUL_ERAM_CTRL_END_ADDR                       0x9000CD88
 Y.CREATE.L   UNUSED_TX_EUL_ERAM_CTRL_END                                 0x9000CD88
 Y.CREATE.L   HWIO_UNUSED_TX_EUL_CODING_PARAM_BANK0_ADDR                  0x9000CD8C
 Y.CREATE.L   UNUSED_TX_EUL_CODING_PARAM_BANK0                            0x9000CD8C
 Y.CREATE.L   HWIO_UNUSED_TX_EUL_CODING_PARAM_BANK1_ADDR                  0x9000CD90
 Y.CREATE.L   UNUSED_TX_EUL_CODING_PARAM_BANK1                            0x9000CD90
 Y.CREATE.L   HWIO_UNUSED_TX_EUL_CODING_PARAM_BANK2_ADDR                  0x9000CD94
 Y.CREATE.L   UNUSED_TX_EUL_CODING_PARAM_BANK2                            0x9000CD94
 Y.CREATE.L   HWIO_UNUSED_TX_EUL_CODING_PARAM_BANK3_ADDR                  0x9000CD98
 Y.CREATE.L   UNUSED_TX_EUL_CODING_PARAM_BANK3                            0x9000CD98
 Y.CREATE.L   HWIO_UNUSED_TX_EUL_CODING_PARAM_BANK4_ADDR                  0x9000CD9C
 Y.CREATE.L   UNUSED_TX_EUL_CODING_PARAM_BANK4                            0x9000CD9C
 Y.CREATE.L   HWIO_UNUSED_TX_EUL_CODING_PARAM_BANK5_ADDR                  0x9000CDA0
 Y.CREATE.L   UNUSED_TX_EUL_CODING_PARAM_BANK5                            0x9000CDA0
 Y.CREATE.L   HWIO_UNUSED_TX_EUL_CODING_PARAM_BANK6_ADDR                  0x9000CDA4
 Y.CREATE.L   UNUSED_TX_EUL_CODING_PARAM_BANK6                            0x9000CDA4
 Y.CREATE.L   HWIO_UNUSED_TX_EUL_CODING_PARAM_BANK7_ADDR                  0x9000CDA8
 Y.CREATE.L   UNUSED_TX_EUL_CODING_PARAM_BANK7                            0x9000CDA8
 Y.CREATE.L   HWIO_UNUSED_TX_EUL_CODE_SEG_SIZE_BANK0_ADDR                 0x9000CDAC
 Y.CREATE.L   UNUSED_TX_EUL_CODE_SEG_SIZE_BANK0                           0x9000CDAC
 Y.CREATE.L   HWIO_UNUSED_TX_EUL_CODE_SEG_SIZE_BANK1_ADDR                 0x9000CDB0
 Y.CREATE.L   UNUSED_TX_EUL_CODE_SEG_SIZE_BANK1                           0x9000CDB0
 Y.CREATE.L   HWIO_UNUSED_TX_EUL_CODE_SEG_SIZE_BANK2_ADDR                 0x9000CDB4
 Y.CREATE.L   UNUSED_TX_EUL_CODE_SEG_SIZE_BANK2                           0x9000CDB4
 Y.CREATE.L   HWIO_UNUSED_TX_EUL_CODE_SEG_SIZE_BANK3_ADDR                 0x9000CDB8
 Y.CREATE.L   UNUSED_TX_EUL_CODE_SEG_SIZE_BANK3                           0x9000CDB8
 Y.CREATE.L   HWIO_UNUSED_TX_EUL_CODE_SEG_SIZE_BANK4_ADDR                 0x9000CDBC
 Y.CREATE.L   UNUSED_TX_EUL_CODE_SEG_SIZE_BANK4                           0x9000CDBC
 Y.CREATE.L   HWIO_UNUSED_TX_EUL_CODE_SEG_SIZE_BANK5_ADDR                 0x9000CDC0
 Y.CREATE.L   UNUSED_TX_EUL_CODE_SEG_SIZE_BANK5                           0x9000CDC0
 Y.CREATE.L   HWIO_UNUSED_TX_EUL_CODE_SEG_SIZE_BANK6_ADDR                 0x9000CDC4
 Y.CREATE.L   UNUSED_TX_EUL_CODE_SEG_SIZE_BANK6                           0x9000CDC4
 Y.CREATE.L   HWIO_UNUSED_TX_EUL_CODE_SEG_SIZE_BANK7_ADDR                 0x9000CDC8
 Y.CREATE.L   UNUSED_TX_EUL_CODE_SEG_SIZE_BANK7                           0x9000CDC8
 Y.CREATE.L   HWIO_UNUSED_TX_EUL_TURBO_INTLV_PARAM0_BANK0_ADDR            0x9000CDCC
 Y.CREATE.L   UNUSED_TX_EUL_TURBO_INTLV_PARAM0_BANK0                      0x9000CDCC
 Y.CREATE.L   HWIO_UNUSED_TX_EUL_TURBO_INTLV_PARAM0_BANK1_ADDR            0x9000CDD0
 Y.CREATE.L   UNUSED_TX_EUL_TURBO_INTLV_PARAM0_BANK1                      0x9000CDD0
 Y.CREATE.L   HWIO_UNUSED_TX_EUL_TURBO_INTLV_PARAM0_BANK2_ADDR            0x9000CDD4
 Y.CREATE.L   UNUSED_TX_EUL_TURBO_INTLV_PARAM0_BANK2                      0x9000CDD4
 Y.CREATE.L   HWIO_UNUSED_TX_EUL_TURBO_INTLV_PARAM0_BANK3_ADDR            0x9000CDD8
 Y.CREATE.L   UNUSED_TX_EUL_TURBO_INTLV_PARAM0_BANK3                      0x9000CDD8
 Y.CREATE.L   HWIO_UNUSED_TX_EUL_TURBO_INTLV_PARAM0_BANK4_ADDR            0x9000CDDC
 Y.CREATE.L   UNUSED_TX_EUL_TURBO_INTLV_PARAM0_BANK4                      0x9000CDDC
 Y.CREATE.L   HWIO_UNUSED_TX_EUL_TURBO_INTLV_PARAM0_BANK5_ADDR            0x9000CDE0
 Y.CREATE.L   UNUSED_TX_EUL_TURBO_INTLV_PARAM0_BANK5                      0x9000CDE0
 Y.CREATE.L   HWIO_UNUSED_TX_EUL_TURBO_INTLV_PARAM0_BANK6_ADDR            0x9000CDE4
 Y.CREATE.L   UNUSED_TX_EUL_TURBO_INTLV_PARAM0_BANK6                      0x9000CDE4
 Y.CREATE.L   HWIO_UNUSED_TX_EUL_TURBO_INTLV_PARAM0_BANK7_ADDR            0x9000CDE8
 Y.CREATE.L   UNUSED_TX_EUL_TURBO_INTLV_PARAM0_BANK7                      0x9000CDE8
 Y.CREATE.L   HWIO_UNUSED_TX_EUL_TURBO_INTLV_PARAM1_BANK0_ADDR            0x9000CDEC
 Y.CREATE.L   UNUSED_TX_EUL_TURBO_INTLV_PARAM1_BANK0                      0x9000CDEC
 Y.CREATE.L   HWIO_UNUSED_TX_EUL_TURBO_INTLV_PARAM1_BANK1_ADDR            0x9000CDF0
 Y.CREATE.L   UNUSED_TX_EUL_TURBO_INTLV_PARAM1_BANK1                      0x9000CDF0
 Y.CREATE.L   HWIO_UNUSED_TX_EUL_TURBO_INTLV_PARAM1_BANK2_ADDR            0x9000CDF4
 Y.CREATE.L   UNUSED_TX_EUL_TURBO_INTLV_PARAM1_BANK2                      0x9000CDF4
 Y.CREATE.L   HWIO_UNUSED_TX_EUL_TURBO_INTLV_PARAM1_BANK3_ADDR            0x9000CDF8
 Y.CREATE.L   UNUSED_TX_EUL_TURBO_INTLV_PARAM1_BANK3                      0x9000CDF8
 Y.CREATE.L   HWIO_UNUSED_TX_EUL_TURBO_INTLV_PARAM1_BANK4_ADDR            0x9000CDFC
 Y.CREATE.L   UNUSED_TX_EUL_TURBO_INTLV_PARAM1_BANK4                      0x9000CDFC
 Y.CREATE.L   HWIO_UNUSED_TX_EUL_TURBO_INTLV_PARAM1_BANK5_ADDR            0x9000CE00
 Y.CREATE.L   UNUSED_TX_EUL_TURBO_INTLV_PARAM1_BANK5                      0x9000CE00
 Y.CREATE.L   HWIO_UNUSED_TX_EUL_TURBO_INTLV_PARAM1_BANK6_ADDR            0x9000CE04
 Y.CREATE.L   UNUSED_TX_EUL_TURBO_INTLV_PARAM1_BANK6                      0x9000CE04
 Y.CREATE.L   HWIO_UNUSED_TX_EUL_TURBO_INTLV_PARAM1_BANK7_ADDR            0x9000CE08
 Y.CREATE.L   UNUSED_TX_EUL_TURBO_INTLV_PARAM1_BANK7                      0x9000CE08
 Y.CREATE.L   HWIO_UNUSED_TX_TEST_MEM_MODE_ADDR                           0x9000CE0C
 Y.CREATE.L   UNUSED_TX_TEST_MEM_MODE                                     0x9000CE0C
 Y.CREATE.L   HWIO_UNUSED_TX_TEST_MEM_SEL_ADDR                            0x9000CE10
 Y.CREATE.L   UNUSED_TX_TEST_MEM_SEL                                      0x9000CE10
 Y.CREATE.L   HWIO_UNUSED_TX_TEST_MEM_WORD_SEL_ADDR                       0x9000CE14
 Y.CREATE.L   UNUSED_TX_TEST_MEM_WORD_SEL                                 0x9000CE14
 Y.CREATE.L   HWIO_UNUSED_TX_TEST_MISR_RESET_ADDR                         0x9000CE18
 Y.CREATE.L   UNUSED_TX_TEST_MISR_RESET                                   0x9000CE18
 Y.CREATE.L   HWIO_UNUSED_TX_TEST_MISR_ENABLE_ADDR                        0x9000CE1C
 Y.CREATE.L   UNUSED_TX_TEST_MISR_ENABLE                                  0x9000CE1C
 Y.CREATE.L   HWIO_UNUSED_TX_TEST_MISR_CTRL_ADDR                          0x9000CE20
 Y.CREATE.L   UNUSED_TX_TEST_MISR_CTRL                                    0x9000CE20
 Y.CREATE.L   HWIO_UNUSED_TX_TEST_MISR_VALUE_ADDR                         0x9000CE24
 Y.CREATE.L   UNUSED_TX_TEST_MISR_VALUE                                   0x9000CE24
 Y.CREATE.L   HWIO_UNUSED_TX_TXC_VALID_FALL_TIME_ADDR                     0x9000CE28
 Y.CREATE.L   UNUSED_TX_TXC_VALID_FALL_TIME                               0x9000CE28
 Y.CREATE.L   HWIO_UNUSED_STMR_RESET_ADDR                                 0x9000D000
 Y.CREATE.L   UNUSED_STMR_RESET                                           0x9000D000
 Y.CREATE.L   HWIO_UNUSED_STMR_ST_EVENT_CTL_ADDR                          0x9000D004
 Y.CREATE.L   UNUSED_STMR_ST_EVENT_CTL                                    0x9000D004
 Y.CREATE.L   HWIO_UNUSED_STMR_TIME_CMD_MICRO_ADDR                        0x9000D008
 Y.CREATE.L   UNUSED_STMR_TIME_CMD_MICRO                                  0x9000D008
 Y.CREATE.L   HWIO_UNUSED_STMR_REF_COUNT_MICRO_ADDR                       0x9000D00C
 Y.CREATE.L   UNUSED_STMR_REF_COUNT_MICRO                                 0x9000D00C
 Y.CREATE.L   HWIO_UNUSED_STMR_COMBINER_COUNT_MICRO_ADDR                  0x9000D010
 Y.CREATE.L   UNUSED_STMR_COMBINER_COUNT_MICRO                            0x9000D010
 Y.CREATE.L   HWIO_UNUSED_STMR_COMBINER_COUNT2_MICRO_ADDR                 0x9000D014
 Y.CREATE.L   UNUSED_STMR_COMBINER_COUNT2_MICRO                           0x9000D014
 Y.CREATE.L   HWIO_UNUSED_STMR_COMBINER_COUNT3_MICRO_ADDR                 0x9000D018
 Y.CREATE.L   UNUSED_STMR_COMBINER_COUNT3_MICRO                           0x9000D018
 Y.CREATE.L   HWIO_UNUSED_STMR_COMBINER_COUNT4_MICRO_ADDR                 0x9000D01C
 Y.CREATE.L   UNUSED_STMR_COMBINER_COUNT4_MICRO                           0x9000D01C
 Y.CREATE.L   HWIO_UNUSED_STMR_WALL_TIME_MODIFIER_ADDR                    0x9000D020
 Y.CREATE.L   UNUSED_STMR_WALL_TIME_MODIFIER                              0x9000D020
 Y.CREATE.L   HWIO_UNUSED_STMR_STATUS_DUMP_CMD_MICRO_ADDR                 0x9000D024
 Y.CREATE.L   UNUSED_STMR_STATUS_DUMP_CMD_MICRO                           0x9000D024
 Y.CREATE.L   HWIO_UNUSED_STMR_TX_10MS_INT_OFFSET_ADDR                    0x9000D028
 Y.CREATE.L   UNUSED_STMR_TX_10MS_INT_OFFSET                              0x9000D028
 Y.CREATE.L   HWIO_UNUSED_STMR_REF_COUNT_STATUS_MICRO_ADDR                0x9000D02C
 Y.CREATE.L   UNUSED_STMR_REF_COUNT_STATUS_MICRO                          0x9000D02C
 Y.CREATE.L   HWIO_UNUSED_STMR_TX_TIME_STATUS_MICRO_ADDR                  0x9000D030
 Y.CREATE.L   UNUSED_STMR_TX_TIME_STATUS_MICRO                            0x9000D030
 Y.CREATE.L   HWIO_UNUSED_STMR_C0_COUNT_STATUS_MICRO_ADDR                 0x9000D034
 Y.CREATE.L   UNUSED_STMR_C0_COUNT_STATUS_MICRO                           0x9000D034
 Y.CREATE.L   HWIO_UNUSED_STMR_C1_COUNT_STATUS_MICRO_ADDR                 0x9000D038
 Y.CREATE.L   UNUSED_STMR_C1_COUNT_STATUS_MICRO                           0x9000D038
 Y.CREATE.L   HWIO_UNUSED_STMR_C2_COUNT_STATUS_MICRO_ADDR                 0x9000D03C
 Y.CREATE.L   UNUSED_STMR_C2_COUNT_STATUS_MICRO                           0x9000D03C
 Y.CREATE.L   HWIO_UNUSED_STMR_C3_COUNT_STATUS_MICRO_ADDR                 0x9000D040
 Y.CREATE.L   UNUSED_STMR_C3_COUNT_STATUS_MICRO                           0x9000D040
 Y.CREATE.L   HWIO_UNUSED_STMR_C4_COUNT_STATUS_MICRO_ADDR                 0x9000D044
 Y.CREATE.L   UNUSED_STMR_C4_COUNT_STATUS_MICRO                           0x9000D044
 Y.CREATE.L   HWIO_UNUSED_STMR_C5_COUNT_STATUS_MICRO_ADDR                 0x9000D048
 Y.CREATE.L   UNUSED_STMR_C5_COUNT_STATUS_MICRO                           0x9000D048
 Y.CREATE.L   HWIO_UNUSED_STMR_C6_COUNT_STATUS_MICRO_ADDR                 0x9000D04C
 Y.CREATE.L   UNUSED_STMR_C6_COUNT_STATUS_MICRO                           0x9000D04C
 Y.CREATE.L   HWIO_UNUSED_STMR_C7_COUNT_STATUS_MICRO_ADDR                 0x9000D050
 Y.CREATE.L   UNUSED_STMR_C7_COUNT_STATUS_MICRO                           0x9000D050
 Y.CREATE.L   HWIO_UNUSED_STMR_C8_COUNT_STATUS_MICRO_ADDR                 0x9000D054
 Y.CREATE.L   UNUSED_STMR_C8_COUNT_STATUS_MICRO                           0x9000D054
 Y.CREATE.L   HWIO_UNUSED_STMR_C9_COUNT_STATUS_MICRO_ADDR                 0x9000D058
 Y.CREATE.L   UNUSED_STMR_C9_COUNT_STATUS_MICRO                           0x9000D058
 Y.CREATE.L   HWIO_UNUSED_STMR_C10_COUNT_STATUS_MICRO_ADDR                0x9000D05C
 Y.CREATE.L   UNUSED_STMR_C10_COUNT_STATUS_MICRO                          0x9000D05C
 Y.CREATE.L   HWIO_UNUSED_STMR_C11_COUNT_STATUS_MICRO_ADDR                0x9000D060
 Y.CREATE.L   UNUSED_STMR_C11_COUNT_STATUS_MICRO                          0x9000D060
 Y.CREATE.L   HWIO_UNUSED_STMR_C12_COUNT_STATUS_MICRO_ADDR                0x9000D064
 Y.CREATE.L   UNUSED_STMR_C12_COUNT_STATUS_MICRO                          0x9000D064
 Y.CREATE.L   HWIO_UNUSED_STMR_C13_COUNT_STATUS_MICRO_ADDR                0x9000D068
 Y.CREATE.L   UNUSED_STMR_C13_COUNT_STATUS_MICRO                          0x9000D068
 Y.CREATE.L   HWIO_UNUSED_STMR_C14_COUNT_STATUS_MICRO_ADDR                0x9000D06C
 Y.CREATE.L   UNUSED_STMR_C14_COUNT_STATUS_MICRO                          0x9000D06C
 Y.CREATE.L   HWIO_UNUSED_STMR_C15_COUNT_STATUS_MICRO_ADDR                0x9000D070
 Y.CREATE.L   UNUSED_STMR_C15_COUNT_STATUS_MICRO                          0x9000D070
 Y.CREATE.L   HWIO_UNUSED_STMR_C16_COUNT_STATUS_MICRO_ADDR                0x9000D074
 Y.CREATE.L   UNUSED_STMR_C16_COUNT_STATUS_MICRO                          0x9000D074
 Y.CREATE.L   HWIO_UNUSED_STMR_CFN_COUNT_MICRO_ADDR                       0x9000D078
 Y.CREATE.L   UNUSED_STMR_CFN_COUNT_MICRO                                 0x9000D078
 Y.CREATE.L   HWIO_UNUSED_STMR_CFN_COUNT2_MICRO_ADDR                      0x9000D07C
 Y.CREATE.L   UNUSED_STMR_CFN_COUNT2_MICRO                                0x9000D07C
 Y.CREATE.L   HWIO_UNUSED_STMR_CFN_COUNT3_MICRO_ADDR                      0x9000D080
 Y.CREATE.L   UNUSED_STMR_CFN_COUNT3_MICRO                                0x9000D080
 Y.CREATE.L   HWIO_UNUSED_STMR_CFN_COUNT4_MICRO_ADDR                      0x9000D084
 Y.CREATE.L   UNUSED_STMR_CFN_COUNT4_MICRO                                0x9000D084
 Y.CREATE.L   HWIO_UNUSED_STMR_C4_COUNT_MICRO_ADDR                        0x9000D088
 Y.CREATE.L   UNUSED_STMR_C4_COUNT_MICRO                                  0x9000D088
 Y.CREATE.L   HWIO_UNUSED_STMR_C4_CFN_MICRO_ADDR                          0x9000D08C
 Y.CREATE.L   UNUSED_STMR_C4_CFN_MICRO                                    0x9000D08C
 Y.CREATE.L   HWIO_UNUSED_STMR_PROG_INT0_STATUS_ADDR                      0x9000D090
 Y.CREATE.L   UNUSED_STMR_PROG_INT0_STATUS                                0x9000D090
 Y.CREATE.L   HWIO_UNUSED_STMR_PROG_INT1_STATUS_ADDR                      0x9000D094
 Y.CREATE.L   UNUSED_STMR_PROG_INT1_STATUS                                0x9000D094
 Y.CREATE.L   HWIO_UNUSED_STMR_PROG_INT2_STATUS_ADDR                      0x9000D098
 Y.CREATE.L   UNUSED_STMR_PROG_INT2_STATUS                                0x9000D098
 Y.CREATE.L   HWIO_UNUSED_STMR_PROG_INT3_STATUS_ADDR                      0x9000D09C
 Y.CREATE.L   UNUSED_STMR_PROG_INT3_STATUS                                0x9000D09C
 Y.CREATE.L   HWIO_UNUSED_STMR_PROG_INT0_CMD_ADDR                         0x9000D0A0
 Y.CREATE.L   UNUSED_STMR_PROG_INT0_CMD                                   0x9000D0A0
 Y.CREATE.L   HWIO_UNUSED_STMR_PROG_INT1_CMD_ADDR                         0x9000D0A4
 Y.CREATE.L   UNUSED_STMR_PROG_INT1_CMD                                   0x9000D0A4
 Y.CREATE.L   HWIO_UNUSED_STMR_PROG_INT2_CMD_ADDR                         0x9000D0A8
 Y.CREATE.L   UNUSED_STMR_PROG_INT2_CMD                                   0x9000D0A8
 Y.CREATE.L   HWIO_UNUSED_STMR_PROG_INT3_CMD_ADDR                         0x9000D0AC
 Y.CREATE.L   UNUSED_STMR_PROG_INT3_CMD                                   0x9000D0AC
 Y.CREATE.L   HWIO_UNUSED_STMR_PROG_INT0_CTL_ADDR                         0x9000D0B0
 Y.CREATE.L   UNUSED_STMR_PROG_INT0_CTL                                   0x9000D0B0
 Y.CREATE.L   HWIO_UNUSED_STMR_PROG_INT1_CTL_ADDR                         0x9000D0B4
 Y.CREATE.L   UNUSED_STMR_PROG_INT1_CTL                                   0x9000D0B4
 Y.CREATE.L   HWIO_UNUSED_STMR_PROG_INT2_CTL_ADDR                         0x9000D0B8
 Y.CREATE.L   UNUSED_STMR_PROG_INT2_CTL                                   0x9000D0B8
 Y.CREATE.L   HWIO_UNUSED_STMR_PROG_INT3_CTL_ADDR                         0x9000D0BC
 Y.CREATE.L   UNUSED_STMR_PROG_INT3_CTL                                   0x9000D0BC
 Y.CREATE.L   HWIO_UNUSED_STMR_INT0_EVENT_0_ADDR                          0x9000D0C0
 Y.CREATE.L   UNUSED_STMR_INT0_EVENT_0                                    0x9000D0C0
 Y.CREATE.L   HWIO_UNUSED_STMR_INT0_EVENT_1_ADDR                          0x9000D0C4
 Y.CREATE.L   UNUSED_STMR_INT0_EVENT_1                                    0x9000D0C4
 Y.CREATE.L   HWIO_UNUSED_STMR_INT0_EVENT_2_ADDR                          0x9000D0C8
 Y.CREATE.L   UNUSED_STMR_INT0_EVENT_2                                    0x9000D0C8
 Y.CREATE.L   HWIO_UNUSED_STMR_INT0_EVENT_3_ADDR                          0x9000D0CC
 Y.CREATE.L   UNUSED_STMR_INT0_EVENT_3                                    0x9000D0CC
 Y.CREATE.L   HWIO_UNUSED_STMR_INT0_EVENT_4_ADDR                          0x9000D0D0
 Y.CREATE.L   UNUSED_STMR_INT0_EVENT_4                                    0x9000D0D0
 Y.CREATE.L   HWIO_UNUSED_STMR_INT0_EVENT_5_ADDR                          0x9000D0D4
 Y.CREATE.L   UNUSED_STMR_INT0_EVENT_5                                    0x9000D0D4
 Y.CREATE.L   HWIO_UNUSED_STMR_INT0_EVENT_6_ADDR                          0x9000D0D8
 Y.CREATE.L   UNUSED_STMR_INT0_EVENT_6                                    0x9000D0D8
 Y.CREATE.L   HWIO_UNUSED_STMR_INT0_EVENT_7_ADDR                          0x9000D0DC
 Y.CREATE.L   UNUSED_STMR_INT0_EVENT_7                                    0x9000D0DC
 Y.CREATE.L   HWIO_UNUSED_STMR_INT0_EVENT_8_ADDR                          0x9000D0E0
 Y.CREATE.L   UNUSED_STMR_INT0_EVENT_8                                    0x9000D0E0
 Y.CREATE.L   HWIO_UNUSED_STMR_INT0_EVENT_9_ADDR                          0x9000D0E4
 Y.CREATE.L   UNUSED_STMR_INT0_EVENT_9                                    0x9000D0E4
 Y.CREATE.L   HWIO_UNUSED_STMR_INT0_EVENT_10_ADDR                         0x9000D0E8
 Y.CREATE.L   UNUSED_STMR_INT0_EVENT_10                                   0x9000D0E8
 Y.CREATE.L   HWIO_UNUSED_STMR_INT0_EVENT_11_ADDR                         0x9000D0EC
 Y.CREATE.L   UNUSED_STMR_INT0_EVENT_11                                   0x9000D0EC
 Y.CREATE.L   HWIO_UNUSED_STMR_INT0_EVENT_12_ADDR                         0x9000D0F0
 Y.CREATE.L   UNUSED_STMR_INT0_EVENT_12                                   0x9000D0F0
 Y.CREATE.L   HWIO_UNUSED_STMR_INT0_EVENT_13_ADDR                         0x9000D0F4
 Y.CREATE.L   UNUSED_STMR_INT0_EVENT_13                                   0x9000D0F4
 Y.CREATE.L   HWIO_UNUSED_STMR_INT0_EVENT_14_ADDR                         0x9000D0F8
 Y.CREATE.L   UNUSED_STMR_INT0_EVENT_14                                   0x9000D0F8
 Y.CREATE.L   HWIO_UNUSED_STMR_INT0_EVENT_15_ADDR                         0x9000D0FC
 Y.CREATE.L   UNUSED_STMR_INT0_EVENT_15                                   0x9000D0FC
 Y.CREATE.L   HWIO_UNUSED_STMR_INT1_EVENT_0_ADDR                          0x9000D100
 Y.CREATE.L   UNUSED_STMR_INT1_EVENT_0                                    0x9000D100
 Y.CREATE.L   HWIO_UNUSED_STMR_INT1_EVENT_1_ADDR                          0x9000D104
 Y.CREATE.L   UNUSED_STMR_INT1_EVENT_1                                    0x9000D104
 Y.CREATE.L   HWIO_UNUSED_STMR_INT1_EVENT_2_ADDR                          0x9000D108
 Y.CREATE.L   UNUSED_STMR_INT1_EVENT_2                                    0x9000D108
 Y.CREATE.L   HWIO_UNUSED_STMR_INT1_EVENT_3_ADDR                          0x9000D10C
 Y.CREATE.L   UNUSED_STMR_INT1_EVENT_3                                    0x9000D10C
 Y.CREATE.L   HWIO_UNUSED_STMR_INT1_EVENT_4_ADDR                          0x9000D110
 Y.CREATE.L   UNUSED_STMR_INT1_EVENT_4                                    0x9000D110
 Y.CREATE.L   HWIO_UNUSED_STMR_INT1_EVENT_5_ADDR                          0x9000D114
 Y.CREATE.L   UNUSED_STMR_INT1_EVENT_5                                    0x9000D114
 Y.CREATE.L   HWIO_UNUSED_STMR_INT1_EVENT_6_ADDR                          0x9000D118
 Y.CREATE.L   UNUSED_STMR_INT1_EVENT_6                                    0x9000D118
 Y.CREATE.L   HWIO_UNUSED_STMR_INT1_EVENT_7_ADDR                          0x9000D11C
 Y.CREATE.L   UNUSED_STMR_INT1_EVENT_7                                    0x9000D11C
 Y.CREATE.L   HWIO_UNUSED_STMR_INT2_EVENT_0_ADDR                          0x9000D120
 Y.CREATE.L   UNUSED_STMR_INT2_EVENT_0                                    0x9000D120
 Y.CREATE.L   HWIO_UNUSED_STMR_INT2_EVENT_1_ADDR                          0x9000D124
 Y.CREATE.L   UNUSED_STMR_INT2_EVENT_1                                    0x9000D124
 Y.CREATE.L   HWIO_UNUSED_STMR_INT2_EVENT_2_ADDR                          0x9000D128
 Y.CREATE.L   UNUSED_STMR_INT2_EVENT_2                                    0x9000D128
 Y.CREATE.L   HWIO_UNUSED_STMR_INT2_EVENT_3_ADDR                          0x9000D12C
 Y.CREATE.L   UNUSED_STMR_INT2_EVENT_3                                    0x9000D12C
 Y.CREATE.L   HWIO_UNUSED_STMR_INT2_EVENT_4_ADDR                          0x9000D130
 Y.CREATE.L   UNUSED_STMR_INT2_EVENT_4                                    0x9000D130
 Y.CREATE.L   HWIO_UNUSED_STMR_INT2_EVENT_5_ADDR                          0x9000D134
 Y.CREATE.L   UNUSED_STMR_INT2_EVENT_5                                    0x9000D134
 Y.CREATE.L   HWIO_UNUSED_STMR_INT2_EVENT_6_ADDR                          0x9000D138
 Y.CREATE.L   UNUSED_STMR_INT2_EVENT_6                                    0x9000D138
 Y.CREATE.L   HWIO_UNUSED_STMR_INT2_EVENT_7_ADDR                          0x9000D13C
 Y.CREATE.L   UNUSED_STMR_INT2_EVENT_7                                    0x9000D13C
 Y.CREATE.L   HWIO_UNUSED_STMR_INT3_EVENT_0_ADDR                          0x9000D140
 Y.CREATE.L   UNUSED_STMR_INT3_EVENT_0                                    0x9000D140
 Y.CREATE.L   HWIO_UNUSED_STMR_INT3_EVENT_1_ADDR                          0x9000D144
 Y.CREATE.L   UNUSED_STMR_INT3_EVENT_1                                    0x9000D144
 Y.CREATE.L   HWIO_UNUSED_STMR_INT3_EVENT_2_ADDR                          0x9000D148
 Y.CREATE.L   UNUSED_STMR_INT3_EVENT_2                                    0x9000D148
 Y.CREATE.L   HWIO_UNUSED_STMR_INT3_EVENT_3_ADDR                          0x9000D14C
 Y.CREATE.L   UNUSED_STMR_INT3_EVENT_3                                    0x9000D14C
 Y.CREATE.L   HWIO_UNUSED_STMR_INT3_EVENT_4_ADDR                          0x9000D150
 Y.CREATE.L   UNUSED_STMR_INT3_EVENT_4                                    0x9000D150
 Y.CREATE.L   HWIO_UNUSED_STMR_INT3_EVENT_5_ADDR                          0x9000D154
 Y.CREATE.L   UNUSED_STMR_INT3_EVENT_5                                    0x9000D154
 Y.CREATE.L   HWIO_UNUSED_STMR_INT3_EVENT_6_ADDR                          0x9000D158
 Y.CREATE.L   UNUSED_STMR_INT3_EVENT_6                                    0x9000D158
 Y.CREATE.L   HWIO_UNUSED_STMR_INT3_EVENT_7_ADDR                          0x9000D15C
 Y.CREATE.L   UNUSED_STMR_INT3_EVENT_7                                    0x9000D15C
 Y.CREATE.L   HWIO_UNUSED_STMR_DSP_INT_DELAY_ADDR                         0x9000D160
 Y.CREATE.L   UNUSED_STMR_DSP_INT_DELAY                                   0x9000D160
 Y.CREATE.L   HWIO_UNUSED_STMR_TEST_BUS_SEL_ADDR                          0x9000D164
 Y.CREATE.L   UNUSED_STMR_TEST_BUS_SEL                                    0x9000D164
 Y.CREATE.L   HWIO_UNUSED_STMR_GSM_COUNT_MICRO_ADDR                       0x9000D168
 Y.CREATE.L   UNUSED_STMR_GSM_COUNT_MICRO                                 0x9000D168
 Y.CREATE.L   HWIO_UNUSED_STMR_WCDMA_COUNT_MICRO_ADDR                     0x9000D16C
 Y.CREATE.L   UNUSED_STMR_WCDMA_COUNT_MICRO                               0x9000D16C
 Y.CREATE.L   HWIO_UNUSED_STMR_CLK_ENA_ADDR                               0x9000D170
 Y.CREATE.L   UNUSED_STMR_CLK_ENA                                         0x9000D170
 Y.CREATE.L   HWIO_UNUSED_STMR_CLK_STATUS_ADDR                            0x9000D174
 Y.CREATE.L   UNUSED_STMR_CLK_STATUS                                      0x9000D174
 Y.CREATE.L   HWIO_UNUSED_STMR_CFN_MODIFIER1_MICRO_ADDR                   0x9000D178
 Y.CREATE.L   UNUSED_STMR_CFN_MODIFIER1_MICRO                             0x9000D178
 Y.CREATE.L   HWIO_UNUSED_STMR_CFN_MODIFIER2_MICRO_ADDR                   0x9000D17C
 Y.CREATE.L   UNUSED_STMR_CFN_MODIFIER2_MICRO                             0x9000D17C
 Y.CREATE.L   HWIO_UNUSED_STMR_CFN_MODIFIER3_MICRO_ADDR                   0x9000D180
 Y.CREATE.L   UNUSED_STMR_CFN_MODIFIER3_MICRO                             0x9000D180
 Y.CREATE.L   HWIO_UNUSED_STMR_CFN_MODIFIER4_MICRO_ADDR                   0x9000D184
 Y.CREATE.L   UNUSED_STMR_CFN_MODIFIER4_MICRO                             0x9000D184
 Y.CREATE.L   HWIO_UNUSED_STMR_CFN_MODIFIER5_MICRO_ADDR                   0x9000D188
 Y.CREATE.L   UNUSED_STMR_CFN_MODIFIER5_MICRO                             0x9000D188
 Y.CREATE.L   HWIO_UNUSED_STMR_CFN_MODIFIER_SEL_ADDR                      0x9000D18C
 Y.CREATE.L   UNUSED_STMR_CFN_MODIFIER_SEL                                0x9000D18C
 Y.CREATE.L   HWIO_UNUSED_STMR_MISC_CTL_ADDR                              0x9000D190
 Y.CREATE.L   UNUSED_STMR_MISC_CTL                                        0x9000D190
 Y.CREATE.L   HWIO_UNUSED_STMR_TIME_SYNC_CTL_ADDR                         0x9000D194
 Y.CREATE.L   UNUSED_STMR_TIME_SYNC_CTL                                   0x9000D194
 Y.CREATE.L   HWIO_UNUSED_STMR_CN_MODIFIER_ON_LINE_ADDR                   0x9000D198
 Y.CREATE.L   UNUSED_STMR_CN_MODIFIER_ON_LINE                             0x9000D198
 Y.CREATE.L   HWIO_UNUSED_STMR_GSM_SYNC_TIME_ADDR                         0x9000D19C
 Y.CREATE.L   UNUSED_STMR_GSM_SYNC_TIME                                   0x9000D19C
 Y.CREATE.L   HWIO_UNUSED_STMR_GPS_SYNC_TIME_ADDR                         0x9000D1A0
 Y.CREATE.L   UNUSED_STMR_GPS_SYNC_TIME                                   0x9000D1A0
 Y.CREATE.L   HWIO_UNUSED_UMTS_SAMPSRV_SW_RESET_ADDR                      0x9000D200
 Y.CREATE.L   UNUSED_UMTS_SAMPSRV_SW_RESET                                0x9000D200
 Y.CREATE.L   HWIO_UNUSED_UMTS_SAMPSRV_CTL_SEL_ADDR                       0x9000D204
 Y.CREATE.L   UNUSED_UMTS_SAMPSRV_CTL_SEL                                 0x9000D204
 Y.CREATE.L   HWIO_UNUSED_UMTS_SAMPSRV_CLK_DISABLE_ADDR                   0x9000D208
 Y.CREATE.L   UNUSED_UMTS_SAMPSRV_CLK_DISABLE                             0x9000D208
 Y.CREATE.L   HWIO_UNUSED_UMTS_SAMPSRV_CLK_STATUS_ADDR                    0x9000D20C
 Y.CREATE.L   UNUSED_UMTS_SAMPSRV_CLK_STATUS                              0x9000D20C
 Y.CREATE.L   HWIO_UNUSED_UMTS_SAMPSRV_0_CAPTURE_CTL_ADDR                 0x9000D210
 Y.CREATE.L   UNUSED_UMTS_SAMPSRV_0_CAPTURE_CTL                           0x9000D210
 Y.CREATE.L   HWIO_UNUSED_UMTS_SAMPSRV_1_CAPTURE_CTL_ADDR                 0x9000D214
 Y.CREATE.L   UNUSED_UMTS_SAMPSRV_1_CAPTURE_CTL                           0x9000D214
 Y.CREATE.L   HWIO_UNUSED_UMTS_SAMPSRV_0_WIND_START_CTL_ADDR              0x9000D218
 Y.CREATE.L   UNUSED_UMTS_SAMPSRV_0_WIND_START_CTL                        0x9000D218
 Y.CREATE.L   HWIO_UNUSED_UMTS_SAMPSRV_1_WIND_START_CTL_ADDR              0x9000D21C
 Y.CREATE.L   UNUSED_UMTS_SAMPSRV_1_WIND_START_CTL                        0x9000D21C
 Y.CREATE.L   HWIO_UNUSED_UMTS_SAMPSRV_0_WIND_STOP_CTL_ADDR               0x9000D220
 Y.CREATE.L   UNUSED_UMTS_SAMPSRV_0_WIND_STOP_CTL                         0x9000D220
 Y.CREATE.L   HWIO_UNUSED_UMTS_SAMPSRV_1_WIND_STOP_CTL_ADDR               0x9000D224
 Y.CREATE.L   UNUSED_UMTS_SAMPSRV_1_WIND_STOP_CTL                         0x9000D224
 Y.CREATE.L   HWIO_UNUSED_UMTS_SAMPSRV_0_SRC_SEL_ADDR                     0x9000D228
 Y.CREATE.L   UNUSED_UMTS_SAMPSRV_0_SRC_SEL                               0x9000D228
 Y.CREATE.L   HWIO_UNUSED_UMTS_SAMPSRV_1_SRC_SEL_ADDR                     0x9000D22C
 Y.CREATE.L   UNUSED_UMTS_SAMPSRV_1_SRC_SEL                               0x9000D22C
 Y.CREATE.L   HWIO_UNUSED_UMTS_SAMPSRV_0_WIND_STATUS_ADDR                 0x9000D230
 Y.CREATE.L   UNUSED_UMTS_SAMPSRV_0_WIND_STATUS                           0x9000D230
 Y.CREATE.L   HWIO_UNUSED_UMTS_SAMPSRV_1_WIND_STATUS_ADDR                 0x9000D234
 Y.CREATE.L   UNUSED_UMTS_SAMPSRV_1_WIND_STATUS                           0x9000D234
 Y.CREATE.L   HWIO_UNUSED_UMTS_SAMPSRV_0_LATEST_ADDR_ADDR                 0x9000D238
 Y.CREATE.L   UNUSED_UMTS_SAMPSRV_0_LATEST_ADDR                           0x9000D238
 Y.CREATE.L   HWIO_UNUSED_UMTS_SAMPSRV_1_LATEST_ADDR_ADDR                 0x9000D23C
 Y.CREATE.L   UNUSED_UMTS_SAMPSRV_1_LATEST_ADDR                           0x9000D23C
 Y.CREATE.L   HWIO_UNUSED_UMTS_SAMPSRV_0_Y1Y2_CAPTURE_CTL_ADDR            0x9000D240
 Y.CREATE.L   UNUSED_UMTS_SAMPSRV_0_Y1Y2_CAPTURE_CTL                      0x9000D240
 Y.CREATE.L   HWIO_UNUSED_UMTS_SAMPSRV_1_Y1Y2_CAPTURE_CTL_ADDR            0x9000D244
 Y.CREATE.L   UNUSED_UMTS_SAMPSRV_1_Y1Y2_CAPTURE_CTL                      0x9000D244
 Y.CREATE.L   HWIO_UNUSED_UMTS_SAMPSRV_TEST_RAM_ADDR_ADDR                 0x9000D248
 Y.CREATE.L   UNUSED_UMTS_SAMPSRV_TEST_RAM_ADDR                           0x9000D248
 Y.CREATE.L   HWIO_UNUSED_UMTS_SAMPSRV_TEST_RAM_DATA_ADDR                 0x9000D24C
 Y.CREATE.L   UNUSED_UMTS_SAMPSRV_TEST_RAM_DATA                           0x9000D24C
 Y.CREATE.L   HWIO_UNUSED_UMTS_SAMPSRV_TESTBUS_ENABLE_ADDR                0x9000D250
 Y.CREATE.L   UNUSED_UMTS_SAMPSRV_TESTBUS_ENABLE                          0x9000D250
 Y.CREATE.L   HWIO_UNUSED_UMTS_SAMPSRV_SPARE_ADDR                         0x9000D254
 Y.CREATE.L   UNUSED_UMTS_SAMPSRV_SPARE                                   0x9000D254
 Y.CREATE.L   HWIO_UNUSED_MODEM_TEST_MEM_ACCESS_ADDR                      0x90008000
 Y.CREATE.L   UNUSED_MODEM_TEST_MEM_ACCESS                                0x90008000
 Y.CREATE.L   HWIO_UNUSED_MODEM_TEST_MEM_ACCESS_LAST_ADDR                 0x90008FFC
 Y.CREATE.L   UNUSED_MODEM_TEST_MEM_ACCESS_LAST                           0x90008FFC
 Y.CREATE.L   HWIO_MDM_HI0_CH0_CMD_PTR_SD0_ADDR                           0x90400000
 Y.CREATE.L   MDM_HI0_CH0_CMD_PTR_SD0                                     0x90400000
 Y.CREATE.L   HWIO_MDM_HI0_CH0_CMD_PTR_SD1_ADDR                           0x90400400
 Y.CREATE.L   MDM_HI0_CH0_CMD_PTR_SD1                                     0x90400400
 Y.CREATE.L   HWIO_MDM_HI0_CH0_CMD_PTR_SD2_ADDR                           0x90400800
 Y.CREATE.L   MDM_HI0_CH0_CMD_PTR_SD2                                     0x90400800
 Y.CREATE.L   HWIO_MDM_HI0_CH0_CMD_PTR_SD3_ADDR                           0x90400C00
 Y.CREATE.L   MDM_HI0_CH0_CMD_PTR_SD3                                     0x90400C00
 Y.CREATE.L   HWIO_MDM_HI0_CH1_CMD_PTR_SD0_ADDR                           0x90400004
 Y.CREATE.L   MDM_HI0_CH1_CMD_PTR_SD0                                     0x90400004
 Y.CREATE.L   HWIO_MDM_HI0_CH1_CMD_PTR_SD1_ADDR                           0x90400404
 Y.CREATE.L   MDM_HI0_CH1_CMD_PTR_SD1                                     0x90400404
 Y.CREATE.L   HWIO_MDM_HI0_CH1_CMD_PTR_SD2_ADDR                           0x90400804
 Y.CREATE.L   MDM_HI0_CH1_CMD_PTR_SD2                                     0x90400804
 Y.CREATE.L   HWIO_MDM_HI0_CH1_CMD_PTR_SD3_ADDR                           0x90400C04
 Y.CREATE.L   MDM_HI0_CH1_CMD_PTR_SD3                                     0x90400C04
 Y.CREATE.L   HWIO_MDM_HI0_CH2_CMD_PTR_SD0_ADDR                           0x90400008
 Y.CREATE.L   MDM_HI0_CH2_CMD_PTR_SD0                                     0x90400008
 Y.CREATE.L   HWIO_MDM_HI0_CH2_CMD_PTR_SD1_ADDR                           0x90400408
 Y.CREATE.L   MDM_HI0_CH2_CMD_PTR_SD1                                     0x90400408
 Y.CREATE.L   HWIO_MDM_HI0_CH2_CMD_PTR_SD2_ADDR                           0x90400808
 Y.CREATE.L   MDM_HI0_CH2_CMD_PTR_SD2                                     0x90400808
 Y.CREATE.L   HWIO_MDM_HI0_CH2_CMD_PTR_SD3_ADDR                           0x90400C08
 Y.CREATE.L   MDM_HI0_CH2_CMD_PTR_SD3                                     0x90400C08
 Y.CREATE.L   HWIO_MDM_HI0_CH3_CMD_PTR_SD0_ADDR                           0x9040000C
 Y.CREATE.L   MDM_HI0_CH3_CMD_PTR_SD0                                     0x9040000C
 Y.CREATE.L   HWIO_MDM_HI0_CH3_CMD_PTR_SD1_ADDR                           0x9040040C
 Y.CREATE.L   MDM_HI0_CH3_CMD_PTR_SD1                                     0x9040040C
 Y.CREATE.L   HWIO_MDM_HI0_CH3_CMD_PTR_SD2_ADDR                           0x9040080C
 Y.CREATE.L   MDM_HI0_CH3_CMD_PTR_SD2                                     0x9040080C
 Y.CREATE.L   HWIO_MDM_HI0_CH3_CMD_PTR_SD3_ADDR                           0x90400C0C
 Y.CREATE.L   MDM_HI0_CH3_CMD_PTR_SD3                                     0x90400C0C
 Y.CREATE.L   HWIO_MDM_HI0_CH4_CMD_PTR_SD0_ADDR                           0x90400010
 Y.CREATE.L   MDM_HI0_CH4_CMD_PTR_SD0                                     0x90400010
 Y.CREATE.L   HWIO_MDM_HI0_CH4_CMD_PTR_SD1_ADDR                           0x90400410
 Y.CREATE.L   MDM_HI0_CH4_CMD_PTR_SD1                                     0x90400410
 Y.CREATE.L   HWIO_MDM_HI0_CH4_CMD_PTR_SD2_ADDR                           0x90400810
 Y.CREATE.L   MDM_HI0_CH4_CMD_PTR_SD2                                     0x90400810
 Y.CREATE.L   HWIO_MDM_HI0_CH4_CMD_PTR_SD3_ADDR                           0x90400C10
 Y.CREATE.L   MDM_HI0_CH4_CMD_PTR_SD3                                     0x90400C10
 Y.CREATE.L   HWIO_MDM_HI0_CH5_CMD_PTR_SD0_ADDR                           0x90400014
 Y.CREATE.L   MDM_HI0_CH5_CMD_PTR_SD0                                     0x90400014
 Y.CREATE.L   HWIO_MDM_HI0_CH5_CMD_PTR_SD1_ADDR                           0x90400414
 Y.CREATE.L   MDM_HI0_CH5_CMD_PTR_SD1                                     0x90400414
 Y.CREATE.L   HWIO_MDM_HI0_CH5_CMD_PTR_SD2_ADDR                           0x90400814
 Y.CREATE.L   MDM_HI0_CH5_CMD_PTR_SD2                                     0x90400814
 Y.CREATE.L   HWIO_MDM_HI0_CH5_CMD_PTR_SD3_ADDR                           0x90400C14
 Y.CREATE.L   MDM_HI0_CH5_CMD_PTR_SD3                                     0x90400C14
 Y.CREATE.L   HWIO_MDM_HI0_CH6_CMD_PTR_SD0_ADDR                           0x90400018
 Y.CREATE.L   MDM_HI0_CH6_CMD_PTR_SD0                                     0x90400018
 Y.CREATE.L   HWIO_MDM_HI0_CH6_CMD_PTR_SD1_ADDR                           0x90400418
 Y.CREATE.L   MDM_HI0_CH6_CMD_PTR_SD1                                     0x90400418
 Y.CREATE.L   HWIO_MDM_HI0_CH6_CMD_PTR_SD2_ADDR                           0x90400818
 Y.CREATE.L   MDM_HI0_CH6_CMD_PTR_SD2                                     0x90400818
 Y.CREATE.L   HWIO_MDM_HI0_CH6_CMD_PTR_SD3_ADDR                           0x90400C18
 Y.CREATE.L   MDM_HI0_CH6_CMD_PTR_SD3                                     0x90400C18
 Y.CREATE.L   HWIO_MDM_HI0_CH7_CMD_PTR_SD0_ADDR                           0x9040001C
 Y.CREATE.L   MDM_HI0_CH7_CMD_PTR_SD0                                     0x9040001C
 Y.CREATE.L   HWIO_MDM_HI0_CH7_CMD_PTR_SD1_ADDR                           0x9040041C
 Y.CREATE.L   MDM_HI0_CH7_CMD_PTR_SD1                                     0x9040041C
 Y.CREATE.L   HWIO_MDM_HI0_CH7_CMD_PTR_SD2_ADDR                           0x9040081C
 Y.CREATE.L   MDM_HI0_CH7_CMD_PTR_SD2                                     0x9040081C
 Y.CREATE.L   HWIO_MDM_HI0_CH7_CMD_PTR_SD3_ADDR                           0x90400C1C
 Y.CREATE.L   MDM_HI0_CH7_CMD_PTR_SD3                                     0x90400C1C
 Y.CREATE.L   HWIO_MDM_HI0_CH8_CMD_PTR_SD0_ADDR                           0x90400020
 Y.CREATE.L   MDM_HI0_CH8_CMD_PTR_SD0                                     0x90400020
 Y.CREATE.L   HWIO_MDM_HI0_CH8_CMD_PTR_SD1_ADDR                           0x90400420
 Y.CREATE.L   MDM_HI0_CH8_CMD_PTR_SD1                                     0x90400420
 Y.CREATE.L   HWIO_MDM_HI0_CH8_CMD_PTR_SD2_ADDR                           0x90400820
 Y.CREATE.L   MDM_HI0_CH8_CMD_PTR_SD2                                     0x90400820
 Y.CREATE.L   HWIO_MDM_HI0_CH8_CMD_PTR_SD3_ADDR                           0x90400C20
 Y.CREATE.L   MDM_HI0_CH8_CMD_PTR_SD3                                     0x90400C20
 Y.CREATE.L   HWIO_MDM_HI0_CH9_CMD_PTR_SD0_ADDR                           0x90400024
 Y.CREATE.L   MDM_HI0_CH9_CMD_PTR_SD0                                     0x90400024
 Y.CREATE.L   HWIO_MDM_HI0_CH9_CMD_PTR_SD1_ADDR                           0x90400424
 Y.CREATE.L   MDM_HI0_CH9_CMD_PTR_SD1                                     0x90400424
 Y.CREATE.L   HWIO_MDM_HI0_CH9_CMD_PTR_SD2_ADDR                           0x90400824
 Y.CREATE.L   MDM_HI0_CH9_CMD_PTR_SD2                                     0x90400824
 Y.CREATE.L   HWIO_MDM_HI0_CH9_CMD_PTR_SD3_ADDR                           0x90400C24
 Y.CREATE.L   MDM_HI0_CH9_CMD_PTR_SD3                                     0x90400C24
 Y.CREATE.L   HWIO_MDM_HI0_CH10_CMD_PTR_SD0_ADDR                          0x90400028
 Y.CREATE.L   MDM_HI0_CH10_CMD_PTR_SD0                                    0x90400028
 Y.CREATE.L   HWIO_MDM_HI0_CH10_CMD_PTR_SD1_ADDR                          0x90400428
 Y.CREATE.L   MDM_HI0_CH10_CMD_PTR_SD1                                    0x90400428
 Y.CREATE.L   HWIO_MDM_HI0_CH10_CMD_PTR_SD2_ADDR                          0x90400828
 Y.CREATE.L   MDM_HI0_CH10_CMD_PTR_SD2                                    0x90400828
 Y.CREATE.L   HWIO_MDM_HI0_CH10_CMD_PTR_SD3_ADDR                          0x90400C28
 Y.CREATE.L   MDM_HI0_CH10_CMD_PTR_SD3                                    0x90400C28
 Y.CREATE.L   HWIO_MDM_HI0_CH11_CMD_PTR_SD0_ADDR                          0x9040002C
 Y.CREATE.L   MDM_HI0_CH11_CMD_PTR_SD0                                    0x9040002C
 Y.CREATE.L   HWIO_MDM_HI0_CH11_CMD_PTR_SD1_ADDR                          0x9040042C
 Y.CREATE.L   MDM_HI0_CH11_CMD_PTR_SD1                                    0x9040042C
 Y.CREATE.L   HWIO_MDM_HI0_CH11_CMD_PTR_SD2_ADDR                          0x9040082C
 Y.CREATE.L   MDM_HI0_CH11_CMD_PTR_SD2                                    0x9040082C
 Y.CREATE.L   HWIO_MDM_HI0_CH11_CMD_PTR_SD3_ADDR                          0x90400C2C
 Y.CREATE.L   MDM_HI0_CH11_CMD_PTR_SD3                                    0x90400C2C
 Y.CREATE.L   HWIO_MDM_HI0_CH12_CMD_PTR_SD0_ADDR                          0x90400030
 Y.CREATE.L   MDM_HI0_CH12_CMD_PTR_SD0                                    0x90400030
 Y.CREATE.L   HWIO_MDM_HI0_CH12_CMD_PTR_SD1_ADDR                          0x90400430
 Y.CREATE.L   MDM_HI0_CH12_CMD_PTR_SD1                                    0x90400430
 Y.CREATE.L   HWIO_MDM_HI0_CH12_CMD_PTR_SD2_ADDR                          0x90400830
 Y.CREATE.L   MDM_HI0_CH12_CMD_PTR_SD2                                    0x90400830
 Y.CREATE.L   HWIO_MDM_HI0_CH12_CMD_PTR_SD3_ADDR                          0x90400C30
 Y.CREATE.L   MDM_HI0_CH12_CMD_PTR_SD3                                    0x90400C30
 Y.CREATE.L   HWIO_MDM_HI0_CH13_CMD_PTR_SD0_ADDR                          0x90400034
 Y.CREATE.L   MDM_HI0_CH13_CMD_PTR_SD0                                    0x90400034
 Y.CREATE.L   HWIO_MDM_HI0_CH13_CMD_PTR_SD1_ADDR                          0x90400434
 Y.CREATE.L   MDM_HI0_CH13_CMD_PTR_SD1                                    0x90400434
 Y.CREATE.L   HWIO_MDM_HI0_CH13_CMD_PTR_SD2_ADDR                          0x90400834
 Y.CREATE.L   MDM_HI0_CH13_CMD_PTR_SD2                                    0x90400834
 Y.CREATE.L   HWIO_MDM_HI0_CH13_CMD_PTR_SD3_ADDR                          0x90400C34
 Y.CREATE.L   MDM_HI0_CH13_CMD_PTR_SD3                                    0x90400C34
 Y.CREATE.L   HWIO_MDM_HI0_CH14_CMD_PTR_SD0_ADDR                          0x90400038
 Y.CREATE.L   MDM_HI0_CH14_CMD_PTR_SD0                                    0x90400038
 Y.CREATE.L   HWIO_MDM_HI0_CH14_CMD_PTR_SD1_ADDR                          0x90400438
 Y.CREATE.L   MDM_HI0_CH14_CMD_PTR_SD1                                    0x90400438
 Y.CREATE.L   HWIO_MDM_HI0_CH14_CMD_PTR_SD2_ADDR                          0x90400838
 Y.CREATE.L   MDM_HI0_CH14_CMD_PTR_SD2                                    0x90400838
 Y.CREATE.L   HWIO_MDM_HI0_CH14_CMD_PTR_SD3_ADDR                          0x90400C38
 Y.CREATE.L   MDM_HI0_CH14_CMD_PTR_SD3                                    0x90400C38
 Y.CREATE.L   HWIO_MDM_HI0_CH15_CMD_PTR_SD0_ADDR                          0x9040003C
 Y.CREATE.L   MDM_HI0_CH15_CMD_PTR_SD0                                    0x9040003C
 Y.CREATE.L   HWIO_MDM_HI0_CH15_CMD_PTR_SD1_ADDR                          0x9040043C
 Y.CREATE.L   MDM_HI0_CH15_CMD_PTR_SD1                                    0x9040043C
 Y.CREATE.L   HWIO_MDM_HI0_CH15_CMD_PTR_SD2_ADDR                          0x9040083C
 Y.CREATE.L   MDM_HI0_CH15_CMD_PTR_SD2                                    0x9040083C
 Y.CREATE.L   HWIO_MDM_HI0_CH15_CMD_PTR_SD3_ADDR                          0x90400C3C
 Y.CREATE.L   MDM_HI0_CH15_CMD_PTR_SD3                                    0x90400C3C
 Y.CREATE.L   HWIO_MDM_HI0_CH0_RSLT_SD0_ADDR                              0x90400040
 Y.CREATE.L   MDM_HI0_CH0_RSLT_SD0                                        0x90400040
 Y.CREATE.L   HWIO_MDM_HI0_CH0_RSLT_SD1_ADDR                              0x90400440
 Y.CREATE.L   MDM_HI0_CH0_RSLT_SD1                                        0x90400440
 Y.CREATE.L   HWIO_MDM_HI0_CH0_RSLT_SD2_ADDR                              0x90400840
 Y.CREATE.L   MDM_HI0_CH0_RSLT_SD2                                        0x90400840
 Y.CREATE.L   HWIO_MDM_HI0_CH0_RSLT_SD3_ADDR                              0x90400C40
 Y.CREATE.L   MDM_HI0_CH0_RSLT_SD3                                        0x90400C40
 Y.CREATE.L   HWIO_MDM_HI0_CH1_RSLT_SD0_ADDR                              0x90400044
 Y.CREATE.L   MDM_HI0_CH1_RSLT_SD0                                        0x90400044
 Y.CREATE.L   HWIO_MDM_HI0_CH1_RSLT_SD1_ADDR                              0x90400444
 Y.CREATE.L   MDM_HI0_CH1_RSLT_SD1                                        0x90400444
 Y.CREATE.L   HWIO_MDM_HI0_CH1_RSLT_SD2_ADDR                              0x90400844
 Y.CREATE.L   MDM_HI0_CH1_RSLT_SD2                                        0x90400844
 Y.CREATE.L   HWIO_MDM_HI0_CH1_RSLT_SD3_ADDR                              0x90400C44
 Y.CREATE.L   MDM_HI0_CH1_RSLT_SD3                                        0x90400C44
 Y.CREATE.L   HWIO_MDM_HI0_CH2_RSLT_SD0_ADDR                              0x90400048
 Y.CREATE.L   MDM_HI0_CH2_RSLT_SD0                                        0x90400048
 Y.CREATE.L   HWIO_MDM_HI0_CH2_RSLT_SD1_ADDR                              0x90400448
 Y.CREATE.L   MDM_HI0_CH2_RSLT_SD1                                        0x90400448
 Y.CREATE.L   HWIO_MDM_HI0_CH2_RSLT_SD2_ADDR                              0x90400848
 Y.CREATE.L   MDM_HI0_CH2_RSLT_SD2                                        0x90400848
 Y.CREATE.L   HWIO_MDM_HI0_CH2_RSLT_SD3_ADDR                              0x90400C48
 Y.CREATE.L   MDM_HI0_CH2_RSLT_SD3                                        0x90400C48
 Y.CREATE.L   HWIO_MDM_HI0_CH3_RSLT_SD0_ADDR                              0x9040004C
 Y.CREATE.L   MDM_HI0_CH3_RSLT_SD0                                        0x9040004C
 Y.CREATE.L   HWIO_MDM_HI0_CH3_RSLT_SD1_ADDR                              0x9040044C
 Y.CREATE.L   MDM_HI0_CH3_RSLT_SD1                                        0x9040044C
 Y.CREATE.L   HWIO_MDM_HI0_CH3_RSLT_SD2_ADDR                              0x9040084C
 Y.CREATE.L   MDM_HI0_CH3_RSLT_SD2                                        0x9040084C
 Y.CREATE.L   HWIO_MDM_HI0_CH3_RSLT_SD3_ADDR                              0x90400C4C
 Y.CREATE.L   MDM_HI0_CH3_RSLT_SD3                                        0x90400C4C
 Y.CREATE.L   HWIO_MDM_HI0_CH4_RSLT_SD0_ADDR                              0x90400050
 Y.CREATE.L   MDM_HI0_CH4_RSLT_SD0                                        0x90400050
 Y.CREATE.L   HWIO_MDM_HI0_CH4_RSLT_SD1_ADDR                              0x90400450
 Y.CREATE.L   MDM_HI0_CH4_RSLT_SD1                                        0x90400450
 Y.CREATE.L   HWIO_MDM_HI0_CH4_RSLT_SD2_ADDR                              0x90400850
 Y.CREATE.L   MDM_HI0_CH4_RSLT_SD2                                        0x90400850
 Y.CREATE.L   HWIO_MDM_HI0_CH4_RSLT_SD3_ADDR                              0x90400C50
 Y.CREATE.L   MDM_HI0_CH4_RSLT_SD3                                        0x90400C50
 Y.CREATE.L   HWIO_MDM_HI0_CH5_RSLT_SD0_ADDR                              0x90400054
 Y.CREATE.L   MDM_HI0_CH5_RSLT_SD0                                        0x90400054
 Y.CREATE.L   HWIO_MDM_HI0_CH5_RSLT_SD1_ADDR                              0x90400454
 Y.CREATE.L   MDM_HI0_CH5_RSLT_SD1                                        0x90400454
 Y.CREATE.L   HWIO_MDM_HI0_CH5_RSLT_SD2_ADDR                              0x90400854
 Y.CREATE.L   MDM_HI0_CH5_RSLT_SD2                                        0x90400854
 Y.CREATE.L   HWIO_MDM_HI0_CH5_RSLT_SD3_ADDR                              0x90400C54
 Y.CREATE.L   MDM_HI0_CH5_RSLT_SD3                                        0x90400C54
 Y.CREATE.L   HWIO_MDM_HI0_CH6_RSLT_SD0_ADDR                              0x90400058
 Y.CREATE.L   MDM_HI0_CH6_RSLT_SD0                                        0x90400058
 Y.CREATE.L   HWIO_MDM_HI0_CH6_RSLT_SD1_ADDR                              0x90400458
 Y.CREATE.L   MDM_HI0_CH6_RSLT_SD1                                        0x90400458
 Y.CREATE.L   HWIO_MDM_HI0_CH6_RSLT_SD2_ADDR                              0x90400858
 Y.CREATE.L   MDM_HI0_CH6_RSLT_SD2                                        0x90400858
 Y.CREATE.L   HWIO_MDM_HI0_CH6_RSLT_SD3_ADDR                              0x90400C58
 Y.CREATE.L   MDM_HI0_CH6_RSLT_SD3                                        0x90400C58
 Y.CREATE.L   HWIO_MDM_HI0_CH7_RSLT_SD0_ADDR                              0x9040005C
 Y.CREATE.L   MDM_HI0_CH7_RSLT_SD0                                        0x9040005C
 Y.CREATE.L   HWIO_MDM_HI0_CH7_RSLT_SD1_ADDR                              0x9040045C
 Y.CREATE.L   MDM_HI0_CH7_RSLT_SD1                                        0x9040045C
 Y.CREATE.L   HWIO_MDM_HI0_CH7_RSLT_SD2_ADDR                              0x9040085C
 Y.CREATE.L   MDM_HI0_CH7_RSLT_SD2                                        0x9040085C
 Y.CREATE.L   HWIO_MDM_HI0_CH7_RSLT_SD3_ADDR                              0x90400C5C
 Y.CREATE.L   MDM_HI0_CH7_RSLT_SD3                                        0x90400C5C
 Y.CREATE.L   HWIO_MDM_HI0_CH8_RSLT_SD0_ADDR                              0x90400060
 Y.CREATE.L   MDM_HI0_CH8_RSLT_SD0                                        0x90400060
 Y.CREATE.L   HWIO_MDM_HI0_CH8_RSLT_SD1_ADDR                              0x90400460
 Y.CREATE.L   MDM_HI0_CH8_RSLT_SD1                                        0x90400460
 Y.CREATE.L   HWIO_MDM_HI0_CH8_RSLT_SD2_ADDR                              0x90400860
 Y.CREATE.L   MDM_HI0_CH8_RSLT_SD2                                        0x90400860
 Y.CREATE.L   HWIO_MDM_HI0_CH8_RSLT_SD3_ADDR                              0x90400C60
 Y.CREATE.L   MDM_HI0_CH8_RSLT_SD3                                        0x90400C60
 Y.CREATE.L   HWIO_MDM_HI0_CH9_RSLT_SD0_ADDR                              0x90400064
 Y.CREATE.L   MDM_HI0_CH9_RSLT_SD0                                        0x90400064
 Y.CREATE.L   HWIO_MDM_HI0_CH9_RSLT_SD1_ADDR                              0x90400464
 Y.CREATE.L   MDM_HI0_CH9_RSLT_SD1                                        0x90400464
 Y.CREATE.L   HWIO_MDM_HI0_CH9_RSLT_SD2_ADDR                              0x90400864
 Y.CREATE.L   MDM_HI0_CH9_RSLT_SD2                                        0x90400864
 Y.CREATE.L   HWIO_MDM_HI0_CH9_RSLT_SD3_ADDR                              0x90400C64
 Y.CREATE.L   MDM_HI0_CH9_RSLT_SD3                                        0x90400C64
 Y.CREATE.L   HWIO_MDM_HI0_CH10_RSLT_SD0_ADDR                             0x90400068
 Y.CREATE.L   MDM_HI0_CH10_RSLT_SD0                                       0x90400068
 Y.CREATE.L   HWIO_MDM_HI0_CH10_RSLT_SD1_ADDR                             0x90400468
 Y.CREATE.L   MDM_HI0_CH10_RSLT_SD1                                       0x90400468
 Y.CREATE.L   HWIO_MDM_HI0_CH10_RSLT_SD2_ADDR                             0x90400868
 Y.CREATE.L   MDM_HI0_CH10_RSLT_SD2                                       0x90400868
 Y.CREATE.L   HWIO_MDM_HI0_CH10_RSLT_SD3_ADDR                             0x90400C68
 Y.CREATE.L   MDM_HI0_CH10_RSLT_SD3                                       0x90400C68
 Y.CREATE.L   HWIO_MDM_HI0_CH11_RSLT_SD0_ADDR                             0x9040006C
 Y.CREATE.L   MDM_HI0_CH11_RSLT_SD0                                       0x9040006C
 Y.CREATE.L   HWIO_MDM_HI0_CH11_RSLT_SD1_ADDR                             0x9040046C
 Y.CREATE.L   MDM_HI0_CH11_RSLT_SD1                                       0x9040046C
 Y.CREATE.L   HWIO_MDM_HI0_CH11_RSLT_SD2_ADDR                             0x9040086C
 Y.CREATE.L   MDM_HI0_CH11_RSLT_SD2                                       0x9040086C
 Y.CREATE.L   HWIO_MDM_HI0_CH11_RSLT_SD3_ADDR                             0x90400C6C
 Y.CREATE.L   MDM_HI0_CH11_RSLT_SD3                                       0x90400C6C
 Y.CREATE.L   HWIO_MDM_HI0_CH12_RSLT_SD0_ADDR                             0x90400070
 Y.CREATE.L   MDM_HI0_CH12_RSLT_SD0                                       0x90400070
 Y.CREATE.L   HWIO_MDM_HI0_CH12_RSLT_SD1_ADDR                             0x90400470
 Y.CREATE.L   MDM_HI0_CH12_RSLT_SD1                                       0x90400470
 Y.CREATE.L   HWIO_MDM_HI0_CH12_RSLT_SD2_ADDR                             0x90400870
 Y.CREATE.L   MDM_HI0_CH12_RSLT_SD2                                       0x90400870
 Y.CREATE.L   HWIO_MDM_HI0_CH12_RSLT_SD3_ADDR                             0x90400C70
 Y.CREATE.L   MDM_HI0_CH12_RSLT_SD3                                       0x90400C70
 Y.CREATE.L   HWIO_MDM_HI0_CH13_RSLT_SD0_ADDR                             0x90400074
 Y.CREATE.L   MDM_HI0_CH13_RSLT_SD0                                       0x90400074
 Y.CREATE.L   HWIO_MDM_HI0_CH13_RSLT_SD1_ADDR                             0x90400474
 Y.CREATE.L   MDM_HI0_CH13_RSLT_SD1                                       0x90400474
 Y.CREATE.L   HWIO_MDM_HI0_CH13_RSLT_SD2_ADDR                             0x90400874
 Y.CREATE.L   MDM_HI0_CH13_RSLT_SD2                                       0x90400874
 Y.CREATE.L   HWIO_MDM_HI0_CH13_RSLT_SD3_ADDR                             0x90400C74
 Y.CREATE.L   MDM_HI0_CH13_RSLT_SD3                                       0x90400C74
 Y.CREATE.L   HWIO_MDM_HI0_CH14_RSLT_SD0_ADDR                             0x90400078
 Y.CREATE.L   MDM_HI0_CH14_RSLT_SD0                                       0x90400078
 Y.CREATE.L   HWIO_MDM_HI0_CH14_RSLT_SD1_ADDR                             0x90400478
 Y.CREATE.L   MDM_HI0_CH14_RSLT_SD1                                       0x90400478
 Y.CREATE.L   HWIO_MDM_HI0_CH14_RSLT_SD2_ADDR                             0x90400878
 Y.CREATE.L   MDM_HI0_CH14_RSLT_SD2                                       0x90400878
 Y.CREATE.L   HWIO_MDM_HI0_CH14_RSLT_SD3_ADDR                             0x90400C78
 Y.CREATE.L   MDM_HI0_CH14_RSLT_SD3                                       0x90400C78
 Y.CREATE.L   HWIO_MDM_HI0_CH15_RSLT_SD0_ADDR                             0x9040007C
 Y.CREATE.L   MDM_HI0_CH15_RSLT_SD0                                       0x9040007C
 Y.CREATE.L   HWIO_MDM_HI0_CH15_RSLT_SD1_ADDR                             0x9040047C
 Y.CREATE.L   MDM_HI0_CH15_RSLT_SD1                                       0x9040047C
 Y.CREATE.L   HWIO_MDM_HI0_CH15_RSLT_SD2_ADDR                             0x9040087C
 Y.CREATE.L   MDM_HI0_CH15_RSLT_SD2                                       0x9040087C
 Y.CREATE.L   HWIO_MDM_HI0_CH15_RSLT_SD3_ADDR                             0x90400C7C
 Y.CREATE.L   MDM_HI0_CH15_RSLT_SD3                                       0x90400C7C
 Y.CREATE.L   HWIO_MDM_HI0_CH0_FLUSH_STATE0_SD0_ADDR                      0x90400080
 Y.CREATE.L   MDM_HI0_CH0_FLUSH_STATE0_SD0                                0x90400080
 Y.CREATE.L   HWIO_MDM_HI0_CH0_FLUSH_STATE0_SD1_ADDR                      0x90400480
 Y.CREATE.L   MDM_HI0_CH0_FLUSH_STATE0_SD1                                0x90400480
 Y.CREATE.L   HWIO_MDM_HI0_CH0_FLUSH_STATE0_SD2_ADDR                      0x90400880
 Y.CREATE.L   MDM_HI0_CH0_FLUSH_STATE0_SD2                                0x90400880
 Y.CREATE.L   HWIO_MDM_HI0_CH0_FLUSH_STATE0_SD3_ADDR                      0x90400C80
 Y.CREATE.L   MDM_HI0_CH0_FLUSH_STATE0_SD3                                0x90400C80
 Y.CREATE.L   HWIO_MDM_HI0_CH1_FLUSH_STATE0_SD0_ADDR                      0x90400084
 Y.CREATE.L   MDM_HI0_CH1_FLUSH_STATE0_SD0                                0x90400084
 Y.CREATE.L   HWIO_MDM_HI0_CH1_FLUSH_STATE0_SD1_ADDR                      0x90400484
 Y.CREATE.L   MDM_HI0_CH1_FLUSH_STATE0_SD1                                0x90400484
 Y.CREATE.L   HWIO_MDM_HI0_CH1_FLUSH_STATE0_SD2_ADDR                      0x90400884
 Y.CREATE.L   MDM_HI0_CH1_FLUSH_STATE0_SD2                                0x90400884
 Y.CREATE.L   HWIO_MDM_HI0_CH1_FLUSH_STATE0_SD3_ADDR                      0x90400C84
 Y.CREATE.L   MDM_HI0_CH1_FLUSH_STATE0_SD3                                0x90400C84
 Y.CREATE.L   HWIO_MDM_HI0_CH2_FLUSH_STATE0_SD0_ADDR                      0x90400088
 Y.CREATE.L   MDM_HI0_CH2_FLUSH_STATE0_SD0                                0x90400088
 Y.CREATE.L   HWIO_MDM_HI0_CH2_FLUSH_STATE0_SD1_ADDR                      0x90400488
 Y.CREATE.L   MDM_HI0_CH2_FLUSH_STATE0_SD1                                0x90400488
 Y.CREATE.L   HWIO_MDM_HI0_CH2_FLUSH_STATE0_SD2_ADDR                      0x90400888
 Y.CREATE.L   MDM_HI0_CH2_FLUSH_STATE0_SD2                                0x90400888
 Y.CREATE.L   HWIO_MDM_HI0_CH2_FLUSH_STATE0_SD3_ADDR                      0x90400C88
 Y.CREATE.L   MDM_HI0_CH2_FLUSH_STATE0_SD3                                0x90400C88
 Y.CREATE.L   HWIO_MDM_HI0_CH3_FLUSH_STATE0_SD0_ADDR                      0x9040008C
 Y.CREATE.L   MDM_HI0_CH3_FLUSH_STATE0_SD0                                0x9040008C
 Y.CREATE.L   HWIO_MDM_HI0_CH3_FLUSH_STATE0_SD1_ADDR                      0x9040048C
 Y.CREATE.L   MDM_HI0_CH3_FLUSH_STATE0_SD1                                0x9040048C
 Y.CREATE.L   HWIO_MDM_HI0_CH3_FLUSH_STATE0_SD2_ADDR                      0x9040088C
 Y.CREATE.L   MDM_HI0_CH3_FLUSH_STATE0_SD2                                0x9040088C
 Y.CREATE.L   HWIO_MDM_HI0_CH3_FLUSH_STATE0_SD3_ADDR                      0x90400C8C
 Y.CREATE.L   MDM_HI0_CH3_FLUSH_STATE0_SD3                                0x90400C8C
 Y.CREATE.L   HWIO_MDM_HI0_CH4_FLUSH_STATE0_SD0_ADDR                      0x90400090
 Y.CREATE.L   MDM_HI0_CH4_FLUSH_STATE0_SD0                                0x90400090
 Y.CREATE.L   HWIO_MDM_HI0_CH4_FLUSH_STATE0_SD1_ADDR                      0x90400490
 Y.CREATE.L   MDM_HI0_CH4_FLUSH_STATE0_SD1                                0x90400490
 Y.CREATE.L   HWIO_MDM_HI0_CH4_FLUSH_STATE0_SD2_ADDR                      0x90400890
 Y.CREATE.L   MDM_HI0_CH4_FLUSH_STATE0_SD2                                0x90400890
 Y.CREATE.L   HWIO_MDM_HI0_CH4_FLUSH_STATE0_SD3_ADDR                      0x90400C90
 Y.CREATE.L   MDM_HI0_CH4_FLUSH_STATE0_SD3                                0x90400C90
 Y.CREATE.L   HWIO_MDM_HI0_CH5_FLUSH_STATE0_SD0_ADDR                      0x90400094
 Y.CREATE.L   MDM_HI0_CH5_FLUSH_STATE0_SD0                                0x90400094
 Y.CREATE.L   HWIO_MDM_HI0_CH5_FLUSH_STATE0_SD1_ADDR                      0x90400494
 Y.CREATE.L   MDM_HI0_CH5_FLUSH_STATE0_SD1                                0x90400494
 Y.CREATE.L   HWIO_MDM_HI0_CH5_FLUSH_STATE0_SD2_ADDR                      0x90400894
 Y.CREATE.L   MDM_HI0_CH5_FLUSH_STATE0_SD2                                0x90400894
 Y.CREATE.L   HWIO_MDM_HI0_CH5_FLUSH_STATE0_SD3_ADDR                      0x90400C94
 Y.CREATE.L   MDM_HI0_CH5_FLUSH_STATE0_SD3                                0x90400C94
 Y.CREATE.L   HWIO_MDM_HI0_CH6_FLUSH_STATE0_SD0_ADDR                      0x90400098
 Y.CREATE.L   MDM_HI0_CH6_FLUSH_STATE0_SD0                                0x90400098
 Y.CREATE.L   HWIO_MDM_HI0_CH6_FLUSH_STATE0_SD1_ADDR                      0x90400498
 Y.CREATE.L   MDM_HI0_CH6_FLUSH_STATE0_SD1                                0x90400498
 Y.CREATE.L   HWIO_MDM_HI0_CH6_FLUSH_STATE0_SD2_ADDR                      0x90400898
 Y.CREATE.L   MDM_HI0_CH6_FLUSH_STATE0_SD2                                0x90400898
 Y.CREATE.L   HWIO_MDM_HI0_CH6_FLUSH_STATE0_SD3_ADDR                      0x90400C98
 Y.CREATE.L   MDM_HI0_CH6_FLUSH_STATE0_SD3                                0x90400C98
 Y.CREATE.L   HWIO_MDM_HI0_CH7_FLUSH_STATE0_SD0_ADDR                      0x9040009C
 Y.CREATE.L   MDM_HI0_CH7_FLUSH_STATE0_SD0                                0x9040009C
 Y.CREATE.L   HWIO_MDM_HI0_CH7_FLUSH_STATE0_SD1_ADDR                      0x9040049C
 Y.CREATE.L   MDM_HI0_CH7_FLUSH_STATE0_SD1                                0x9040049C
 Y.CREATE.L   HWIO_MDM_HI0_CH7_FLUSH_STATE0_SD2_ADDR                      0x9040089C
 Y.CREATE.L   MDM_HI0_CH7_FLUSH_STATE0_SD2                                0x9040089C
 Y.CREATE.L   HWIO_MDM_HI0_CH7_FLUSH_STATE0_SD3_ADDR                      0x90400C9C
 Y.CREATE.L   MDM_HI0_CH7_FLUSH_STATE0_SD3                                0x90400C9C
 Y.CREATE.L   HWIO_MDM_HI0_CH8_FLUSH_STATE0_SD0_ADDR                      0x904000A0
 Y.CREATE.L   MDM_HI0_CH8_FLUSH_STATE0_SD0                                0x904000A0
 Y.CREATE.L   HWIO_MDM_HI0_CH8_FLUSH_STATE0_SD1_ADDR                      0x904004A0
 Y.CREATE.L   MDM_HI0_CH8_FLUSH_STATE0_SD1                                0x904004A0
 Y.CREATE.L   HWIO_MDM_HI0_CH8_FLUSH_STATE0_SD2_ADDR                      0x904008A0
 Y.CREATE.L   MDM_HI0_CH8_FLUSH_STATE0_SD2                                0x904008A0
 Y.CREATE.L   HWIO_MDM_HI0_CH8_FLUSH_STATE0_SD3_ADDR                      0x90400CA0
 Y.CREATE.L   MDM_HI0_CH8_FLUSH_STATE0_SD3                                0x90400CA0
 Y.CREATE.L   HWIO_MDM_HI0_CH9_FLUSH_STATE0_SD0_ADDR                      0x904000A4
 Y.CREATE.L   MDM_HI0_CH9_FLUSH_STATE0_SD0                                0x904000A4
 Y.CREATE.L   HWIO_MDM_HI0_CH9_FLUSH_STATE0_SD1_ADDR                      0x904004A4
 Y.CREATE.L   MDM_HI0_CH9_FLUSH_STATE0_SD1                                0x904004A4
 Y.CREATE.L   HWIO_MDM_HI0_CH9_FLUSH_STATE0_SD2_ADDR                      0x904008A4
 Y.CREATE.L   MDM_HI0_CH9_FLUSH_STATE0_SD2                                0x904008A4
 Y.CREATE.L   HWIO_MDM_HI0_CH9_FLUSH_STATE0_SD3_ADDR                      0x90400CA4
 Y.CREATE.L   MDM_HI0_CH9_FLUSH_STATE0_SD3                                0x90400CA4
 Y.CREATE.L   HWIO_MDM_HI0_CH10_FLUSH_STATE0_SD0_ADDR                     0x904000A8
 Y.CREATE.L   MDM_HI0_CH10_FLUSH_STATE0_SD0                               0x904000A8
 Y.CREATE.L   HWIO_MDM_HI0_CH10_FLUSH_STATE0_SD1_ADDR                     0x904004A8
 Y.CREATE.L   MDM_HI0_CH10_FLUSH_STATE0_SD1                               0x904004A8
 Y.CREATE.L   HWIO_MDM_HI0_CH10_FLUSH_STATE0_SD2_ADDR                     0x904008A8
 Y.CREATE.L   MDM_HI0_CH10_FLUSH_STATE0_SD2                               0x904008A8
 Y.CREATE.L   HWIO_MDM_HI0_CH10_FLUSH_STATE0_SD3_ADDR                     0x90400CA8
 Y.CREATE.L   MDM_HI0_CH10_FLUSH_STATE0_SD3                               0x90400CA8
 Y.CREATE.L   HWIO_MDM_HI0_CH11_FLUSH_STATE0_SD0_ADDR                     0x904000AC
 Y.CREATE.L   MDM_HI0_CH11_FLUSH_STATE0_SD0                               0x904000AC
 Y.CREATE.L   HWIO_MDM_HI0_CH11_FLUSH_STATE0_SD1_ADDR                     0x904004AC
 Y.CREATE.L   MDM_HI0_CH11_FLUSH_STATE0_SD1                               0x904004AC
 Y.CREATE.L   HWIO_MDM_HI0_CH11_FLUSH_STATE0_SD2_ADDR                     0x904008AC
 Y.CREATE.L   MDM_HI0_CH11_FLUSH_STATE0_SD2                               0x904008AC
 Y.CREATE.L   HWIO_MDM_HI0_CH11_FLUSH_STATE0_SD3_ADDR                     0x90400CAC
 Y.CREATE.L   MDM_HI0_CH11_FLUSH_STATE0_SD3                               0x90400CAC
 Y.CREATE.L   HWIO_MDM_HI0_CH12_FLUSH_STATE0_SD0_ADDR                     0x904000B0
 Y.CREATE.L   MDM_HI0_CH12_FLUSH_STATE0_SD0                               0x904000B0
 Y.CREATE.L   HWIO_MDM_HI0_CH12_FLUSH_STATE0_SD1_ADDR                     0x904004B0
 Y.CREATE.L   MDM_HI0_CH12_FLUSH_STATE0_SD1                               0x904004B0
 Y.CREATE.L   HWIO_MDM_HI0_CH12_FLUSH_STATE0_SD2_ADDR                     0x904008B0
 Y.CREATE.L   MDM_HI0_CH12_FLUSH_STATE0_SD2                               0x904008B0
 Y.CREATE.L   HWIO_MDM_HI0_CH12_FLUSH_STATE0_SD3_ADDR                     0x90400CB0
 Y.CREATE.L   MDM_HI0_CH12_FLUSH_STATE0_SD3                               0x90400CB0
 Y.CREATE.L   HWIO_MDM_HI0_CH13_FLUSH_STATE0_SD0_ADDR                     0x904000B4
 Y.CREATE.L   MDM_HI0_CH13_FLUSH_STATE0_SD0                               0x904000B4
 Y.CREATE.L   HWIO_MDM_HI0_CH13_FLUSH_STATE0_SD1_ADDR                     0x904004B4
 Y.CREATE.L   MDM_HI0_CH13_FLUSH_STATE0_SD1                               0x904004B4
 Y.CREATE.L   HWIO_MDM_HI0_CH13_FLUSH_STATE0_SD2_ADDR                     0x904008B4
 Y.CREATE.L   MDM_HI0_CH13_FLUSH_STATE0_SD2                               0x904008B4
 Y.CREATE.L   HWIO_MDM_HI0_CH13_FLUSH_STATE0_SD3_ADDR                     0x90400CB4
 Y.CREATE.L   MDM_HI0_CH13_FLUSH_STATE0_SD3                               0x90400CB4
 Y.CREATE.L   HWIO_MDM_HI0_CH14_FLUSH_STATE0_SD0_ADDR                     0x904000B8
 Y.CREATE.L   MDM_HI0_CH14_FLUSH_STATE0_SD0                               0x904000B8
 Y.CREATE.L   HWIO_MDM_HI0_CH14_FLUSH_STATE0_SD1_ADDR                     0x904004B8
 Y.CREATE.L   MDM_HI0_CH14_FLUSH_STATE0_SD1                               0x904004B8
 Y.CREATE.L   HWIO_MDM_HI0_CH14_FLUSH_STATE0_SD2_ADDR                     0x904008B8
 Y.CREATE.L   MDM_HI0_CH14_FLUSH_STATE0_SD2                               0x904008B8
 Y.CREATE.L   HWIO_MDM_HI0_CH14_FLUSH_STATE0_SD3_ADDR                     0x90400CB8
 Y.CREATE.L   MDM_HI0_CH14_FLUSH_STATE0_SD3                               0x90400CB8
 Y.CREATE.L   HWIO_MDM_HI0_CH15_FLUSH_STATE0_SD0_ADDR                     0x904000BC
 Y.CREATE.L   MDM_HI0_CH15_FLUSH_STATE0_SD0                               0x904000BC
 Y.CREATE.L   HWIO_MDM_HI0_CH15_FLUSH_STATE0_SD1_ADDR                     0x904004BC
 Y.CREATE.L   MDM_HI0_CH15_FLUSH_STATE0_SD1                               0x904004BC
 Y.CREATE.L   HWIO_MDM_HI0_CH15_FLUSH_STATE0_SD2_ADDR                     0x904008BC
 Y.CREATE.L   MDM_HI0_CH15_FLUSH_STATE0_SD2                               0x904008BC
 Y.CREATE.L   HWIO_MDM_HI0_CH15_FLUSH_STATE0_SD3_ADDR                     0x90400CBC
 Y.CREATE.L   MDM_HI0_CH15_FLUSH_STATE0_SD3                               0x90400CBC
 Y.CREATE.L   HWIO_MDM_HI0_CH0_FLUSH_STATE1_SD0_ADDR                      0x904000C0
 Y.CREATE.L   MDM_HI0_CH0_FLUSH_STATE1_SD0                                0x904000C0
 Y.CREATE.L   HWIO_MDM_HI0_CH0_FLUSH_STATE1_SD1_ADDR                      0x904004C0
 Y.CREATE.L   MDM_HI0_CH0_FLUSH_STATE1_SD1                                0x904004C0
 Y.CREATE.L   HWIO_MDM_HI0_CH0_FLUSH_STATE1_SD2_ADDR                      0x904008C0
 Y.CREATE.L   MDM_HI0_CH0_FLUSH_STATE1_SD2                                0x904008C0
 Y.CREATE.L   HWIO_MDM_HI0_CH0_FLUSH_STATE1_SD3_ADDR                      0x90400CC0
 Y.CREATE.L   MDM_HI0_CH0_FLUSH_STATE1_SD3                                0x90400CC0
 Y.CREATE.L   HWIO_MDM_HI0_CH1_FLUSH_STATE1_SD0_ADDR                      0x904000C4
 Y.CREATE.L   MDM_HI0_CH1_FLUSH_STATE1_SD0                                0x904000C4
 Y.CREATE.L   HWIO_MDM_HI0_CH1_FLUSH_STATE1_SD1_ADDR                      0x904004C4
 Y.CREATE.L   MDM_HI0_CH1_FLUSH_STATE1_SD1                                0x904004C4
 Y.CREATE.L   HWIO_MDM_HI0_CH1_FLUSH_STATE1_SD2_ADDR                      0x904008C4
 Y.CREATE.L   MDM_HI0_CH1_FLUSH_STATE1_SD2                                0x904008C4
 Y.CREATE.L   HWIO_MDM_HI0_CH1_FLUSH_STATE1_SD3_ADDR                      0x90400CC4
 Y.CREATE.L   MDM_HI0_CH1_FLUSH_STATE1_SD3                                0x90400CC4
 Y.CREATE.L   HWIO_MDM_HI0_CH2_FLUSH_STATE1_SD0_ADDR                      0x904000C8
 Y.CREATE.L   MDM_HI0_CH2_FLUSH_STATE1_SD0                                0x904000C8
 Y.CREATE.L   HWIO_MDM_HI0_CH2_FLUSH_STATE1_SD1_ADDR                      0x904004C8
 Y.CREATE.L   MDM_HI0_CH2_FLUSH_STATE1_SD1                                0x904004C8
 Y.CREATE.L   HWIO_MDM_HI0_CH2_FLUSH_STATE1_SD2_ADDR                      0x904008C8
 Y.CREATE.L   MDM_HI0_CH2_FLUSH_STATE1_SD2                                0x904008C8
 Y.CREATE.L   HWIO_MDM_HI0_CH2_FLUSH_STATE1_SD3_ADDR                      0x90400CC8
 Y.CREATE.L   MDM_HI0_CH2_FLUSH_STATE1_SD3                                0x90400CC8
 Y.CREATE.L   HWIO_MDM_HI0_CH3_FLUSH_STATE1_SD0_ADDR                      0x904000CC
 Y.CREATE.L   MDM_HI0_CH3_FLUSH_STATE1_SD0                                0x904000CC
 Y.CREATE.L   HWIO_MDM_HI0_CH3_FLUSH_STATE1_SD1_ADDR                      0x904004CC
 Y.CREATE.L   MDM_HI0_CH3_FLUSH_STATE1_SD1                                0x904004CC
 Y.CREATE.L   HWIO_MDM_HI0_CH3_FLUSH_STATE1_SD2_ADDR                      0x904008CC
 Y.CREATE.L   MDM_HI0_CH3_FLUSH_STATE1_SD2                                0x904008CC
 Y.CREATE.L   HWIO_MDM_HI0_CH3_FLUSH_STATE1_SD3_ADDR                      0x90400CCC
 Y.CREATE.L   MDM_HI0_CH3_FLUSH_STATE1_SD3                                0x90400CCC
 Y.CREATE.L   HWIO_MDM_HI0_CH4_FLUSH_STATE1_SD0_ADDR                      0x904000D0
 Y.CREATE.L   MDM_HI0_CH4_FLUSH_STATE1_SD0                                0x904000D0
 Y.CREATE.L   HWIO_MDM_HI0_CH4_FLUSH_STATE1_SD1_ADDR                      0x904004D0
 Y.CREATE.L   MDM_HI0_CH4_FLUSH_STATE1_SD1                                0x904004D0
 Y.CREATE.L   HWIO_MDM_HI0_CH4_FLUSH_STATE1_SD2_ADDR                      0x904008D0
 Y.CREATE.L   MDM_HI0_CH4_FLUSH_STATE1_SD2                                0x904008D0
 Y.CREATE.L   HWIO_MDM_HI0_CH4_FLUSH_STATE1_SD3_ADDR                      0x90400CD0
 Y.CREATE.L   MDM_HI0_CH4_FLUSH_STATE1_SD3                                0x90400CD0
 Y.CREATE.L   HWIO_MDM_HI0_CH5_FLUSH_STATE1_SD0_ADDR                      0x904000D4
 Y.CREATE.L   MDM_HI0_CH5_FLUSH_STATE1_SD0                                0x904000D4
 Y.CREATE.L   HWIO_MDM_HI0_CH5_FLUSH_STATE1_SD1_ADDR                      0x904004D4
 Y.CREATE.L   MDM_HI0_CH5_FLUSH_STATE1_SD1                                0x904004D4
 Y.CREATE.L   HWIO_MDM_HI0_CH5_FLUSH_STATE1_SD2_ADDR                      0x904008D4
 Y.CREATE.L   MDM_HI0_CH5_FLUSH_STATE1_SD2                                0x904008D4
 Y.CREATE.L   HWIO_MDM_HI0_CH5_FLUSH_STATE1_SD3_ADDR                      0x90400CD4
 Y.CREATE.L   MDM_HI0_CH5_FLUSH_STATE1_SD3                                0x90400CD4
 Y.CREATE.L   HWIO_MDM_HI0_CH6_FLUSH_STATE1_SD0_ADDR                      0x904000D8
 Y.CREATE.L   MDM_HI0_CH6_FLUSH_STATE1_SD0                                0x904000D8
 Y.CREATE.L   HWIO_MDM_HI0_CH6_FLUSH_STATE1_SD1_ADDR                      0x904004D8
 Y.CREATE.L   MDM_HI0_CH6_FLUSH_STATE1_SD1                                0x904004D8
 Y.CREATE.L   HWIO_MDM_HI0_CH6_FLUSH_STATE1_SD2_ADDR                      0x904008D8
 Y.CREATE.L   MDM_HI0_CH6_FLUSH_STATE1_SD2                                0x904008D8
 Y.CREATE.L   HWIO_MDM_HI0_CH6_FLUSH_STATE1_SD3_ADDR                      0x90400CD8
 Y.CREATE.L   MDM_HI0_CH6_FLUSH_STATE1_SD3                                0x90400CD8
 Y.CREATE.L   HWIO_MDM_HI0_CH7_FLUSH_STATE1_SD0_ADDR                      0x904000DC
 Y.CREATE.L   MDM_HI0_CH7_FLUSH_STATE1_SD0                                0x904000DC
 Y.CREATE.L   HWIO_MDM_HI0_CH7_FLUSH_STATE1_SD1_ADDR                      0x904004DC
 Y.CREATE.L   MDM_HI0_CH7_FLUSH_STATE1_SD1                                0x904004DC
 Y.CREATE.L   HWIO_MDM_HI0_CH7_FLUSH_STATE1_SD2_ADDR                      0x904008DC
 Y.CREATE.L   MDM_HI0_CH7_FLUSH_STATE1_SD2                                0x904008DC
 Y.CREATE.L   HWIO_MDM_HI0_CH7_FLUSH_STATE1_SD3_ADDR                      0x90400CDC
 Y.CREATE.L   MDM_HI0_CH7_FLUSH_STATE1_SD3                                0x90400CDC
 Y.CREATE.L   HWIO_MDM_HI0_CH8_FLUSH_STATE1_SD0_ADDR                      0x904000E0
 Y.CREATE.L   MDM_HI0_CH8_FLUSH_STATE1_SD0                                0x904000E0
 Y.CREATE.L   HWIO_MDM_HI0_CH8_FLUSH_STATE1_SD1_ADDR                      0x904004E0
 Y.CREATE.L   MDM_HI0_CH8_FLUSH_STATE1_SD1                                0x904004E0
 Y.CREATE.L   HWIO_MDM_HI0_CH8_FLUSH_STATE1_SD2_ADDR                      0x904008E0
 Y.CREATE.L   MDM_HI0_CH8_FLUSH_STATE1_SD2                                0x904008E0
 Y.CREATE.L   HWIO_MDM_HI0_CH8_FLUSH_STATE1_SD3_ADDR                      0x90400CE0
 Y.CREATE.L   MDM_HI0_CH8_FLUSH_STATE1_SD3                                0x90400CE0
 Y.CREATE.L   HWIO_MDM_HI0_CH9_FLUSH_STATE1_SD0_ADDR                      0x904000E4
 Y.CREATE.L   MDM_HI0_CH9_FLUSH_STATE1_SD0                                0x904000E4
 Y.CREATE.L   HWIO_MDM_HI0_CH9_FLUSH_STATE1_SD1_ADDR                      0x904004E4
 Y.CREATE.L   MDM_HI0_CH9_FLUSH_STATE1_SD1                                0x904004E4
 Y.CREATE.L   HWIO_MDM_HI0_CH9_FLUSH_STATE1_SD2_ADDR                      0x904008E4
 Y.CREATE.L   MDM_HI0_CH9_FLUSH_STATE1_SD2                                0x904008E4
 Y.CREATE.L   HWIO_MDM_HI0_CH9_FLUSH_STATE1_SD3_ADDR                      0x90400CE4
 Y.CREATE.L   MDM_HI0_CH9_FLUSH_STATE1_SD3                                0x90400CE4
 Y.CREATE.L   HWIO_MDM_HI0_CH10_FLUSH_STATE1_SD0_ADDR                     0x904000E8
 Y.CREATE.L   MDM_HI0_CH10_FLUSH_STATE1_SD0                               0x904000E8
 Y.CREATE.L   HWIO_MDM_HI0_CH10_FLUSH_STATE1_SD1_ADDR                     0x904004E8
 Y.CREATE.L   MDM_HI0_CH10_FLUSH_STATE1_SD1                               0x904004E8
 Y.CREATE.L   HWIO_MDM_HI0_CH10_FLUSH_STATE1_SD2_ADDR                     0x904008E8
 Y.CREATE.L   MDM_HI0_CH10_FLUSH_STATE1_SD2                               0x904008E8
 Y.CREATE.L   HWIO_MDM_HI0_CH10_FLUSH_STATE1_SD3_ADDR                     0x90400CE8
 Y.CREATE.L   MDM_HI0_CH10_FLUSH_STATE1_SD3                               0x90400CE8
 Y.CREATE.L   HWIO_MDM_HI0_CH11_FLUSH_STATE1_SD0_ADDR                     0x904000EC
 Y.CREATE.L   MDM_HI0_CH11_FLUSH_STATE1_SD0                               0x904000EC
 Y.CREATE.L   HWIO_MDM_HI0_CH11_FLUSH_STATE1_SD1_ADDR                     0x904004EC
 Y.CREATE.L   MDM_HI0_CH11_FLUSH_STATE1_SD1                               0x904004EC
 Y.CREATE.L   HWIO_MDM_HI0_CH11_FLUSH_STATE1_SD2_ADDR                     0x904008EC
 Y.CREATE.L   MDM_HI0_CH11_FLUSH_STATE1_SD2                               0x904008EC
 Y.CREATE.L   HWIO_MDM_HI0_CH11_FLUSH_STATE1_SD3_ADDR                     0x90400CEC
 Y.CREATE.L   MDM_HI0_CH11_FLUSH_STATE1_SD3                               0x90400CEC
 Y.CREATE.L   HWIO_MDM_HI0_CH12_FLUSH_STATE1_SD0_ADDR                     0x904000F0
 Y.CREATE.L   MDM_HI0_CH12_FLUSH_STATE1_SD0                               0x904000F0
 Y.CREATE.L   HWIO_MDM_HI0_CH12_FLUSH_STATE1_SD1_ADDR                     0x904004F0
 Y.CREATE.L   MDM_HI0_CH12_FLUSH_STATE1_SD1                               0x904004F0
 Y.CREATE.L   HWIO_MDM_HI0_CH12_FLUSH_STATE1_SD2_ADDR                     0x904008F0
 Y.CREATE.L   MDM_HI0_CH12_FLUSH_STATE1_SD2                               0x904008F0
 Y.CREATE.L   HWIO_MDM_HI0_CH12_FLUSH_STATE1_SD3_ADDR                     0x90400CF0
 Y.CREATE.L   MDM_HI0_CH12_FLUSH_STATE1_SD3                               0x90400CF0
 Y.CREATE.L   HWIO_MDM_HI0_CH13_FLUSH_STATE1_SD0_ADDR                     0x904000F4
 Y.CREATE.L   MDM_HI0_CH13_FLUSH_STATE1_SD0                               0x904000F4
 Y.CREATE.L   HWIO_MDM_HI0_CH13_FLUSH_STATE1_SD1_ADDR                     0x904004F4
 Y.CREATE.L   MDM_HI0_CH13_FLUSH_STATE1_SD1                               0x904004F4
 Y.CREATE.L   HWIO_MDM_HI0_CH13_FLUSH_STATE1_SD2_ADDR                     0x904008F4
 Y.CREATE.L   MDM_HI0_CH13_FLUSH_STATE1_SD2                               0x904008F4
 Y.CREATE.L   HWIO_MDM_HI0_CH13_FLUSH_STATE1_SD3_ADDR                     0x90400CF4
 Y.CREATE.L   MDM_HI0_CH13_FLUSH_STATE1_SD3                               0x90400CF4
 Y.CREATE.L   HWIO_MDM_HI0_CH14_FLUSH_STATE1_SD0_ADDR                     0x904000F8
 Y.CREATE.L   MDM_HI0_CH14_FLUSH_STATE1_SD0                               0x904000F8
 Y.CREATE.L   HWIO_MDM_HI0_CH14_FLUSH_STATE1_SD1_ADDR                     0x904004F8
 Y.CREATE.L   MDM_HI0_CH14_FLUSH_STATE1_SD1                               0x904004F8
 Y.CREATE.L   HWIO_MDM_HI0_CH14_FLUSH_STATE1_SD2_ADDR                     0x904008F8
 Y.CREATE.L   MDM_HI0_CH14_FLUSH_STATE1_SD2                               0x904008F8
 Y.CREATE.L   HWIO_MDM_HI0_CH14_FLUSH_STATE1_SD3_ADDR                     0x90400CF8
 Y.CREATE.L   MDM_HI0_CH14_FLUSH_STATE1_SD3                               0x90400CF8
 Y.CREATE.L   HWIO_MDM_HI0_CH15_FLUSH_STATE1_SD0_ADDR                     0x904000FC
 Y.CREATE.L   MDM_HI0_CH15_FLUSH_STATE1_SD0                               0x904000FC
 Y.CREATE.L   HWIO_MDM_HI0_CH15_FLUSH_STATE1_SD1_ADDR                     0x904004FC
 Y.CREATE.L   MDM_HI0_CH15_FLUSH_STATE1_SD1                               0x904004FC
 Y.CREATE.L   HWIO_MDM_HI0_CH15_FLUSH_STATE1_SD2_ADDR                     0x904008FC
 Y.CREATE.L   MDM_HI0_CH15_FLUSH_STATE1_SD2                               0x904008FC
 Y.CREATE.L   HWIO_MDM_HI0_CH15_FLUSH_STATE1_SD3_ADDR                     0x90400CFC
 Y.CREATE.L   MDM_HI0_CH15_FLUSH_STATE1_SD3                               0x90400CFC
 Y.CREATE.L   HWIO_MDM_HI0_CH0_FLUSH_STATE2_SD0_ADDR                      0x90400100
 Y.CREATE.L   MDM_HI0_CH0_FLUSH_STATE2_SD0                                0x90400100
 Y.CREATE.L   HWIO_MDM_HI0_CH0_FLUSH_STATE2_SD1_ADDR                      0x90400500
 Y.CREATE.L   MDM_HI0_CH0_FLUSH_STATE2_SD1                                0x90400500
 Y.CREATE.L   HWIO_MDM_HI0_CH0_FLUSH_STATE2_SD2_ADDR                      0x90400900
 Y.CREATE.L   MDM_HI0_CH0_FLUSH_STATE2_SD2                                0x90400900
 Y.CREATE.L   HWIO_MDM_HI0_CH0_FLUSH_STATE2_SD3_ADDR                      0x90400D00
 Y.CREATE.L   MDM_HI0_CH0_FLUSH_STATE2_SD3                                0x90400D00
 Y.CREATE.L   HWIO_MDM_HI0_CH1_FLUSH_STATE2_SD0_ADDR                      0x90400104
 Y.CREATE.L   MDM_HI0_CH1_FLUSH_STATE2_SD0                                0x90400104
 Y.CREATE.L   HWIO_MDM_HI0_CH1_FLUSH_STATE2_SD1_ADDR                      0x90400504
 Y.CREATE.L   MDM_HI0_CH1_FLUSH_STATE2_SD1                                0x90400504
 Y.CREATE.L   HWIO_MDM_HI0_CH1_FLUSH_STATE2_SD2_ADDR                      0x90400904
 Y.CREATE.L   MDM_HI0_CH1_FLUSH_STATE2_SD2                                0x90400904
 Y.CREATE.L   HWIO_MDM_HI0_CH1_FLUSH_STATE2_SD3_ADDR                      0x90400D04
 Y.CREATE.L   MDM_HI0_CH1_FLUSH_STATE2_SD3                                0x90400D04
 Y.CREATE.L   HWIO_MDM_HI0_CH2_FLUSH_STATE2_SD0_ADDR                      0x90400108
 Y.CREATE.L   MDM_HI0_CH2_FLUSH_STATE2_SD0                                0x90400108
 Y.CREATE.L   HWIO_MDM_HI0_CH2_FLUSH_STATE2_SD1_ADDR                      0x90400508
 Y.CREATE.L   MDM_HI0_CH2_FLUSH_STATE2_SD1                                0x90400508
 Y.CREATE.L   HWIO_MDM_HI0_CH2_FLUSH_STATE2_SD2_ADDR                      0x90400908
 Y.CREATE.L   MDM_HI0_CH2_FLUSH_STATE2_SD2                                0x90400908
 Y.CREATE.L   HWIO_MDM_HI0_CH2_FLUSH_STATE2_SD3_ADDR                      0x90400D08
 Y.CREATE.L   MDM_HI0_CH2_FLUSH_STATE2_SD3                                0x90400D08
 Y.CREATE.L   HWIO_MDM_HI0_CH3_FLUSH_STATE2_SD0_ADDR                      0x9040010C
 Y.CREATE.L   MDM_HI0_CH3_FLUSH_STATE2_SD0                                0x9040010C
 Y.CREATE.L   HWIO_MDM_HI0_CH3_FLUSH_STATE2_SD1_ADDR                      0x9040050C
 Y.CREATE.L   MDM_HI0_CH3_FLUSH_STATE2_SD1                                0x9040050C
 Y.CREATE.L   HWIO_MDM_HI0_CH3_FLUSH_STATE2_SD2_ADDR                      0x9040090C
 Y.CREATE.L   MDM_HI0_CH3_FLUSH_STATE2_SD2                                0x9040090C
 Y.CREATE.L   HWIO_MDM_HI0_CH3_FLUSH_STATE2_SD3_ADDR                      0x90400D0C
 Y.CREATE.L   MDM_HI0_CH3_FLUSH_STATE2_SD3                                0x90400D0C
 Y.CREATE.L   HWIO_MDM_HI0_CH4_FLUSH_STATE2_SD0_ADDR                      0x90400110
 Y.CREATE.L   MDM_HI0_CH4_FLUSH_STATE2_SD0                                0x90400110
 Y.CREATE.L   HWIO_MDM_HI0_CH4_FLUSH_STATE2_SD1_ADDR                      0x90400510
 Y.CREATE.L   MDM_HI0_CH4_FLUSH_STATE2_SD1                                0x90400510
 Y.CREATE.L   HWIO_MDM_HI0_CH4_FLUSH_STATE2_SD2_ADDR                      0x90400910
 Y.CREATE.L   MDM_HI0_CH4_FLUSH_STATE2_SD2                                0x90400910
 Y.CREATE.L   HWIO_MDM_HI0_CH4_FLUSH_STATE2_SD3_ADDR                      0x90400D10
 Y.CREATE.L   MDM_HI0_CH4_FLUSH_STATE2_SD3                                0x90400D10
 Y.CREATE.L   HWIO_MDM_HI0_CH5_FLUSH_STATE2_SD0_ADDR                      0x90400114
 Y.CREATE.L   MDM_HI0_CH5_FLUSH_STATE2_SD0                                0x90400114
 Y.CREATE.L   HWIO_MDM_HI0_CH5_FLUSH_STATE2_SD1_ADDR                      0x90400514
 Y.CREATE.L   MDM_HI0_CH5_FLUSH_STATE2_SD1                                0x90400514
 Y.CREATE.L   HWIO_MDM_HI0_CH5_FLUSH_STATE2_SD2_ADDR                      0x90400914
 Y.CREATE.L   MDM_HI0_CH5_FLUSH_STATE2_SD2                                0x90400914
 Y.CREATE.L   HWIO_MDM_HI0_CH5_FLUSH_STATE2_SD3_ADDR                      0x90400D14
 Y.CREATE.L   MDM_HI0_CH5_FLUSH_STATE2_SD3                                0x90400D14
 Y.CREATE.L   HWIO_MDM_HI0_CH6_FLUSH_STATE2_SD0_ADDR                      0x90400118
 Y.CREATE.L   MDM_HI0_CH6_FLUSH_STATE2_SD0                                0x90400118
 Y.CREATE.L   HWIO_MDM_HI0_CH6_FLUSH_STATE2_SD1_ADDR                      0x90400518
 Y.CREATE.L   MDM_HI0_CH6_FLUSH_STATE2_SD1                                0x90400518
 Y.CREATE.L   HWIO_MDM_HI0_CH6_FLUSH_STATE2_SD2_ADDR                      0x90400918
 Y.CREATE.L   MDM_HI0_CH6_FLUSH_STATE2_SD2                                0x90400918
 Y.CREATE.L   HWIO_MDM_HI0_CH6_FLUSH_STATE2_SD3_ADDR                      0x90400D18
 Y.CREATE.L   MDM_HI0_CH6_FLUSH_STATE2_SD3                                0x90400D18
 Y.CREATE.L   HWIO_MDM_HI0_CH7_FLUSH_STATE2_SD0_ADDR                      0x9040011C
 Y.CREATE.L   MDM_HI0_CH7_FLUSH_STATE2_SD0                                0x9040011C
 Y.CREATE.L   HWIO_MDM_HI0_CH7_FLUSH_STATE2_SD1_ADDR                      0x9040051C
 Y.CREATE.L   MDM_HI0_CH7_FLUSH_STATE2_SD1                                0x9040051C
 Y.CREATE.L   HWIO_MDM_HI0_CH7_FLUSH_STATE2_SD2_ADDR                      0x9040091C
 Y.CREATE.L   MDM_HI0_CH7_FLUSH_STATE2_SD2                                0x9040091C
 Y.CREATE.L   HWIO_MDM_HI0_CH7_FLUSH_STATE2_SD3_ADDR                      0x90400D1C
 Y.CREATE.L   MDM_HI0_CH7_FLUSH_STATE2_SD3                                0x90400D1C
 Y.CREATE.L   HWIO_MDM_HI0_CH8_FLUSH_STATE2_SD0_ADDR                      0x90400120
 Y.CREATE.L   MDM_HI0_CH8_FLUSH_STATE2_SD0                                0x90400120
 Y.CREATE.L   HWIO_MDM_HI0_CH8_FLUSH_STATE2_SD1_ADDR                      0x90400520
 Y.CREATE.L   MDM_HI0_CH8_FLUSH_STATE2_SD1                                0x90400520
 Y.CREATE.L   HWIO_MDM_HI0_CH8_FLUSH_STATE2_SD2_ADDR                      0x90400920
 Y.CREATE.L   MDM_HI0_CH8_FLUSH_STATE2_SD2                                0x90400920
 Y.CREATE.L   HWIO_MDM_HI0_CH8_FLUSH_STATE2_SD3_ADDR                      0x90400D20
 Y.CREATE.L   MDM_HI0_CH8_FLUSH_STATE2_SD3                                0x90400D20
 Y.CREATE.L   HWIO_MDM_HI0_CH9_FLUSH_STATE2_SD0_ADDR                      0x90400124
 Y.CREATE.L   MDM_HI0_CH9_FLUSH_STATE2_SD0                                0x90400124
 Y.CREATE.L   HWIO_MDM_HI0_CH9_FLUSH_STATE2_SD1_ADDR                      0x90400524
 Y.CREATE.L   MDM_HI0_CH9_FLUSH_STATE2_SD1                                0x90400524
 Y.CREATE.L   HWIO_MDM_HI0_CH9_FLUSH_STATE2_SD2_ADDR                      0x90400924
 Y.CREATE.L   MDM_HI0_CH9_FLUSH_STATE2_SD2                                0x90400924
 Y.CREATE.L   HWIO_MDM_HI0_CH9_FLUSH_STATE2_SD3_ADDR                      0x90400D24
 Y.CREATE.L   MDM_HI0_CH9_FLUSH_STATE2_SD3                                0x90400D24
 Y.CREATE.L   HWIO_MDM_HI0_CH10_FLUSH_STATE2_SD0_ADDR                     0x90400128
 Y.CREATE.L   MDM_HI0_CH10_FLUSH_STATE2_SD0                               0x90400128
 Y.CREATE.L   HWIO_MDM_HI0_CH10_FLUSH_STATE2_SD1_ADDR                     0x90400528
 Y.CREATE.L   MDM_HI0_CH10_FLUSH_STATE2_SD1                               0x90400528
 Y.CREATE.L   HWIO_MDM_HI0_CH10_FLUSH_STATE2_SD2_ADDR                     0x90400928
 Y.CREATE.L   MDM_HI0_CH10_FLUSH_STATE2_SD2                               0x90400928
 Y.CREATE.L   HWIO_MDM_HI0_CH10_FLUSH_STATE2_SD3_ADDR                     0x90400D28
 Y.CREATE.L   MDM_HI0_CH10_FLUSH_STATE2_SD3                               0x90400D28
 Y.CREATE.L   HWIO_MDM_HI0_CH11_FLUSH_STATE2_SD0_ADDR                     0x9040012C
 Y.CREATE.L   MDM_HI0_CH11_FLUSH_STATE2_SD0                               0x9040012C
 Y.CREATE.L   HWIO_MDM_HI0_CH11_FLUSH_STATE2_SD1_ADDR                     0x9040052C
 Y.CREATE.L   MDM_HI0_CH11_FLUSH_STATE2_SD1                               0x9040052C
 Y.CREATE.L   HWIO_MDM_HI0_CH11_FLUSH_STATE2_SD2_ADDR                     0x9040092C
 Y.CREATE.L   MDM_HI0_CH11_FLUSH_STATE2_SD2                               0x9040092C
 Y.CREATE.L   HWIO_MDM_HI0_CH11_FLUSH_STATE2_SD3_ADDR                     0x90400D2C
 Y.CREATE.L   MDM_HI0_CH11_FLUSH_STATE2_SD3                               0x90400D2C
 Y.CREATE.L   HWIO_MDM_HI0_CH12_FLUSH_STATE2_SD0_ADDR                     0x90400130
 Y.CREATE.L   MDM_HI0_CH12_FLUSH_STATE2_SD0                               0x90400130
 Y.CREATE.L   HWIO_MDM_HI0_CH12_FLUSH_STATE2_SD1_ADDR                     0x90400530
 Y.CREATE.L   MDM_HI0_CH12_FLUSH_STATE2_SD1                               0x90400530
 Y.CREATE.L   HWIO_MDM_HI0_CH12_FLUSH_STATE2_SD2_ADDR                     0x90400930
 Y.CREATE.L   MDM_HI0_CH12_FLUSH_STATE2_SD2                               0x90400930
 Y.CREATE.L   HWIO_MDM_HI0_CH12_FLUSH_STATE2_SD3_ADDR                     0x90400D30
 Y.CREATE.L   MDM_HI0_CH12_FLUSH_STATE2_SD3                               0x90400D30
 Y.CREATE.L   HWIO_MDM_HI0_CH13_FLUSH_STATE2_SD0_ADDR                     0x90400134
 Y.CREATE.L   MDM_HI0_CH13_FLUSH_STATE2_SD0                               0x90400134
 Y.CREATE.L   HWIO_MDM_HI0_CH13_FLUSH_STATE2_SD1_ADDR                     0x90400534
 Y.CREATE.L   MDM_HI0_CH13_FLUSH_STATE2_SD1                               0x90400534
 Y.CREATE.L   HWIO_MDM_HI0_CH13_FLUSH_STATE2_SD2_ADDR                     0x90400934
 Y.CREATE.L   MDM_HI0_CH13_FLUSH_STATE2_SD2                               0x90400934
 Y.CREATE.L   HWIO_MDM_HI0_CH13_FLUSH_STATE2_SD3_ADDR                     0x90400D34
 Y.CREATE.L   MDM_HI0_CH13_FLUSH_STATE2_SD3                               0x90400D34
 Y.CREATE.L   HWIO_MDM_HI0_CH14_FLUSH_STATE2_SD0_ADDR                     0x90400138
 Y.CREATE.L   MDM_HI0_CH14_FLUSH_STATE2_SD0                               0x90400138
 Y.CREATE.L   HWIO_MDM_HI0_CH14_FLUSH_STATE2_SD1_ADDR                     0x90400538
 Y.CREATE.L   MDM_HI0_CH14_FLUSH_STATE2_SD1                               0x90400538
 Y.CREATE.L   HWIO_MDM_HI0_CH14_FLUSH_STATE2_SD2_ADDR                     0x90400938
 Y.CREATE.L   MDM_HI0_CH14_FLUSH_STATE2_SD2                               0x90400938
 Y.CREATE.L   HWIO_MDM_HI0_CH14_FLUSH_STATE2_SD3_ADDR                     0x90400D38
 Y.CREATE.L   MDM_HI0_CH14_FLUSH_STATE2_SD3                               0x90400D38
 Y.CREATE.L   HWIO_MDM_HI0_CH15_FLUSH_STATE2_SD0_ADDR                     0x9040013C
 Y.CREATE.L   MDM_HI0_CH15_FLUSH_STATE2_SD0                               0x9040013C
 Y.CREATE.L   HWIO_MDM_HI0_CH15_FLUSH_STATE2_SD1_ADDR                     0x9040053C
 Y.CREATE.L   MDM_HI0_CH15_FLUSH_STATE2_SD1                               0x9040053C
 Y.CREATE.L   HWIO_MDM_HI0_CH15_FLUSH_STATE2_SD2_ADDR                     0x9040093C
 Y.CREATE.L   MDM_HI0_CH15_FLUSH_STATE2_SD2                               0x9040093C
 Y.CREATE.L   HWIO_MDM_HI0_CH15_FLUSH_STATE2_SD3_ADDR                     0x90400D3C
 Y.CREATE.L   MDM_HI0_CH15_FLUSH_STATE2_SD3                               0x90400D3C
 Y.CREATE.L   HWIO_MDM_HI0_CH0_FLUSH_STATE3_SD0_ADDR                      0x90400140
 Y.CREATE.L   MDM_HI0_CH0_FLUSH_STATE3_SD0                                0x90400140
 Y.CREATE.L   HWIO_MDM_HI0_CH0_FLUSH_STATE3_SD1_ADDR                      0x90400540
 Y.CREATE.L   MDM_HI0_CH0_FLUSH_STATE3_SD1                                0x90400540
 Y.CREATE.L   HWIO_MDM_HI0_CH0_FLUSH_STATE3_SD2_ADDR                      0x90400940
 Y.CREATE.L   MDM_HI0_CH0_FLUSH_STATE3_SD2                                0x90400940
 Y.CREATE.L   HWIO_MDM_HI0_CH0_FLUSH_STATE3_SD3_ADDR                      0x90400D40
 Y.CREATE.L   MDM_HI0_CH0_FLUSH_STATE3_SD3                                0x90400D40
 Y.CREATE.L   HWIO_MDM_HI0_CH1_FLUSH_STATE3_SD0_ADDR                      0x90400144
 Y.CREATE.L   MDM_HI0_CH1_FLUSH_STATE3_SD0                                0x90400144
 Y.CREATE.L   HWIO_MDM_HI0_CH1_FLUSH_STATE3_SD1_ADDR                      0x90400544
 Y.CREATE.L   MDM_HI0_CH1_FLUSH_STATE3_SD1                                0x90400544
 Y.CREATE.L   HWIO_MDM_HI0_CH1_FLUSH_STATE3_SD2_ADDR                      0x90400944
 Y.CREATE.L   MDM_HI0_CH1_FLUSH_STATE3_SD2                                0x90400944
 Y.CREATE.L   HWIO_MDM_HI0_CH1_FLUSH_STATE3_SD3_ADDR                      0x90400D44
 Y.CREATE.L   MDM_HI0_CH1_FLUSH_STATE3_SD3                                0x90400D44
 Y.CREATE.L   HWIO_MDM_HI0_CH2_FLUSH_STATE3_SD0_ADDR                      0x90400148
 Y.CREATE.L   MDM_HI0_CH2_FLUSH_STATE3_SD0                                0x90400148
 Y.CREATE.L   HWIO_MDM_HI0_CH2_FLUSH_STATE3_SD1_ADDR                      0x90400548
 Y.CREATE.L   MDM_HI0_CH2_FLUSH_STATE3_SD1                                0x90400548
 Y.CREATE.L   HWIO_MDM_HI0_CH2_FLUSH_STATE3_SD2_ADDR                      0x90400948
 Y.CREATE.L   MDM_HI0_CH2_FLUSH_STATE3_SD2                                0x90400948
 Y.CREATE.L   HWIO_MDM_HI0_CH2_FLUSH_STATE3_SD3_ADDR                      0x90400D48
 Y.CREATE.L   MDM_HI0_CH2_FLUSH_STATE3_SD3                                0x90400D48
 Y.CREATE.L   HWIO_MDM_HI0_CH3_FLUSH_STATE3_SD0_ADDR                      0x9040014C
 Y.CREATE.L   MDM_HI0_CH3_FLUSH_STATE3_SD0                                0x9040014C
 Y.CREATE.L   HWIO_MDM_HI0_CH3_FLUSH_STATE3_SD1_ADDR                      0x9040054C
 Y.CREATE.L   MDM_HI0_CH3_FLUSH_STATE3_SD1                                0x9040054C
 Y.CREATE.L   HWIO_MDM_HI0_CH3_FLUSH_STATE3_SD2_ADDR                      0x9040094C
 Y.CREATE.L   MDM_HI0_CH3_FLUSH_STATE3_SD2                                0x9040094C
 Y.CREATE.L   HWIO_MDM_HI0_CH3_FLUSH_STATE3_SD3_ADDR                      0x90400D4C
 Y.CREATE.L   MDM_HI0_CH3_FLUSH_STATE3_SD3                                0x90400D4C
 Y.CREATE.L   HWIO_MDM_HI0_CH4_FLUSH_STATE3_SD0_ADDR                      0x90400150
 Y.CREATE.L   MDM_HI0_CH4_FLUSH_STATE3_SD0                                0x90400150
 Y.CREATE.L   HWIO_MDM_HI0_CH4_FLUSH_STATE3_SD1_ADDR                      0x90400550
 Y.CREATE.L   MDM_HI0_CH4_FLUSH_STATE3_SD1                                0x90400550
 Y.CREATE.L   HWIO_MDM_HI0_CH4_FLUSH_STATE3_SD2_ADDR                      0x90400950
 Y.CREATE.L   MDM_HI0_CH4_FLUSH_STATE3_SD2                                0x90400950
 Y.CREATE.L   HWIO_MDM_HI0_CH4_FLUSH_STATE3_SD3_ADDR                      0x90400D50
 Y.CREATE.L   MDM_HI0_CH4_FLUSH_STATE3_SD3                                0x90400D50
 Y.CREATE.L   HWIO_MDM_HI0_CH5_FLUSH_STATE3_SD0_ADDR                      0x90400154
 Y.CREATE.L   MDM_HI0_CH5_FLUSH_STATE3_SD0                                0x90400154
 Y.CREATE.L   HWIO_MDM_HI0_CH5_FLUSH_STATE3_SD1_ADDR                      0x90400554
 Y.CREATE.L   MDM_HI0_CH5_FLUSH_STATE3_SD1                                0x90400554
 Y.CREATE.L   HWIO_MDM_HI0_CH5_FLUSH_STATE3_SD2_ADDR                      0x90400954
 Y.CREATE.L   MDM_HI0_CH5_FLUSH_STATE3_SD2                                0x90400954
 Y.CREATE.L   HWIO_MDM_HI0_CH5_FLUSH_STATE3_SD3_ADDR                      0x90400D54
 Y.CREATE.L   MDM_HI0_CH5_FLUSH_STATE3_SD3                                0x90400D54
 Y.CREATE.L   HWIO_MDM_HI0_CH6_FLUSH_STATE3_SD0_ADDR                      0x90400158
 Y.CREATE.L   MDM_HI0_CH6_FLUSH_STATE3_SD0                                0x90400158
 Y.CREATE.L   HWIO_MDM_HI0_CH6_FLUSH_STATE3_SD1_ADDR                      0x90400558
 Y.CREATE.L   MDM_HI0_CH6_FLUSH_STATE3_SD1                                0x90400558
 Y.CREATE.L   HWIO_MDM_HI0_CH6_FLUSH_STATE3_SD2_ADDR                      0x90400958
 Y.CREATE.L   MDM_HI0_CH6_FLUSH_STATE3_SD2                                0x90400958
 Y.CREATE.L   HWIO_MDM_HI0_CH6_FLUSH_STATE3_SD3_ADDR                      0x90400D58
 Y.CREATE.L   MDM_HI0_CH6_FLUSH_STATE3_SD3                                0x90400D58
 Y.CREATE.L   HWIO_MDM_HI0_CH7_FLUSH_STATE3_SD0_ADDR                      0x9040015C
 Y.CREATE.L   MDM_HI0_CH7_FLUSH_STATE3_SD0                                0x9040015C
 Y.CREATE.L   HWIO_MDM_HI0_CH7_FLUSH_STATE3_SD1_ADDR                      0x9040055C
 Y.CREATE.L   MDM_HI0_CH7_FLUSH_STATE3_SD1                                0x9040055C
 Y.CREATE.L   HWIO_MDM_HI0_CH7_FLUSH_STATE3_SD2_ADDR                      0x9040095C
 Y.CREATE.L   MDM_HI0_CH7_FLUSH_STATE3_SD2                                0x9040095C
 Y.CREATE.L   HWIO_MDM_HI0_CH7_FLUSH_STATE3_SD3_ADDR                      0x90400D5C
 Y.CREATE.L   MDM_HI0_CH7_FLUSH_STATE3_SD3                                0x90400D5C
 Y.CREATE.L   HWIO_MDM_HI0_CH8_FLUSH_STATE3_SD0_ADDR                      0x90400160
 Y.CREATE.L   MDM_HI0_CH8_FLUSH_STATE3_SD0                                0x90400160
 Y.CREATE.L   HWIO_MDM_HI0_CH8_FLUSH_STATE3_SD1_ADDR                      0x90400560
 Y.CREATE.L   MDM_HI0_CH8_FLUSH_STATE3_SD1                                0x90400560
 Y.CREATE.L   HWIO_MDM_HI0_CH8_FLUSH_STATE3_SD2_ADDR                      0x90400960
 Y.CREATE.L   MDM_HI0_CH8_FLUSH_STATE3_SD2                                0x90400960
 Y.CREATE.L   HWIO_MDM_HI0_CH8_FLUSH_STATE3_SD3_ADDR                      0x90400D60
 Y.CREATE.L   MDM_HI0_CH8_FLUSH_STATE3_SD3                                0x90400D60
 Y.CREATE.L   HWIO_MDM_HI0_CH9_FLUSH_STATE3_SD0_ADDR                      0x90400164
 Y.CREATE.L   MDM_HI0_CH9_FLUSH_STATE3_SD0                                0x90400164
 Y.CREATE.L   HWIO_MDM_HI0_CH9_FLUSH_STATE3_SD1_ADDR                      0x90400564
 Y.CREATE.L   MDM_HI0_CH9_FLUSH_STATE3_SD1                                0x90400564
 Y.CREATE.L   HWIO_MDM_HI0_CH9_FLUSH_STATE3_SD2_ADDR                      0x90400964
 Y.CREATE.L   MDM_HI0_CH9_FLUSH_STATE3_SD2                                0x90400964
 Y.CREATE.L   HWIO_MDM_HI0_CH9_FLUSH_STATE3_SD3_ADDR                      0x90400D64
 Y.CREATE.L   MDM_HI0_CH9_FLUSH_STATE3_SD3                                0x90400D64
 Y.CREATE.L   HWIO_MDM_HI0_CH10_FLUSH_STATE3_SD0_ADDR                     0x90400168
 Y.CREATE.L   MDM_HI0_CH10_FLUSH_STATE3_SD0                               0x90400168
 Y.CREATE.L   HWIO_MDM_HI0_CH10_FLUSH_STATE3_SD1_ADDR                     0x90400568
 Y.CREATE.L   MDM_HI0_CH10_FLUSH_STATE3_SD1                               0x90400568
 Y.CREATE.L   HWIO_MDM_HI0_CH10_FLUSH_STATE3_SD2_ADDR                     0x90400968
 Y.CREATE.L   MDM_HI0_CH10_FLUSH_STATE3_SD2                               0x90400968
 Y.CREATE.L   HWIO_MDM_HI0_CH10_FLUSH_STATE3_SD3_ADDR                     0x90400D68
 Y.CREATE.L   MDM_HI0_CH10_FLUSH_STATE3_SD3                               0x90400D68
 Y.CREATE.L   HWIO_MDM_HI0_CH11_FLUSH_STATE3_SD0_ADDR                     0x9040016C
 Y.CREATE.L   MDM_HI0_CH11_FLUSH_STATE3_SD0                               0x9040016C
 Y.CREATE.L   HWIO_MDM_HI0_CH11_FLUSH_STATE3_SD1_ADDR                     0x9040056C
 Y.CREATE.L   MDM_HI0_CH11_FLUSH_STATE3_SD1                               0x9040056C
 Y.CREATE.L   HWIO_MDM_HI0_CH11_FLUSH_STATE3_SD2_ADDR                     0x9040096C
 Y.CREATE.L   MDM_HI0_CH11_FLUSH_STATE3_SD2                               0x9040096C
 Y.CREATE.L   HWIO_MDM_HI0_CH11_FLUSH_STATE3_SD3_ADDR                     0x90400D6C
 Y.CREATE.L   MDM_HI0_CH11_FLUSH_STATE3_SD3                               0x90400D6C
 Y.CREATE.L   HWIO_MDM_HI0_CH12_FLUSH_STATE3_SD0_ADDR                     0x90400170
 Y.CREATE.L   MDM_HI0_CH12_FLUSH_STATE3_SD0                               0x90400170
 Y.CREATE.L   HWIO_MDM_HI0_CH12_FLUSH_STATE3_SD1_ADDR                     0x90400570
 Y.CREATE.L   MDM_HI0_CH12_FLUSH_STATE3_SD1                               0x90400570
 Y.CREATE.L   HWIO_MDM_HI0_CH12_FLUSH_STATE3_SD2_ADDR                     0x90400970
 Y.CREATE.L   MDM_HI0_CH12_FLUSH_STATE3_SD2                               0x90400970
 Y.CREATE.L   HWIO_MDM_HI0_CH12_FLUSH_STATE3_SD3_ADDR                     0x90400D70
 Y.CREATE.L   MDM_HI0_CH12_FLUSH_STATE3_SD3                               0x90400D70
 Y.CREATE.L   HWIO_MDM_HI0_CH13_FLUSH_STATE3_SD0_ADDR                     0x90400174
 Y.CREATE.L   MDM_HI0_CH13_FLUSH_STATE3_SD0                               0x90400174
 Y.CREATE.L   HWIO_MDM_HI0_CH13_FLUSH_STATE3_SD1_ADDR                     0x90400574
 Y.CREATE.L   MDM_HI0_CH13_FLUSH_STATE3_SD1                               0x90400574
 Y.CREATE.L   HWIO_MDM_HI0_CH13_FLUSH_STATE3_SD2_ADDR                     0x90400974
 Y.CREATE.L   MDM_HI0_CH13_FLUSH_STATE3_SD2                               0x90400974
 Y.CREATE.L   HWIO_MDM_HI0_CH13_FLUSH_STATE3_SD3_ADDR                     0x90400D74
 Y.CREATE.L   MDM_HI0_CH13_FLUSH_STATE3_SD3                               0x90400D74
 Y.CREATE.L   HWIO_MDM_HI0_CH14_FLUSH_STATE3_SD0_ADDR                     0x90400178
 Y.CREATE.L   MDM_HI0_CH14_FLUSH_STATE3_SD0                               0x90400178
 Y.CREATE.L   HWIO_MDM_HI0_CH14_FLUSH_STATE3_SD1_ADDR                     0x90400578
 Y.CREATE.L   MDM_HI0_CH14_FLUSH_STATE3_SD1                               0x90400578
 Y.CREATE.L   HWIO_MDM_HI0_CH14_FLUSH_STATE3_SD2_ADDR                     0x90400978
 Y.CREATE.L   MDM_HI0_CH14_FLUSH_STATE3_SD2                               0x90400978
 Y.CREATE.L   HWIO_MDM_HI0_CH14_FLUSH_STATE3_SD3_ADDR                     0x90400D78
 Y.CREATE.L   MDM_HI0_CH14_FLUSH_STATE3_SD3                               0x90400D78
 Y.CREATE.L   HWIO_MDM_HI0_CH15_FLUSH_STATE3_SD0_ADDR                     0x9040017C
 Y.CREATE.L   MDM_HI0_CH15_FLUSH_STATE3_SD0                               0x9040017C
 Y.CREATE.L   HWIO_MDM_HI0_CH15_FLUSH_STATE3_SD1_ADDR                     0x9040057C
 Y.CREATE.L   MDM_HI0_CH15_FLUSH_STATE3_SD1                               0x9040057C
 Y.CREATE.L   HWIO_MDM_HI0_CH15_FLUSH_STATE3_SD2_ADDR                     0x9040097C
 Y.CREATE.L   MDM_HI0_CH15_FLUSH_STATE3_SD2                               0x9040097C
 Y.CREATE.L   HWIO_MDM_HI0_CH15_FLUSH_STATE3_SD3_ADDR                     0x90400D7C
 Y.CREATE.L   MDM_HI0_CH15_FLUSH_STATE3_SD3                               0x90400D7C
 Y.CREATE.L   HWIO_MDM_HI0_CH0_FLUSH_STATE4_SD0_ADDR                      0x90400180
 Y.CREATE.L   MDM_HI0_CH0_FLUSH_STATE4_SD0                                0x90400180
 Y.CREATE.L   HWIO_MDM_HI0_CH0_FLUSH_STATE4_SD1_ADDR                      0x90400580
 Y.CREATE.L   MDM_HI0_CH0_FLUSH_STATE4_SD1                                0x90400580
 Y.CREATE.L   HWIO_MDM_HI0_CH0_FLUSH_STATE4_SD2_ADDR                      0x90400980
 Y.CREATE.L   MDM_HI0_CH0_FLUSH_STATE4_SD2                                0x90400980
 Y.CREATE.L   HWIO_MDM_HI0_CH0_FLUSH_STATE4_SD3_ADDR                      0x90400D80
 Y.CREATE.L   MDM_HI0_CH0_FLUSH_STATE4_SD3                                0x90400D80
 Y.CREATE.L   HWIO_MDM_HI0_CH1_FLUSH_STATE4_SD0_ADDR                      0x90400184
 Y.CREATE.L   MDM_HI0_CH1_FLUSH_STATE4_SD0                                0x90400184
 Y.CREATE.L   HWIO_MDM_HI0_CH1_FLUSH_STATE4_SD1_ADDR                      0x90400584
 Y.CREATE.L   MDM_HI0_CH1_FLUSH_STATE4_SD1                                0x90400584
 Y.CREATE.L   HWIO_MDM_HI0_CH1_FLUSH_STATE4_SD2_ADDR                      0x90400984
 Y.CREATE.L   MDM_HI0_CH1_FLUSH_STATE4_SD2                                0x90400984
 Y.CREATE.L   HWIO_MDM_HI0_CH1_FLUSH_STATE4_SD3_ADDR                      0x90400D84
 Y.CREATE.L   MDM_HI0_CH1_FLUSH_STATE4_SD3                                0x90400D84
 Y.CREATE.L   HWIO_MDM_HI0_CH2_FLUSH_STATE4_SD0_ADDR                      0x90400188
 Y.CREATE.L   MDM_HI0_CH2_FLUSH_STATE4_SD0                                0x90400188
 Y.CREATE.L   HWIO_MDM_HI0_CH2_FLUSH_STATE4_SD1_ADDR                      0x90400588
 Y.CREATE.L   MDM_HI0_CH2_FLUSH_STATE4_SD1                                0x90400588
 Y.CREATE.L   HWIO_MDM_HI0_CH2_FLUSH_STATE4_SD2_ADDR                      0x90400988
 Y.CREATE.L   MDM_HI0_CH2_FLUSH_STATE4_SD2                                0x90400988
 Y.CREATE.L   HWIO_MDM_HI0_CH2_FLUSH_STATE4_SD3_ADDR                      0x90400D88
 Y.CREATE.L   MDM_HI0_CH2_FLUSH_STATE4_SD3                                0x90400D88
 Y.CREATE.L   HWIO_MDM_HI0_CH3_FLUSH_STATE4_SD0_ADDR                      0x9040018C
 Y.CREATE.L   MDM_HI0_CH3_FLUSH_STATE4_SD0                                0x9040018C
 Y.CREATE.L   HWIO_MDM_HI0_CH3_FLUSH_STATE4_SD1_ADDR                      0x9040058C
 Y.CREATE.L   MDM_HI0_CH3_FLUSH_STATE4_SD1                                0x9040058C
 Y.CREATE.L   HWIO_MDM_HI0_CH3_FLUSH_STATE4_SD2_ADDR                      0x9040098C
 Y.CREATE.L   MDM_HI0_CH3_FLUSH_STATE4_SD2                                0x9040098C
 Y.CREATE.L   HWIO_MDM_HI0_CH3_FLUSH_STATE4_SD3_ADDR                      0x90400D8C
 Y.CREATE.L   MDM_HI0_CH3_FLUSH_STATE4_SD3                                0x90400D8C
 Y.CREATE.L   HWIO_MDM_HI0_CH4_FLUSH_STATE4_SD0_ADDR                      0x90400190
 Y.CREATE.L   MDM_HI0_CH4_FLUSH_STATE4_SD0                                0x90400190
 Y.CREATE.L   HWIO_MDM_HI0_CH4_FLUSH_STATE4_SD1_ADDR                      0x90400590
 Y.CREATE.L   MDM_HI0_CH4_FLUSH_STATE4_SD1                                0x90400590
 Y.CREATE.L   HWIO_MDM_HI0_CH4_FLUSH_STATE4_SD2_ADDR                      0x90400990
 Y.CREATE.L   MDM_HI0_CH4_FLUSH_STATE4_SD2                                0x90400990
 Y.CREATE.L   HWIO_MDM_HI0_CH4_FLUSH_STATE4_SD3_ADDR                      0x90400D90
 Y.CREATE.L   MDM_HI0_CH4_FLUSH_STATE4_SD3                                0x90400D90
 Y.CREATE.L   HWIO_MDM_HI0_CH5_FLUSH_STATE4_SD0_ADDR                      0x90400194
 Y.CREATE.L   MDM_HI0_CH5_FLUSH_STATE4_SD0                                0x90400194
 Y.CREATE.L   HWIO_MDM_HI0_CH5_FLUSH_STATE4_SD1_ADDR                      0x90400594
 Y.CREATE.L   MDM_HI0_CH5_FLUSH_STATE4_SD1                                0x90400594
 Y.CREATE.L   HWIO_MDM_HI0_CH5_FLUSH_STATE4_SD2_ADDR                      0x90400994
 Y.CREATE.L   MDM_HI0_CH5_FLUSH_STATE4_SD2                                0x90400994
 Y.CREATE.L   HWIO_MDM_HI0_CH5_FLUSH_STATE4_SD3_ADDR                      0x90400D94
 Y.CREATE.L   MDM_HI0_CH5_FLUSH_STATE4_SD3                                0x90400D94
 Y.CREATE.L   HWIO_MDM_HI0_CH6_FLUSH_STATE4_SD0_ADDR                      0x90400198
 Y.CREATE.L   MDM_HI0_CH6_FLUSH_STATE4_SD0                                0x90400198
 Y.CREATE.L   HWIO_MDM_HI0_CH6_FLUSH_STATE4_SD1_ADDR                      0x90400598
 Y.CREATE.L   MDM_HI0_CH6_FLUSH_STATE4_SD1                                0x90400598
 Y.CREATE.L   HWIO_MDM_HI0_CH6_FLUSH_STATE4_SD2_ADDR                      0x90400998
 Y.CREATE.L   MDM_HI0_CH6_FLUSH_STATE4_SD2                                0x90400998
 Y.CREATE.L   HWIO_MDM_HI0_CH6_FLUSH_STATE4_SD3_ADDR                      0x90400D98
 Y.CREATE.L   MDM_HI0_CH6_FLUSH_STATE4_SD3                                0x90400D98
 Y.CREATE.L   HWIO_MDM_HI0_CH7_FLUSH_STATE4_SD0_ADDR                      0x9040019C
 Y.CREATE.L   MDM_HI0_CH7_FLUSH_STATE4_SD0                                0x9040019C
 Y.CREATE.L   HWIO_MDM_HI0_CH7_FLUSH_STATE4_SD1_ADDR                      0x9040059C
 Y.CREATE.L   MDM_HI0_CH7_FLUSH_STATE4_SD1                                0x9040059C
 Y.CREATE.L   HWIO_MDM_HI0_CH7_FLUSH_STATE4_SD2_ADDR                      0x9040099C
 Y.CREATE.L   MDM_HI0_CH7_FLUSH_STATE4_SD2                                0x9040099C
 Y.CREATE.L   HWIO_MDM_HI0_CH7_FLUSH_STATE4_SD3_ADDR                      0x90400D9C
 Y.CREATE.L   MDM_HI0_CH7_FLUSH_STATE4_SD3                                0x90400D9C
 Y.CREATE.L   HWIO_MDM_HI0_CH8_FLUSH_STATE4_SD0_ADDR                      0x904001A0
 Y.CREATE.L   MDM_HI0_CH8_FLUSH_STATE4_SD0                                0x904001A0
 Y.CREATE.L   HWIO_MDM_HI0_CH8_FLUSH_STATE4_SD1_ADDR                      0x904005A0
 Y.CREATE.L   MDM_HI0_CH8_FLUSH_STATE4_SD1                                0x904005A0
 Y.CREATE.L   HWIO_MDM_HI0_CH8_FLUSH_STATE4_SD2_ADDR                      0x904009A0
 Y.CREATE.L   MDM_HI0_CH8_FLUSH_STATE4_SD2                                0x904009A0
 Y.CREATE.L   HWIO_MDM_HI0_CH8_FLUSH_STATE4_SD3_ADDR                      0x90400DA0
 Y.CREATE.L   MDM_HI0_CH8_FLUSH_STATE4_SD3                                0x90400DA0
 Y.CREATE.L   HWIO_MDM_HI0_CH9_FLUSH_STATE4_SD0_ADDR                      0x904001A4
 Y.CREATE.L   MDM_HI0_CH9_FLUSH_STATE4_SD0                                0x904001A4
 Y.CREATE.L   HWIO_MDM_HI0_CH9_FLUSH_STATE4_SD1_ADDR                      0x904005A4
 Y.CREATE.L   MDM_HI0_CH9_FLUSH_STATE4_SD1                                0x904005A4
 Y.CREATE.L   HWIO_MDM_HI0_CH9_FLUSH_STATE4_SD2_ADDR                      0x904009A4
 Y.CREATE.L   MDM_HI0_CH9_FLUSH_STATE4_SD2                                0x904009A4
 Y.CREATE.L   HWIO_MDM_HI0_CH9_FLUSH_STATE4_SD3_ADDR                      0x90400DA4
 Y.CREATE.L   MDM_HI0_CH9_FLUSH_STATE4_SD3                                0x90400DA4
 Y.CREATE.L   HWIO_MDM_HI0_CH10_FLUSH_STATE4_SD0_ADDR                     0x904001A8
 Y.CREATE.L   MDM_HI0_CH10_FLUSH_STATE4_SD0                               0x904001A8
 Y.CREATE.L   HWIO_MDM_HI0_CH10_FLUSH_STATE4_SD1_ADDR                     0x904005A8
 Y.CREATE.L   MDM_HI0_CH10_FLUSH_STATE4_SD1                               0x904005A8
 Y.CREATE.L   HWIO_MDM_HI0_CH10_FLUSH_STATE4_SD2_ADDR                     0x904009A8
 Y.CREATE.L   MDM_HI0_CH10_FLUSH_STATE4_SD2                               0x904009A8
 Y.CREATE.L   HWIO_MDM_HI0_CH10_FLUSH_STATE4_SD3_ADDR                     0x90400DA8
 Y.CREATE.L   MDM_HI0_CH10_FLUSH_STATE4_SD3                               0x90400DA8
 Y.CREATE.L   HWIO_MDM_HI0_CH11_FLUSH_STATE4_SD0_ADDR                     0x904001AC
 Y.CREATE.L   MDM_HI0_CH11_FLUSH_STATE4_SD0                               0x904001AC
 Y.CREATE.L   HWIO_MDM_HI0_CH11_FLUSH_STATE4_SD1_ADDR                     0x904005AC
 Y.CREATE.L   MDM_HI0_CH11_FLUSH_STATE4_SD1                               0x904005AC
 Y.CREATE.L   HWIO_MDM_HI0_CH11_FLUSH_STATE4_SD2_ADDR                     0x904009AC
 Y.CREATE.L   MDM_HI0_CH11_FLUSH_STATE4_SD2                               0x904009AC
 Y.CREATE.L   HWIO_MDM_HI0_CH11_FLUSH_STATE4_SD3_ADDR                     0x90400DAC
 Y.CREATE.L   MDM_HI0_CH11_FLUSH_STATE4_SD3                               0x90400DAC
 Y.CREATE.L   HWIO_MDM_HI0_CH12_FLUSH_STATE4_SD0_ADDR                     0x904001B0
 Y.CREATE.L   MDM_HI0_CH12_FLUSH_STATE4_SD0                               0x904001B0
 Y.CREATE.L   HWIO_MDM_HI0_CH12_FLUSH_STATE4_SD1_ADDR                     0x904005B0
 Y.CREATE.L   MDM_HI0_CH12_FLUSH_STATE4_SD1                               0x904005B0
 Y.CREATE.L   HWIO_MDM_HI0_CH12_FLUSH_STATE4_SD2_ADDR                     0x904009B0
 Y.CREATE.L   MDM_HI0_CH12_FLUSH_STATE4_SD2                               0x904009B0
 Y.CREATE.L   HWIO_MDM_HI0_CH12_FLUSH_STATE4_SD3_ADDR                     0x90400DB0
 Y.CREATE.L   MDM_HI0_CH12_FLUSH_STATE4_SD3                               0x90400DB0
 Y.CREATE.L   HWIO_MDM_HI0_CH13_FLUSH_STATE4_SD0_ADDR                     0x904001B4
 Y.CREATE.L   MDM_HI0_CH13_FLUSH_STATE4_SD0                               0x904001B4
 Y.CREATE.L   HWIO_MDM_HI0_CH13_FLUSH_STATE4_SD1_ADDR                     0x904005B4
 Y.CREATE.L   MDM_HI0_CH13_FLUSH_STATE4_SD1                               0x904005B4
 Y.CREATE.L   HWIO_MDM_HI0_CH13_FLUSH_STATE4_SD2_ADDR                     0x904009B4
 Y.CREATE.L   MDM_HI0_CH13_FLUSH_STATE4_SD2                               0x904009B4
 Y.CREATE.L   HWIO_MDM_HI0_CH13_FLUSH_STATE4_SD3_ADDR                     0x90400DB4
 Y.CREATE.L   MDM_HI0_CH13_FLUSH_STATE4_SD3                               0x90400DB4
 Y.CREATE.L   HWIO_MDM_HI0_CH14_FLUSH_STATE4_SD0_ADDR                     0x904001B8
 Y.CREATE.L   MDM_HI0_CH14_FLUSH_STATE4_SD0                               0x904001B8
 Y.CREATE.L   HWIO_MDM_HI0_CH14_FLUSH_STATE4_SD1_ADDR                     0x904005B8
 Y.CREATE.L   MDM_HI0_CH14_FLUSH_STATE4_SD1                               0x904005B8
 Y.CREATE.L   HWIO_MDM_HI0_CH14_FLUSH_STATE4_SD2_ADDR                     0x904009B8
 Y.CREATE.L   MDM_HI0_CH14_FLUSH_STATE4_SD2                               0x904009B8
 Y.CREATE.L   HWIO_MDM_HI0_CH14_FLUSH_STATE4_SD3_ADDR                     0x90400DB8
 Y.CREATE.L   MDM_HI0_CH14_FLUSH_STATE4_SD3                               0x90400DB8
 Y.CREATE.L   HWIO_MDM_HI0_CH15_FLUSH_STATE4_SD0_ADDR                     0x904001BC
 Y.CREATE.L   MDM_HI0_CH15_FLUSH_STATE4_SD0                               0x904001BC
 Y.CREATE.L   HWIO_MDM_HI0_CH15_FLUSH_STATE4_SD1_ADDR                     0x904005BC
 Y.CREATE.L   MDM_HI0_CH15_FLUSH_STATE4_SD1                               0x904005BC
 Y.CREATE.L   HWIO_MDM_HI0_CH15_FLUSH_STATE4_SD2_ADDR                     0x904009BC
 Y.CREATE.L   MDM_HI0_CH15_FLUSH_STATE4_SD2                               0x904009BC
 Y.CREATE.L   HWIO_MDM_HI0_CH15_FLUSH_STATE4_SD3_ADDR                     0x90400DBC
 Y.CREATE.L   MDM_HI0_CH15_FLUSH_STATE4_SD3                               0x90400DBC
 Y.CREATE.L   HWIO_MDM_HI0_CH0_FLUSH_STATE5_SD0_ADDR                      0x904001C0
 Y.CREATE.L   MDM_HI0_CH0_FLUSH_STATE5_SD0                                0x904001C0
 Y.CREATE.L   HWIO_MDM_HI0_CH0_FLUSH_STATE5_SD1_ADDR                      0x904005C0
 Y.CREATE.L   MDM_HI0_CH0_FLUSH_STATE5_SD1                                0x904005C0
 Y.CREATE.L   HWIO_MDM_HI0_CH0_FLUSH_STATE5_SD2_ADDR                      0x904009C0
 Y.CREATE.L   MDM_HI0_CH0_FLUSH_STATE5_SD2                                0x904009C0
 Y.CREATE.L   HWIO_MDM_HI0_CH0_FLUSH_STATE5_SD3_ADDR                      0x90400DC0
 Y.CREATE.L   MDM_HI0_CH0_FLUSH_STATE5_SD3                                0x90400DC0
 Y.CREATE.L   HWIO_MDM_HI0_CH1_FLUSH_STATE5_SD0_ADDR                      0x904001C4
 Y.CREATE.L   MDM_HI0_CH1_FLUSH_STATE5_SD0                                0x904001C4
 Y.CREATE.L   HWIO_MDM_HI0_CH1_FLUSH_STATE5_SD1_ADDR                      0x904005C4
 Y.CREATE.L   MDM_HI0_CH1_FLUSH_STATE5_SD1                                0x904005C4
 Y.CREATE.L   HWIO_MDM_HI0_CH1_FLUSH_STATE5_SD2_ADDR                      0x904009C4
 Y.CREATE.L   MDM_HI0_CH1_FLUSH_STATE5_SD2                                0x904009C4
 Y.CREATE.L   HWIO_MDM_HI0_CH1_FLUSH_STATE5_SD3_ADDR                      0x90400DC4
 Y.CREATE.L   MDM_HI0_CH1_FLUSH_STATE5_SD3                                0x90400DC4
 Y.CREATE.L   HWIO_MDM_HI0_CH2_FLUSH_STATE5_SD0_ADDR                      0x904001C8
 Y.CREATE.L   MDM_HI0_CH2_FLUSH_STATE5_SD0                                0x904001C8
 Y.CREATE.L   HWIO_MDM_HI0_CH2_FLUSH_STATE5_SD1_ADDR                      0x904005C8
 Y.CREATE.L   MDM_HI0_CH2_FLUSH_STATE5_SD1                                0x904005C8
 Y.CREATE.L   HWIO_MDM_HI0_CH2_FLUSH_STATE5_SD2_ADDR                      0x904009C8
 Y.CREATE.L   MDM_HI0_CH2_FLUSH_STATE5_SD2                                0x904009C8
 Y.CREATE.L   HWIO_MDM_HI0_CH2_FLUSH_STATE5_SD3_ADDR                      0x90400DC8
 Y.CREATE.L   MDM_HI0_CH2_FLUSH_STATE5_SD3                                0x90400DC8
 Y.CREATE.L   HWIO_MDM_HI0_CH3_FLUSH_STATE5_SD0_ADDR                      0x904001CC
 Y.CREATE.L   MDM_HI0_CH3_FLUSH_STATE5_SD0                                0x904001CC
 Y.CREATE.L   HWIO_MDM_HI0_CH3_FLUSH_STATE5_SD1_ADDR                      0x904005CC
 Y.CREATE.L   MDM_HI0_CH3_FLUSH_STATE5_SD1                                0x904005CC
 Y.CREATE.L   HWIO_MDM_HI0_CH3_FLUSH_STATE5_SD2_ADDR                      0x904009CC
 Y.CREATE.L   MDM_HI0_CH3_FLUSH_STATE5_SD2                                0x904009CC
 Y.CREATE.L   HWIO_MDM_HI0_CH3_FLUSH_STATE5_SD3_ADDR                      0x90400DCC
 Y.CREATE.L   MDM_HI0_CH3_FLUSH_STATE5_SD3                                0x90400DCC
 Y.CREATE.L   HWIO_MDM_HI0_CH4_FLUSH_STATE5_SD0_ADDR                      0x904001D0
 Y.CREATE.L   MDM_HI0_CH4_FLUSH_STATE5_SD0                                0x904001D0
 Y.CREATE.L   HWIO_MDM_HI0_CH4_FLUSH_STATE5_SD1_ADDR                      0x904005D0
 Y.CREATE.L   MDM_HI0_CH4_FLUSH_STATE5_SD1                                0x904005D0
 Y.CREATE.L   HWIO_MDM_HI0_CH4_FLUSH_STATE5_SD2_ADDR                      0x904009D0
 Y.CREATE.L   MDM_HI0_CH4_FLUSH_STATE5_SD2                                0x904009D0
 Y.CREATE.L   HWIO_MDM_HI0_CH4_FLUSH_STATE5_SD3_ADDR                      0x90400DD0
 Y.CREATE.L   MDM_HI0_CH4_FLUSH_STATE5_SD3                                0x90400DD0
 Y.CREATE.L   HWIO_MDM_HI0_CH5_FLUSH_STATE5_SD0_ADDR                      0x904001D4
 Y.CREATE.L   MDM_HI0_CH5_FLUSH_STATE5_SD0                                0x904001D4
 Y.CREATE.L   HWIO_MDM_HI0_CH5_FLUSH_STATE5_SD1_ADDR                      0x904005D4
 Y.CREATE.L   MDM_HI0_CH5_FLUSH_STATE5_SD1                                0x904005D4
 Y.CREATE.L   HWIO_MDM_HI0_CH5_FLUSH_STATE5_SD2_ADDR                      0x904009D4
 Y.CREATE.L   MDM_HI0_CH5_FLUSH_STATE5_SD2                                0x904009D4
 Y.CREATE.L   HWIO_MDM_HI0_CH5_FLUSH_STATE5_SD3_ADDR                      0x90400DD4
 Y.CREATE.L   MDM_HI0_CH5_FLUSH_STATE5_SD3                                0x90400DD4
 Y.CREATE.L   HWIO_MDM_HI0_CH6_FLUSH_STATE5_SD0_ADDR                      0x904001D8
 Y.CREATE.L   MDM_HI0_CH6_FLUSH_STATE5_SD0                                0x904001D8
 Y.CREATE.L   HWIO_MDM_HI0_CH6_FLUSH_STATE5_SD1_ADDR                      0x904005D8
 Y.CREATE.L   MDM_HI0_CH6_FLUSH_STATE5_SD1                                0x904005D8
 Y.CREATE.L   HWIO_MDM_HI0_CH6_FLUSH_STATE5_SD2_ADDR                      0x904009D8
 Y.CREATE.L   MDM_HI0_CH6_FLUSH_STATE5_SD2                                0x904009D8
 Y.CREATE.L   HWIO_MDM_HI0_CH6_FLUSH_STATE5_SD3_ADDR                      0x90400DD8
 Y.CREATE.L   MDM_HI0_CH6_FLUSH_STATE5_SD3                                0x90400DD8
 Y.CREATE.L   HWIO_MDM_HI0_CH7_FLUSH_STATE5_SD0_ADDR                      0x904001DC
 Y.CREATE.L   MDM_HI0_CH7_FLUSH_STATE5_SD0                                0x904001DC
 Y.CREATE.L   HWIO_MDM_HI0_CH7_FLUSH_STATE5_SD1_ADDR                      0x904005DC
 Y.CREATE.L   MDM_HI0_CH7_FLUSH_STATE5_SD1                                0x904005DC
 Y.CREATE.L   HWIO_MDM_HI0_CH7_FLUSH_STATE5_SD2_ADDR                      0x904009DC
 Y.CREATE.L   MDM_HI0_CH7_FLUSH_STATE5_SD2                                0x904009DC
 Y.CREATE.L   HWIO_MDM_HI0_CH7_FLUSH_STATE5_SD3_ADDR                      0x90400DDC
 Y.CREATE.L   MDM_HI0_CH7_FLUSH_STATE5_SD3                                0x90400DDC
 Y.CREATE.L   HWIO_MDM_HI0_CH8_FLUSH_STATE5_SD0_ADDR                      0x904001E0
 Y.CREATE.L   MDM_HI0_CH8_FLUSH_STATE5_SD0                                0x904001E0
 Y.CREATE.L   HWIO_MDM_HI0_CH8_FLUSH_STATE5_SD1_ADDR                      0x904005E0
 Y.CREATE.L   MDM_HI0_CH8_FLUSH_STATE5_SD1                                0x904005E0
 Y.CREATE.L   HWIO_MDM_HI0_CH8_FLUSH_STATE5_SD2_ADDR                      0x904009E0
 Y.CREATE.L   MDM_HI0_CH8_FLUSH_STATE5_SD2                                0x904009E0
 Y.CREATE.L   HWIO_MDM_HI0_CH8_FLUSH_STATE5_SD3_ADDR                      0x90400DE0
 Y.CREATE.L   MDM_HI0_CH8_FLUSH_STATE5_SD3                                0x90400DE0
 Y.CREATE.L   HWIO_MDM_HI0_CH9_FLUSH_STATE5_SD0_ADDR                      0x904001E4
 Y.CREATE.L   MDM_HI0_CH9_FLUSH_STATE5_SD0                                0x904001E4
 Y.CREATE.L   HWIO_MDM_HI0_CH9_FLUSH_STATE5_SD1_ADDR                      0x904005E4
 Y.CREATE.L   MDM_HI0_CH9_FLUSH_STATE5_SD1                                0x904005E4
 Y.CREATE.L   HWIO_MDM_HI0_CH9_FLUSH_STATE5_SD2_ADDR                      0x904009E4
 Y.CREATE.L   MDM_HI0_CH9_FLUSH_STATE5_SD2                                0x904009E4
 Y.CREATE.L   HWIO_MDM_HI0_CH9_FLUSH_STATE5_SD3_ADDR                      0x90400DE4
 Y.CREATE.L   MDM_HI0_CH9_FLUSH_STATE5_SD3                                0x90400DE4
 Y.CREATE.L   HWIO_MDM_HI0_CH10_FLUSH_STATE5_SD0_ADDR                     0x904001E8
 Y.CREATE.L   MDM_HI0_CH10_FLUSH_STATE5_SD0                               0x904001E8
 Y.CREATE.L   HWIO_MDM_HI0_CH10_FLUSH_STATE5_SD1_ADDR                     0x904005E8
 Y.CREATE.L   MDM_HI0_CH10_FLUSH_STATE5_SD1                               0x904005E8
 Y.CREATE.L   HWIO_MDM_HI0_CH10_FLUSH_STATE5_SD2_ADDR                     0x904009E8
 Y.CREATE.L   MDM_HI0_CH10_FLUSH_STATE5_SD2                               0x904009E8
 Y.CREATE.L   HWIO_MDM_HI0_CH10_FLUSH_STATE5_SD3_ADDR                     0x90400DE8
 Y.CREATE.L   MDM_HI0_CH10_FLUSH_STATE5_SD3                               0x90400DE8
 Y.CREATE.L   HWIO_MDM_HI0_CH11_FLUSH_STATE5_SD0_ADDR                     0x904001EC
 Y.CREATE.L   MDM_HI0_CH11_FLUSH_STATE5_SD0                               0x904001EC
 Y.CREATE.L   HWIO_MDM_HI0_CH11_FLUSH_STATE5_SD1_ADDR                     0x904005EC
 Y.CREATE.L   MDM_HI0_CH11_FLUSH_STATE5_SD1                               0x904005EC
 Y.CREATE.L   HWIO_MDM_HI0_CH11_FLUSH_STATE5_SD2_ADDR                     0x904009EC
 Y.CREATE.L   MDM_HI0_CH11_FLUSH_STATE5_SD2                               0x904009EC
 Y.CREATE.L   HWIO_MDM_HI0_CH11_FLUSH_STATE5_SD3_ADDR                     0x90400DEC
 Y.CREATE.L   MDM_HI0_CH11_FLUSH_STATE5_SD3                               0x90400DEC
 Y.CREATE.L   HWIO_MDM_HI0_CH12_FLUSH_STATE5_SD0_ADDR                     0x904001F0
 Y.CREATE.L   MDM_HI0_CH12_FLUSH_STATE5_SD0                               0x904001F0
 Y.CREATE.L   HWIO_MDM_HI0_CH12_FLUSH_STATE5_SD1_ADDR                     0x904005F0
 Y.CREATE.L   MDM_HI0_CH12_FLUSH_STATE5_SD1                               0x904005F0
 Y.CREATE.L   HWIO_MDM_HI0_CH12_FLUSH_STATE5_SD2_ADDR                     0x904009F0
 Y.CREATE.L   MDM_HI0_CH12_FLUSH_STATE5_SD2                               0x904009F0
 Y.CREATE.L   HWIO_MDM_HI0_CH12_FLUSH_STATE5_SD3_ADDR                     0x90400DF0
 Y.CREATE.L   MDM_HI0_CH12_FLUSH_STATE5_SD3                               0x90400DF0
 Y.CREATE.L   HWIO_MDM_HI0_CH13_FLUSH_STATE5_SD0_ADDR                     0x904001F4
 Y.CREATE.L   MDM_HI0_CH13_FLUSH_STATE5_SD0                               0x904001F4
 Y.CREATE.L   HWIO_MDM_HI0_CH13_FLUSH_STATE5_SD1_ADDR                     0x904005F4
 Y.CREATE.L   MDM_HI0_CH13_FLUSH_STATE5_SD1                               0x904005F4
 Y.CREATE.L   HWIO_MDM_HI0_CH13_FLUSH_STATE5_SD2_ADDR                     0x904009F4
 Y.CREATE.L   MDM_HI0_CH13_FLUSH_STATE5_SD2                               0x904009F4
 Y.CREATE.L   HWIO_MDM_HI0_CH13_FLUSH_STATE5_SD3_ADDR                     0x90400DF4
 Y.CREATE.L   MDM_HI0_CH13_FLUSH_STATE5_SD3                               0x90400DF4
 Y.CREATE.L   HWIO_MDM_HI0_CH14_FLUSH_STATE5_SD0_ADDR                     0x904001F8
 Y.CREATE.L   MDM_HI0_CH14_FLUSH_STATE5_SD0                               0x904001F8
 Y.CREATE.L   HWIO_MDM_HI0_CH14_FLUSH_STATE5_SD1_ADDR                     0x904005F8
 Y.CREATE.L   MDM_HI0_CH14_FLUSH_STATE5_SD1                               0x904005F8
 Y.CREATE.L   HWIO_MDM_HI0_CH14_FLUSH_STATE5_SD2_ADDR                     0x904009F8
 Y.CREATE.L   MDM_HI0_CH14_FLUSH_STATE5_SD2                               0x904009F8
 Y.CREATE.L   HWIO_MDM_HI0_CH14_FLUSH_STATE5_SD3_ADDR                     0x90400DF8
 Y.CREATE.L   MDM_HI0_CH14_FLUSH_STATE5_SD3                               0x90400DF8
 Y.CREATE.L   HWIO_MDM_HI0_CH15_FLUSH_STATE5_SD0_ADDR                     0x904001FC
 Y.CREATE.L   MDM_HI0_CH15_FLUSH_STATE5_SD0                               0x904001FC
 Y.CREATE.L   HWIO_MDM_HI0_CH15_FLUSH_STATE5_SD1_ADDR                     0x904005FC
 Y.CREATE.L   MDM_HI0_CH15_FLUSH_STATE5_SD1                               0x904005FC
 Y.CREATE.L   HWIO_MDM_HI0_CH15_FLUSH_STATE5_SD2_ADDR                     0x904009FC
 Y.CREATE.L   MDM_HI0_CH15_FLUSH_STATE5_SD2                               0x904009FC
 Y.CREATE.L   HWIO_MDM_HI0_CH15_FLUSH_STATE5_SD3_ADDR                     0x90400DFC
 Y.CREATE.L   MDM_HI0_CH15_FLUSH_STATE5_SD3                               0x90400DFC
 Y.CREATE.L   HWIO_MDM_HI0_SEC_DOMAIN_IRQ_STATUS_SD0_ADDR                 0x90400380
 Y.CREATE.L   MDM_HI0_SEC_DOMAIN_IRQ_STATUS_SD0                           0x90400380
 Y.CREATE.L   HWIO_MDM_HI0_SEC_DOMAIN_IRQ_STATUS_SD1_ADDR                 0x90400780
 Y.CREATE.L   MDM_HI0_SEC_DOMAIN_IRQ_STATUS_SD1                           0x90400780
 Y.CREATE.L   HWIO_MDM_HI0_SEC_DOMAIN_IRQ_STATUS_SD2_ADDR                 0x90400B80
 Y.CREATE.L   MDM_HI0_SEC_DOMAIN_IRQ_STATUS_SD2                           0x90400B80
 Y.CREATE.L   HWIO_MDM_HI0_SEC_DOMAIN_IRQ_STATUS_SD3_ADDR                 0x90400F80
 Y.CREATE.L   MDM_HI0_SEC_DOMAIN_IRQ_STATUS_SD3                           0x90400F80
 Y.CREATE.L   HWIO_MDM_HI0_CH0_RSLT_CONF_SD0_ADDR                         0x90400300
 Y.CREATE.L   MDM_HI0_CH0_RSLT_CONF_SD0                                   0x90400300
 Y.CREATE.L   HWIO_MDM_HI0_CH0_RSLT_CONF_SD1_ADDR                         0x90400700
 Y.CREATE.L   MDM_HI0_CH0_RSLT_CONF_SD1                                   0x90400700
 Y.CREATE.L   HWIO_MDM_HI0_CH0_RSLT_CONF_SD2_ADDR                         0x90400B00
 Y.CREATE.L   MDM_HI0_CH0_RSLT_CONF_SD2                                   0x90400B00
 Y.CREATE.L   HWIO_MDM_HI0_CH0_RSLT_CONF_SD3_ADDR                         0x90400F00
 Y.CREATE.L   MDM_HI0_CH0_RSLT_CONF_SD3                                   0x90400F00
 Y.CREATE.L   HWIO_MDM_HI0_CH1_RSLT_CONF_SD0_ADDR                         0x90400304
 Y.CREATE.L   MDM_HI0_CH1_RSLT_CONF_SD0                                   0x90400304
 Y.CREATE.L   HWIO_MDM_HI0_CH1_RSLT_CONF_SD1_ADDR                         0x90400704
 Y.CREATE.L   MDM_HI0_CH1_RSLT_CONF_SD1                                   0x90400704
 Y.CREATE.L   HWIO_MDM_HI0_CH1_RSLT_CONF_SD2_ADDR                         0x90400B04
 Y.CREATE.L   MDM_HI0_CH1_RSLT_CONF_SD2                                   0x90400B04
 Y.CREATE.L   HWIO_MDM_HI0_CH1_RSLT_CONF_SD3_ADDR                         0x90400F04
 Y.CREATE.L   MDM_HI0_CH1_RSLT_CONF_SD3                                   0x90400F04
 Y.CREATE.L   HWIO_MDM_HI0_CH2_RSLT_CONF_SD0_ADDR                         0x90400308
 Y.CREATE.L   MDM_HI0_CH2_RSLT_CONF_SD0                                   0x90400308
 Y.CREATE.L   HWIO_MDM_HI0_CH2_RSLT_CONF_SD1_ADDR                         0x90400708
 Y.CREATE.L   MDM_HI0_CH2_RSLT_CONF_SD1                                   0x90400708
 Y.CREATE.L   HWIO_MDM_HI0_CH2_RSLT_CONF_SD2_ADDR                         0x90400B08
 Y.CREATE.L   MDM_HI0_CH2_RSLT_CONF_SD2                                   0x90400B08
 Y.CREATE.L   HWIO_MDM_HI0_CH2_RSLT_CONF_SD3_ADDR                         0x90400F08
 Y.CREATE.L   MDM_HI0_CH2_RSLT_CONF_SD3                                   0x90400F08
 Y.CREATE.L   HWIO_MDM_HI0_CH3_RSLT_CONF_SD0_ADDR                         0x9040030C
 Y.CREATE.L   MDM_HI0_CH3_RSLT_CONF_SD0                                   0x9040030C
 Y.CREATE.L   HWIO_MDM_HI0_CH3_RSLT_CONF_SD1_ADDR                         0x9040070C
 Y.CREATE.L   MDM_HI0_CH3_RSLT_CONF_SD1                                   0x9040070C
 Y.CREATE.L   HWIO_MDM_HI0_CH3_RSLT_CONF_SD2_ADDR                         0x90400B0C
 Y.CREATE.L   MDM_HI0_CH3_RSLT_CONF_SD2                                   0x90400B0C
 Y.CREATE.L   HWIO_MDM_HI0_CH3_RSLT_CONF_SD3_ADDR                         0x90400F0C
 Y.CREATE.L   MDM_HI0_CH3_RSLT_CONF_SD3                                   0x90400F0C
 Y.CREATE.L   HWIO_MDM_HI0_CH4_RSLT_CONF_SD0_ADDR                         0x90400310
 Y.CREATE.L   MDM_HI0_CH4_RSLT_CONF_SD0                                   0x90400310
 Y.CREATE.L   HWIO_MDM_HI0_CH4_RSLT_CONF_SD1_ADDR                         0x90400710
 Y.CREATE.L   MDM_HI0_CH4_RSLT_CONF_SD1                                   0x90400710
 Y.CREATE.L   HWIO_MDM_HI0_CH4_RSLT_CONF_SD2_ADDR                         0x90400B10
 Y.CREATE.L   MDM_HI0_CH4_RSLT_CONF_SD2                                   0x90400B10
 Y.CREATE.L   HWIO_MDM_HI0_CH4_RSLT_CONF_SD3_ADDR                         0x90400F10
 Y.CREATE.L   MDM_HI0_CH4_RSLT_CONF_SD3                                   0x90400F10
 Y.CREATE.L   HWIO_MDM_HI0_CH5_RSLT_CONF_SD0_ADDR                         0x90400314
 Y.CREATE.L   MDM_HI0_CH5_RSLT_CONF_SD0                                   0x90400314
 Y.CREATE.L   HWIO_MDM_HI0_CH5_RSLT_CONF_SD1_ADDR                         0x90400714
 Y.CREATE.L   MDM_HI0_CH5_RSLT_CONF_SD1                                   0x90400714
 Y.CREATE.L   HWIO_MDM_HI0_CH5_RSLT_CONF_SD2_ADDR                         0x90400B14
 Y.CREATE.L   MDM_HI0_CH5_RSLT_CONF_SD2                                   0x90400B14
 Y.CREATE.L   HWIO_MDM_HI0_CH5_RSLT_CONF_SD3_ADDR                         0x90400F14
 Y.CREATE.L   MDM_HI0_CH5_RSLT_CONF_SD3                                   0x90400F14
 Y.CREATE.L   HWIO_MDM_HI0_CH6_RSLT_CONF_SD0_ADDR                         0x90400318
 Y.CREATE.L   MDM_HI0_CH6_RSLT_CONF_SD0                                   0x90400318
 Y.CREATE.L   HWIO_MDM_HI0_CH6_RSLT_CONF_SD1_ADDR                         0x90400718
 Y.CREATE.L   MDM_HI0_CH6_RSLT_CONF_SD1                                   0x90400718
 Y.CREATE.L   HWIO_MDM_HI0_CH6_RSLT_CONF_SD2_ADDR                         0x90400B18
 Y.CREATE.L   MDM_HI0_CH6_RSLT_CONF_SD2                                   0x90400B18
 Y.CREATE.L   HWIO_MDM_HI0_CH6_RSLT_CONF_SD3_ADDR                         0x90400F18
 Y.CREATE.L   MDM_HI0_CH6_RSLT_CONF_SD3                                   0x90400F18
 Y.CREATE.L   HWIO_MDM_HI0_CH7_RSLT_CONF_SD0_ADDR                         0x9040031C
 Y.CREATE.L   MDM_HI0_CH7_RSLT_CONF_SD0                                   0x9040031C
 Y.CREATE.L   HWIO_MDM_HI0_CH7_RSLT_CONF_SD1_ADDR                         0x9040071C
 Y.CREATE.L   MDM_HI0_CH7_RSLT_CONF_SD1                                   0x9040071C
 Y.CREATE.L   HWIO_MDM_HI0_CH7_RSLT_CONF_SD2_ADDR                         0x90400B1C
 Y.CREATE.L   MDM_HI0_CH7_RSLT_CONF_SD2                                   0x90400B1C
 Y.CREATE.L   HWIO_MDM_HI0_CH7_RSLT_CONF_SD3_ADDR                         0x90400F1C
 Y.CREATE.L   MDM_HI0_CH7_RSLT_CONF_SD3                                   0x90400F1C
 Y.CREATE.L   HWIO_MDM_HI0_CH8_RSLT_CONF_SD0_ADDR                         0x90400320
 Y.CREATE.L   MDM_HI0_CH8_RSLT_CONF_SD0                                   0x90400320
 Y.CREATE.L   HWIO_MDM_HI0_CH8_RSLT_CONF_SD1_ADDR                         0x90400720
 Y.CREATE.L   MDM_HI0_CH8_RSLT_CONF_SD1                                   0x90400720
 Y.CREATE.L   HWIO_MDM_HI0_CH8_RSLT_CONF_SD2_ADDR                         0x90400B20
 Y.CREATE.L   MDM_HI0_CH8_RSLT_CONF_SD2                                   0x90400B20
 Y.CREATE.L   HWIO_MDM_HI0_CH8_RSLT_CONF_SD3_ADDR                         0x90400F20
 Y.CREATE.L   MDM_HI0_CH8_RSLT_CONF_SD3                                   0x90400F20
 Y.CREATE.L   HWIO_MDM_HI0_CH9_RSLT_CONF_SD0_ADDR                         0x90400324
 Y.CREATE.L   MDM_HI0_CH9_RSLT_CONF_SD0                                   0x90400324
 Y.CREATE.L   HWIO_MDM_HI0_CH9_RSLT_CONF_SD1_ADDR                         0x90400724
 Y.CREATE.L   MDM_HI0_CH9_RSLT_CONF_SD1                                   0x90400724
 Y.CREATE.L   HWIO_MDM_HI0_CH9_RSLT_CONF_SD2_ADDR                         0x90400B24
 Y.CREATE.L   MDM_HI0_CH9_RSLT_CONF_SD2                                   0x90400B24
 Y.CREATE.L   HWIO_MDM_HI0_CH9_RSLT_CONF_SD3_ADDR                         0x90400F24
 Y.CREATE.L   MDM_HI0_CH9_RSLT_CONF_SD3                                   0x90400F24
 Y.CREATE.L   HWIO_MDM_HI0_CH10_RSLT_CONF_SD0_ADDR                        0x90400328
 Y.CREATE.L   MDM_HI0_CH10_RSLT_CONF_SD0                                  0x90400328
 Y.CREATE.L   HWIO_MDM_HI0_CH10_RSLT_CONF_SD1_ADDR                        0x90400728
 Y.CREATE.L   MDM_HI0_CH10_RSLT_CONF_SD1                                  0x90400728
 Y.CREATE.L   HWIO_MDM_HI0_CH10_RSLT_CONF_SD2_ADDR                        0x90400B28
 Y.CREATE.L   MDM_HI0_CH10_RSLT_CONF_SD2                                  0x90400B28
 Y.CREATE.L   HWIO_MDM_HI0_CH10_RSLT_CONF_SD3_ADDR                        0x90400F28
 Y.CREATE.L   MDM_HI0_CH10_RSLT_CONF_SD3                                  0x90400F28
 Y.CREATE.L   HWIO_MDM_HI0_CH11_RSLT_CONF_SD0_ADDR                        0x9040032C
 Y.CREATE.L   MDM_HI0_CH11_RSLT_CONF_SD0                                  0x9040032C
 Y.CREATE.L   HWIO_MDM_HI0_CH11_RSLT_CONF_SD1_ADDR                        0x9040072C
 Y.CREATE.L   MDM_HI0_CH11_RSLT_CONF_SD1                                  0x9040072C
 Y.CREATE.L   HWIO_MDM_HI0_CH11_RSLT_CONF_SD2_ADDR                        0x90400B2C
 Y.CREATE.L   MDM_HI0_CH11_RSLT_CONF_SD2                                  0x90400B2C
 Y.CREATE.L   HWIO_MDM_HI0_CH11_RSLT_CONF_SD3_ADDR                        0x90400F2C
 Y.CREATE.L   MDM_HI0_CH11_RSLT_CONF_SD3                                  0x90400F2C
 Y.CREATE.L   HWIO_MDM_HI0_CH12_RSLT_CONF_SD0_ADDR                        0x90400330
 Y.CREATE.L   MDM_HI0_CH12_RSLT_CONF_SD0                                  0x90400330
 Y.CREATE.L   HWIO_MDM_HI0_CH12_RSLT_CONF_SD1_ADDR                        0x90400730
 Y.CREATE.L   MDM_HI0_CH12_RSLT_CONF_SD1                                  0x90400730
 Y.CREATE.L   HWIO_MDM_HI0_CH12_RSLT_CONF_SD2_ADDR                        0x90400B30
 Y.CREATE.L   MDM_HI0_CH12_RSLT_CONF_SD2                                  0x90400B30
 Y.CREATE.L   HWIO_MDM_HI0_CH12_RSLT_CONF_SD3_ADDR                        0x90400F30
 Y.CREATE.L   MDM_HI0_CH12_RSLT_CONF_SD3                                  0x90400F30
 Y.CREATE.L   HWIO_MDM_HI0_CH13_RSLT_CONF_SD0_ADDR                        0x90400334
 Y.CREATE.L   MDM_HI0_CH13_RSLT_CONF_SD0                                  0x90400334
 Y.CREATE.L   HWIO_MDM_HI0_CH13_RSLT_CONF_SD1_ADDR                        0x90400734
 Y.CREATE.L   MDM_HI0_CH13_RSLT_CONF_SD1                                  0x90400734
 Y.CREATE.L   HWIO_MDM_HI0_CH13_RSLT_CONF_SD2_ADDR                        0x90400B34
 Y.CREATE.L   MDM_HI0_CH13_RSLT_CONF_SD2                                  0x90400B34
 Y.CREATE.L   HWIO_MDM_HI0_CH13_RSLT_CONF_SD3_ADDR                        0x90400F34
 Y.CREATE.L   MDM_HI0_CH13_RSLT_CONF_SD3                                  0x90400F34
 Y.CREATE.L   HWIO_MDM_HI0_CH14_RSLT_CONF_SD0_ADDR                        0x90400338
 Y.CREATE.L   MDM_HI0_CH14_RSLT_CONF_SD0                                  0x90400338
 Y.CREATE.L   HWIO_MDM_HI0_CH14_RSLT_CONF_SD1_ADDR                        0x90400738
 Y.CREATE.L   MDM_HI0_CH14_RSLT_CONF_SD1                                  0x90400738
 Y.CREATE.L   HWIO_MDM_HI0_CH14_RSLT_CONF_SD2_ADDR                        0x90400B38
 Y.CREATE.L   MDM_HI0_CH14_RSLT_CONF_SD2                                  0x90400B38
 Y.CREATE.L   HWIO_MDM_HI0_CH14_RSLT_CONF_SD3_ADDR                        0x90400F38
 Y.CREATE.L   MDM_HI0_CH14_RSLT_CONF_SD3                                  0x90400F38
 Y.CREATE.L   HWIO_MDM_HI0_CH15_RSLT_CONF_SD0_ADDR                        0x9040033C
 Y.CREATE.L   MDM_HI0_CH15_RSLT_CONF_SD0                                  0x9040033C
 Y.CREATE.L   HWIO_MDM_HI0_CH15_RSLT_CONF_SD1_ADDR                        0x9040073C
 Y.CREATE.L   MDM_HI0_CH15_RSLT_CONF_SD1                                  0x9040073C
 Y.CREATE.L   HWIO_MDM_HI0_CH15_RSLT_CONF_SD2_ADDR                        0x90400B3C
 Y.CREATE.L   MDM_HI0_CH15_RSLT_CONF_SD2                                  0x90400B3C
 Y.CREATE.L   HWIO_MDM_HI0_CH15_RSLT_CONF_SD3_ADDR                        0x90400F3C
 Y.CREATE.L   MDM_HI0_CH15_RSLT_CONF_SD3                                  0x90400F3C
 Y.CREATE.L   HWIO_MDM_HI0_CH0_STATUS_SD0_ADDR                            0x90400200
 Y.CREATE.L   MDM_HI0_CH0_STATUS_SD0                                      0x90400200
 Y.CREATE.L   HWIO_MDM_HI0_CH0_STATUS_SD1_ADDR                            0x90400600
 Y.CREATE.L   MDM_HI0_CH0_STATUS_SD1                                      0x90400600
 Y.CREATE.L   HWIO_MDM_HI0_CH0_STATUS_SD2_ADDR                            0x90400A00
 Y.CREATE.L   MDM_HI0_CH0_STATUS_SD2                                      0x90400A00
 Y.CREATE.L   HWIO_MDM_HI0_CH0_STATUS_SD3_ADDR                            0x90400E00
 Y.CREATE.L   MDM_HI0_CH0_STATUS_SD3                                      0x90400E00
 Y.CREATE.L   HWIO_MDM_HI0_CH1_STATUS_SD0_ADDR                            0x90400204
 Y.CREATE.L   MDM_HI0_CH1_STATUS_SD0                                      0x90400204
 Y.CREATE.L   HWIO_MDM_HI0_CH1_STATUS_SD1_ADDR                            0x90400604
 Y.CREATE.L   MDM_HI0_CH1_STATUS_SD1                                      0x90400604
 Y.CREATE.L   HWIO_MDM_HI0_CH1_STATUS_SD2_ADDR                            0x90400A04
 Y.CREATE.L   MDM_HI0_CH1_STATUS_SD2                                      0x90400A04
 Y.CREATE.L   HWIO_MDM_HI0_CH1_STATUS_SD3_ADDR                            0x90400E04
 Y.CREATE.L   MDM_HI0_CH1_STATUS_SD3                                      0x90400E04
 Y.CREATE.L   HWIO_MDM_HI0_CH2_STATUS_SD0_ADDR                            0x90400208
 Y.CREATE.L   MDM_HI0_CH2_STATUS_SD0                                      0x90400208
 Y.CREATE.L   HWIO_MDM_HI0_CH2_STATUS_SD1_ADDR                            0x90400608
 Y.CREATE.L   MDM_HI0_CH2_STATUS_SD1                                      0x90400608
 Y.CREATE.L   HWIO_MDM_HI0_CH2_STATUS_SD2_ADDR                            0x90400A08
 Y.CREATE.L   MDM_HI0_CH2_STATUS_SD2                                      0x90400A08
 Y.CREATE.L   HWIO_MDM_HI0_CH2_STATUS_SD3_ADDR                            0x90400E08
 Y.CREATE.L   MDM_HI0_CH2_STATUS_SD3                                      0x90400E08
 Y.CREATE.L   HWIO_MDM_HI0_CH3_STATUS_SD0_ADDR                            0x9040020C
 Y.CREATE.L   MDM_HI0_CH3_STATUS_SD0                                      0x9040020C
 Y.CREATE.L   HWIO_MDM_HI0_CH3_STATUS_SD1_ADDR                            0x9040060C
 Y.CREATE.L   MDM_HI0_CH3_STATUS_SD1                                      0x9040060C
 Y.CREATE.L   HWIO_MDM_HI0_CH3_STATUS_SD2_ADDR                            0x90400A0C
 Y.CREATE.L   MDM_HI0_CH3_STATUS_SD2                                      0x90400A0C
 Y.CREATE.L   HWIO_MDM_HI0_CH3_STATUS_SD3_ADDR                            0x90400E0C
 Y.CREATE.L   MDM_HI0_CH3_STATUS_SD3                                      0x90400E0C
 Y.CREATE.L   HWIO_MDM_HI0_CH4_STATUS_SD0_ADDR                            0x90400210
 Y.CREATE.L   MDM_HI0_CH4_STATUS_SD0                                      0x90400210
 Y.CREATE.L   HWIO_MDM_HI0_CH4_STATUS_SD1_ADDR                            0x90400610
 Y.CREATE.L   MDM_HI0_CH4_STATUS_SD1                                      0x90400610
 Y.CREATE.L   HWIO_MDM_HI0_CH4_STATUS_SD2_ADDR                            0x90400A10
 Y.CREATE.L   MDM_HI0_CH4_STATUS_SD2                                      0x90400A10
 Y.CREATE.L   HWIO_MDM_HI0_CH4_STATUS_SD3_ADDR                            0x90400E10
 Y.CREATE.L   MDM_HI0_CH4_STATUS_SD3                                      0x90400E10
 Y.CREATE.L   HWIO_MDM_HI0_CH5_STATUS_SD0_ADDR                            0x90400214
 Y.CREATE.L   MDM_HI0_CH5_STATUS_SD0                                      0x90400214
 Y.CREATE.L   HWIO_MDM_HI0_CH5_STATUS_SD1_ADDR                            0x90400614
 Y.CREATE.L   MDM_HI0_CH5_STATUS_SD1                                      0x90400614
 Y.CREATE.L   HWIO_MDM_HI0_CH5_STATUS_SD2_ADDR                            0x90400A14
 Y.CREATE.L   MDM_HI0_CH5_STATUS_SD2                                      0x90400A14
 Y.CREATE.L   HWIO_MDM_HI0_CH5_STATUS_SD3_ADDR                            0x90400E14
 Y.CREATE.L   MDM_HI0_CH5_STATUS_SD3                                      0x90400E14
 Y.CREATE.L   HWIO_MDM_HI0_CH6_STATUS_SD0_ADDR                            0x90400218
 Y.CREATE.L   MDM_HI0_CH6_STATUS_SD0                                      0x90400218
 Y.CREATE.L   HWIO_MDM_HI0_CH6_STATUS_SD1_ADDR                            0x90400618
 Y.CREATE.L   MDM_HI0_CH6_STATUS_SD1                                      0x90400618
 Y.CREATE.L   HWIO_MDM_HI0_CH6_STATUS_SD2_ADDR                            0x90400A18
 Y.CREATE.L   MDM_HI0_CH6_STATUS_SD2                                      0x90400A18
 Y.CREATE.L   HWIO_MDM_HI0_CH6_STATUS_SD3_ADDR                            0x90400E18
 Y.CREATE.L   MDM_HI0_CH6_STATUS_SD3                                      0x90400E18
 Y.CREATE.L   HWIO_MDM_HI0_CH7_STATUS_SD0_ADDR                            0x9040021C
 Y.CREATE.L   MDM_HI0_CH7_STATUS_SD0                                      0x9040021C
 Y.CREATE.L   HWIO_MDM_HI0_CH7_STATUS_SD1_ADDR                            0x9040061C
 Y.CREATE.L   MDM_HI0_CH7_STATUS_SD1                                      0x9040061C
 Y.CREATE.L   HWIO_MDM_HI0_CH7_STATUS_SD2_ADDR                            0x90400A1C
 Y.CREATE.L   MDM_HI0_CH7_STATUS_SD2                                      0x90400A1C
 Y.CREATE.L   HWIO_MDM_HI0_CH7_STATUS_SD3_ADDR                            0x90400E1C
 Y.CREATE.L   MDM_HI0_CH7_STATUS_SD3                                      0x90400E1C
 Y.CREATE.L   HWIO_MDM_HI0_CH8_STATUS_SD0_ADDR                            0x90400220
 Y.CREATE.L   MDM_HI0_CH8_STATUS_SD0                                      0x90400220
 Y.CREATE.L   HWIO_MDM_HI0_CH8_STATUS_SD1_ADDR                            0x90400620
 Y.CREATE.L   MDM_HI0_CH8_STATUS_SD1                                      0x90400620
 Y.CREATE.L   HWIO_MDM_HI0_CH8_STATUS_SD2_ADDR                            0x90400A20
 Y.CREATE.L   MDM_HI0_CH8_STATUS_SD2                                      0x90400A20
 Y.CREATE.L   HWIO_MDM_HI0_CH8_STATUS_SD3_ADDR                            0x90400E20
 Y.CREATE.L   MDM_HI0_CH8_STATUS_SD3                                      0x90400E20
 Y.CREATE.L   HWIO_MDM_HI0_CH9_STATUS_SD0_ADDR                            0x90400224
 Y.CREATE.L   MDM_HI0_CH9_STATUS_SD0                                      0x90400224
 Y.CREATE.L   HWIO_MDM_HI0_CH9_STATUS_SD1_ADDR                            0x90400624
 Y.CREATE.L   MDM_HI0_CH9_STATUS_SD1                                      0x90400624
 Y.CREATE.L   HWIO_MDM_HI0_CH9_STATUS_SD2_ADDR                            0x90400A24
 Y.CREATE.L   MDM_HI0_CH9_STATUS_SD2                                      0x90400A24
 Y.CREATE.L   HWIO_MDM_HI0_CH9_STATUS_SD3_ADDR                            0x90400E24
 Y.CREATE.L   MDM_HI0_CH9_STATUS_SD3                                      0x90400E24
 Y.CREATE.L   HWIO_MDM_HI0_CH10_STATUS_SD0_ADDR                           0x90400228
 Y.CREATE.L   MDM_HI0_CH10_STATUS_SD0                                     0x90400228
 Y.CREATE.L   HWIO_MDM_HI0_CH10_STATUS_SD1_ADDR                           0x90400628
 Y.CREATE.L   MDM_HI0_CH10_STATUS_SD1                                     0x90400628
 Y.CREATE.L   HWIO_MDM_HI0_CH10_STATUS_SD2_ADDR                           0x90400A28
 Y.CREATE.L   MDM_HI0_CH10_STATUS_SD2                                     0x90400A28
 Y.CREATE.L   HWIO_MDM_HI0_CH10_STATUS_SD3_ADDR                           0x90400E28
 Y.CREATE.L   MDM_HI0_CH10_STATUS_SD3                                     0x90400E28
 Y.CREATE.L   HWIO_MDM_HI0_CH11_STATUS_SD0_ADDR                           0x9040022C
 Y.CREATE.L   MDM_HI0_CH11_STATUS_SD0                                     0x9040022C
 Y.CREATE.L   HWIO_MDM_HI0_CH11_STATUS_SD1_ADDR                           0x9040062C
 Y.CREATE.L   MDM_HI0_CH11_STATUS_SD1                                     0x9040062C
 Y.CREATE.L   HWIO_MDM_HI0_CH11_STATUS_SD2_ADDR                           0x90400A2C
 Y.CREATE.L   MDM_HI0_CH11_STATUS_SD2                                     0x90400A2C
 Y.CREATE.L   HWIO_MDM_HI0_CH11_STATUS_SD3_ADDR                           0x90400E2C
 Y.CREATE.L   MDM_HI0_CH11_STATUS_SD3                                     0x90400E2C
 Y.CREATE.L   HWIO_MDM_HI0_CH12_STATUS_SD0_ADDR                           0x90400230
 Y.CREATE.L   MDM_HI0_CH12_STATUS_SD0                                     0x90400230
 Y.CREATE.L   HWIO_MDM_HI0_CH12_STATUS_SD1_ADDR                           0x90400630
 Y.CREATE.L   MDM_HI0_CH12_STATUS_SD1                                     0x90400630
 Y.CREATE.L   HWIO_MDM_HI0_CH12_STATUS_SD2_ADDR                           0x90400A30
 Y.CREATE.L   MDM_HI0_CH12_STATUS_SD2                                     0x90400A30
 Y.CREATE.L   HWIO_MDM_HI0_CH12_STATUS_SD3_ADDR                           0x90400E30
 Y.CREATE.L   MDM_HI0_CH12_STATUS_SD3                                     0x90400E30
 Y.CREATE.L   HWIO_MDM_HI0_CH13_STATUS_SD0_ADDR                           0x90400234
 Y.CREATE.L   MDM_HI0_CH13_STATUS_SD0                                     0x90400234
 Y.CREATE.L   HWIO_MDM_HI0_CH13_STATUS_SD1_ADDR                           0x90400634
 Y.CREATE.L   MDM_HI0_CH13_STATUS_SD1                                     0x90400634
 Y.CREATE.L   HWIO_MDM_HI0_CH13_STATUS_SD2_ADDR                           0x90400A34
 Y.CREATE.L   MDM_HI0_CH13_STATUS_SD2                                     0x90400A34
 Y.CREATE.L   HWIO_MDM_HI0_CH13_STATUS_SD3_ADDR                           0x90400E34
 Y.CREATE.L   MDM_HI0_CH13_STATUS_SD3                                     0x90400E34
 Y.CREATE.L   HWIO_MDM_HI0_CH14_STATUS_SD0_ADDR                           0x90400238
 Y.CREATE.L   MDM_HI0_CH14_STATUS_SD0                                     0x90400238
 Y.CREATE.L   HWIO_MDM_HI0_CH14_STATUS_SD1_ADDR                           0x90400638
 Y.CREATE.L   MDM_HI0_CH14_STATUS_SD1                                     0x90400638
 Y.CREATE.L   HWIO_MDM_HI0_CH14_STATUS_SD2_ADDR                           0x90400A38
 Y.CREATE.L   MDM_HI0_CH14_STATUS_SD2                                     0x90400A38
 Y.CREATE.L   HWIO_MDM_HI0_CH14_STATUS_SD3_ADDR                           0x90400E38
 Y.CREATE.L   MDM_HI0_CH14_STATUS_SD3                                     0x90400E38
 Y.CREATE.L   HWIO_MDM_HI0_CH15_STATUS_SD0_ADDR                           0x9040023C
 Y.CREATE.L   MDM_HI0_CH15_STATUS_SD0                                     0x9040023C
 Y.CREATE.L   HWIO_MDM_HI0_CH15_STATUS_SD1_ADDR                           0x9040063C
 Y.CREATE.L   MDM_HI0_CH15_STATUS_SD1                                     0x9040063C
 Y.CREATE.L   HWIO_MDM_HI0_CH15_STATUS_SD2_ADDR                           0x90400A3C
 Y.CREATE.L   MDM_HI0_CH15_STATUS_SD2                                     0x90400A3C
 Y.CREATE.L   HWIO_MDM_HI0_CH15_STATUS_SD3_ADDR                           0x90400E3C
 Y.CREATE.L   MDM_HI0_CH15_STATUS_SD3                                     0x90400E3C
 Y.CREATE.L   HWIO_MDM_HI0_CH0_CONF_ADDR                                  0x90400240
 Y.CREATE.L   MDM_HI0_CH0_CONF                                            0x90400240
 Y.CREATE.L   HWIO_MDM_HI0_CH1_CONF_ADDR                                  0x90400244
 Y.CREATE.L   MDM_HI0_CH1_CONF                                            0x90400244
 Y.CREATE.L   HWIO_MDM_HI0_CH2_CONF_ADDR                                  0x90400248
 Y.CREATE.L   MDM_HI0_CH2_CONF                                            0x90400248
 Y.CREATE.L   HWIO_MDM_HI0_CH3_CONF_ADDR                                  0x9040024C
 Y.CREATE.L   MDM_HI0_CH3_CONF                                            0x9040024C
 Y.CREATE.L   HWIO_MDM_HI0_CH4_CONF_ADDR                                  0x90400250
 Y.CREATE.L   MDM_HI0_CH4_CONF                                            0x90400250
 Y.CREATE.L   HWIO_MDM_HI0_CH5_CONF_ADDR                                  0x90400254
 Y.CREATE.L   MDM_HI0_CH5_CONF                                            0x90400254
 Y.CREATE.L   HWIO_MDM_HI0_CH6_CONF_ADDR                                  0x90400258
 Y.CREATE.L   MDM_HI0_CH6_CONF                                            0x90400258
 Y.CREATE.L   HWIO_MDM_HI0_CH7_CONF_ADDR                                  0x9040025C
 Y.CREATE.L   MDM_HI0_CH7_CONF                                            0x9040025C
 Y.CREATE.L   HWIO_MDM_HI0_CH8_CONF_ADDR                                  0x90400260
 Y.CREATE.L   MDM_HI0_CH8_CONF                                            0x90400260
 Y.CREATE.L   HWIO_MDM_HI0_CH9_CONF_ADDR                                  0x90400264
 Y.CREATE.L   MDM_HI0_CH9_CONF                                            0x90400264
 Y.CREATE.L   HWIO_MDM_HI0_CH10_CONF_ADDR                                 0x90400268
 Y.CREATE.L   MDM_HI0_CH10_CONF                                           0x90400268
 Y.CREATE.L   HWIO_MDM_HI0_CH11_CONF_ADDR                                 0x9040026C
 Y.CREATE.L   MDM_HI0_CH11_CONF                                           0x9040026C
 Y.CREATE.L   HWIO_MDM_HI0_CH12_CONF_ADDR                                 0x90400270
 Y.CREATE.L   MDM_HI0_CH12_CONF                                           0x90400270
 Y.CREATE.L   HWIO_MDM_HI0_CH13_CONF_ADDR                                 0x90400274
 Y.CREATE.L   MDM_HI0_CH13_CONF                                           0x90400274
 Y.CREATE.L   HWIO_MDM_HI0_CH14_CONF_ADDR                                 0x90400278
 Y.CREATE.L   MDM_HI0_CH14_CONF                                           0x90400278
 Y.CREATE.L   HWIO_MDM_HI0_CH15_CONF_ADDR                                 0x9040027C
 Y.CREATE.L   MDM_HI0_CH15_CONF                                           0x9040027C
 Y.CREATE.L   HWIO_MDM_HI0_CH0_DBG_0_ADDR                                 0x90400280
 Y.CREATE.L   MDM_HI0_CH0_DBG_0                                           0x90400280
 Y.CREATE.L   HWIO_MDM_HI0_CH1_DBG_0_ADDR                                 0x90400284
 Y.CREATE.L   MDM_HI0_CH1_DBG_0                                           0x90400284
 Y.CREATE.L   HWIO_MDM_HI0_CH2_DBG_0_ADDR                                 0x90400288
 Y.CREATE.L   MDM_HI0_CH2_DBG_0                                           0x90400288
 Y.CREATE.L   HWIO_MDM_HI0_CH3_DBG_0_ADDR                                 0x9040028C
 Y.CREATE.L   MDM_HI0_CH3_DBG_0                                           0x9040028C
 Y.CREATE.L   HWIO_MDM_HI0_CH4_DBG_0_ADDR                                 0x90400290
 Y.CREATE.L   MDM_HI0_CH4_DBG_0                                           0x90400290
 Y.CREATE.L   HWIO_MDM_HI0_CH5_DBG_0_ADDR                                 0x90400294
 Y.CREATE.L   MDM_HI0_CH5_DBG_0                                           0x90400294
 Y.CREATE.L   HWIO_MDM_HI0_CH6_DBG_0_ADDR                                 0x90400298
 Y.CREATE.L   MDM_HI0_CH6_DBG_0                                           0x90400298
 Y.CREATE.L   HWIO_MDM_HI0_CH7_DBG_0_ADDR                                 0x9040029C
 Y.CREATE.L   MDM_HI0_CH7_DBG_0                                           0x9040029C
 Y.CREATE.L   HWIO_MDM_HI0_CH8_DBG_0_ADDR                                 0x904002A0
 Y.CREATE.L   MDM_HI0_CH8_DBG_0                                           0x904002A0
 Y.CREATE.L   HWIO_MDM_HI0_CH9_DBG_0_ADDR                                 0x904002A4
 Y.CREATE.L   MDM_HI0_CH9_DBG_0                                           0x904002A4
 Y.CREATE.L   HWIO_MDM_HI0_CH10_DBG_0_ADDR                                0x904002A8
 Y.CREATE.L   MDM_HI0_CH10_DBG_0                                          0x904002A8
 Y.CREATE.L   HWIO_MDM_HI0_CH11_DBG_0_ADDR                                0x904002AC
 Y.CREATE.L   MDM_HI0_CH11_DBG_0                                          0x904002AC
 Y.CREATE.L   HWIO_MDM_HI0_CH12_DBG_0_ADDR                                0x904002B0
 Y.CREATE.L   MDM_HI0_CH12_DBG_0                                          0x904002B0
 Y.CREATE.L   HWIO_MDM_HI0_CH13_DBG_0_ADDR                                0x904002B4
 Y.CREATE.L   MDM_HI0_CH13_DBG_0                                          0x904002B4
 Y.CREATE.L   HWIO_MDM_HI0_CH14_DBG_0_ADDR                                0x904002B8
 Y.CREATE.L   MDM_HI0_CH14_DBG_0                                          0x904002B8
 Y.CREATE.L   HWIO_MDM_HI0_CH15_DBG_0_ADDR                                0x904002BC
 Y.CREATE.L   MDM_HI0_CH15_DBG_0                                          0x904002BC
 Y.CREATE.L   HWIO_MDM_HI0_CH0_DBG_1_ADDR                                 0x904002C0
 Y.CREATE.L   MDM_HI0_CH0_DBG_1                                           0x904002C0
 Y.CREATE.L   HWIO_MDM_HI0_CH1_DBG_1_ADDR                                 0x904002C4
 Y.CREATE.L   MDM_HI0_CH1_DBG_1                                           0x904002C4
 Y.CREATE.L   HWIO_MDM_HI0_CH2_DBG_1_ADDR                                 0x904002C8
 Y.CREATE.L   MDM_HI0_CH2_DBG_1                                           0x904002C8
 Y.CREATE.L   HWIO_MDM_HI0_CH3_DBG_1_ADDR                                 0x904002CC
 Y.CREATE.L   MDM_HI0_CH3_DBG_1                                           0x904002CC
 Y.CREATE.L   HWIO_MDM_HI0_CH4_DBG_1_ADDR                                 0x904002D0
 Y.CREATE.L   MDM_HI0_CH4_DBG_1                                           0x904002D0
 Y.CREATE.L   HWIO_MDM_HI0_CH5_DBG_1_ADDR                                 0x904002D4
 Y.CREATE.L   MDM_HI0_CH5_DBG_1                                           0x904002D4
 Y.CREATE.L   HWIO_MDM_HI0_CH6_DBG_1_ADDR                                 0x904002D8
 Y.CREATE.L   MDM_HI0_CH6_DBG_1                                           0x904002D8
 Y.CREATE.L   HWIO_MDM_HI0_CH7_DBG_1_ADDR                                 0x904002DC
 Y.CREATE.L   MDM_HI0_CH7_DBG_1                                           0x904002DC
 Y.CREATE.L   HWIO_MDM_HI0_CH8_DBG_1_ADDR                                 0x904002E0
 Y.CREATE.L   MDM_HI0_CH8_DBG_1                                           0x904002E0
 Y.CREATE.L   HWIO_MDM_HI0_CH9_DBG_1_ADDR                                 0x904002E4
 Y.CREATE.L   MDM_HI0_CH9_DBG_1                                           0x904002E4
 Y.CREATE.L   HWIO_MDM_HI0_CH10_DBG_1_ADDR                                0x904002E8
 Y.CREATE.L   MDM_HI0_CH10_DBG_1                                          0x904002E8
 Y.CREATE.L   HWIO_MDM_HI0_CH11_DBG_1_ADDR                                0x904002EC
 Y.CREATE.L   MDM_HI0_CH11_DBG_1                                          0x904002EC
 Y.CREATE.L   HWIO_MDM_HI0_CH12_DBG_1_ADDR                                0x904002F0
 Y.CREATE.L   MDM_HI0_CH12_DBG_1                                          0x904002F0
 Y.CREATE.L   HWIO_MDM_HI0_CH13_DBG_1_ADDR                                0x904002F4
 Y.CREATE.L   MDM_HI0_CH13_DBG_1                                          0x904002F4
 Y.CREATE.L   HWIO_MDM_HI0_CH14_DBG_1_ADDR                                0x904002F8
 Y.CREATE.L   MDM_HI0_CH14_DBG_1                                          0x904002F8
 Y.CREATE.L   HWIO_MDM_HI0_CH15_DBG_1_ADDR                                0x904002FC
 Y.CREATE.L   MDM_HI0_CH15_DBG_1                                          0x904002FC
 Y.CREATE.L   HWIO_MDM_HI0_CI0_CONF_ADDR                                  0x90400390
 Y.CREATE.L   MDM_HI0_CI0_CONF                                            0x90400390
 Y.CREATE.L   HWIO_MDM_HI0_CI1_CONF_ADDR                                  0x90400394
 Y.CREATE.L   MDM_HI0_CI1_CONF                                            0x90400394
 Y.CREATE.L   HWIO_MDM_HI0_CI2_CONF_ADDR                                  0x90400398
 Y.CREATE.L   MDM_HI0_CI2_CONF                                            0x90400398
 Y.CREATE.L   HWIO_MDM_HI0_CI3_CONF_ADDR                                  0x9040039C
 Y.CREATE.L   MDM_HI0_CI3_CONF                                            0x9040039C
 Y.CREATE.L   HWIO_MDM_HI0_CI4_CONF_ADDR                                  0x904003A0
 Y.CREATE.L   MDM_HI0_CI4_CONF                                            0x904003A0
 Y.CREATE.L   HWIO_MDM_HI0_CI5_CONF_ADDR                                  0x904003A4
 Y.CREATE.L   MDM_HI0_CI5_CONF                                            0x904003A4
 Y.CREATE.L   HWIO_MDM_HI0_CI6_CONF_ADDR                                  0x904003A8
 Y.CREATE.L   MDM_HI0_CI6_CONF                                            0x904003A8
 Y.CREATE.L   HWIO_MDM_HI0_CI7_CONF_ADDR                                  0x904003AC
 Y.CREATE.L   MDM_HI0_CI7_CONF                                            0x904003AC
 Y.CREATE.L   HWIO_MDM_HI0_CI0_DBG_ERR_ADDR                               0x904003B0
 Y.CREATE.L   MDM_HI0_CI0_DBG_ERR                                         0x904003B0
 Y.CREATE.L   HWIO_MDM_HI0_CI1_DBG_ERR_ADDR                               0x904003B4
 Y.CREATE.L   MDM_HI0_CI1_DBG_ERR                                         0x904003B4
 Y.CREATE.L   HWIO_MDM_HI0_CI2_DBG_ERR_ADDR                               0x904003B8
 Y.CREATE.L   MDM_HI0_CI2_DBG_ERR                                         0x904003B8
 Y.CREATE.L   HWIO_MDM_HI0_CI3_DBG_ERR_ADDR                               0x904003BC
 Y.CREATE.L   MDM_HI0_CI3_DBG_ERR                                         0x904003BC
 Y.CREATE.L   HWIO_MDM_HI0_CI4_DBG_ERR_ADDR                               0x904003C0
 Y.CREATE.L   MDM_HI0_CI4_DBG_ERR                                         0x904003C0
 Y.CREATE.L   HWIO_MDM_HI0_CI5_DBG_ERR_ADDR                               0x904003C4
 Y.CREATE.L   MDM_HI0_CI5_DBG_ERR                                         0x904003C4
 Y.CREATE.L   HWIO_MDM_HI0_CI6_DBG_ERR_ADDR                               0x904003C8
 Y.CREATE.L   MDM_HI0_CI6_DBG_ERR                                         0x904003C8
 Y.CREATE.L   HWIO_MDM_HI0_CI7_DBG_ERR_ADDR                               0x904003CC
 Y.CREATE.L   MDM_HI0_CI7_DBG_ERR                                         0x904003CC
 Y.CREATE.L   HWIO_MDM_HI0_CRCI_DBG_ADDR                                  0x904003D0
 Y.CREATE.L   MDM_HI0_CRCI_DBG                                            0x904003D0
 Y.CREATE.L   HWIO_MDM_HI0_CRCI_STATUS_ADDR                               0x904003D4
 Y.CREATE.L   MDM_HI0_CRCI_STATUS                                         0x904003D4
 Y.CREATE.L   HWIO_MDM_HI0_GP_CTL_ADDR                                    0x904003D8
 Y.CREATE.L   MDM_HI0_GP_CTL                                              0x904003D8
 Y.CREATE.L   HWIO_MDM_HI0_GP_STATUS_ADDR                                 0x904003DC
 Y.CREATE.L   MDM_HI0_GP_STATUS                                           0x904003DC
 Y.CREATE.L   HWIO_MDM_HI0_GLBL_DBG_CMD_ENG_ADDR                          0x904003E0
 Y.CREATE.L   MDM_HI0_GLBL_DBG_CMD_ENG                                    0x904003E0
 Y.CREATE.L   HWIO_MDM_HI0_GLBL_DBG_REQ_ENG_ADDR                          0x904003E4
 Y.CREATE.L   MDM_HI0_GLBL_DBG_REQ_ENG                                    0x904003E4
 Y.CREATE.L   HWIO_MDM_HI0_GLBL_DBG_XFR_ENG_ADDR                          0x904003E8
 Y.CREATE.L   MDM_HI0_GLBL_DBG_XFR_ENG                                    0x904003E8
 Y.CREATE.L   HWIO_MDM_HI0_GLBL_DBG_CHAN_BLK_ADDR                         0x904003EC
 Y.CREATE.L   MDM_HI0_GLBL_DBG_CHAN_BLK                                   0x904003EC
 Y.CREATE.L   HWIO_MDM_HI0_GLBL_DBG_CHAN_BLK_CLR_ADDR                     0x904003F0
 Y.CREATE.L   MDM_HI0_GLBL_DBG_CHAN_BLK_CLR                               0x904003F0
 Y.CREATE.L   HWIO_MDM_HI0_GLBL_DBG_TEST_SEL_ADDR                         0x904003F4
 Y.CREATE.L   MDM_HI0_GLBL_DBG_TEST_SEL                                   0x904003F4
 Y.CREATE.L   HWIO_GPS_SRCH_DM_BYPASS_ADDR                                0x90500000
 Y.CREATE.L   GPS_SRCH_DM_BYPASS                                          0x90500000
 Y.CREATE.L   HWIO_GPS_SRCH_RESET_ADDR                                    0x90500004
 Y.CREATE.L   GPS_SRCH_RESET                                              0x90500004
 Y.CREATE.L   HWIO_GPS_SRCH_CTL_ADDR                                      0x90500008
 Y.CREATE.L   GPS_SRCH_CTL                                                0x90500008
 Y.CREATE.L   HWIO_GPS_SRCH_TESTBUS_OUT_ADDR                              0x9050000C
 Y.CREATE.L   GPS_SRCH_TESTBUS_OUT                                        0x9050000C
 Y.CREATE.L   HWIO_GPS_SRCH_SS_TESTBUS_OUT_ADDR                           0x90500010
 Y.CREATE.L   GPS_SRCH_SS_TESTBUS_OUT                                     0x90500010
 Y.CREATE.L   HWIO_ALT_GPS_SRCH_CMD_ADDR                                  0x90580000
 Y.CREATE.L   ALT_GPS_SRCH_CMD                                            0x90580000
 Y.CREATE.L   HWIO_ALT_GPS_SRCH_OUT_ADDR                                  0x905C0000
 Y.CREATE.L   ALT_GPS_SRCH_OUT                                            0x905C0000
 Y.CREATE.L   HWIO_GPS_SRCH_CMD_START_ADDR_ADDR                           0x90580000
 Y.CREATE.L   GPS_SRCH_CMD_START_ADDR                                     0x90580000
 Y.CREATE.L   HWIO_GPS_SRCH_CMD_END_ADDR_ADDR                             0x905BFFFC
 Y.CREATE.L   GPS_SRCH_CMD_END_ADDR                                       0x905BFFFC
 Y.CREATE.L   HWIO_GPS_SRCH_OUT_START_ADDR_ADDR                           0x905C0000
 Y.CREATE.L   GPS_SRCH_OUT_START_ADDR                                     0x905C0000
 Y.CREATE.L   HWIO_GPS_SRCH_OUT_END_ADDR_ADDR                             0x905FFFFC
 Y.CREATE.L   GPS_SRCH_OUT_END_ADDR                                       0x905FFFFC
 Y.CREATE.L   HWIO_GPS_SRCH_CMD_ST0_ADDR                                  0x90580004
 Y.CREATE.L   GPS_SRCH_CMD_ST0                                            0x90580004
 Y.CREATE.L   HWIO_GPS_SRCH_CMD_DIAG0_ADDR                                0x90580008
 Y.CREATE.L   GPS_SRCH_CMD_DIAG0                                          0x90580008
 Y.CREATE.L   HWIO_GPS_SRCH_CMD_WD0_ADDR                                  0x9058000C
 Y.CREATE.L   GPS_SRCH_CMD_WD0                                            0x9058000C
 Y.CREATE.L   HWIO_GPS_SRCH_CMD_WD1_ADDR                                  0x90580010
 Y.CREATE.L   GPS_SRCH_CMD_WD1                                            0x90580010
 Y.CREATE.L   HWIO_GPS_SRCH_CMD_WD2_ADDR                                  0x90580014
 Y.CREATE.L   GPS_SRCH_CMD_WD2                                            0x90580014
 Y.CREATE.L   HWIO_GPS_SRCH_CMD_CDMA_WD3_ADDR                             0x90580018
 Y.CREATE.L   GPS_SRCH_CMD_CDMA_WD3                                       0x90580018
 Y.CREATE.L   HWIO_GPS_SRCH_CMD_GPS_WD3_ADDR                              0x9058001C
 Y.CREATE.L   GPS_SRCH_CMD_GPS_WD3                                        0x9058001C
 Y.CREATE.L   HWIO_GPS_SRCH_CMD_HDR_WD3_ADDR                              0x90580020
 Y.CREATE.L   GPS_SRCH_CMD_HDR_WD3                                        0x90580020
 Y.CREATE.L   HWIO_GACC_DM_BYPASS_ADDR                                    0x90600000
 Y.CREATE.L   GACC_DM_BYPASS                                              0x90600000
 Y.CREATE.L   HWIO_GACC_CLK_CTL_ADDR                                      0x90600004
 Y.CREATE.L   GACC_CLK_CTL                                                0x90600004
 Y.CREATE.L   HWIO_GACC_TEST_BUS_OUT_ADDR                                 0x90600008
 Y.CREATE.L   GACC_TEST_BUS_OUT                                           0x90600008
 Y.CREATE.L   HWIO_GACC_RTC_WAIT_ALT_ADDR                                 0x90680000
 Y.CREATE.L   GACC_RTC_WAIT_ALT                                           0x90680000
 Y.CREATE.L   HWIO_GACC_START_ADDR_ALT_ADDR                               0x90680004
 Y.CREATE.L   GACC_START_ADDR_ALT                                         0x90680004
 Y.CREATE.L   HWIO_GACC_COUNT_ALT_ADDR                                    0x90680008
 Y.CREATE.L   GACC_COUNT_ALT                                              0x90680008
 Y.CREATE.L   HWIO_GACC_INCR_ALT_ADDR                                     0x9068000C
 Y.CREATE.L   GACC_INCR_ALT                                               0x9068000C
 Y.CREATE.L   HWIO_GACC_FREQ_ALT_ADDR                                     0x90680010
 Y.CREATE.L   GACC_FREQ_ALT                                               0x90680010
 Y.CREATE.L   HWIO_GACC_CONFIG_ALT_ADDR                                   0x90680014
 Y.CREATE.L   GACC_CONFIG_ALT                                             0x90680014
 Y.CREATE.L   HWIO_GACC_PEAK_ALT_ADDR                                     0x90680018
 Y.CREATE.L   GACC_PEAK_ALT                                               0x90680018
 Y.CREATE.L   HWIO_GACC_DONE_ALT_ADDR                                     0x9068001C
 Y.CREATE.L   GACC_DONE_ALT                                               0x9068001C
 Y.CREATE.L   HWIO_GACC_RTC_ALT_ADDR                                      0x90680020
 Y.CREATE.L   GACC_RTC_ALT                                                0x90680020
 Y.CREATE.L   HWIO_GACC_SAMPLE_MEM_START_ADDR_ALT_ADDR                    0x90681000
 Y.CREATE.L   GACC_SAMPLE_MEM_START_ADDR_ALT                              0x90681000
 Y.CREATE.L   HWIO_GACC_SAMPLE_MEM_END_ADDR_ALT_ADDR                      0x906819FC
 Y.CREATE.L   GACC_SAMPLE_MEM_END_ADDR_ALT                                0x906819FC
 Y.CREATE.L   HWIO_GACC_ENERGY_MEM_START_ADDR_ALT_ADDR                    0x90682000
 Y.CREATE.L   GACC_ENERGY_MEM_START_ADDR_ALT                              0x90682000
 Y.CREATE.L   HWIO_GACC_ENERGY_MEM_END_ADDR_ALT_ADDR                      0x906829FC
 Y.CREATE.L   GACC_ENERGY_MEM_END_ADDR_ALT                                0x906829FC
 Y.CREATE.L   HWIO_GACC_RTC_WAIT_ADDR                                     0x90680000
 Y.CREATE.L   GACC_RTC_WAIT                                               0x90680000
 Y.CREATE.L   HWIO_GACC_START_ADDR_ADDR                                   0x90680004
 Y.CREATE.L   GACC_START_ADDR                                             0x90680004
 Y.CREATE.L   HWIO_GACC_COUNT_ADDR                                        0x90680008
 Y.CREATE.L   GACC_COUNT                                                  0x90680008
 Y.CREATE.L   HWIO_GACC_INCR_ADDR                                         0x9068000C
 Y.CREATE.L   GACC_INCR                                                   0x9068000C
 Y.CREATE.L   HWIO_GACC_FREQ_ADDR                                         0x90680010
 Y.CREATE.L   GACC_FREQ                                                   0x90680010
 Y.CREATE.L   HWIO_GACC_CONFIG_ADDR                                       0x90680014
 Y.CREATE.L   GACC_CONFIG                                                 0x90680014
 Y.CREATE.L   HWIO_GACC_PEAK_ADDR                                         0x90680018
 Y.CREATE.L   GACC_PEAK                                                   0x90680018
 Y.CREATE.L   HWIO_GACC_DONE_ADDR                                         0x9068001C
 Y.CREATE.L   GACC_DONE                                                   0x9068001C
 Y.CREATE.L   HWIO_GACC_RTC_ADDR                                          0x90680020
 Y.CREATE.L   GACC_RTC                                                    0x90680020
 Y.CREATE.L   HWIO_GACC_SAMPLE_MEM_START_ADDR_ADDR                        0x90681000
 Y.CREATE.L   GACC_SAMPLE_MEM_START_ADDR                                  0x90681000
 Y.CREATE.L   HWIO_GACC_SAMPLE_MEM_END_ADDR_ADDR                          0x906819FC
 Y.CREATE.L   GACC_SAMPLE_MEM_END_ADDR                                    0x906819FC
 Y.CREATE.L   HWIO_GACC_ENERGY_MEM_START_ADDR_ADDR                        0x90682000
 Y.CREATE.L   GACC_ENERGY_MEM_START_ADDR                                  0x90682000
 Y.CREATE.L   HWIO_GACC_ENERGY_MEM_END_ADDR_ADDR                          0x906829FC
 Y.CREATE.L   GACC_ENERGY_MEM_END_ADDR                                    0x906829FC
 Y.CREATE.L   HWIO_MDSP_CTRL_ADDR                                         0x91C00000
 Y.CREATE.L   MDSP_CTRL                                                   0x91C00000
 Y.CREATE.L   HWIO_MDSP_UP_IRQ_ADDR                                       0x91C00004
 Y.CREATE.L   MDSP_UP_IRQ                                                 0x91C00004
 Y.CREATE.L   HWIO_MDSP_UP_IRQ_VECTOR_ADDR                                0x91C00008
 Y.CREATE.L   MDSP_UP_IRQ_VECTOR                                          0x91C00008
 Y.CREATE.L   HWIO_MDSP_CLK_GATE_CTRL_ADDR                                0x91C00010
 Y.CREATE.L   MDSP_CLK_GATE_CTRL                                          0x91C00010
 Y.CREATE.L   HWIO_MDSP_CLK_STATUS_ADDR                                   0x91C00014
 Y.CREATE.L   MDSP_CLK_STATUS                                             0x91C00014
 Y.CREATE.L   HWIO_MDSP_DBG_CTRL_ADDR                                     0x91C0001C
 Y.CREATE.L   MDSP_DBG_CTRL                                               0x91C0001C
 Y.CREATE.L   HWIO_MDSP_PC_DBG_ADDR                                       0x91C00020
 Y.CREATE.L   MDSP_PC_DBG                                                 0x91C00020
 Y.CREATE.L   HWIO_MDSP_INT_MASK_DBG_ADDR                                 0x91C00024
 Y.CREATE.L   MDSP_INT_MASK_DBG                                           0x91C00024
 Y.CREATE.L   HWIO_MDSP_INT_MASK2_DBG_ADDR                                0x91C00028
 Y.CREATE.L   MDSP_INT_MASK2_DBG                                          0x91C00028
 Y.CREATE.L   HWIO_MDSP_MEM_ACC_CTRL_ADDR                                 0x91C0002C
 Y.CREATE.L   MDSP_MEM_ACC_CTRL                                           0x91C0002C
 Y.CREATE.L   HWIO_ADSP_CTL_ADDR                                          0x70C00000
 Y.CREATE.L   ADSP_CTL                                                    0x70C00000
 Y.CREATE.L   HWIO_MICRO_TO_ADSP_IRQ_ADDR                                 0x70C00004
 Y.CREATE.L   MICRO_TO_ADSP_IRQ                                           0x70C00004
 Y.CREATE.L   HWIO_MICRO_TO_ADSP_IRQ_VECTOR_ADDR                          0x70C00008
 Y.CREATE.L   MICRO_TO_ADSP_IRQ_VECTOR                                    0x70C00008
 Y.CREATE.L   HWIO_ADSP_CLK_GATE_CTL_ADDR                                 0x70C00010
 Y.CREATE.L   ADSP_CLK_GATE_CTL                                           0x70C00010
 Y.CREATE.L   HWIO_ADSP_CLK_STATUS_ADDR                                   0x70C00014
 Y.CREATE.L   ADSP_CLK_STATUS                                             0x70C00014
 Y.CREATE.L   HWIO_ADSP_DBG_CTRL_ADDR                                     0x70C0001C
 Y.CREATE.L   ADSP_DBG_CTRL                                               0x70C0001C
 Y.CREATE.L   HWIO_ADSP_PC_DBG_ADDR                                       0x70C00020
 Y.CREATE.L   ADSP_PC_DBG                                                 0x70C00020
 Y.CREATE.L   HWIO_ADSP_INT_MASK_DBG_ADDR                                 0x70C00024
 Y.CREATE.L   ADSP_INT_MASK_DBG                                           0x70C00024
 Y.CREATE.L   HWIO_ADSP_INT_MASK2_DBG_ADDR                                0x70C00028
 Y.CREATE.L   ADSP_INT_MASK2_DBG                                          0x70C00028
 Y.CREATE.L   HWIO_ADSP_MEM_ACC_CTRL_ADDR                                 0x70C0002C
 Y.CREATE.L   ADSP_MEM_ACC_CTRL                                           0x70C0002C
 Y.CREATE.L   HWIO_GSBI0_GSBI_CTRL_REG_ADDR                               0x98000000
 Y.CREATE.L   GSBI0_GSBI_CTRL_REG                                         0x98000000
 Y.CREATE.L   HWIO_GSBI0_GSBI_DBG0_REG_ADDR                               0x98000004
 Y.CREATE.L   GSBI0_GSBI_DBG0_REG                                         0x98000004
 Y.CREATE.L   HWIO_GSBI0_GSBI_DBG1_REG_ADDR                               0x98000008
 Y.CREATE.L   GSBI0_GSBI_DBG1_REG                                         0x98000008
 Y.CREATE.L   HWIO_GSBI0_GSBI_DBG2_REG_ADDR                               0x9800000C
 Y.CREATE.L   GSBI0_GSBI_DBG2_REG                                         0x9800000C
 Y.CREATE.L   HWIO_GSBI0_GSBI_DBG3_REG_ADDR                               0x98000010
 Y.CREATE.L   GSBI0_GSBI_DBG3_REG                                         0x98000010
 Y.CREATE.L   HWIO_GSBI0_UART_DM_MR1_ADDR                                 0x9A000000
 Y.CREATE.L   GSBI0_UART_DM_MR1                                           0x9A000000
 Y.CREATE.L   HWIO_GSBI0_UART_DM_MR2_ADDR                                 0x9A000004
 Y.CREATE.L   GSBI0_UART_DM_MR2                                           0x9A000004
 Y.CREATE.L   HWIO_GSBI0_UART_DM_CSR_ADDR                                 0x9A000008
 Y.CREATE.L   GSBI0_UART_DM_CSR                                           0x9A000008
 Y.CREATE.L   HWIO_GSBI0_UART_DM_TF_ADDR                                  0x9A000070
 Y.CREATE.L   GSBI0_UART_DM_TF                                            0x9A000070
 Y.CREATE.L   HWIO_GSBI0_UART_DM_TF_2_ADDR                                0x9A000074
 Y.CREATE.L   GSBI0_UART_DM_TF_2                                          0x9A000074
 Y.CREATE.L   HWIO_GSBI0_UART_DM_TF_3_ADDR                                0x9A000078
 Y.CREATE.L   GSBI0_UART_DM_TF_3                                          0x9A000078
 Y.CREATE.L   HWIO_GSBI0_UART_DM_TF_4_ADDR                                0x9A00007C
 Y.CREATE.L   GSBI0_UART_DM_TF_4                                          0x9A00007C
 Y.CREATE.L   HWIO_GSBI0_UART_DM_CR_ADDR                                  0x9A000010
 Y.CREATE.L   GSBI0_UART_DM_CR                                            0x9A000010
 Y.CREATE.L   HWIO_GSBI0_UART_DM_IMR_ADDR                                 0x9A000014
 Y.CREATE.L   GSBI0_UART_DM_IMR                                           0x9A000014
 Y.CREATE.L   HWIO_GSBI0_UART_DM_IPR_ADDR                                 0x9A000018
 Y.CREATE.L   GSBI0_UART_DM_IPR                                           0x9A000018
 Y.CREATE.L   HWIO_GSBI0_UART_DM_TFWR_ADDR                                0x9A00001C
 Y.CREATE.L   GSBI0_UART_DM_TFWR                                          0x9A00001C
 Y.CREATE.L   HWIO_GSBI0_UART_DM_RFWR_ADDR                                0x9A000020
 Y.CREATE.L   GSBI0_UART_DM_RFWR                                          0x9A000020
 Y.CREATE.L   HWIO_GSBI0_UART_DM_HCR_ADDR                                 0x9A000024
 Y.CREATE.L   GSBI0_UART_DM_HCR                                           0x9A000024
 Y.CREATE.L   HWIO_GSBI0_UART_DM_DMRX_ADDR                                0x9A000034
 Y.CREATE.L   GSBI0_UART_DM_DMRX                                          0x9A000034
 Y.CREATE.L   HWIO_GSBI0_UART_DM_IRDA_ADDR                                0x9A000038
 Y.CREATE.L   GSBI0_UART_DM_IRDA                                          0x9A000038
 Y.CREATE.L   HWIO_GSBI0_UART_DM_DMEN_ADDR                                0x9A00003C
 Y.CREATE.L   GSBI0_UART_DM_DMEN                                          0x9A00003C
 Y.CREATE.L   HWIO_GSBI0_UART_DM_NO_CHARS_FOR_TX_ADDR                     0x9A000040
 Y.CREATE.L   GSBI0_UART_DM_NO_CHARS_FOR_TX                               0x9A000040
 Y.CREATE.L   HWIO_GSBI0_UART_DM_BADR_ADDR                                0x9A000044
 Y.CREATE.L   GSBI0_UART_DM_BADR                                          0x9A000044
 Y.CREATE.L   HWIO_GSBI0_UART_DM_TESTSL_ADDR                              0x9A000048
 Y.CREATE.L   GSBI0_UART_DM_TESTSL                                        0x9A000048
 Y.CREATE.L   HWIO_GSBI0_UART_DM_MISR_MODE_ADDR                           0x9A000060
 Y.CREATE.L   GSBI0_UART_DM_MISR_MODE                                     0x9A000060
 Y.CREATE.L   HWIO_GSBI0_UART_DM_MISR_RESET_ADDR                          0x9A000064
 Y.CREATE.L   GSBI0_UART_DM_MISR_RESET                                    0x9A000064
 Y.CREATE.L   HWIO_GSBI0_UART_DM_MISR_EXPORT_ADDR                         0x9A000068
 Y.CREATE.L   GSBI0_UART_DM_MISR_EXPORT                                   0x9A000068
 Y.CREATE.L   HWIO_GSBI0_UART_DM_MISR_VAL_ADDR                            0x9A00006C
 Y.CREATE.L   GSBI0_UART_DM_MISR_VAL                                      0x9A00006C
 Y.CREATE.L   HWIO_GSBI0_UART_DM_SIM_CFG_ADDR                             0x9A000080
 Y.CREATE.L   GSBI0_UART_DM_SIM_CFG                                       0x9A000080
 Y.CREATE.L   HWIO_GSBI0_UART_DM_TEST_WR_ADDR_ADDR                        0x9A000084
 Y.CREATE.L   GSBI0_UART_DM_TEST_WR_ADDR                                  0x9A000084
 Y.CREATE.L   HWIO_GSBI0_UART_DM_TEST_WR_DATA_ADDR                        0x9A000088
 Y.CREATE.L   GSBI0_UART_DM_TEST_WR_DATA                                  0x9A000088
 Y.CREATE.L   HWIO_GSBI0_UART_DM_TEST_RD_ADDR_ADDR                        0x9A00008C
 Y.CREATE.L   GSBI0_UART_DM_TEST_RD_ADDR                                  0x9A00008C
 Y.CREATE.L   HWIO_GSBI0_UART_DM_SR_ADDR                                  0x9A000008
 Y.CREATE.L   GSBI0_UART_DM_SR                                            0x9A000008
 Y.CREATE.L   HWIO_GSBI0_UART_DM_RF_ADDR                                  0x9A000070
 Y.CREATE.L   GSBI0_UART_DM_RF                                            0x9A000070
 Y.CREATE.L   HWIO_GSBI0_UART_DM_RF_2_ADDR                                0x9A000074
 Y.CREATE.L   GSBI0_UART_DM_RF_2                                          0x9A000074
 Y.CREATE.L   HWIO_GSBI0_UART_DM_RF_3_ADDR                                0x9A000078
 Y.CREATE.L   GSBI0_UART_DM_RF_3                                          0x9A000078
 Y.CREATE.L   HWIO_GSBI0_UART_DM_RF_4_ADDR                                0x9A00007C
 Y.CREATE.L   GSBI0_UART_DM_RF_4                                          0x9A00007C
 Y.CREATE.L   HWIO_GSBI0_UART_DM_MISR_ADDR                                0x9A000010
 Y.CREATE.L   GSBI0_UART_DM_MISR                                          0x9A000010
 Y.CREATE.L   HWIO_GSBI0_UART_DM_ISR_ADDR                                 0x9A000014
 Y.CREATE.L   GSBI0_UART_DM_ISR                                           0x9A000014
 Y.CREATE.L   HWIO_GSBI0_UART_DM_RX_TOTAL_SNAP_ADDR                       0x9A000038
 Y.CREATE.L   GSBI0_UART_DM_RX_TOTAL_SNAP                                 0x9A000038
 Y.CREATE.L   HWIO_GSBI0_UART_DM_TXFS_ADDR                                0x9A00004C
 Y.CREATE.L   GSBI0_UART_DM_TXFS                                          0x9A00004C
 Y.CREATE.L   HWIO_GSBI0_UART_DM_RXFS_ADDR                                0x9A000050
 Y.CREATE.L   GSBI0_UART_DM_RXFS                                          0x9A000050
 Y.CREATE.L   HWIO_GSBI0_UART_DM_TEST_RD_DATA_ADDR                        0x9A000090
 Y.CREATE.L   GSBI0_UART_DM_TEST_RD_DATA                                  0x9A000090
 Y.CREATE.L   HWIO_GSBI0_I2C_WRITE_DATA_ADDR                              0x9C000000
 Y.CREATE.L   GSBI0_I2C_WRITE_DATA                                        0x9C000000
 Y.CREATE.L   HWIO_GSBI0_I2C_CLK_CTL_ADDR                                 0x9C000004
 Y.CREATE.L   GSBI0_I2C_CLK_CTL                                           0x9C000004
 Y.CREATE.L   HWIO_GSBI0_I2C_STATUS_ADDR                                  0x9C000008
 Y.CREATE.L   GSBI0_I2C_STATUS                                            0x9C000008
 Y.CREATE.L   HWIO_GSBI0_I2C_READ_DATA_ADDR                               0x9C00000C
 Y.CREATE.L   GSBI0_I2C_READ_DATA                                         0x9C00000C
 Y.CREATE.L   HWIO_GSBI0_I2C_INTERFACE_SELECT_ADDR                        0x9C000010
 Y.CREATE.L   GSBI0_I2C_INTERFACE_SELECT                                  0x9C000010
 Y.CREATE.L   HWIO_GSBI0_SPI_CONFIG_ADDR                                  0x9E000000
 Y.CREATE.L   GSBI0_SPI_CONFIG                                            0x9E000000
 Y.CREATE.L   HWIO_GSBI0_SPI_IO_CONTROL_ADDR                              0x9E000004
 Y.CREATE.L   GSBI0_SPI_IO_CONTROL                                        0x9E000004
 Y.CREATE.L   HWIO_GSBI0_SPI_IO_MODES_ADDR                                0x9E000008
 Y.CREATE.L   GSBI0_SPI_IO_MODES                                          0x9E000008
 Y.CREATE.L   HWIO_GSBI0_SPI_SW_RESET_ADDR                                0x9E00000C
 Y.CREATE.L   GSBI0_SPI_SW_RESET                                          0x9E00000C
 Y.CREATE.L   HWIO_GSBI0_SPI_TIME_OUT_ADDR                                0x9E000010
 Y.CREATE.L   GSBI0_SPI_TIME_OUT                                          0x9E000010
 Y.CREATE.L   HWIO_GSBI0_SPI_TIME_OUT_CURRENT_ADDR                        0x9E000014
 Y.CREATE.L   GSBI0_SPI_TIME_OUT_CURRENT                                  0x9E000014
 Y.CREATE.L   HWIO_GSBI0_SPI_MX_OUTPUT_COUNT_ADDR                         0x9E000018
 Y.CREATE.L   GSBI0_SPI_MX_OUTPUT_COUNT                                   0x9E000018
 Y.CREATE.L   HWIO_GSBI0_SPI_MX_OUTPUT_CNT_CURRENT_ADDR                   0x9E00001C
 Y.CREATE.L   GSBI0_SPI_MX_OUTPUT_CNT_CURRENT                             0x9E00001C
 Y.CREATE.L   HWIO_GSBI0_SPI_MX_INPUT_COUNT_ADDR                          0x9E000020
 Y.CREATE.L   GSBI0_SPI_MX_INPUT_COUNT                                    0x9E000020
 Y.CREATE.L   HWIO_GSBI0_SPI_MX_INPUT_CNT_CURRENT_ADDR                    0x9E000024
 Y.CREATE.L   GSBI0_SPI_MX_INPUT_CNT_CURRENT                              0x9E000024
 Y.CREATE.L   HWIO_GSBI0_SPI_MX_READ_COUNT_ADDR                           0x9E000028
 Y.CREATE.L   GSBI0_SPI_MX_READ_COUNT                                     0x9E000028
 Y.CREATE.L   HWIO_GSBI0_SPI_MX_READ_CNT_CURRENT_ADDR                     0x9E00002C
 Y.CREATE.L   GSBI0_SPI_MX_READ_CNT_CURRENT                               0x9E00002C
 Y.CREATE.L   HWIO_GSBI0_SPI_OPERATIONAL_ADDR                             0x9E000030
 Y.CREATE.L   GSBI0_SPI_OPERATIONAL                                       0x9E000030
 Y.CREATE.L   HWIO_GSBI0_SPI_ERROR_FLAGS_ADDR                             0x9E000034
 Y.CREATE.L   GSBI0_SPI_ERROR_FLAGS                                       0x9E000034
 Y.CREATE.L   HWIO_GSBI0_SPI_ERROR_FLAGS_EN_ADDR                          0x9E000038
 Y.CREATE.L   GSBI0_SPI_ERROR_FLAGS_EN                                    0x9E000038
 Y.CREATE.L   HWIO_GSBI0_SPI_DEASSERT_WAIT_ADDR                           0x9E00003C
 Y.CREATE.L   GSBI0_SPI_DEASSERT_WAIT                                     0x9E00003C
 Y.CREATE.L   HWIO_GSBI0_SPI_OUTPUT_DEBUG_ADDR                            0x9E000040
 Y.CREATE.L   GSBI0_SPI_OUTPUT_DEBUG                                      0x9E000040
 Y.CREATE.L   HWIO_GSBI0_SPI_INPUT_DEBUG_ADDR                             0x9E000044
 Y.CREATE.L   GSBI0_SPI_INPUT_DEBUG                                       0x9E000044
 Y.CREATE.L   HWIO_GSBI0_SPI_FIFO_WORD_CNT_ADDR                           0x9E000048
 Y.CREATE.L   GSBI0_SPI_FIFO_WORD_CNT                                     0x9E000048
 Y.CREATE.L   HWIO_GSBI0_SPI_TEST_CTRL_ADDR                               0x9E00004C
 Y.CREATE.L   GSBI0_SPI_TEST_CTRL                                         0x9E00004C
 Y.CREATE.L   HWIO_GSBI0_SPI_OUTPUT_FIFO_ADDR                             0x9E000100
 Y.CREATE.L   GSBI0_SPI_OUTPUT_FIFO                                       0x9E000100
 Y.CREATE.L   HWIO_GSBI0_SPI_INPUT_FIFO_ADDR                              0x9E000200
 Y.CREATE.L   GSBI0_SPI_INPUT_FIFO                                        0x9E000200
 Y.CREATE.L   HWIO_GSBI1_GSBI_CTRL_REG_ADDR                               0xA0000000
 Y.CREATE.L   GSBI1_GSBI_CTRL_REG                                         0xA0000000
 Y.CREATE.L   HWIO_GSBI1_GSBI_DBG0_REG_ADDR                               0xA0000004
 Y.CREATE.L   GSBI1_GSBI_DBG0_REG                                         0xA0000004
 Y.CREATE.L   HWIO_GSBI1_GSBI_DBG1_REG_ADDR                               0xA0000008
 Y.CREATE.L   GSBI1_GSBI_DBG1_REG                                         0xA0000008
 Y.CREATE.L   HWIO_GSBI1_GSBI_DBG2_REG_ADDR                               0xA000000C
 Y.CREATE.L   GSBI1_GSBI_DBG2_REG                                         0xA000000C
 Y.CREATE.L   HWIO_GSBI1_GSBI_DBG3_REG_ADDR                               0xA0000010
 Y.CREATE.L   GSBI1_GSBI_DBG3_REG                                         0xA0000010
 Y.CREATE.L   HWIO_GSBI1_UART_DM_MR1_ADDR                                 0xA2000000
 Y.CREATE.L   GSBI1_UART_DM_MR1                                           0xA2000000
 Y.CREATE.L   HWIO_GSBI1_UART_DM_MR2_ADDR                                 0xA2000004
 Y.CREATE.L   GSBI1_UART_DM_MR2                                           0xA2000004
 Y.CREATE.L   HWIO_GSBI1_UART_DM_CSR_ADDR                                 0xA2000008
 Y.CREATE.L   GSBI1_UART_DM_CSR                                           0xA2000008
 Y.CREATE.L   HWIO_GSBI1_UART_DM_TF_ADDR                                  0xA2000070
 Y.CREATE.L   GSBI1_UART_DM_TF                                            0xA2000070
 Y.CREATE.L   HWIO_GSBI1_UART_DM_TF_2_ADDR                                0xA2000074
 Y.CREATE.L   GSBI1_UART_DM_TF_2                                          0xA2000074
 Y.CREATE.L   HWIO_GSBI1_UART_DM_TF_3_ADDR                                0xA2000078
 Y.CREATE.L   GSBI1_UART_DM_TF_3                                          0xA2000078
 Y.CREATE.L   HWIO_GSBI1_UART_DM_TF_4_ADDR                                0xA200007C
 Y.CREATE.L   GSBI1_UART_DM_TF_4                                          0xA200007C
 Y.CREATE.L   HWIO_GSBI1_UART_DM_CR_ADDR                                  0xA2000010
 Y.CREATE.L   GSBI1_UART_DM_CR                                            0xA2000010
 Y.CREATE.L   HWIO_GSBI1_UART_DM_IMR_ADDR                                 0xA2000014
 Y.CREATE.L   GSBI1_UART_DM_IMR                                           0xA2000014
 Y.CREATE.L   HWIO_GSBI1_UART_DM_IPR_ADDR                                 0xA2000018
 Y.CREATE.L   GSBI1_UART_DM_IPR                                           0xA2000018
 Y.CREATE.L   HWIO_GSBI1_UART_DM_TFWR_ADDR                                0xA200001C
 Y.CREATE.L   GSBI1_UART_DM_TFWR                                          0xA200001C
 Y.CREATE.L   HWIO_GSBI1_UART_DM_RFWR_ADDR                                0xA2000020
 Y.CREATE.L   GSBI1_UART_DM_RFWR                                          0xA2000020
 Y.CREATE.L   HWIO_GSBI1_UART_DM_HCR_ADDR                                 0xA2000024
 Y.CREATE.L   GSBI1_UART_DM_HCR                                           0xA2000024
 Y.CREATE.L   HWIO_GSBI1_UART_DM_DMRX_ADDR                                0xA2000034
 Y.CREATE.L   GSBI1_UART_DM_DMRX                                          0xA2000034
 Y.CREATE.L   HWIO_GSBI1_UART_DM_IRDA_ADDR                                0xA2000038
 Y.CREATE.L   GSBI1_UART_DM_IRDA                                          0xA2000038
 Y.CREATE.L   HWIO_GSBI1_UART_DM_DMEN_ADDR                                0xA200003C
 Y.CREATE.L   GSBI1_UART_DM_DMEN                                          0xA200003C
 Y.CREATE.L   HWIO_GSBI1_UART_DM_NO_CHARS_FOR_TX_ADDR                     0xA2000040
 Y.CREATE.L   GSBI1_UART_DM_NO_CHARS_FOR_TX                               0xA2000040
 Y.CREATE.L   HWIO_GSBI1_UART_DM_BADR_ADDR                                0xA2000044
 Y.CREATE.L   GSBI1_UART_DM_BADR                                          0xA2000044
 Y.CREATE.L   HWIO_GSBI1_UART_DM_TESTSL_ADDR                              0xA2000048
 Y.CREATE.L   GSBI1_UART_DM_TESTSL                                        0xA2000048
 Y.CREATE.L   HWIO_GSBI1_UART_DM_MISR_MODE_ADDR                           0xA2000060
 Y.CREATE.L   GSBI1_UART_DM_MISR_MODE                                     0xA2000060
 Y.CREATE.L   HWIO_GSBI1_UART_DM_MISR_RESET_ADDR                          0xA2000064
 Y.CREATE.L   GSBI1_UART_DM_MISR_RESET                                    0xA2000064
 Y.CREATE.L   HWIO_GSBI1_UART_DM_MISR_EXPORT_ADDR                         0xA2000068
 Y.CREATE.L   GSBI1_UART_DM_MISR_EXPORT                                   0xA2000068
 Y.CREATE.L   HWIO_GSBI1_UART_DM_MISR_VAL_ADDR                            0xA200006C
 Y.CREATE.L   GSBI1_UART_DM_MISR_VAL                                      0xA200006C
 Y.CREATE.L   HWIO_GSBI1_UART_DM_SIM_CFG_ADDR                             0xA2000080
 Y.CREATE.L   GSBI1_UART_DM_SIM_CFG                                       0xA2000080
 Y.CREATE.L   HWIO_GSBI1_UART_DM_TEST_WR_ADDR_ADDR                        0xA2000084
 Y.CREATE.L   GSBI1_UART_DM_TEST_WR_ADDR                                  0xA2000084
 Y.CREATE.L   HWIO_GSBI1_UART_DM_TEST_WR_DATA_ADDR                        0xA2000088
 Y.CREATE.L   GSBI1_UART_DM_TEST_WR_DATA                                  0xA2000088
 Y.CREATE.L   HWIO_GSBI1_UART_DM_TEST_RD_ADDR_ADDR                        0xA200008C
 Y.CREATE.L   GSBI1_UART_DM_TEST_RD_ADDR                                  0xA200008C
 Y.CREATE.L   HWIO_GSBI1_UART_DM_SR_ADDR                                  0xA2000008
 Y.CREATE.L   GSBI1_UART_DM_SR                                            0xA2000008
 Y.CREATE.L   HWIO_GSBI1_UART_DM_RF_ADDR                                  0xA2000070
 Y.CREATE.L   GSBI1_UART_DM_RF                                            0xA2000070
 Y.CREATE.L   HWIO_GSBI1_UART_DM_RF_2_ADDR                                0xA2000074
 Y.CREATE.L   GSBI1_UART_DM_RF_2                                          0xA2000074
 Y.CREATE.L   HWIO_GSBI1_UART_DM_RF_3_ADDR                                0xA2000078
 Y.CREATE.L   GSBI1_UART_DM_RF_3                                          0xA2000078
 Y.CREATE.L   HWIO_GSBI1_UART_DM_RF_4_ADDR                                0xA200007C
 Y.CREATE.L   GSBI1_UART_DM_RF_4                                          0xA200007C
 Y.CREATE.L   HWIO_GSBI1_UART_DM_MISR_ADDR                                0xA2000010
 Y.CREATE.L   GSBI1_UART_DM_MISR                                          0xA2000010
 Y.CREATE.L   HWIO_GSBI1_UART_DM_ISR_ADDR                                 0xA2000014
 Y.CREATE.L   GSBI1_UART_DM_ISR                                           0xA2000014
 Y.CREATE.L   HWIO_GSBI1_UART_DM_RX_TOTAL_SNAP_ADDR                       0xA2000038
 Y.CREATE.L   GSBI1_UART_DM_RX_TOTAL_SNAP                                 0xA2000038
 Y.CREATE.L   HWIO_GSBI1_UART_DM_TXFS_ADDR                                0xA200004C
 Y.CREATE.L   GSBI1_UART_DM_TXFS                                          0xA200004C
 Y.CREATE.L   HWIO_GSBI1_UART_DM_RXFS_ADDR                                0xA2000050
 Y.CREATE.L   GSBI1_UART_DM_RXFS                                          0xA2000050
 Y.CREATE.L   HWIO_GSBI1_UART_DM_TEST_RD_DATA_ADDR                        0xA2000090
 Y.CREATE.L   GSBI1_UART_DM_TEST_RD_DATA                                  0xA2000090
 Y.CREATE.L   HWIO_GSBI1_I2C_WRITE_DATA_ADDR                              0xA4000000
 Y.CREATE.L   GSBI1_I2C_WRITE_DATA                                        0xA4000000
 Y.CREATE.L   HWIO_GSBI1_I2C_CLK_CTL_ADDR                                 0xA4000004
 Y.CREATE.L   GSBI1_I2C_CLK_CTL                                           0xA4000004
 Y.CREATE.L   HWIO_GSBI1_I2C_STATUS_ADDR                                  0xA4000008
 Y.CREATE.L   GSBI1_I2C_STATUS                                            0xA4000008
 Y.CREATE.L   HWIO_GSBI1_I2C_READ_DATA_ADDR                               0xA400000C
 Y.CREATE.L   GSBI1_I2C_READ_DATA                                         0xA400000C
 Y.CREATE.L   HWIO_GSBI1_I2C_INTERFACE_SELECT_ADDR                        0xA4000010
 Y.CREATE.L   GSBI1_I2C_INTERFACE_SELECT                                  0xA4000010
 Y.CREATE.L   HWIO_GSBI1_SPI_CONFIG_ADDR                                  0xA6000000
 Y.CREATE.L   GSBI1_SPI_CONFIG                                            0xA6000000
 Y.CREATE.L   HWIO_GSBI1_SPI_IO_CONTROL_ADDR                              0xA6000004
 Y.CREATE.L   GSBI1_SPI_IO_CONTROL                                        0xA6000004
 Y.CREATE.L   HWIO_GSBI1_SPI_IO_MODES_ADDR                                0xA6000008
 Y.CREATE.L   GSBI1_SPI_IO_MODES                                          0xA6000008
 Y.CREATE.L   HWIO_GSBI1_SPI_SW_RESET_ADDR                                0xA600000C
 Y.CREATE.L   GSBI1_SPI_SW_RESET                                          0xA600000C
 Y.CREATE.L   HWIO_GSBI1_SPI_TIME_OUT_ADDR                                0xA6000010
 Y.CREATE.L   GSBI1_SPI_TIME_OUT                                          0xA6000010
 Y.CREATE.L   HWIO_GSBI1_SPI_TIME_OUT_CURRENT_ADDR                        0xA6000014
 Y.CREATE.L   GSBI1_SPI_TIME_OUT_CURRENT                                  0xA6000014
 Y.CREATE.L   HWIO_GSBI1_SPI_MX_OUTPUT_COUNT_ADDR                         0xA6000018
 Y.CREATE.L   GSBI1_SPI_MX_OUTPUT_COUNT                                   0xA6000018
 Y.CREATE.L   HWIO_GSBI1_SPI_MX_OUTPUT_CNT_CURRENT_ADDR                   0xA600001C
 Y.CREATE.L   GSBI1_SPI_MX_OUTPUT_CNT_CURRENT                             0xA600001C
 Y.CREATE.L   HWIO_GSBI1_SPI_MX_INPUT_COUNT_ADDR                          0xA6000020
 Y.CREATE.L   GSBI1_SPI_MX_INPUT_COUNT                                    0xA6000020
 Y.CREATE.L   HWIO_GSBI1_SPI_MX_INPUT_CNT_CURRENT_ADDR                    0xA6000024
 Y.CREATE.L   GSBI1_SPI_MX_INPUT_CNT_CURRENT                              0xA6000024
 Y.CREATE.L   HWIO_GSBI1_SPI_MX_READ_COUNT_ADDR                           0xA6000028
 Y.CREATE.L   GSBI1_SPI_MX_READ_COUNT                                     0xA6000028
 Y.CREATE.L   HWIO_GSBI1_SPI_MX_READ_CNT_CURRENT_ADDR                     0xA600002C
 Y.CREATE.L   GSBI1_SPI_MX_READ_CNT_CURRENT                               0xA600002C
 Y.CREATE.L   HWIO_GSBI1_SPI_OPERATIONAL_ADDR                             0xA6000030
 Y.CREATE.L   GSBI1_SPI_OPERATIONAL                                       0xA6000030
 Y.CREATE.L   HWIO_GSBI1_SPI_ERROR_FLAGS_ADDR                             0xA6000034
 Y.CREATE.L   GSBI1_SPI_ERROR_FLAGS                                       0xA6000034
 Y.CREATE.L   HWIO_GSBI1_SPI_ERROR_FLAGS_EN_ADDR                          0xA6000038
 Y.CREATE.L   GSBI1_SPI_ERROR_FLAGS_EN                                    0xA6000038
 Y.CREATE.L   HWIO_GSBI1_SPI_DEASSERT_WAIT_ADDR                           0xA600003C
 Y.CREATE.L   GSBI1_SPI_DEASSERT_WAIT                                     0xA600003C
 Y.CREATE.L   HWIO_GSBI1_SPI_OUTPUT_DEBUG_ADDR                            0xA6000040
 Y.CREATE.L   GSBI1_SPI_OUTPUT_DEBUG                                      0xA6000040
 Y.CREATE.L   HWIO_GSBI1_SPI_INPUT_DEBUG_ADDR                             0xA6000044
 Y.CREATE.L   GSBI1_SPI_INPUT_DEBUG                                       0xA6000044
 Y.CREATE.L   HWIO_GSBI1_SPI_FIFO_WORD_CNT_ADDR                           0xA6000048
 Y.CREATE.L   GSBI1_SPI_FIFO_WORD_CNT                                     0xA6000048
 Y.CREATE.L   HWIO_GSBI1_SPI_TEST_CTRL_ADDR                               0xA600004C
 Y.CREATE.L   GSBI1_SPI_TEST_CTRL                                         0xA600004C
 Y.CREATE.L   HWIO_GSBI1_SPI_OUTPUT_FIFO_ADDR                             0xA6000100
 Y.CREATE.L   GSBI1_SPI_OUTPUT_FIFO                                       0xA6000100
 Y.CREATE.L   HWIO_GSBI1_SPI_INPUT_FIFO_ADDR                              0xA6000200
 Y.CREATE.L   GSBI1_SPI_INPUT_FIFO                                        0xA6000200
 Y.CREATE.L   HWIO_GSBI2_GSBI_CTRL_REG_ADDR                               0xA8000000
 Y.CREATE.L   GSBI2_GSBI_CTRL_REG                                         0xA8000000
 Y.CREATE.L   HWIO_GSBI2_GSBI_DBG0_REG_ADDR                               0xA8000004
 Y.CREATE.L   GSBI2_GSBI_DBG0_REG                                         0xA8000004
 Y.CREATE.L   HWIO_GSBI2_GSBI_DBG1_REG_ADDR                               0xA8000008
 Y.CREATE.L   GSBI2_GSBI_DBG1_REG                                         0xA8000008
 Y.CREATE.L   HWIO_GSBI2_GSBI_DBG2_REG_ADDR                               0xA800000C
 Y.CREATE.L   GSBI2_GSBI_DBG2_REG                                         0xA800000C
 Y.CREATE.L   HWIO_GSBI2_GSBI_DBG3_REG_ADDR                               0xA8000010
 Y.CREATE.L   GSBI2_GSBI_DBG3_REG                                         0xA8000010
 Y.CREATE.L   HWIO_GSBI2_UART_DM_MR1_ADDR                                 0xAA000000
 Y.CREATE.L   GSBI2_UART_DM_MR1                                           0xAA000000
 Y.CREATE.L   HWIO_GSBI2_UART_DM_MR2_ADDR                                 0xAA000004
 Y.CREATE.L   GSBI2_UART_DM_MR2                                           0xAA000004
 Y.CREATE.L   HWIO_GSBI2_UART_DM_CSR_ADDR                                 0xAA000008
 Y.CREATE.L   GSBI2_UART_DM_CSR                                           0xAA000008
 Y.CREATE.L   HWIO_GSBI2_UART_DM_TF_ADDR                                  0xAA000070
 Y.CREATE.L   GSBI2_UART_DM_TF                                            0xAA000070
 Y.CREATE.L   HWIO_GSBI2_UART_DM_TF_2_ADDR                                0xAA000074
 Y.CREATE.L   GSBI2_UART_DM_TF_2                                          0xAA000074
 Y.CREATE.L   HWIO_GSBI2_UART_DM_TF_3_ADDR                                0xAA000078
 Y.CREATE.L   GSBI2_UART_DM_TF_3                                          0xAA000078
 Y.CREATE.L   HWIO_GSBI2_UART_DM_TF_4_ADDR                                0xAA00007C
 Y.CREATE.L   GSBI2_UART_DM_TF_4                                          0xAA00007C
 Y.CREATE.L   HWIO_GSBI2_UART_DM_CR_ADDR                                  0xAA000010
 Y.CREATE.L   GSBI2_UART_DM_CR                                            0xAA000010
 Y.CREATE.L   HWIO_GSBI2_UART_DM_IMR_ADDR                                 0xAA000014
 Y.CREATE.L   GSBI2_UART_DM_IMR                                           0xAA000014
 Y.CREATE.L   HWIO_GSBI2_UART_DM_IPR_ADDR                                 0xAA000018
 Y.CREATE.L   GSBI2_UART_DM_IPR                                           0xAA000018
 Y.CREATE.L   HWIO_GSBI2_UART_DM_TFWR_ADDR                                0xAA00001C
 Y.CREATE.L   GSBI2_UART_DM_TFWR                                          0xAA00001C
 Y.CREATE.L   HWIO_GSBI2_UART_DM_RFWR_ADDR                                0xAA000020
 Y.CREATE.L   GSBI2_UART_DM_RFWR                                          0xAA000020
 Y.CREATE.L   HWIO_GSBI2_UART_DM_HCR_ADDR                                 0xAA000024
 Y.CREATE.L   GSBI2_UART_DM_HCR                                           0xAA000024
 Y.CREATE.L   HWIO_GSBI2_UART_DM_DMRX_ADDR                                0xAA000034
 Y.CREATE.L   GSBI2_UART_DM_DMRX                                          0xAA000034
 Y.CREATE.L   HWIO_GSBI2_UART_DM_IRDA_ADDR                                0xAA000038
 Y.CREATE.L   GSBI2_UART_DM_IRDA                                          0xAA000038
 Y.CREATE.L   HWIO_GSBI2_UART_DM_DMEN_ADDR                                0xAA00003C
 Y.CREATE.L   GSBI2_UART_DM_DMEN                                          0xAA00003C
 Y.CREATE.L   HWIO_GSBI2_UART_DM_NO_CHARS_FOR_TX_ADDR                     0xAA000040
 Y.CREATE.L   GSBI2_UART_DM_NO_CHARS_FOR_TX                               0xAA000040
 Y.CREATE.L   HWIO_GSBI2_UART_DM_BADR_ADDR                                0xAA000044
 Y.CREATE.L   GSBI2_UART_DM_BADR                                          0xAA000044
 Y.CREATE.L   HWIO_GSBI2_UART_DM_TESTSL_ADDR                              0xAA000048
 Y.CREATE.L   GSBI2_UART_DM_TESTSL                                        0xAA000048
 Y.CREATE.L   HWIO_GSBI2_UART_DM_MISR_MODE_ADDR                           0xAA000060
 Y.CREATE.L   GSBI2_UART_DM_MISR_MODE                                     0xAA000060
 Y.CREATE.L   HWIO_GSBI2_UART_DM_MISR_RESET_ADDR                          0xAA000064
 Y.CREATE.L   GSBI2_UART_DM_MISR_RESET                                    0xAA000064
 Y.CREATE.L   HWIO_GSBI2_UART_DM_MISR_EXPORT_ADDR                         0xAA000068
 Y.CREATE.L   GSBI2_UART_DM_MISR_EXPORT                                   0xAA000068
 Y.CREATE.L   HWIO_GSBI2_UART_DM_MISR_VAL_ADDR                            0xAA00006C
 Y.CREATE.L   GSBI2_UART_DM_MISR_VAL                                      0xAA00006C
 Y.CREATE.L   HWIO_GSBI2_UART_DM_SIM_CFG_ADDR                             0xAA000080
 Y.CREATE.L   GSBI2_UART_DM_SIM_CFG                                       0xAA000080
 Y.CREATE.L   HWIO_GSBI2_UART_DM_TEST_WR_ADDR_ADDR                        0xAA000084
 Y.CREATE.L   GSBI2_UART_DM_TEST_WR_ADDR                                  0xAA000084
 Y.CREATE.L   HWIO_GSBI2_UART_DM_TEST_WR_DATA_ADDR                        0xAA000088
 Y.CREATE.L   GSBI2_UART_DM_TEST_WR_DATA                                  0xAA000088
 Y.CREATE.L   HWIO_GSBI2_UART_DM_TEST_RD_ADDR_ADDR                        0xAA00008C
 Y.CREATE.L   GSBI2_UART_DM_TEST_RD_ADDR                                  0xAA00008C
 Y.CREATE.L   HWIO_GSBI2_UART_DM_SR_ADDR                                  0xAA000008
 Y.CREATE.L   GSBI2_UART_DM_SR                                            0xAA000008
 Y.CREATE.L   HWIO_GSBI2_UART_DM_RF_ADDR                                  0xAA000070
 Y.CREATE.L   GSBI2_UART_DM_RF                                            0xAA000070
 Y.CREATE.L   HWIO_GSBI2_UART_DM_RF_2_ADDR                                0xAA000074
 Y.CREATE.L   GSBI2_UART_DM_RF_2                                          0xAA000074
 Y.CREATE.L   HWIO_GSBI2_UART_DM_RF_3_ADDR                                0xAA000078
 Y.CREATE.L   GSBI2_UART_DM_RF_3                                          0xAA000078
 Y.CREATE.L   HWIO_GSBI2_UART_DM_RF_4_ADDR                                0xAA00007C
 Y.CREATE.L   GSBI2_UART_DM_RF_4                                          0xAA00007C
 Y.CREATE.L   HWIO_GSBI2_UART_DM_MISR_ADDR                                0xAA000010
 Y.CREATE.L   GSBI2_UART_DM_MISR                                          0xAA000010
 Y.CREATE.L   HWIO_GSBI2_UART_DM_ISR_ADDR                                 0xAA000014
 Y.CREATE.L   GSBI2_UART_DM_ISR                                           0xAA000014
 Y.CREATE.L   HWIO_GSBI2_UART_DM_RX_TOTAL_SNAP_ADDR                       0xAA000038
 Y.CREATE.L   GSBI2_UART_DM_RX_TOTAL_SNAP                                 0xAA000038
 Y.CREATE.L   HWIO_GSBI2_UART_DM_TXFS_ADDR                                0xAA00004C
 Y.CREATE.L   GSBI2_UART_DM_TXFS                                          0xAA00004C
 Y.CREATE.L   HWIO_GSBI2_UART_DM_RXFS_ADDR                                0xAA000050
 Y.CREATE.L   GSBI2_UART_DM_RXFS                                          0xAA000050
 Y.CREATE.L   HWIO_GSBI2_UART_DM_TEST_RD_DATA_ADDR                        0xAA000090
 Y.CREATE.L   GSBI2_UART_DM_TEST_RD_DATA                                  0xAA000090
 Y.CREATE.L   HWIO_GSBI2_I2C_WRITE_DATA_ADDR                              0xAC000000
 Y.CREATE.L   GSBI2_I2C_WRITE_DATA                                        0xAC000000
 Y.CREATE.L   HWIO_GSBI2_I2C_CLK_CTL_ADDR                                 0xAC000004
 Y.CREATE.L   GSBI2_I2C_CLK_CTL                                           0xAC000004
 Y.CREATE.L   HWIO_GSBI2_I2C_STATUS_ADDR                                  0xAC000008
 Y.CREATE.L   GSBI2_I2C_STATUS                                            0xAC000008
 Y.CREATE.L   HWIO_GSBI2_I2C_READ_DATA_ADDR                               0xAC00000C
 Y.CREATE.L   GSBI2_I2C_READ_DATA                                         0xAC00000C
 Y.CREATE.L   HWIO_GSBI2_I2C_INTERFACE_SELECT_ADDR                        0xAC000010
 Y.CREATE.L   GSBI2_I2C_INTERFACE_SELECT                                  0xAC000010
 Y.CREATE.L   HWIO_GSBI2_SPI_CONFIG_ADDR                                  0xAE000000
 Y.CREATE.L   GSBI2_SPI_CONFIG                                            0xAE000000
 Y.CREATE.L   HWIO_GSBI2_SPI_IO_CONTROL_ADDR                              0xAE000004
 Y.CREATE.L   GSBI2_SPI_IO_CONTROL                                        0xAE000004
 Y.CREATE.L   HWIO_GSBI2_SPI_IO_MODES_ADDR                                0xAE000008
 Y.CREATE.L   GSBI2_SPI_IO_MODES                                          0xAE000008
 Y.CREATE.L   HWIO_GSBI2_SPI_SW_RESET_ADDR                                0xAE00000C
 Y.CREATE.L   GSBI2_SPI_SW_RESET                                          0xAE00000C
 Y.CREATE.L   HWIO_GSBI2_SPI_TIME_OUT_ADDR                                0xAE000010
 Y.CREATE.L   GSBI2_SPI_TIME_OUT                                          0xAE000010
 Y.CREATE.L   HWIO_GSBI2_SPI_TIME_OUT_CURRENT_ADDR                        0xAE000014
 Y.CREATE.L   GSBI2_SPI_TIME_OUT_CURRENT                                  0xAE000014
 Y.CREATE.L   HWIO_GSBI2_SPI_MX_OUTPUT_COUNT_ADDR                         0xAE000018
 Y.CREATE.L   GSBI2_SPI_MX_OUTPUT_COUNT                                   0xAE000018
 Y.CREATE.L   HWIO_GSBI2_SPI_MX_OUTPUT_CNT_CURRENT_ADDR                   0xAE00001C
 Y.CREATE.L   GSBI2_SPI_MX_OUTPUT_CNT_CURRENT                             0xAE00001C
 Y.CREATE.L   HWIO_GSBI2_SPI_MX_INPUT_COUNT_ADDR                          0xAE000020
 Y.CREATE.L   GSBI2_SPI_MX_INPUT_COUNT                                    0xAE000020
 Y.CREATE.L   HWIO_GSBI2_SPI_MX_INPUT_CNT_CURRENT_ADDR                    0xAE000024
 Y.CREATE.L   GSBI2_SPI_MX_INPUT_CNT_CURRENT                              0xAE000024
 Y.CREATE.L   HWIO_GSBI2_SPI_MX_READ_COUNT_ADDR                           0xAE000028
 Y.CREATE.L   GSBI2_SPI_MX_READ_COUNT                                     0xAE000028
 Y.CREATE.L   HWIO_GSBI2_SPI_MX_READ_CNT_CURRENT_ADDR                     0xAE00002C
 Y.CREATE.L   GSBI2_SPI_MX_READ_CNT_CURRENT                               0xAE00002C
 Y.CREATE.L   HWIO_GSBI2_SPI_OPERATIONAL_ADDR                             0xAE000030
 Y.CREATE.L   GSBI2_SPI_OPERATIONAL                                       0xAE000030
 Y.CREATE.L   HWIO_GSBI2_SPI_ERROR_FLAGS_ADDR                             0xAE000034
 Y.CREATE.L   GSBI2_SPI_ERROR_FLAGS                                       0xAE000034
 Y.CREATE.L   HWIO_GSBI2_SPI_ERROR_FLAGS_EN_ADDR                          0xAE000038
 Y.CREATE.L   GSBI2_SPI_ERROR_FLAGS_EN                                    0xAE000038
 Y.CREATE.L   HWIO_GSBI2_SPI_DEASSERT_WAIT_ADDR                           0xAE00003C
 Y.CREATE.L   GSBI2_SPI_DEASSERT_WAIT                                     0xAE00003C
 Y.CREATE.L   HWIO_GSBI2_SPI_OUTPUT_DEBUG_ADDR                            0xAE000040
 Y.CREATE.L   GSBI2_SPI_OUTPUT_DEBUG                                      0xAE000040
 Y.CREATE.L   HWIO_GSBI2_SPI_INPUT_DEBUG_ADDR                             0xAE000044
 Y.CREATE.L   GSBI2_SPI_INPUT_DEBUG                                       0xAE000044
 Y.CREATE.L   HWIO_GSBI2_SPI_FIFO_WORD_CNT_ADDR                           0xAE000048
 Y.CREATE.L   GSBI2_SPI_FIFO_WORD_CNT                                     0xAE000048
 Y.CREATE.L   HWIO_GSBI2_SPI_TEST_CTRL_ADDR                               0xAE00004C
 Y.CREATE.L   GSBI2_SPI_TEST_CTRL                                         0xAE00004C
 Y.CREATE.L   HWIO_GSBI2_SPI_OUTPUT_FIFO_ADDR                             0xAE000100
 Y.CREATE.L   GSBI2_SPI_OUTPUT_FIFO                                       0xAE000100
 Y.CREATE.L   HWIO_GSBI2_SPI_INPUT_FIFO_ADDR                              0xAE000200
 Y.CREATE.L   GSBI2_SPI_INPUT_FIFO                                        0xAE000200
 Y.CREATE.L   HWIO_UART_DM_MR1_ADDR                                       0xF0000000
 Y.CREATE.L   UART_DM_MR1                                                 0xF0000000
 Y.CREATE.L   HWIO_UART_DM_MR2_ADDR                                       0xF0000004
 Y.CREATE.L   UART_DM_MR2                                                 0xF0000004
 Y.CREATE.L   HWIO_UART_DM_CSR_ADDR                                       0xF0000008
 Y.CREATE.L   UART_DM_CSR                                                 0xF0000008
 Y.CREATE.L   HWIO_UART_DM_TF_ADDR                                        0xF0000070
 Y.CREATE.L   UART_DM_TF                                                  0xF0000070
 Y.CREATE.L   HWIO_UART_DM_TF_2_ADDR                                      0xF0000074
 Y.CREATE.L   UART_DM_TF_2                                                0xF0000074
 Y.CREATE.L   HWIO_UART_DM_TF_3_ADDR                                      0xF0000078
 Y.CREATE.L   UART_DM_TF_3                                                0xF0000078
 Y.CREATE.L   HWIO_UART_DM_TF_4_ADDR                                      0xF000007C
 Y.CREATE.L   UART_DM_TF_4                                                0xF000007C
 Y.CREATE.L   HWIO_UART_DM_CR_ADDR                                        0xF0000010
 Y.CREATE.L   UART_DM_CR                                                  0xF0000010
 Y.CREATE.L   HWIO_UART_DM_IMR_ADDR                                       0xF0000014
 Y.CREATE.L   UART_DM_IMR                                                 0xF0000014
 Y.CREATE.L   HWIO_UART_DM_IPR_ADDR                                       0xF0000018
 Y.CREATE.L   UART_DM_IPR                                                 0xF0000018
 Y.CREATE.L   HWIO_UART_DM_TFWR_ADDR                                      0xF000001C
 Y.CREATE.L   UART_DM_TFWR                                                0xF000001C
 Y.CREATE.L   HWIO_UART_DM_RFWR_ADDR                                      0xF0000020
 Y.CREATE.L   UART_DM_RFWR                                                0xF0000020
 Y.CREATE.L   HWIO_UART_DM_HCR_ADDR                                       0xF0000024
 Y.CREATE.L   UART_DM_HCR                                                 0xF0000024
 Y.CREATE.L   HWIO_UART_DM_DMRX_ADDR                                      0xF0000034
 Y.CREATE.L   UART_DM_DMRX                                                0xF0000034
 Y.CREATE.L   HWIO_UART_DM_IRDA_ADDR                                      0xF0000038
 Y.CREATE.L   UART_DM_IRDA                                                0xF0000038
 Y.CREATE.L   HWIO_UART_DM_DMEN_ADDR                                      0xF000003C
 Y.CREATE.L   UART_DM_DMEN                                                0xF000003C
 Y.CREATE.L   HWIO_UART_DM_NO_CHARS_FOR_TX_ADDR                           0xF0000040
 Y.CREATE.L   UART_DM_NO_CHARS_FOR_TX                                     0xF0000040
 Y.CREATE.L   HWIO_UART_DM_BADR_ADDR                                      0xF0000044
 Y.CREATE.L   UART_DM_BADR                                                0xF0000044
 Y.CREATE.L   HWIO_UART_DM_TESTSL_ADDR                                    0xF0000048
 Y.CREATE.L   UART_DM_TESTSL                                              0xF0000048
 Y.CREATE.L   HWIO_UART_DM_MISR_MODE_ADDR                                 0xF0000060
 Y.CREATE.L   UART_DM_MISR_MODE                                           0xF0000060
 Y.CREATE.L   HWIO_UART_DM_MISR_RESET_ADDR                                0xF0000064
 Y.CREATE.L   UART_DM_MISR_RESET                                          0xF0000064
 Y.CREATE.L   HWIO_UART_DM_MISR_EXPORT_ADDR                               0xF0000068
 Y.CREATE.L   UART_DM_MISR_EXPORT                                         0xF0000068
 Y.CREATE.L   HWIO_UART_DM_MISR_VAL_ADDR                                  0xF000006C
 Y.CREATE.L   UART_DM_MISR_VAL                                            0xF000006C
 Y.CREATE.L   HWIO_UART_DM_SIM_CFG_ADDR                                   0xF0000080
 Y.CREATE.L   UART_DM_SIM_CFG                                             0xF0000080
 Y.CREATE.L   HWIO_UART_DM_TEST_WR_ADDR_ADDR                              0xF0000084
 Y.CREATE.L   UART_DM_TEST_WR_ADDR                                        0xF0000084
 Y.CREATE.L   HWIO_UART_DM_TEST_WR_DATA_ADDR                              0xF0000088
 Y.CREATE.L   UART_DM_TEST_WR_DATA                                        0xF0000088
 Y.CREATE.L   HWIO_UART_DM_TEST_RD_ADDR_ADDR                              0xF000008C
 Y.CREATE.L   UART_DM_TEST_RD_ADDR                                        0xF000008C
 Y.CREATE.L   HWIO_UART_DM_SR_ADDR                                        0xF0000008
 Y.CREATE.L   UART_DM_SR                                                  0xF0000008
 Y.CREATE.L   HWIO_UART_DM_RF_ADDR                                        0xF0000070
 Y.CREATE.L   UART_DM_RF                                                  0xF0000070
 Y.CREATE.L   HWIO_UART_DM_RF_2_ADDR                                      0xF0000074
 Y.CREATE.L   UART_DM_RF_2                                                0xF0000074
 Y.CREATE.L   HWIO_UART_DM_RF_3_ADDR                                      0xF0000078
 Y.CREATE.L   UART_DM_RF_3                                                0xF0000078
 Y.CREATE.L   HWIO_UART_DM_RF_4_ADDR                                      0xF000007C
 Y.CREATE.L   UART_DM_RF_4                                                0xF000007C
 Y.CREATE.L   HWIO_UART_DM_MISR_ADDR                                      0xF0000010
 Y.CREATE.L   UART_DM_MISR                                                0xF0000010
 Y.CREATE.L   HWIO_UART_DM_ISR_ADDR                                       0xF0000014
 Y.CREATE.L   UART_DM_ISR                                                 0xF0000014
 Y.CREATE.L   HWIO_UART_DM_RX_TOTAL_SNAP_ADDR                             0xF0000038
 Y.CREATE.L   UART_DM_RX_TOTAL_SNAP                                       0xF0000038
 Y.CREATE.L   HWIO_UART_DM_TXFS_ADDR                                      0xF000004C
 Y.CREATE.L   UART_DM_TXFS                                                0xF000004C
 Y.CREATE.L   HWIO_UART_DM_RXFS_ADDR                                      0xF0000050
 Y.CREATE.L   UART_DM_RXFS                                                0xF0000050
 Y.CREATE.L   HWIO_UART_DM_TEST_RD_DATA_ADDR                              0xF0000090
 Y.CREATE.L   UART_DM_TEST_RD_DATA                                        0xF0000090
 Y.CREATE.L   HWIO_NAND_FLASH_CMD_ADDR                                    0x80008000
 Y.CREATE.L   NAND_FLASH_CMD                                              0x80008000
 Y.CREATE.L   HWIO_NAND_ADDR0_ADDR                                        0x80008004
 Y.CREATE.L   NAND_ADDR0                                                  0x80008004
 Y.CREATE.L   HWIO_NAND_ADDR1_ADDR                                        0x80008008
 Y.CREATE.L   NAND_ADDR1                                                  0x80008008
 Y.CREATE.L   HWIO_NAND_FLASH_CHIP_SELECT_ADDR                            0x8000800C
 Y.CREATE.L   NAND_FLASH_CHIP_SELECT                                      0x8000800C
 Y.CREATE.L   HWIO_NANDC_EXEC_CMD_ADDR                                    0x80008010
 Y.CREATE.L   NANDC_EXEC_CMD                                              0x80008010
 Y.CREATE.L   HWIO_NAND_FLASH_STATUS_ADDR                                 0x80008014
 Y.CREATE.L   NAND_FLASH_STATUS                                           0x80008014
 Y.CREATE.L   HWIO_NANDC_BUFFER_STATUS_ADDR                               0x80008018
 Y.CREATE.L   NANDC_BUFFER_STATUS                                         0x80008018
 Y.CREATE.L   HWIO_NAND_DEV0_CFG0_ADDR                                    0x80008020
 Y.CREATE.L   NAND_DEV0_CFG0                                              0x80008020
 Y.CREATE.L   HWIO_NAND_DEV1_CFG0_ADDR                                    0x80008030
 Y.CREATE.L   NAND_DEV1_CFG0                                              0x80008030
 Y.CREATE.L   HWIO_NAND_DEV0_CFG1_ADDR                                    0x80008024
 Y.CREATE.L   NAND_DEV0_CFG1                                              0x80008024
 Y.CREATE.L   HWIO_NAND_DEV1_CFG1_ADDR                                    0x80008034
 Y.CREATE.L   NAND_DEV1_CFG1                                              0x80008034
 Y.CREATE.L   HWIO_NAND_FLASH_READ_ID_ADDR                                0x80008040
 Y.CREATE.L   NAND_FLASH_READ_ID                                          0x80008040
 Y.CREATE.L   HWIO_NAND_FLASH_READ_STATUS_ADDR                            0x80008044
 Y.CREATE.L   NAND_FLASH_READ_STATUS                                      0x80008044
 Y.CREATE.L   HWIO_NAND_CONTROLLER_CFG_ADDR                               0x80008048
 Y.CREATE.L   NAND_CONTROLLER_CFG                                         0x80008048
 Y.CREATE.L   HWIO_NAND_FLASH_CONFIG_DATA_ADDR                            0x80008050
 Y.CREATE.L   NAND_FLASH_CONFIG_DATA                                      0x80008050
 Y.CREATE.L   HWIO_NAND_FLASH_CONFIG_ADDR                                 0x80008054
 Y.CREATE.L   NAND_FLASH_CONFIG                                           0x80008054
 Y.CREATE.L   HWIO_NAND_FLASH_CONFIG_MODE_ADDR                            0x80008058
 Y.CREATE.L   NAND_FLASH_CONFIG_MODE                                      0x80008058
 Y.CREATE.L   HWIO_NAND_FLASH_CONFIG_STATUS_ADDR                          0x80008060
 Y.CREATE.L   NAND_FLASH_CONFIG_STATUS                                    0x80008060
 Y.CREATE.L   HWIO_FLASH_MACRO1_REG_ADDR                                  0x80008064
 Y.CREATE.L   FLASH_MACRO1_REG                                            0x80008064
 Y.CREATE.L   HWIO_FLASH_XFR_STEP1_ADDR                                   0x80008070
 Y.CREATE.L   FLASH_XFR_STEP1                                             0x80008070
 Y.CREATE.L   HWIO_FLASH_XFR_STEP2_ADDR                                   0x80008074
 Y.CREATE.L   FLASH_XFR_STEP2                                             0x80008074
 Y.CREATE.L   HWIO_FLASH_XFR_STEP3_ADDR                                   0x80008078
 Y.CREATE.L   FLASH_XFR_STEP3                                             0x80008078
 Y.CREATE.L   HWIO_FLASH_XFR_STEP4_ADDR                                   0x8000807C
 Y.CREATE.L   FLASH_XFR_STEP4                                             0x8000807C
 Y.CREATE.L   HWIO_FLASH_XFR_STEP5_ADDR                                   0x80008080
 Y.CREATE.L   FLASH_XFR_STEP5                                             0x80008080
 Y.CREATE.L   HWIO_FLASH_XFR_STEP6_ADDR                                   0x80008084
 Y.CREATE.L   FLASH_XFR_STEP6                                             0x80008084
 Y.CREATE.L   HWIO_FLASH_XFR_STEP7_ADDR                                   0x80008088
 Y.CREATE.L   FLASH_XFR_STEP7                                             0x80008088
 Y.CREATE.L   HWIO_NAND_CTLR_DEBUG_BUS_CFG_ADDR                           0x8000808C
 Y.CREATE.L   NAND_CTLR_DEBUG_BUS_CFG                                     0x8000808C
 Y.CREATE.L   HWIO_FLASH_DEV_CMD0_ADDR                                    0x800080A0
 Y.CREATE.L   FLASH_DEV_CMD0                                              0x800080A0
 Y.CREATE.L   HWIO_FLASH_DEV_CMD1_ADDR                                    0x800080A4
 Y.CREATE.L   FLASH_DEV_CMD1                                              0x800080A4
 Y.CREATE.L   HWIO_FLASH_DEV_CMD2_ADDR                                    0x800080A8
 Y.CREATE.L   FLASH_DEV_CMD2                                              0x800080A8
 Y.CREATE.L   HWIO_FLASH_DEV_CMD_VLD_ADDR                                 0x800080AC
 Y.CREATE.L   FLASH_DEV_CMD_VLD                                           0x800080AC
 Y.CREATE.L   HWIO_EBI2_MISR_SIG_REG_ADDR                                 0x800080B0
 Y.CREATE.L   EBI2_MISR_SIG_REG                                           0x800080B0
 Y.CREATE.L   HWIO_NAND_ADDR2_ADDR                                        0x800080C0
 Y.CREATE.L   NAND_ADDR2                                                  0x800080C0
 Y.CREATE.L   HWIO_NAND_ADDR3_ADDR                                        0x800080C4
 Y.CREATE.L   NAND_ADDR3                                                  0x800080C4
 Y.CREATE.L   HWIO_NAND_ADDR4_ADDR                                        0x800080C8
 Y.CREATE.L   NAND_ADDR4                                                  0x800080C8
 Y.CREATE.L   HWIO_NAND_ADDR5_ADDR                                        0x800080CC
 Y.CREATE.L   NAND_ADDR5                                                  0x800080CC
 Y.CREATE.L   HWIO_FLASH_DEV_CMD3_ADDR                                    0x800080D0
 Y.CREATE.L   FLASH_DEV_CMD3                                              0x800080D0
 Y.CREATE.L   HWIO_FLASH_DEV_CMD4_ADDR                                    0x800080D4
 Y.CREATE.L   FLASH_DEV_CMD4                                              0x800080D4
 Y.CREATE.L   HWIO_FLASH_DEV_CMD5_ADDR                                    0x800080D8
 Y.CREATE.L   FLASH_DEV_CMD5                                              0x800080D8
 Y.CREATE.L   HWIO_FLASH_DEV_CMD6_ADDR                                    0x800080DC
 Y.CREATE.L   FLASH_DEV_CMD6                                              0x800080DC
 Y.CREATE.L   HWIO_FLASH_BURST_CFG_ADDR                                   0x800080E0
 Y.CREATE.L   FLASH_BURST_CFG                                             0x800080E0
 Y.CREATE.L   HWIO_EBI2_ECC_BUF_CFG_ADDR                                  0x800080F0
 Y.CREATE.L   EBI2_ECC_BUF_CFG                                            0x800080F0
 Y.CREATE.L   HWIO_NAND_FLASH_BIT_STREAM_ADDR                             0x800080F4
 Y.CREATE.L   NAND_FLASH_BIT_STREAM                                       0x800080F4
 Y.CREATE.L   HWIO_FLASH_BUFF0_ACC_ADDR                                   0x80008100
 Y.CREATE.L   FLASH_BUFF0_ACC                                             0x80008100
 Y.CREATE.L   HWIO_FLASH_BUFF1_ACC_ADDR                                   0x80008104
 Y.CREATE.L   FLASH_BUFF1_ACC                                             0x80008104
 Y.CREATE.L   HWIO_FLASH_BUFF2_ACC_ADDR                                   0x80008108
 Y.CREATE.L   FLASH_BUFF2_ACC                                             0x80008108
 Y.CREATE.L   HWIO_FLASH_BUFF3_ACC_ADDR                                   0x8000810C
 Y.CREATE.L   FLASH_BUFF3_ACC                                             0x8000810C
 Y.CREATE.L   HWIO_FLASH_BUFF4_ACC_ADDR                                   0x80008110
 Y.CREATE.L   FLASH_BUFF4_ACC                                             0x80008110
 Y.CREATE.L   HWIO_FLASH_BUFF5_ACC_ADDR                                   0x80008114
 Y.CREATE.L   FLASH_BUFF5_ACC                                             0x80008114
 Y.CREATE.L   HWIO_FLASH_BUFF6_ACC_ADDR                                   0x80008118
 Y.CREATE.L   FLASH_BUFF6_ACC                                             0x80008118
 Y.CREATE.L   HWIO_FLASH_BUFF7_ACC_ADDR                                   0x8000811C
 Y.CREATE.L   FLASH_BUFF7_ACC                                             0x8000811C
 Y.CREATE.L   HWIO_FLASH_BUFF8_ACC_ADDR                                   0x80008120
 Y.CREATE.L   FLASH_BUFF8_ACC                                             0x80008120
 Y.CREATE.L   HWIO_FLASH_BUFF9_ACC_ADDR                                   0x80008124
 Y.CREATE.L   FLASH_BUFF9_ACC                                             0x80008124
 Y.CREATE.L   HWIO_FLASH_BUFF10_ACC_ADDR                                  0x80008128
 Y.CREATE.L   FLASH_BUFF10_ACC                                            0x80008128
 Y.CREATE.L   HWIO_FLASH_BUFF11_ACC_ADDR                                  0x8000812C
 Y.CREATE.L   FLASH_BUFF11_ACC                                            0x8000812C
 Y.CREATE.L   HWIO_FLASH_BUFF12_ACC_ADDR                                  0x80008130
 Y.CREATE.L   FLASH_BUFF12_ACC                                            0x80008130
 Y.CREATE.L   HWIO_FLASH_BUFF13_ACC_ADDR                                  0x80008134
 Y.CREATE.L   FLASH_BUFF13_ACC                                            0x80008134
 Y.CREATE.L   HWIO_FLASH_BUFF14_ACC_ADDR                                  0x80008138
 Y.CREATE.L   FLASH_BUFF14_ACC                                            0x80008138
 Y.CREATE.L   HWIO_FLASH_BUFF15_ACC_ADDR                                  0x8000813C
 Y.CREATE.L   FLASH_BUFF15_ACC                                            0x8000813C
 Y.CREATE.L   HWIO_FLASH_BUFF16_ACC_ADDR                                  0x80008140
 Y.CREATE.L   FLASH_BUFF16_ACC                                            0x80008140
 Y.CREATE.L   HWIO_FLASH_BUFF17_ACC_ADDR                                  0x80008144
 Y.CREATE.L   FLASH_BUFF17_ACC                                            0x80008144
 Y.CREATE.L   HWIO_FLASH_BUFF18_ACC_ADDR                                  0x80008148
 Y.CREATE.L   FLASH_BUFF18_ACC                                            0x80008148
 Y.CREATE.L   HWIO_FLASH_BUFF19_ACC_ADDR                                  0x8000814C
 Y.CREATE.L   FLASH_BUFF19_ACC                                            0x8000814C
 Y.CREATE.L   HWIO_FLASH_BUFF20_ACC_ADDR                                  0x80008150
 Y.CREATE.L   FLASH_BUFF20_ACC                                            0x80008150
 Y.CREATE.L   HWIO_FLASH_BUFF21_ACC_ADDR                                  0x80008154
 Y.CREATE.L   FLASH_BUFF21_ACC                                            0x80008154
 Y.CREATE.L   HWIO_FLASH_BUFF22_ACC_ADDR                                  0x80008158
 Y.CREATE.L   FLASH_BUFF22_ACC                                            0x80008158
 Y.CREATE.L   HWIO_FLASH_BUFF23_ACC_ADDR                                  0x8000815C
 Y.CREATE.L   FLASH_BUFF23_ACC                                            0x8000815C
 Y.CREATE.L   HWIO_FLASH_BUFF24_ACC_ADDR                                  0x80008160
 Y.CREATE.L   FLASH_BUFF24_ACC                                            0x80008160
 Y.CREATE.L   HWIO_FLASH_BUFF25_ACC_ADDR                                  0x80008164
 Y.CREATE.L   FLASH_BUFF25_ACC                                            0x80008164
 Y.CREATE.L   HWIO_FLASH_BUFF26_ACC_ADDR                                  0x80008168
 Y.CREATE.L   FLASH_BUFF26_ACC                                            0x80008168
 Y.CREATE.L   HWIO_FLASH_BUFF27_ACC_ADDR                                  0x8000816C
 Y.CREATE.L   FLASH_BUFF27_ACC                                            0x8000816C
 Y.CREATE.L   HWIO_FLASH_BUFF28_ACC_ADDR                                  0x80008170
 Y.CREATE.L   FLASH_BUFF28_ACC                                            0x80008170
 Y.CREATE.L   HWIO_FLASH_BUFF29_ACC_ADDR                                  0x80008174
 Y.CREATE.L   FLASH_BUFF29_ACC                                            0x80008174
 Y.CREATE.L   HWIO_FLASH_BUFF30_ACC_ADDR                                  0x80008178
 Y.CREATE.L   FLASH_BUFF30_ACC                                            0x80008178
 Y.CREATE.L   HWIO_FLASH_BUFF31_ACC_ADDR                                  0x8000817C
 Y.CREATE.L   FLASH_BUFF31_ACC                                            0x8000817C
 Y.CREATE.L   HWIO_FLASH_BUFF32_ACC_ADDR                                  0x80008180
 Y.CREATE.L   FLASH_BUFF32_ACC                                            0x80008180
 Y.CREATE.L   HWIO_FLASH_BUFF33_ACC_ADDR                                  0x80008184
 Y.CREATE.L   FLASH_BUFF33_ACC                                            0x80008184
 Y.CREATE.L   HWIO_FLASH_BUFF34_ACC_ADDR                                  0x80008188
 Y.CREATE.L   FLASH_BUFF34_ACC                                            0x80008188
 Y.CREATE.L   HWIO_FLASH_BUFF35_ACC_ADDR                                  0x8000818C
 Y.CREATE.L   FLASH_BUFF35_ACC                                            0x8000818C
 Y.CREATE.L   HWIO_FLASH_BUFF36_ACC_ADDR                                  0x80008190
 Y.CREATE.L   FLASH_BUFF36_ACC                                            0x80008190
 Y.CREATE.L   HWIO_FLASH_BUFF37_ACC_ADDR                                  0x80008194
 Y.CREATE.L   FLASH_BUFF37_ACC                                            0x80008194
 Y.CREATE.L   HWIO_FLASH_BUFF38_ACC_ADDR                                  0x80008198
 Y.CREATE.L   FLASH_BUFF38_ACC                                            0x80008198
 Y.CREATE.L   HWIO_FLASH_BUFF39_ACC_ADDR                                  0x8000819C
 Y.CREATE.L   FLASH_BUFF39_ACC                                            0x8000819C
 Y.CREATE.L   HWIO_FLASH_BUFF40_ACC_ADDR                                  0x800081A0
 Y.CREATE.L   FLASH_BUFF40_ACC                                            0x800081A0
 Y.CREATE.L   HWIO_FLASH_BUFF41_ACC_ADDR                                  0x800081A4
 Y.CREATE.L   FLASH_BUFF41_ACC                                            0x800081A4
 Y.CREATE.L   HWIO_FLASH_BUFF42_ACC_ADDR                                  0x800081A8
 Y.CREATE.L   FLASH_BUFF42_ACC                                            0x800081A8
 Y.CREATE.L   HWIO_FLASH_BUFF43_ACC_ADDR                                  0x800081AC
 Y.CREATE.L   FLASH_BUFF43_ACC                                            0x800081AC
 Y.CREATE.L   HWIO_FLASH_BUFF44_ACC_ADDR                                  0x800081B0
 Y.CREATE.L   FLASH_BUFF44_ACC                                            0x800081B0
 Y.CREATE.L   HWIO_FLASH_BUFF45_ACC_ADDR                                  0x800081B4
 Y.CREATE.L   FLASH_BUFF45_ACC                                            0x800081B4
 Y.CREATE.L   HWIO_FLASH_BUFF46_ACC_ADDR                                  0x800081B8
 Y.CREATE.L   FLASH_BUFF46_ACC                                            0x800081B8
 Y.CREATE.L   HWIO_FLASH_BUFF47_ACC_ADDR                                  0x800081BC
 Y.CREATE.L   FLASH_BUFF47_ACC                                            0x800081BC
 Y.CREATE.L   HWIO_FLASH_BUFF48_ACC_ADDR                                  0x800081C0
 Y.CREATE.L   FLASH_BUFF48_ACC                                            0x800081C0
 Y.CREATE.L   HWIO_FLASH_BUFF49_ACC_ADDR                                  0x800081C4
 Y.CREATE.L   FLASH_BUFF49_ACC                                            0x800081C4
 Y.CREATE.L   HWIO_FLASH_BUFF50_ACC_ADDR                                  0x800081C8
 Y.CREATE.L   FLASH_BUFF50_ACC                                            0x800081C8
 Y.CREATE.L   HWIO_FLASH_BUFF51_ACC_ADDR                                  0x800081CC
 Y.CREATE.L   FLASH_BUFF51_ACC                                            0x800081CC
 Y.CREATE.L   HWIO_FLASH_BUFF52_ACC_ADDR                                  0x800081D0
 Y.CREATE.L   FLASH_BUFF52_ACC                                            0x800081D0
 Y.CREATE.L   HWIO_FLASH_BUFF53_ACC_ADDR                                  0x800081D4
 Y.CREATE.L   FLASH_BUFF53_ACC                                            0x800081D4
 Y.CREATE.L   HWIO_FLASH_BUFF54_ACC_ADDR                                  0x800081D8
 Y.CREATE.L   FLASH_BUFF54_ACC                                            0x800081D8
 Y.CREATE.L   HWIO_FLASH_BUFF55_ACC_ADDR                                  0x800081DC
 Y.CREATE.L   FLASH_BUFF55_ACC                                            0x800081DC
 Y.CREATE.L   HWIO_FLASH_BUFF56_ACC_ADDR                                  0x800081E0
 Y.CREATE.L   FLASH_BUFF56_ACC                                            0x800081E0
 Y.CREATE.L   HWIO_FLASH_BUFF57_ACC_ADDR                                  0x800081E4
 Y.CREATE.L   FLASH_BUFF57_ACC                                            0x800081E4
 Y.CREATE.L   HWIO_FLASH_BUFF58_ACC_ADDR                                  0x800081E8
 Y.CREATE.L   FLASH_BUFF58_ACC                                            0x800081E8
 Y.CREATE.L   HWIO_FLASH_BUFF59_ACC_ADDR                                  0x800081EC
 Y.CREATE.L   FLASH_BUFF59_ACC                                            0x800081EC
 Y.CREATE.L   HWIO_FLASH_BUFF60_ACC_ADDR                                  0x800081F0
 Y.CREATE.L   FLASH_BUFF60_ACC                                            0x800081F0
 Y.CREATE.L   HWIO_FLASH_BUFF61_ACC_ADDR                                  0x800081F4
 Y.CREATE.L   FLASH_BUFF61_ACC                                            0x800081F4
 Y.CREATE.L   HWIO_FLASH_BUFF62_ACC_ADDR                                  0x800081F8
 Y.CREATE.L   FLASH_BUFF62_ACC                                            0x800081F8
 Y.CREATE.L   HWIO_FLASH_BUFF63_ACC_ADDR                                  0x800081FC
 Y.CREATE.L   FLASH_BUFF63_ACC                                            0x800081FC
 Y.CREATE.L   HWIO_FLASH_BUFF64_ACC_ADDR                                  0x80008200
 Y.CREATE.L   FLASH_BUFF64_ACC                                            0x80008200
 Y.CREATE.L   HWIO_FLASH_BUFF65_ACC_ADDR                                  0x80008204
 Y.CREATE.L   FLASH_BUFF65_ACC                                            0x80008204
 Y.CREATE.L   HWIO_FLASH_BUFF66_ACC_ADDR                                  0x80008208
 Y.CREATE.L   FLASH_BUFF66_ACC                                            0x80008208
 Y.CREATE.L   HWIO_FLASH_BUFF67_ACC_ADDR                                  0x8000820C
 Y.CREATE.L   FLASH_BUFF67_ACC                                            0x8000820C
 Y.CREATE.L   HWIO_FLASH_BUFF68_ACC_ADDR                                  0x80008210
 Y.CREATE.L   FLASH_BUFF68_ACC                                            0x80008210
 Y.CREATE.L   HWIO_FLASH_BUFF69_ACC_ADDR                                  0x80008214
 Y.CREATE.L   FLASH_BUFF69_ACC                                            0x80008214
 Y.CREATE.L   HWIO_FLASH_BUFF70_ACC_ADDR                                  0x80008218
 Y.CREATE.L   FLASH_BUFF70_ACC                                            0x80008218
 Y.CREATE.L   HWIO_FLASH_BUFF71_ACC_ADDR                                  0x8000821C
 Y.CREATE.L   FLASH_BUFF71_ACC                                            0x8000821C
 Y.CREATE.L   HWIO_FLASH_BUFF72_ACC_ADDR                                  0x80008220
 Y.CREATE.L   FLASH_BUFF72_ACC                                            0x80008220
 Y.CREATE.L   HWIO_FLASH_BUFF73_ACC_ADDR                                  0x80008224
 Y.CREATE.L   FLASH_BUFF73_ACC                                            0x80008224
 Y.CREATE.L   HWIO_FLASH_BUFF74_ACC_ADDR                                  0x80008228
 Y.CREATE.L   FLASH_BUFF74_ACC                                            0x80008228
 Y.CREATE.L   HWIO_FLASH_BUFF75_ACC_ADDR                                  0x8000822C
 Y.CREATE.L   FLASH_BUFF75_ACC                                            0x8000822C
 Y.CREATE.L   HWIO_FLASH_BUFF76_ACC_ADDR                                  0x80008230
 Y.CREATE.L   FLASH_BUFF76_ACC                                            0x80008230
 Y.CREATE.L   HWIO_FLASH_BUFF77_ACC_ADDR                                  0x80008234
 Y.CREATE.L   FLASH_BUFF77_ACC                                            0x80008234
 Y.CREATE.L   HWIO_FLASH_BUFF78_ACC_ADDR                                  0x80008238
 Y.CREATE.L   FLASH_BUFF78_ACC                                            0x80008238
 Y.CREATE.L   HWIO_FLASH_BUFF79_ACC_ADDR                                  0x8000823C
 Y.CREATE.L   FLASH_BUFF79_ACC                                            0x8000823C
 Y.CREATE.L   HWIO_FLASH_BUFF80_ACC_ADDR                                  0x80008240
 Y.CREATE.L   FLASH_BUFF80_ACC                                            0x80008240
 Y.CREATE.L   HWIO_FLASH_BUFF81_ACC_ADDR                                  0x80008244
 Y.CREATE.L   FLASH_BUFF81_ACC                                            0x80008244
 Y.CREATE.L   HWIO_FLASH_BUFF82_ACC_ADDR                                  0x80008248
 Y.CREATE.L   FLASH_BUFF82_ACC                                            0x80008248
 Y.CREATE.L   HWIO_FLASH_BUFF83_ACC_ADDR                                  0x8000824C
 Y.CREATE.L   FLASH_BUFF83_ACC                                            0x8000824C
 Y.CREATE.L   HWIO_FLASH_BUFF84_ACC_ADDR                                  0x80008250
 Y.CREATE.L   FLASH_BUFF84_ACC                                            0x80008250
 Y.CREATE.L   HWIO_FLASH_BUFF85_ACC_ADDR                                  0x80008254
 Y.CREATE.L   FLASH_BUFF85_ACC                                            0x80008254
 Y.CREATE.L   HWIO_FLASH_BUFF86_ACC_ADDR                                  0x80008258
 Y.CREATE.L   FLASH_BUFF86_ACC                                            0x80008258
 Y.CREATE.L   HWIO_FLASH_BUFF87_ACC_ADDR                                  0x8000825C
 Y.CREATE.L   FLASH_BUFF87_ACC                                            0x8000825C
 Y.CREATE.L   HWIO_FLASH_BUFF88_ACC_ADDR                                  0x80008260
 Y.CREATE.L   FLASH_BUFF88_ACC                                            0x80008260
 Y.CREATE.L   HWIO_FLASH_BUFF89_ACC_ADDR                                  0x80008264
 Y.CREATE.L   FLASH_BUFF89_ACC                                            0x80008264
 Y.CREATE.L   HWIO_FLASH_BUFF90_ACC_ADDR                                  0x80008268
 Y.CREATE.L   FLASH_BUFF90_ACC                                            0x80008268
 Y.CREATE.L   HWIO_FLASH_BUFF91_ACC_ADDR                                  0x8000826C
 Y.CREATE.L   FLASH_BUFF91_ACC                                            0x8000826C
 Y.CREATE.L   HWIO_FLASH_BUFF92_ACC_ADDR                                  0x80008270
 Y.CREATE.L   FLASH_BUFF92_ACC                                            0x80008270
 Y.CREATE.L   HWIO_FLASH_BUFF93_ACC_ADDR                                  0x80008274
 Y.CREATE.L   FLASH_BUFF93_ACC                                            0x80008274
 Y.CREATE.L   HWIO_FLASH_BUFF94_ACC_ADDR                                  0x80008278
 Y.CREATE.L   FLASH_BUFF94_ACC                                            0x80008278
 Y.CREATE.L   HWIO_FLASH_BUFF95_ACC_ADDR                                  0x8000827C
 Y.CREATE.L   FLASH_BUFF95_ACC                                            0x8000827C
 Y.CREATE.L   HWIO_FLASH_BUFF96_ACC_ADDR                                  0x80008280
 Y.CREATE.L   FLASH_BUFF96_ACC                                            0x80008280
 Y.CREATE.L   HWIO_FLASH_BUFF97_ACC_ADDR                                  0x80008284
 Y.CREATE.L   FLASH_BUFF97_ACC                                            0x80008284
 Y.CREATE.L   HWIO_FLASH_BUFF98_ACC_ADDR                                  0x80008288
 Y.CREATE.L   FLASH_BUFF98_ACC                                            0x80008288
 Y.CREATE.L   HWIO_FLASH_BUFF99_ACC_ADDR                                  0x8000828C
 Y.CREATE.L   FLASH_BUFF99_ACC                                            0x8000828C
 Y.CREATE.L   HWIO_FLASH_BUFF100_ACC_ADDR                                 0x80008290
 Y.CREATE.L   FLASH_BUFF100_ACC                                           0x80008290
 Y.CREATE.L   HWIO_FLASH_BUFF101_ACC_ADDR                                 0x80008294
 Y.CREATE.L   FLASH_BUFF101_ACC                                           0x80008294
 Y.CREATE.L   HWIO_FLASH_BUFF102_ACC_ADDR                                 0x80008298
 Y.CREATE.L   FLASH_BUFF102_ACC                                           0x80008298
 Y.CREATE.L   HWIO_FLASH_BUFF103_ACC_ADDR                                 0x8000829C
 Y.CREATE.L   FLASH_BUFF103_ACC                                           0x8000829C
 Y.CREATE.L   HWIO_FLASH_BUFF104_ACC_ADDR                                 0x800082A0
 Y.CREATE.L   FLASH_BUFF104_ACC                                           0x800082A0
 Y.CREATE.L   HWIO_FLASH_BUFF105_ACC_ADDR                                 0x800082A4
 Y.CREATE.L   FLASH_BUFF105_ACC                                           0x800082A4
 Y.CREATE.L   HWIO_FLASH_BUFF106_ACC_ADDR                                 0x800082A8
 Y.CREATE.L   FLASH_BUFF106_ACC                                           0x800082A8
 Y.CREATE.L   HWIO_FLASH_BUFF107_ACC_ADDR                                 0x800082AC
 Y.CREATE.L   FLASH_BUFF107_ACC                                           0x800082AC
 Y.CREATE.L   HWIO_FLASH_BUFF108_ACC_ADDR                                 0x800082B0
 Y.CREATE.L   FLASH_BUFF108_ACC                                           0x800082B0
 Y.CREATE.L   HWIO_FLASH_BUFF109_ACC_ADDR                                 0x800082B4
 Y.CREATE.L   FLASH_BUFF109_ACC                                           0x800082B4
 Y.CREATE.L   HWIO_FLASH_BUFF110_ACC_ADDR                                 0x800082B8
 Y.CREATE.L   FLASH_BUFF110_ACC                                           0x800082B8
 Y.CREATE.L   HWIO_FLASH_BUFF111_ACC_ADDR                                 0x800082BC
 Y.CREATE.L   FLASH_BUFF111_ACC                                           0x800082BC
 Y.CREATE.L   HWIO_FLASH_BUFF112_ACC_ADDR                                 0x800082C0
 Y.CREATE.L   FLASH_BUFF112_ACC                                           0x800082C0
 Y.CREATE.L   HWIO_FLASH_BUFF113_ACC_ADDR                                 0x800082C4
 Y.CREATE.L   FLASH_BUFF113_ACC                                           0x800082C4
 Y.CREATE.L   HWIO_FLASH_BUFF114_ACC_ADDR                                 0x800082C8
 Y.CREATE.L   FLASH_BUFF114_ACC                                           0x800082C8
 Y.CREATE.L   HWIO_FLASH_BUFF115_ACC_ADDR                                 0x800082CC
 Y.CREATE.L   FLASH_BUFF115_ACC                                           0x800082CC
 Y.CREATE.L   HWIO_FLASH_BUFF116_ACC_ADDR                                 0x800082D0
 Y.CREATE.L   FLASH_BUFF116_ACC                                           0x800082D0
 Y.CREATE.L   HWIO_FLASH_BUFF117_ACC_ADDR                                 0x800082D4
 Y.CREATE.L   FLASH_BUFF117_ACC                                           0x800082D4
 Y.CREATE.L   HWIO_FLASH_BUFF118_ACC_ADDR                                 0x800082D8
 Y.CREATE.L   FLASH_BUFF118_ACC                                           0x800082D8
 Y.CREATE.L   HWIO_FLASH_BUFF119_ACC_ADDR                                 0x800082DC
 Y.CREATE.L   FLASH_BUFF119_ACC                                           0x800082DC
 Y.CREATE.L   HWIO_FLASH_BUFF120_ACC_ADDR                                 0x800082E0
 Y.CREATE.L   FLASH_BUFF120_ACC                                           0x800082E0
 Y.CREATE.L   HWIO_FLASH_BUFF121_ACC_ADDR                                 0x800082E4
 Y.CREATE.L   FLASH_BUFF121_ACC                                           0x800082E4
 Y.CREATE.L   HWIO_FLASH_BUFF122_ACC_ADDR                                 0x800082E8
 Y.CREATE.L   FLASH_BUFF122_ACC                                           0x800082E8
 Y.CREATE.L   HWIO_FLASH_BUFF123_ACC_ADDR                                 0x800082EC
 Y.CREATE.L   FLASH_BUFF123_ACC                                           0x800082EC
 Y.CREATE.L   HWIO_FLASH_BUFF124_ACC_ADDR                                 0x800082F0
 Y.CREATE.L   FLASH_BUFF124_ACC                                           0x800082F0
 Y.CREATE.L   HWIO_FLASH_BUFF125_ACC_ADDR                                 0x800082F4
 Y.CREATE.L   FLASH_BUFF125_ACC                                           0x800082F4
 Y.CREATE.L   HWIO_FLASH_BUFF126_ACC_ADDR                                 0x800082F8
 Y.CREATE.L   FLASH_BUFF126_ACC                                           0x800082F8
 Y.CREATE.L   HWIO_FLASH_BUFF127_ACC_ADDR                                 0x800082FC
 Y.CREATE.L   FLASH_BUFF127_ACC                                           0x800082FC
 Y.CREATE.L   HWIO_FLASH_BUFF128_ACC_ADDR                                 0x80008300
 Y.CREATE.L   FLASH_BUFF128_ACC                                           0x80008300
 Y.CREATE.L   HWIO_FLASH_BUFF129_ACC_ADDR                                 0x80008304
 Y.CREATE.L   FLASH_BUFF129_ACC                                           0x80008304
 Y.CREATE.L   HWIO_FLASH_BUFF130_ACC_ADDR                                 0x80008308
 Y.CREATE.L   FLASH_BUFF130_ACC                                           0x80008308
 Y.CREATE.L   HWIO_FLASH_BUFF131_ACC_ADDR                                 0x8000830C
 Y.CREATE.L   FLASH_BUFF131_ACC                                           0x8000830C
 Y.CREATE.L   HWIO_ARM_MOD_REG_ADDR                                       0x80000000
 Y.CREATE.L   ARM_MOD_REG                                                 0x80000000
 Y.CREATE.L   HWIO_ARM_CFG_REG_ADDR                                       0x80000004
 Y.CREATE.L   ARM_CFG_REG                                                 0x80000004
 Y.CREATE.L   HWIO_ARM_CLK_EN_REG_ADDR                                    0x80000008
 Y.CREATE.L   ARM_CLK_EN_REG                                              0x80000008
 Y.CREATE.L   HWIO_ARM_CLK_INV_REG_ADDR                                   0x800000F0
 Y.CREATE.L   ARM_CLK_INV_REG                                             0x800000F0
 Y.CREATE.L   HWIO_ADSP_MND0_REG_ADDR                                     0x80000010
 Y.CREATE.L   ADSP_MND0_REG                                               0x80000010
 Y.CREATE.L   HWIO_ADSP_MND1_REG_ADDR                                     0x80000014
 Y.CREATE.L   ADSP_MND1_REG                                               0x80000014
 Y.CREATE.L   HWIO_ADSP_CFG_REG_ADDR                                      0x80000018
 Y.CREATE.L   ADSP_CFG_REG                                                0x80000018
 Y.CREATE.L   HWIO_ADSP_CLK_CTL_REG_ADDR                                  0x80000054
 Y.CREATE.L   ADSP_CLK_CTL_REG                                            0x80000054
 Y.CREATE.L   HWIO_ADSP_MODE_REG_ADDR                                     0x800000FC
 Y.CREATE.L   ADSP_MODE_REG                                               0x800000FC
 Y.CREATE.L   HWIO_ADSP_FS_CTL_REG_ADDR                                   0x80000100
 Y.CREATE.L   ADSP_FS_CTL_REG                                             0x80000100
 Y.CREATE.L   HWIO_ECODEC_MN_REG_ADDR                                     0x8000001C
 Y.CREATE.L   ECODEC_MN_REG                                               0x8000001C
 Y.CREATE.L   HWIO_ECODEC_CD_REG_ADDR                                     0x80000020
 Y.CREATE.L   ECODEC_CD_REG                                               0x80000020
 Y.CREATE.L   HWIO_GSBI0_MN_REG_ADDR                                      0x8000002C
 Y.CREATE.L   GSBI0_MN_REG                                                0x8000002C
 Y.CREATE.L   HWIO_GSBI0_CD_REG_ADDR                                      0x80000030
 Y.CREATE.L   GSBI0_CD_REG                                                0x80000030
 Y.CREATE.L   HWIO_GSBI1_MN_REG_ADDR                                      0x80000034
 Y.CREATE.L   GSBI1_MN_REG                                                0x80000034
 Y.CREATE.L   HWIO_GSBI1_CD_REG_ADDR                                      0x80000038
 Y.CREATE.L   GSBI1_CD_REG                                                0x80000038
 Y.CREATE.L   HWIO_GSBI2_MN_REG_ADDR                                      0x800000D4
 Y.CREATE.L   GSBI2_MN_REG                                                0x800000D4
 Y.CREATE.L   HWIO_GSBI2_CD_REG_ADDR                                      0x800000D8
 Y.CREATE.L   GSBI2_CD_REG                                                0x800000D8
 Y.CREATE.L   HWIO_I2S_MN_REG_ADDR                                        0x8000003C
 Y.CREATE.L   I2S_MN_REG                                                  0x8000003C
 Y.CREATE.L   HWIO_I2S_CD_REG_ADDR                                        0x80000040
 Y.CREATE.L   I2S_CD_REG                                                  0x80000040
 Y.CREATE.L   HWIO_ICODEC_RX_MN_REG_ADDR                                  0x80000044
 Y.CREATE.L   ICODEC_RX_MN_REG                                            0x80000044
 Y.CREATE.L   HWIO_ICODEC_RX_CD_REG_ADDR                                  0x80000048
 Y.CREATE.L   ICODEC_RX_CD_REG                                            0x80000048
 Y.CREATE.L   HWIO_ICODEC_TX_MN_REG_ADDR                                  0x8000004C
 Y.CREATE.L   ICODEC_TX_MN_REG                                            0x8000004C
 Y.CREATE.L   HWIO_ICODEC_TX_CD_REG_ADDR                                  0x80000050
 Y.CREATE.L   ICODEC_TX_CD_REG                                            0x80000050
 Y.CREATE.L   HWIO_SDCC_MN_REG_ADDR                                       0x800000E0
 Y.CREATE.L   SDCC_MN_REG                                                 0x800000E0
 Y.CREATE.L   HWIO_SDCC_CD_REG_ADDR                                       0x800000E4
 Y.CREATE.L   SDCC_CD_REG                                                 0x800000E4
 Y.CREATE.L   HWIO_MISC_CFG_REG_ADDR                                      0x80000090
 Y.CREATE.L   MISC_CFG_REG                                                0x80000090
 Y.CREATE.L   HWIO_UART_DM_MN_REG_ADDR                                    0x800000F4
 Y.CREATE.L   UART_DM_MN_REG                                              0x800000F4
 Y.CREATE.L   HWIO_UART_DM_CD_REG_ADDR                                    0x800000F8
 Y.CREATE.L   UART_DM_CD_REG                                              0x800000F8
 Y.CREATE.L   HWIO_USB_MN_REG_ADDR                                        0x80000094
 Y.CREATE.L   USB_MN_REG                                                  0x80000094
 Y.CREATE.L   HWIO_USB_CD_REG_ADDR                                        0x800000C0
 Y.CREATE.L   USB_CD_REG                                                  0x800000C0
 Y.CREATE.L   HWIO_CAMCLK_MN_REG_ADDR                                     0x80000104
 Y.CREATE.L   CAMCLK_MN_REG                                               0x80000104
 Y.CREATE.L   HWIO_CAMCLK_CD_REG_ADDR                                     0x80000108
 Y.CREATE.L   CAMCLK_CD_REG                                               0x80000108
 Y.CREATE.L   HWIO_VIDEO_VFE_MN_REG_ADDR                                  0x800000E8
 Y.CREATE.L   VIDEO_VFE_MN_REG                                            0x800000E8
 Y.CREATE.L   HWIO_VIDEO_VFE_CD_REG_ADDR                                  0x800000EC
 Y.CREATE.L   VIDEO_VFE_CD_REG                                            0x800000EC
 Y.CREATE.L   HWIO_CLK_OFF_A_ADDR                                         0x800000C4
 Y.CREATE.L   CLK_OFF_A                                                   0x800000C4
 Y.CREATE.L   HWIO_CLK_OFF_B_ADDR                                         0x800000C8
 Y.CREATE.L   CLK_OFF_B                                                   0x800000C8
 Y.CREATE.L   HWIO_DBG_CFG_REG_ADDR                                       0x800000D0
 Y.CREATE.L   DBG_CFG_REG                                                 0x800000D0
 Y.CREATE.L   HWIO_SW_RESET_ALL_REG_ADDR                                  0x80000200
 Y.CREATE.L   SW_RESET_ALL_REG                                            0x80000200
 Y.CREATE.L   HWIO_RESET_STATUS_REG_ADDR                                  0x80000204
 Y.CREATE.L   RESET_STATUS_REG                                            0x80000204
 Y.CREATE.L   HWIO_SW_RESET_REG_ADDR                                      0x80000208
 Y.CREATE.L   SW_RESET_REG                                                0x80000208
 Y.CREATE.L   HWIO_PLL_TESTPAD_CFG_REG_ADDR                               0x800000CC
 Y.CREATE.L   PLL_TESTPAD_CFG_REG                                         0x800000CC
 Y.CREATE.L   HWIO_PLL_MODE_REG_ADDR                                      0x80000300
 Y.CREATE.L   PLL_MODE_REG                                                0x80000300
 Y.CREATE.L   HWIO_PLL_L_VAL_REG_ADDR                                     0x80000308
 Y.CREATE.L   PLL_L_VAL_REG                                               0x80000308
 Y.CREATE.L   HWIO_PLL_M_VAL_REG_ADDR                                     0x8000030C
 Y.CREATE.L   PLL_M_VAL_REG                                               0x8000030C
 Y.CREATE.L   HWIO_PLL_N_VAL_REG_ADDR                                     0x80000310
 Y.CREATE.L   PLL_N_VAL_REG                                               0x80000310
 Y.CREATE.L   HWIO_PLL_CONFIG_REG_ADDR                                    0x80000314
 Y.CREATE.L   PLL_CONFIG_REG                                              0x80000314
 Y.CREATE.L   HWIO_PLL_TEST_CTL_REG_ADDR                                  0x80000318
 Y.CREATE.L   PLL_TEST_CTL_REG                                            0x80000318
 Y.CREATE.L   HWIO_PLL_STATUS_REG_ADDR                                    0x8000031C
 Y.CREATE.L   PLL_STATUS_REG                                              0x8000031C
 Y.CREATE.L   HWIO_BOOT_ROM_CLOCK_ENABLE_ADDR                             0x80002000
 Y.CREATE.L   BOOT_ROM_CLOCK_ENABLE                                       0x80002000
 Y.CREATE.L   HWIO_PAUSE_TIMER_ADDR                                       0x80002020
 Y.CREATE.L   PAUSE_TIMER                                                 0x80002020
 Y.CREATE.L   HWIO_PAUSE_TIMER_CTL_ADDR                                   0x80002028
 Y.CREATE.L   PAUSE_TIMER_CTL                                             0x80002028
 Y.CREATE.L   HWIO_BPM_TRIGGER_ADDR                                       0x80002030
 Y.CREATE.L   BPM_TRIGGER                                                 0x80002030
 Y.CREATE.L   HWIO_BPM_HSEL_SEL_ADDR                                      0x80002034
 Y.CREATE.L   BPM_HSEL_SEL                                                0x80002034
 Y.CREATE.L   HWIO_EBI1_CS0_CS1_SWAP_ADDR                                 0x80002040
 Y.CREATE.L   EBI1_CS0_CS1_SWAP                                           0x80002040
 Y.CREATE.L   HWIO_MSM_BRIDGE_CFG_ADDR                                    0x8000204C
 Y.CREATE.L   MSM_BRIDGE_CFG                                              0x8000204C
 Y.CREATE.L   HWIO_AHB_TEST_BUS_CTL_ADDR                                  0x80002068
 Y.CREATE.L   AHB_TEST_BUS_CTL                                            0x80002068
 Y.CREATE.L   HWIO_AHB_TEST_BUS_ADDR                                      0x8000206C
 Y.CREATE.L   AHB_TEST_BUS                                                0x8000206C
 Y.CREATE.L   HWIO_BOOT_FROM_ROM_STATUS_ADDR                              0x80002074
 Y.CREATE.L   BOOT_FROM_ROM_STATUS                                        0x80002074
 Y.CREATE.L   HWIO_AHB_APP_BUS_PRIORITY_ADDR                              0x80002090
 Y.CREATE.L   AHB_APP_BUS_PRIORITY                                        0x80002090
 Y.CREATE.L   HWIO_AHB_BUS_REQUEST_ADDR                                   0x80002098
 Y.CREATE.L   AHB_BUS_REQUEST                                             0x80002098
 Y.CREATE.L   HWIO_AHB_BUS_MASTERS_ADDR                                   0x8000209C
 Y.CREATE.L   AHB_BUS_MASTERS                                             0x8000209C
 Y.CREATE.L   HWIO_AHB_SYS_BUS_PRIORITY_ADDR                              0x800020E4
 Y.CREATE.L   AHB_SYS_BUS_PRIORITY                                        0x800020E4
 Y.CREATE.L   HWIO_AHB_SYS_DUMMY0_ADDR                                    0x800020E8
 Y.CREATE.L   AHB_SYS_DUMMY0                                              0x800020E8
 Y.CREATE.L   HWIO_AHB_SYS_DUMMY1_ADDR                                    0x800020EC
 Y.CREATE.L   AHB_SYS_DUMMY1                                              0x800020EC
 Y.CREATE.L   HWIO_AHB_SYS_DUMMY2_ADDR                                    0x800020F0
 Y.CREATE.L   AHB_SYS_DUMMY2                                              0x800020F0
 Y.CREATE.L   HWIO_SYS_FINE_TABLE0_ADDR                                   0x800020F4
 Y.CREATE.L   SYS_FINE_TABLE0                                             0x800020F4
 Y.CREATE.L   HWIO_SYS_FINE_TABLE1_ADDR                                   0x800020F8
 Y.CREATE.L   SYS_FINE_TABLE1                                             0x800020F8
 Y.CREATE.L   HWIO_SYS_FINE_TABLE2_ADDR                                   0x800020FC
 Y.CREATE.L   SYS_FINE_TABLE2                                             0x800020FC
 Y.CREATE.L   HWIO_SYS_FINE_TABLE3_ADDR                                   0x80002100
 Y.CREATE.L   SYS_FINE_TABLE3                                             0x80002100
 Y.CREATE.L   HWIO_SYS_FINE_TABLE4_ADDR                                   0x80002104
 Y.CREATE.L   SYS_FINE_TABLE4                                             0x80002104
 Y.CREATE.L   HWIO_SYS_FINE_TABLE5_ADDR                                   0x80002108
 Y.CREATE.L   SYS_FINE_TABLE5                                             0x80002108
 Y.CREATE.L   HWIO_SYS_FINE_TABLE6_ADDR                                   0x8000210C
 Y.CREATE.L   SYS_FINE_TABLE6                                             0x8000210C
 Y.CREATE.L   HWIO_SYS_FINE_TABLE7_ADDR                                   0x80002110
 Y.CREATE.L   SYS_FINE_TABLE7                                             0x80002110
 Y.CREATE.L   HWIO_SYS_COARSE_TABLE0_ADDR                                 0x80002114
 Y.CREATE.L   SYS_COARSE_TABLE0                                           0x80002114
 Y.CREATE.L   HWIO_SYS_COARSE_TABLE1_ADDR                                 0x80002118
 Y.CREATE.L   SYS_COARSE_TABLE1                                           0x80002118
 Y.CREATE.L   HWIO_SYS_COARSE_TABLE2_ADDR                                 0x8000211C
 Y.CREATE.L   SYS_COARSE_TABLE2                                           0x8000211C
 Y.CREATE.L   HWIO_SYS_COARSE_TABLE3_ADDR                                 0x80002120
 Y.CREATE.L   SYS_COARSE_TABLE3                                           0x80002120
 Y.CREATE.L   HWIO_SYS_COARSE_TABLE4_ADDR                                 0x80002124
 Y.CREATE.L   SYS_COARSE_TABLE4                                           0x80002124
 Y.CREATE.L   HWIO_SYS_COARSE_TABLE5_ADDR                                 0x80002128
 Y.CREATE.L   SYS_COARSE_TABLE5                                           0x80002128
 Y.CREATE.L   HWIO_SYS_COARSE_TABLE6_ADDR                                 0x8000212C
 Y.CREATE.L   SYS_COARSE_TABLE6                                           0x8000212C
 Y.CREATE.L   HWIO_SYS_COARSE_TABLE7_ADDR                                 0x80002130
 Y.CREATE.L   SYS_COARSE_TABLE7                                           0x80002130
 Y.CREATE.L   HWIO_APP_FINE_TABLE0_ADDR                                   0x80002174
 Y.CREATE.L   APP_FINE_TABLE0                                             0x80002174
 Y.CREATE.L   HWIO_APP_FINE_TABLE1_ADDR                                   0x80002178
 Y.CREATE.L   APP_FINE_TABLE1                                             0x80002178
 Y.CREATE.L   HWIO_APP_FINE_TABLE2_ADDR                                   0x8000217C
 Y.CREATE.L   APP_FINE_TABLE2                                             0x8000217C
 Y.CREATE.L   HWIO_APP_FINE_TABLE3_ADDR                                   0x80002180
 Y.CREATE.L   APP_FINE_TABLE3                                             0x80002180
 Y.CREATE.L   HWIO_APP_FINE_TABLE4_ADDR                                   0x80002184
 Y.CREATE.L   APP_FINE_TABLE4                                             0x80002184
 Y.CREATE.L   HWIO_APP_FINE_TABLE5_ADDR                                   0x80002188
 Y.CREATE.L   APP_FINE_TABLE5                                             0x80002188
 Y.CREATE.L   HWIO_APP_FINE_TABLE6_ADDR                                   0x8000218C
 Y.CREATE.L   APP_FINE_TABLE6                                             0x8000218C
 Y.CREATE.L   HWIO_APP_FINE_TABLE7_ADDR                                   0x80002190
 Y.CREATE.L   APP_FINE_TABLE7                                             0x80002190
 Y.CREATE.L   HWIO_APP_COARSE_TABLE0_ADDR                                 0x80002194
 Y.CREATE.L   APP_COARSE_TABLE0                                           0x80002194
 Y.CREATE.L   HWIO_APP_COARSE_TABLE1_ADDR                                 0x80002198
 Y.CREATE.L   APP_COARSE_TABLE1                                           0x80002198
 Y.CREATE.L   HWIO_APP_COARSE_TABLE2_ADDR                                 0x8000219C
 Y.CREATE.L   APP_COARSE_TABLE2                                           0x8000219C
 Y.CREATE.L   HWIO_APP_COARSE_TABLE3_ADDR                                 0x800021A0
 Y.CREATE.L   APP_COARSE_TABLE3                                           0x800021A0
 Y.CREATE.L   HWIO_APP_COARSE_TABLE4_ADDR                                 0x800021A4
 Y.CREATE.L   APP_COARSE_TABLE4                                           0x800021A4
 Y.CREATE.L   HWIO_APP_COARSE_TABLE5_ADDR                                 0x800021A8
 Y.CREATE.L   APP_COARSE_TABLE5                                           0x800021A8
 Y.CREATE.L   HWIO_APP_COARSE_TABLE6_ADDR                                 0x800021AC
 Y.CREATE.L   APP_COARSE_TABLE6                                           0x800021AC
 Y.CREATE.L   HWIO_APP_COARSE_TABLE7_ADDR                                 0x800021B0
 Y.CREATE.L   APP_COARSE_TABLE7                                           0x800021B0
 Y.CREATE.L   HWIO_GT_SLOT_SIZE_ADDR                                      0x800021B8
 Y.CREATE.L   GT_SLOT_SIZE                                                0x800021B8
 Y.CREATE.L   HWIO_RXA2D_GPR_A1_ADDR                                      0x80012000
 Y.CREATE.L   RXA2D_GPR_A1                                                0x80012000
 Y.CREATE.L   HWIO_RXA2D_DDO_ADDR                                         0x80012004
 Y.CREATE.L   RXA2D_DDO                                                   0x80012004
 Y.CREATE.L   HWIO_RXA2D_EN_ADDR                                          0x80012008
 Y.CREATE.L   RXA2D_EN                                                    0x80012008
 Y.CREATE.L   HWIO_RXA2D_CONF_ADDR                                        0x8001200C
 Y.CREATE.L   RXA2D_CONF                                                  0x8001200C
 Y.CREATE.L   HWIO_RXA2D_CLK_ADDR                                         0x80012010
 Y.CREATE.L   RXA2D_CLK                                                   0x80012010
 Y.CREATE.L   HWIO_RXA2D_CLK_HDRV_ADDR                                    0x80012014
 Y.CREATE.L   RXA2D_CLK_HDRV                                              0x80012014
 Y.CREATE.L   HWIO_RXA2D_CM1_ADDR                                         0x80012018
 Y.CREATE.L   RXA2D_CM1                                                   0x80012018
 Y.CREATE.L   HWIO_RXA2D_BOOST_ADDR                                       0x8001201C
 Y.CREATE.L   RXA2D_BOOST                                                 0x8001201C
 Y.CREATE.L   HWIO_RXA2D_I1_ADDR                                          0x80012020
 Y.CREATE.L   RXA2D_I1                                                    0x80012020
 Y.CREATE.L   HWIO_RXA2D_I2_ADDR                                          0x80012024
 Y.CREATE.L   RXA2D_I2                                                    0x80012024
 Y.CREATE.L   HWIO_RXA2D_I3_ADDR                                          0x80012028
 Y.CREATE.L   RXA2D_I3                                                    0x80012028
 Y.CREATE.L   HWIO_RXA2D_TMUX_ADDR                                        0x8001202C
 Y.CREATE.L   RXA2D_TMUX                                                  0x8001202C
 Y.CREATE.L   HWIO_RXA2D_CMP_ADDR                                         0x80012030
 Y.CREATE.L   RXA2D_CMP                                                   0x80012030
 Y.CREATE.L   HWIO_RXA2D_AAF_ADDR                                         0x80012034
 Y.CREATE.L   RXA2D_AAF                                                   0x80012034
 Y.CREATE.L   HWIO_IRQ_CLEAR_0_ADDR                                       0x80006000
 Y.CREATE.L   IRQ_CLEAR_0                                                 0x80006000
 Y.CREATE.L   HWIO_IRQ_CLEAR_1_ADDR                                       0x80006004
 Y.CREATE.L   IRQ_CLEAR_1                                                 0x80006004
 Y.CREATE.L   HWIO_FIQ_CLEAR_0_ADDR                                       0x80006008
 Y.CREATE.L   FIQ_CLEAR_0                                                 0x80006008
 Y.CREATE.L   HWIO_FIQ_CLEAR_1_ADDR                                       0x8000600C
 Y.CREATE.L   FIQ_CLEAR_1                                                 0x8000600C
 Y.CREATE.L   HWIO_INT_SET_0_ADDR                                         0x80006028
 Y.CREATE.L   INT_SET_0                                                   0x80006028
 Y.CREATE.L   HWIO_INT_SET_1_ADDR                                         0x8000602C
 Y.CREATE.L   INT_SET_1                                                   0x8000602C
 Y.CREATE.L   HWIO_INT_POL_SET_ADDR                                       0x80006040
 Y.CREATE.L   INT_POL_SET                                                 0x80006040
 Y.CREATE.L   HWIO_IRQ_EN_0_ADDR                                          0x80006030
 Y.CREATE.L   IRQ_EN_0                                                    0x80006030
 Y.CREATE.L   HWIO_IRQ_EN_1_ADDR                                          0x80006034
 Y.CREATE.L   IRQ_EN_1                                                    0x80006034
 Y.CREATE.L   HWIO_FIQ_EN_0_ADDR                                          0x80006038
 Y.CREATE.L   FIQ_EN_0                                                    0x80006038
 Y.CREATE.L   HWIO_FIQ_EN_1_ADDR                                          0x8000603C
 Y.CREATE.L   FIQ_EN_1                                                    0x8000603C
 Y.CREATE.L   HWIO_INT_DET_REG_0_ADDR                                     0x80006058
 Y.CREATE.L   INT_DET_REG_0                                               0x80006058
 Y.CREATE.L   HWIO_INT_DET_REG_1_ADDR                                     0x8000605C
 Y.CREATE.L   INT_DET_REG_1                                               0x8000605C
 Y.CREATE.L   HWIO_IRQ_STATUS_0_ADDR                                      0x80006074
 Y.CREATE.L   IRQ_STATUS_0                                                0x80006074
 Y.CREATE.L   HWIO_IRQ_STATUS_1_ADDR                                      0x80006078
 Y.CREATE.L   IRQ_STATUS_1                                                0x80006078
 Y.CREATE.L   HWIO_FIQ_STATUS_0_ADDR                                      0x8000607C
 Y.CREATE.L   FIQ_STATUS_0                                                0x8000607C
 Y.CREATE.L   HWIO_FIQ_STATUS_1_ADDR                                      0x80006080
 Y.CREATE.L   FIQ_STATUS_1                                                0x80006080
 Y.CREATE.L   HWIO_IRQ_VEC_INDEX_RD_ADDR                                  0x8000609C
 Y.CREATE.L   IRQ_VEC_INDEX_RD                                            0x8000609C
 Y.CREATE.L   HWIO_IRQ_VEC_INDEX_PEND_RD_ADDR                             0x800060A0
 Y.CREATE.L   IRQ_VEC_INDEX_PEND_RD                                       0x800060A0
 Y.CREATE.L   HWIO_IRQ_IN_SERVICE_RD_ADDR                                 0x800060A4
 Y.CREATE.L   IRQ_IN_SERVICE_RD                                           0x800060A4
 Y.CREATE.L   HWIO_IRQ_IN_STACK_RD_ADDR                                   0x800060A8
 Y.CREATE.L   IRQ_IN_STACK_RD                                             0x800060A8
 Y.CREATE.L   HWIO_INT_CTL_CFG_ADDR                                       0x800060AC
 Y.CREATE.L   INT_CTL_CFG                                                 0x800060AC
 Y.CREATE.L   HWIO_INT_0_PRIORITY_ADDR                                    0x800060B0
 Y.CREATE.L   INT_0_PRIORITY                                              0x800060B0
 Y.CREATE.L   HWIO_INT_1_PRIORITY_ADDR                                    0x800060B4
 Y.CREATE.L   INT_1_PRIORITY                                              0x800060B4
 Y.CREATE.L   HWIO_INT_2_PRIORITY_ADDR                                    0x800060B8
 Y.CREATE.L   INT_2_PRIORITY                                              0x800060B8
 Y.CREATE.L   HWIO_INT_3_PRIORITY_ADDR                                    0x800060BC
 Y.CREATE.L   INT_3_PRIORITY                                              0x800060BC
 Y.CREATE.L   HWIO_INT_4_PRIORITY_ADDR                                    0x800060C0
 Y.CREATE.L   INT_4_PRIORITY                                              0x800060C0
 Y.CREATE.L   HWIO_INT_5_PRIORITY_ADDR                                    0x800060C4
 Y.CREATE.L   INT_5_PRIORITY                                              0x800060C4
 Y.CREATE.L   HWIO_INT_6_PRIORITY_ADDR                                    0x800060C8
 Y.CREATE.L   INT_6_PRIORITY                                              0x800060C8
 Y.CREATE.L   HWIO_INT_7_PRIORITY_ADDR                                    0x800060CC
 Y.CREATE.L   INT_7_PRIORITY                                              0x800060CC
 Y.CREATE.L   HWIO_INT_8_PRIORITY_ADDR                                    0x800060D0
 Y.CREATE.L   INT_8_PRIORITY                                              0x800060D0
 Y.CREATE.L   HWIO_INT_9_PRIORITY_ADDR                                    0x800060D4
 Y.CREATE.L   INT_9_PRIORITY                                              0x800060D4
 Y.CREATE.L   HWIO_INT_10_PRIORITY_ADDR                                   0x800060D8
 Y.CREATE.L   INT_10_PRIORITY                                             0x800060D8
 Y.CREATE.L   HWIO_INT_11_PRIORITY_ADDR                                   0x800060DC
 Y.CREATE.L   INT_11_PRIORITY                                             0x800060DC
 Y.CREATE.L   HWIO_INT_12_PRIORITY_ADDR                                   0x800060E0
 Y.CREATE.L   INT_12_PRIORITY                                             0x800060E0
 Y.CREATE.L   HWIO_INT_13_PRIORITY_ADDR                                   0x800060E4
 Y.CREATE.L   INT_13_PRIORITY                                             0x800060E4
 Y.CREATE.L   HWIO_INT_14_PRIORITY_ADDR                                   0x800060E8
 Y.CREATE.L   INT_14_PRIORITY                                             0x800060E8
 Y.CREATE.L   HWIO_INT_15_PRIORITY_ADDR                                   0x800060EC
 Y.CREATE.L   INT_15_PRIORITY                                             0x800060EC
 Y.CREATE.L   HWIO_INT_16_PRIORITY_ADDR                                   0x800060F0
 Y.CREATE.L   INT_16_PRIORITY                                             0x800060F0
 Y.CREATE.L   HWIO_INT_17_PRIORITY_ADDR                                   0x800060F4
 Y.CREATE.L   INT_17_PRIORITY                                             0x800060F4
 Y.CREATE.L   HWIO_INT_18_PRIORITY_ADDR                                   0x800060F8
 Y.CREATE.L   INT_18_PRIORITY                                             0x800060F8
 Y.CREATE.L   HWIO_INT_19_PRIORITY_ADDR                                   0x800060FC
 Y.CREATE.L   INT_19_PRIORITY                                             0x800060FC
 Y.CREATE.L   HWIO_INT_20_PRIORITY_ADDR                                   0x80006100
 Y.CREATE.L   INT_20_PRIORITY                                             0x80006100
 Y.CREATE.L   HWIO_INT_21_PRIORITY_ADDR                                   0x80006104
 Y.CREATE.L   INT_21_PRIORITY                                             0x80006104
 Y.CREATE.L   HWIO_INT_22_PRIORITY_ADDR                                   0x80006108
 Y.CREATE.L   INT_22_PRIORITY                                             0x80006108
 Y.CREATE.L   HWIO_INT_23_PRIORITY_ADDR                                   0x8000610C
 Y.CREATE.L   INT_23_PRIORITY                                             0x8000610C
 Y.CREATE.L   HWIO_INT_24_PRIORITY_ADDR                                   0x80006110
 Y.CREATE.L   INT_24_PRIORITY                                             0x80006110
 Y.CREATE.L   HWIO_INT_25_PRIORITY_ADDR                                   0x80006114
 Y.CREATE.L   INT_25_PRIORITY                                             0x80006114
 Y.CREATE.L   HWIO_INT_26_PRIORITY_ADDR                                   0x80006118
 Y.CREATE.L   INT_26_PRIORITY                                             0x80006118
 Y.CREATE.L   HWIO_INT_27_PRIORITY_ADDR                                   0x8000611C
 Y.CREATE.L   INT_27_PRIORITY                                             0x8000611C
 Y.CREATE.L   HWIO_INT_28_PRIORITY_ADDR                                   0x80006120
 Y.CREATE.L   INT_28_PRIORITY                                             0x80006120
 Y.CREATE.L   HWIO_INT_29_PRIORITY_ADDR                                   0x80006124
 Y.CREATE.L   INT_29_PRIORITY                                             0x80006124
 Y.CREATE.L   HWIO_INT_30_PRIORITY_ADDR                                   0x80006128
 Y.CREATE.L   INT_30_PRIORITY                                             0x80006128
 Y.CREATE.L   HWIO_INT_31_PRIORITY_ADDR                                   0x8000612C
 Y.CREATE.L   INT_31_PRIORITY                                             0x8000612C
 Y.CREATE.L   HWIO_INT_32_PRIORITY_ADDR                                   0x80006130
 Y.CREATE.L   INT_32_PRIORITY                                             0x80006130
 Y.CREATE.L   HWIO_INT_33_PRIORITY_ADDR                                   0x80006134
 Y.CREATE.L   INT_33_PRIORITY                                             0x80006134
 Y.CREATE.L   HWIO_INT_34_PRIORITY_ADDR                                   0x80006138
 Y.CREATE.L   INT_34_PRIORITY                                             0x80006138
 Y.CREATE.L   HWIO_INT_35_PRIORITY_ADDR                                   0x8000613C
 Y.CREATE.L   INT_35_PRIORITY                                             0x8000613C
 Y.CREATE.L   HWIO_INT_36_PRIORITY_ADDR                                   0x80006140
 Y.CREATE.L   INT_36_PRIORITY                                             0x80006140
 Y.CREATE.L   HWIO_INT_37_PRIORITY_ADDR                                   0x80006144
 Y.CREATE.L   INT_37_PRIORITY                                             0x80006144
 Y.CREATE.L   HWIO_INT_38_PRIORITY_ADDR                                   0x80006148
 Y.CREATE.L   INT_38_PRIORITY                                             0x80006148
 Y.CREATE.L   HWIO_INT_39_PRIORITY_ADDR                                   0x8000614C
 Y.CREATE.L   INT_39_PRIORITY                                             0x8000614C
 Y.CREATE.L   HWIO_INT_40_PRIORITY_ADDR                                   0x80006150
 Y.CREATE.L   INT_40_PRIORITY                                             0x80006150
 Y.CREATE.L   HWIO_INT_41_PRIORITY_ADDR                                   0x80006154
 Y.CREATE.L   INT_41_PRIORITY                                             0x80006154
 Y.CREATE.L   HWIO_INT_42_PRIORITY_ADDR                                   0x80006158
 Y.CREATE.L   INT_42_PRIORITY                                             0x80006158
 Y.CREATE.L   HWIO_INT_43_PRIORITY_ADDR                                   0x8000615C
 Y.CREATE.L   INT_43_PRIORITY                                             0x8000615C
 Y.CREATE.L   HWIO_INT_44_PRIORITY_ADDR                                   0x80006160
 Y.CREATE.L   INT_44_PRIORITY                                             0x80006160
 Y.CREATE.L   HWIO_INT_45_PRIORITY_ADDR                                   0x80006164
 Y.CREATE.L   INT_45_PRIORITY                                             0x80006164
 Y.CREATE.L   HWIO_INT_46_PRIORITY_ADDR                                   0x80006168
 Y.CREATE.L   INT_46_PRIORITY                                             0x80006168
 Y.CREATE.L   HWIO_INT_47_PRIORITY_ADDR                                   0x8000616C
 Y.CREATE.L   INT_47_PRIORITY                                             0x8000616C
 Y.CREATE.L   HWIO_INT_48_PRIORITY_ADDR                                   0x80006170
 Y.CREATE.L   INT_48_PRIORITY                                             0x80006170
 Y.CREATE.L   HWIO_INT_49_PRIORITY_ADDR                                   0x80006174
 Y.CREATE.L   INT_49_PRIORITY                                             0x80006174
 Y.CREATE.L   HWIO_INT_50_PRIORITY_ADDR                                   0x80006178
 Y.CREATE.L   INT_50_PRIORITY                                             0x80006178
 Y.CREATE.L   HWIO_INT_51_PRIORITY_ADDR                                   0x8000617C
 Y.CREATE.L   INT_51_PRIORITY                                             0x8000617C
 Y.CREATE.L   HWIO_INT_52_PRIORITY_ADDR                                   0x80006180
 Y.CREATE.L   INT_52_PRIORITY                                             0x80006180
 Y.CREATE.L   HWIO_INT_53_PRIORITY_ADDR                                   0x80006184
 Y.CREATE.L   INT_53_PRIORITY                                             0x80006184
 Y.CREATE.L   HWIO_INT_54_PRIORITY_ADDR                                   0x80006188
 Y.CREATE.L   INT_54_PRIORITY                                             0x80006188
 Y.CREATE.L   HWIO_INT_55_PRIORITY_ADDR                                   0x8000618C
 Y.CREATE.L   INT_55_PRIORITY                                             0x8000618C
 Y.CREATE.L   HWIO_INT_56_PRIORITY_ADDR                                   0x80006190
 Y.CREATE.L   INT_56_PRIORITY                                             0x80006190
 Y.CREATE.L   HWIO_INT_57_PRIORITY_ADDR                                   0x80006194
 Y.CREATE.L   INT_57_PRIORITY                                             0x80006194
 Y.CREATE.L   HWIO_INT_58_PRIORITY_ADDR                                   0x80006198
 Y.CREATE.L   INT_58_PRIORITY                                             0x80006198
 Y.CREATE.L   HWIO_INT_59_PRIORITY_ADDR                                   0x8000619C
 Y.CREATE.L   INT_59_PRIORITY                                             0x8000619C
 Y.CREATE.L   HWIO_MSM_GPIO1_INT_CLEAR_0_ADDR                             0x800061A4
 Y.CREATE.L   MSM_GPIO1_INT_CLEAR_0                                       0x800061A4
 Y.CREATE.L   HWIO_MSM_GPIO1_INT_EN_0_ADDR                                0x800061A0
 Y.CREATE.L   MSM_GPIO1_INT_EN_0                                          0x800061A0
 Y.CREATE.L   HWIO_MSM_GPIO1_INT_POLARITY_0_ADDR                          0x800061B4
 Y.CREATE.L   MSM_GPIO1_INT_POLARITY_0                                    0x800061B4
 Y.CREATE.L   HWIO_MSM_GPIO1_DETECT_CTL_0_ADDR                            0x800061C8
 Y.CREATE.L   MSM_GPIO1_DETECT_CTL_0                                      0x800061C8
 Y.CREATE.L   HWIO_MSM_GPIO1_INT_STATUS_0_ADDR                            0x800061DC
 Y.CREATE.L   MSM_GPIO1_INT_STATUS_0                                      0x800061DC
 Y.CREATE.L   HWIO_MSM_GPIO1_INT_CLEAR_1_ADDR                             0x800061F0
 Y.CREATE.L   MSM_GPIO1_INT_CLEAR_1                                       0x800061F0
 Y.CREATE.L   HWIO_MSM_GPIO1_INT_EN_1_ADDR                                0x800061F4
 Y.CREATE.L   MSM_GPIO1_INT_EN_1                                          0x800061F4
 Y.CREATE.L   HWIO_MSM_GPIO1_INT_POLARITY_1_ADDR                          0x800061F8
 Y.CREATE.L   MSM_GPIO1_INT_POLARITY_1                                    0x800061F8
 Y.CREATE.L   HWIO_MSM_GPIO1_DETECT_CTL_1_ADDR                            0x800061FC
 Y.CREATE.L   MSM_GPIO1_DETECT_CTL_1                                      0x800061FC
 Y.CREATE.L   HWIO_MSM_GPIO1_INT_STATUS_1_ADDR                            0x80006200
 Y.CREATE.L   MSM_GPIO1_INT_STATUS_1                                      0x80006200
 Y.CREATE.L   HWIO_GPIO_OUT_0_ADDR                                        0x8000A000
 Y.CREATE.L   GPIO_OUT_0                                                  0x8000A000
 Y.CREATE.L   HWIO_GPIO_OUT_1_ADDR                                        0x8000A004
 Y.CREATE.L   GPIO_OUT_1                                                  0x8000A004
 Y.CREATE.L   HWIO_GPIO_OE_0_ADDR                                         0x8000A008
 Y.CREATE.L   GPIO_OE_0                                                   0x8000A008
 Y.CREATE.L   HWIO_GPIO_OE_1_ADDR                                         0x8000A00C
 Y.CREATE.L   GPIO_OE_1                                                   0x8000A00C
 Y.CREATE.L   HWIO_GPIO_PAGE_ADDR                                         0x8000A010
 Y.CREATE.L   GPIO_PAGE                                                   0x8000A010
 Y.CREATE.L   HWIO_GPIO_CFG_ADDR                                          0x8000A014
 Y.CREATE.L   GPIO_CFG                                                    0x8000A014
 Y.CREATE.L   HWIO_GPIO_IN_0_ADDR                                         0x8000A018
 Y.CREATE.L   GPIO_IN_0                                                   0x8000A018
 Y.CREATE.L   HWIO_GPIO_IN_1_ADDR                                         0x8000A01C
 Y.CREATE.L   GPIO_IN_1                                                   0x8000A01C
 Y.CREATE.L   HWIO_CHIP_MODE_ADDR                                         0x8000C000
 Y.CREATE.L   CHIP_MODE                                                   0x8000C000
 Y.CREATE.L   HWIO_WEB_MISC_WR_ADDR                                       0x8000C004
 Y.CREATE.L   WEB_MISC_WR                                                 0x8000C004
 Y.CREATE.L   HWIO_EBI1_PAD_PULL_0_ADDR                                   0x8000C120
 Y.CREATE.L   EBI1_PAD_PULL_0                                             0x8000C120
 Y.CREATE.L   HWIO_EBI1_PAD_PULL_1_ADDR                                   0x8000C124
 Y.CREATE.L   EBI1_PAD_PULL_1                                             0x8000C124
 Y.CREATE.L   HWIO_EBI2_PAD_PULL_0_ADDR                                   0x8000C128
 Y.CREATE.L   EBI2_PAD_PULL_0                                             0x8000C128
 Y.CREATE.L   HWIO_EBI2_PAD_PULL_1_ADDR                                   0x8000C12C
 Y.CREATE.L   EBI2_PAD_PULL_1                                             0x8000C12C
 Y.CREATE.L   HWIO_D2D_PAD_PULL_0_ADDR                                    0x8000C008
 Y.CREATE.L   D2D_PAD_PULL_0                                              0x8000C008
 Y.CREATE.L   HWIO_D2D_PAD_PULL_1_ADDR                                    0x8000C00C
 Y.CREATE.L   D2D_PAD_PULL_1                                              0x8000C00C
 Y.CREATE.L   HWIO_D2D_PAD_HDRIVE_MSEL_0_ADDR                             0x8000C010
 Y.CREATE.L   D2D_PAD_HDRIVE_MSEL_0                                       0x8000C010
 Y.CREATE.L   HWIO_D2D_PAD_HDRIVE_MSEL_1_ADDR                             0x8000C014
 Y.CREATE.L   D2D_PAD_HDRIVE_MSEL_1                                       0x8000C014
 Y.CREATE.L   HWIO_PAD_HDRIVE_MSEL_ADDR                                   0x8000C018
 Y.CREATE.L   PAD_HDRIVE_MSEL                                             0x8000C018
 Y.CREATE.L   HWIO_EBI1_PAD_HDRIVE_MSEL_0_ADDR                            0x8000C01C
 Y.CREATE.L   EBI1_PAD_HDRIVE_MSEL_0                                      0x8000C01C
 Y.CREATE.L   HWIO_EBI1_PAD_HDRIVE_MSEL_1_ADDR                            0x8000C020
 Y.CREATE.L   EBI1_PAD_HDRIVE_MSEL_1                                      0x8000C020
 Y.CREATE.L   HWIO_EBI2_PAD_HDRIVE_MSEL_0_ADDR                            0x8000C024
 Y.CREATE.L   EBI2_PAD_HDRIVE_MSEL_0                                      0x8000C024
 Y.CREATE.L   HWIO_GPIO_PAD_HDRIVE_MSEL_0_ADDR                            0x8000C030
 Y.CREATE.L   GPIO_PAD_HDRIVE_MSEL_0                                      0x8000C030
 Y.CREATE.L   HWIO_GPIO_PAD_HDRIVE_MSEL_1_ADDR                            0x8000C034
 Y.CREATE.L   GPIO_PAD_HDRIVE_MSEL_1                                      0x8000C034
 Y.CREATE.L   HWIO_GPIO_PAD_HDRIVE_MSEL_2_ADDR                            0x8000C038
 Y.CREATE.L   GPIO_PAD_HDRIVE_MSEL_2                                      0x8000C038
 Y.CREATE.L   HWIO_GPIO_PAD_HDRIVE_MSEL_3_ADDR                            0x8000C03C
 Y.CREATE.L   GPIO_PAD_HDRIVE_MSEL_3                                      0x8000C03C
 Y.CREATE.L   HWIO_GPIO_PAD_HDRIVE_MSEL_4_ADDR                            0x8000C040
 Y.CREATE.L   GPIO_PAD_HDRIVE_MSEL_4                                      0x8000C040
 Y.CREATE.L   HWIO_GPIO_PAD_HDRIVE_MSEL_5_ADDR                            0x8000C044
 Y.CREATE.L   GPIO_PAD_HDRIVE_MSEL_5                                      0x8000C044
 Y.CREATE.L   HWIO_GPIO_PAD_HDRIVE_MSEL_6_ADDR                            0x8000C048
 Y.CREATE.L   GPIO_PAD_HDRIVE_MSEL_6                                      0x8000C048
 Y.CREATE.L   HWIO_GPIO_PAD_HDRIVE_MSEL_7_ADDR                            0x8000C04C
 Y.CREATE.L   GPIO_PAD_HDRIVE_MSEL_7                                      0x8000C04C
 Y.CREATE.L   HWIO_PMIC_CONTROL_ADDR                                      0x8000C100
 Y.CREATE.L   PMIC_CONTROL                                                0x8000C100
 Y.CREATE.L   HWIO_ANALOG_TEST_SEL_ADDR                                   0x8000C058
 Y.CREATE.L   ANALOG_TEST_SEL                                             0x8000C058
 Y.CREATE.L   HWIO_ADIE_TEST_CONTROL_ADDR                                 0x8000C05C
 Y.CREATE.L   ADIE_TEST_CONTROL                                           0x8000C05C
 Y.CREATE.L   HWIO_TXDAC_TEST_CONTROL_ADDR                                0x8000C060
 Y.CREATE.L   TXDAC_TEST_CONTROL                                          0x8000C060
 Y.CREATE.L   HWIO_HW_REVISION_NUMBER_ADDR                                0x8000C064
 Y.CREATE.L   HW_REVISION_NUMBER                                          0x8000C064
 Y.CREATE.L   HWIO_CHIP_FEATURE_ID_ADDR                                   0x8000C068
 Y.CREATE.L   CHIP_FEATURE_ID                                             0x8000C068
 Y.CREATE.L   HWIO_USB_GPIO_TEST_ADDR                                     0x8000C130
 Y.CREATE.L   USB_GPIO_TEST                                               0x8000C130
 Y.CREATE.L   HWIO_SSBI_GPIO_TEST_ADDR                                    0x8000C134
 Y.CREATE.L   SSBI_GPIO_TEST                                              0x8000C134
 Y.CREATE.L   HWIO_USB_PIN_CONFIG_ADDR                                    0x8000C07C
 Y.CREATE.L   USB_PIN_CONFIG                                              0x8000C07C
 Y.CREATE.L   HWIO_USB_PIN_SEL_ADDR                                       0x8000C080
 Y.CREATE.L   USB_PIN_SEL                                                 0x8000C080
 Y.CREATE.L   HWIO_TEST_BUS_EN_ADDR                                       0x8000C084
 Y.CREATE.L   TEST_BUS_EN                                                 0x8000C084
 Y.CREATE.L   HWIO_PMBLK_CONFIG_ADDR                                      0x8000C088
 Y.CREATE.L   PMBLK_CONFIG                                                0x8000C088
 Y.CREATE.L   HWIO_PMBLK_CNT0_ADDR                                        0x8000C08C
 Y.CREATE.L   PMBLK_CNT0                                                  0x8000C08C
 Y.CREATE.L   HWIO_PMBLK_CNT1_ADDR                                        0x8000C090
 Y.CREATE.L   PMBLK_CNT1                                                  0x8000C090
 Y.CREATE.L   HWIO_PMBLK_CNT2_ADDR                                        0x8000C094
 Y.CREATE.L   PMBLK_CNT2                                                  0x8000C094
 Y.CREATE.L   HWIO_PMBLK_CNT3_ADDR                                        0x8000C098
 Y.CREATE.L   PMBLK_CNT3                                                  0x8000C098
 Y.CREATE.L   HWIO_PMBLK_CNT4_ADDR                                        0x8000C09C
 Y.CREATE.L   PMBLK_CNT4                                                  0x8000C09C
 Y.CREATE.L   HWIO_TIME_TICK_CTL_ADDR                                     0x8000E0A4
 Y.CREATE.L   TIME_TICK_CTL                                               0x8000E0A4
 Y.CREATE.L   HWIO_TIME_TICK_INT_MSB_ADDR                                 0x8000E0A8
 Y.CREATE.L   TIME_TICK_INT_MSB                                           0x8000E0A8
 Y.CREATE.L   HWIO_TCXO_PDM_CTL_ADDR                                      0x80030040
 Y.CREATE.L   TCXO_PDM_CTL                                                0x80030040
 Y.CREATE.L   HWIO_PDM0_CTL_ADDR                                          0x80030044
 Y.CREATE.L   PDM0_CTL                                                    0x80030044
 Y.CREATE.L   HWIO_PDM1_CTL_ADDR                                          0x80030048
 Y.CREATE.L   PDM1_CTL                                                    0x80030048
 Y.CREATE.L   HWIO_GP_MN_CLK_MDIV_ADDR                                    0x8003004C
 Y.CREATE.L   GP_MN_CLK_MDIV                                              0x8003004C
 Y.CREATE.L   HWIO_GP_MN_CLK_NDIV_ADDR                                    0x80030050
 Y.CREATE.L   GP_MN_CLK_NDIV                                              0x80030050
 Y.CREATE.L   HWIO_GP_MN_CLK_DUTY_ADDR                                    0x80030054
 Y.CREATE.L   GP_MN_CLK_DUTY                                              0x80030054
 Y.CREATE.L   HWIO_WEB_TCXO4_TEST_ADDR                                    0x80030058
 Y.CREATE.L   WEB_TCXO4_TEST                                              0x80030058
 Y.CREATE.L   HWIO_I2C_WRITE_DATA_ADDR                                    0x80030000
 Y.CREATE.L   I2C_WRITE_DATA                                              0x80030000
 Y.CREATE.L   HWIO_I2C_CLK_CTL_ADDR                                       0x80030004
 Y.CREATE.L   I2C_CLK_CTL                                                 0x80030004
 Y.CREATE.L   HWIO_I2C_STATUS_ADDR                                        0x80030008
 Y.CREATE.L   I2C_STATUS                                                  0x80030008
 Y.CREATE.L   HWIO_I2C_READ_DATA_ADDR                                     0x8003000C
 Y.CREATE.L   I2C_READ_DATA                                               0x8003000C
 Y.CREATE.L   HWIO_I2C_INTERFACE_SELECT_ADDR                              0x80030010
 Y.CREATE.L   I2C_INTERFACE_SELECT                                        0x80030010
 Y.CREATE.L   HWIO_MCI_POWER_ADDR                                         0x80010000
 Y.CREATE.L   MCI_POWER                                                   0x80010000
 Y.CREATE.L   HWIO_MCI_CLK_ADDR                                           0x80010004
 Y.CREATE.L   MCI_CLK                                                     0x80010004
 Y.CREATE.L   HWIO_MCI_ARGUMENT_ADDR                                      0x80010008
 Y.CREATE.L   MCI_ARGUMENT                                                0x80010008
 Y.CREATE.L   HWIO_MCI_CMD_ADDR                                           0x8001000C
 Y.CREATE.L   MCI_CMD                                                     0x8001000C
 Y.CREATE.L   HWIO_MCI_RESP_CMD_ADDR                                      0x80010010
 Y.CREATE.L   MCI_RESP_CMD                                                0x80010010
 Y.CREATE.L   HWIO_MCI_RESP0_ADDR                                         0x80010014
 Y.CREATE.L   MCI_RESP0                                                   0x80010014
 Y.CREATE.L   HWIO_MCI_RESP1_ADDR                                         0x80010018
 Y.CREATE.L   MCI_RESP1                                                   0x80010018
 Y.CREATE.L   HWIO_MCI_RESP2_ADDR                                         0x8001001C
 Y.CREATE.L   MCI_RESP2                                                   0x8001001C
 Y.CREATE.L   HWIO_MCI_RESP3_ADDR                                         0x80010020
 Y.CREATE.L   MCI_RESP3                                                   0x80010020
 Y.CREATE.L   HWIO_MCI_DATA_TIMER_ADDR                                    0x80010024
 Y.CREATE.L   MCI_DATA_TIMER                                              0x80010024
 Y.CREATE.L   HWIO_MCI_DATA_LENGTH_ADDR                                   0x80010028
 Y.CREATE.L   MCI_DATA_LENGTH                                             0x80010028
 Y.CREATE.L   HWIO_MCI_DATA_CTL_ADDR                                      0x8001002C
 Y.CREATE.L   MCI_DATA_CTL                                                0x8001002C
 Y.CREATE.L   HWIO_MCI_DATA_COUNT_ADDR                                    0x80010030
 Y.CREATE.L   MCI_DATA_COUNT                                              0x80010030
 Y.CREATE.L   HWIO_MCI_STATUS_ADDR                                        0x80010034
 Y.CREATE.L   MCI_STATUS                                                  0x80010034
 Y.CREATE.L   HWIO_MCI_CLEAR_ADDR                                         0x80010038
 Y.CREATE.L   MCI_CLEAR                                                   0x80010038
 Y.CREATE.L   HWIO_MCI_INT_MASK0_ADDR                                     0x8001003C
 Y.CREATE.L   MCI_INT_MASK0                                               0x8001003C
 Y.CREATE.L   HWIO_MCI_INT_MASK1_ADDR                                     0x80010040
 Y.CREATE.L   MCI_INT_MASK1                                               0x80010040
 Y.CREATE.L   HWIO_MCI_FIFO_COUNT_ADDR                                    0x80010044
 Y.CREATE.L   MCI_FIFO_COUNT                                              0x80010044
 Y.CREATE.L   HWIO_MCI_FIFO_ADDR                                          0x80010080
 Y.CREATE.L   MCI_FIFO                                                    0x80010080
 Y.CREATE.L   HWIO_MCI_ABORT_ADDR                                         0x800100C0
 Y.CREATE.L   MCI_ABORT                                                   0x800100C0
 Y.CREATE.L   HWIO_MCI_START_ADDR_ADDR                                    0x800100C4
 Y.CREATE.L   MCI_START_ADDR                                              0x800100C4
 Y.CREATE.L   HWIO_MCI_DMA_CONFIG_ADDR                                    0x800100C8
 Y.CREATE.L   MCI_DMA_CONFIG                                              0x800100C8
 Y.CREATE.L   HWIO_MCI_TESTBUS_CONFIG_ADDR                                0x800100CC
 Y.CREATE.L   MCI_TESTBUS_CONFIG                                          0x800100CC
 Y.CREATE.L   HWIO_MCI_TEST_CTL_ADDR                                      0x800100D0
 Y.CREATE.L   MCI_TEST_CTL                                                0x800100D0
 Y.CREATE.L   HWIO_MCI_TEST_INPUT_ADDR                                    0x800100D4
 Y.CREATE.L   MCI_TEST_INPUT                                              0x800100D4
 Y.CREATE.L   HWIO_MCI_TEST_OUT_ADDR                                      0x800100D8
 Y.CREATE.L   MCI_TEST_OUT                                                0x800100D8
 Y.CREATE.L   HWIO_MCI_PERPH_ID0_ADDR                                     0x800100E0
 Y.CREATE.L   MCI_PERPH_ID0                                               0x800100E0
 Y.CREATE.L   HWIO_MCI_PERPH_ID1_ADDR                                     0x800100E4
 Y.CREATE.L   MCI_PERPH_ID1                                               0x800100E4
 Y.CREATE.L   HWIO_MCI_PERPH_ID2_ADDR                                     0x800100E8
 Y.CREATE.L   MCI_PERPH_ID2                                               0x800100E8
 Y.CREATE.L   HWIO_MCI_PERPH_ID3_ADDR                                     0x800100EC
 Y.CREATE.L   MCI_PERPH_ID3                                               0x800100EC
 Y.CREATE.L   HWIO_MCI_PCELL_ID0_ADDR                                     0x800100F0
 Y.CREATE.L   MCI_PCELL_ID0                                               0x800100F0
 Y.CREATE.L   HWIO_MCI_PCELL_ID1_ADDR                                     0x800100F4
 Y.CREATE.L   MCI_PCELL_ID1                                               0x800100F4
 Y.CREATE.L   HWIO_MCI_PCELL_ID2_ADDR                                     0x800100F8
 Y.CREATE.L   MCI_PCELL_ID2                                               0x800100F8
 Y.CREATE.L   HWIO_MCI_PCELL_ID3_ADDR                                     0x800100FC
 Y.CREATE.L   MCI_PCELL_ID3                                               0x800100FC
 Y.CREATE.L   HWIO_USB_OTG_HS_ID_ADDR                                     0x80016000
 Y.CREATE.L   USB_OTG_HS_ID                                               0x80016000
 Y.CREATE.L   HWIO_USB_OTG_HS_HWGENERAL_ADDR                              0x80016004
 Y.CREATE.L   USB_OTG_HS_HWGENERAL                                        0x80016004
 Y.CREATE.L   HWIO_USB_OTG_HS_HWHOST_ADDR                                 0x80016008
 Y.CREATE.L   USB_OTG_HS_HWHOST                                           0x80016008
 Y.CREATE.L   HWIO_USB_OTG_HS_HWDEVICE_ADDR                               0x8001600C
 Y.CREATE.L   USB_OTG_HS_HWDEVICE                                         0x8001600C
 Y.CREATE.L   HWIO_USB_OTG_HS_HWTXBUF_ADDR                                0x80016010
 Y.CREATE.L   USB_OTG_HS_HWTXBUF                                          0x80016010
 Y.CREATE.L   HWIO_USB_OTG_HS_HWRXBUF_ADDR                                0x80016014
 Y.CREATE.L   USB_OTG_HS_HWRXBUF                                          0x80016014
 Y.CREATE.L   HWIO_USB_OTG_HS_GPTIMER0LD_ADDR                             0x80016080
 Y.CREATE.L   USB_OTG_HS_GPTIMER0LD                                       0x80016080
 Y.CREATE.L   HWIO_USB_OTG_HS_GPTIMER0CTRL_ADDR                           0x80016084
 Y.CREATE.L   USB_OTG_HS_GPTIMER0CTRL                                     0x80016084
 Y.CREATE.L   HWIO_USB_OTG_HS_GPTIMER1LD_ADDR                             0x80016088
 Y.CREATE.L   USB_OTG_HS_GPTIMER1LD                                       0x80016088
 Y.CREATE.L   HWIO_USB_OTG_HS_GPTIMER1CTRL_ADDR                           0x8001608C
 Y.CREATE.L   USB_OTG_HS_GPTIMER1CTRL                                     0x8001608C
 Y.CREATE.L   HWIO_USB_OTG_HS_AHB_BURST_ADDR                              0x80016090
 Y.CREATE.L   USB_OTG_HS_AHB_BURST                                        0x80016090
 Y.CREATE.L   HWIO_USB_OTG_HS_XTOR_STS_ADDR                               0x80016094
 Y.CREATE.L   USB_OTG_HS_XTOR_STS                                         0x80016094
 Y.CREATE.L   HWIO_USB_OTG_HS_AHB_MODE_ADDR                               0x80016098
 Y.CREATE.L   USB_OTG_HS_AHB_MODE                                         0x80016098
 Y.CREATE.L   HWIO_USB_OTG_HS_GEN_CONFIG_ADDR                             0x8001609C
 Y.CREATE.L   USB_OTG_HS_GEN_CONFIG                                       0x8001609C
 Y.CREATE.L   HWIO_USB_OTG_HS_CAPLENGTH_ADDR                              0x80016100
 Y.CREATE.L   USB_OTG_HS_CAPLENGTH                                        0x80016100
 Y.CREATE.L   HWIO_USB_OTG_HS_HCIVERSION_ADDR                             0x80016102
 Y.CREATE.L   USB_OTG_HS_HCIVERSION                                       0x80016102
 Y.CREATE.L   HWIO_USB_OTG_HS_HCSPARAMS_ADDR                              0x80016104
 Y.CREATE.L   USB_OTG_HS_HCSPARAMS                                        0x80016104
 Y.CREATE.L   HWIO_USB_OTG_HS_HCCPARAMS_ADDR                              0x80016108
 Y.CREATE.L   USB_OTG_HS_HCCPARAMS                                        0x80016108
 Y.CREATE.L   HWIO_USB_OTG_HS_DCIVERSION_ADDR                             0x80016120
 Y.CREATE.L   USB_OTG_HS_DCIVERSION                                       0x80016120
 Y.CREATE.L   HWIO_USB_OTG_HS_DCCPARAMS_ADDR                              0x80016124
 Y.CREATE.L   USB_OTG_HS_DCCPARAMS                                        0x80016124
 Y.CREATE.L   HWIO_USB_OTG_HS_USBCMD_ADDR                                 0x80016140
 Y.CREATE.L   USB_OTG_HS_USBCMD                                           0x80016140
 Y.CREATE.L   HWIO_USB_OTG_HS_USBSTS_ADDR                                 0x80016144
 Y.CREATE.L   USB_OTG_HS_USBSTS                                           0x80016144
 Y.CREATE.L   HWIO_USB_OTG_HS_USBINTR_ADDR                                0x80016148
 Y.CREATE.L   USB_OTG_HS_USBINTR                                          0x80016148
 Y.CREATE.L   HWIO_USB_OTG_HS_FRINDEX_ADDR                                0x8001614C
 Y.CREATE.L   USB_OTG_HS_FRINDEX                                          0x8001614C
 Y.CREATE.L   HWIO_USB_OTG_HS_PERIODICLISTBASE_ADDR                       0x80016154
 Y.CREATE.L   USB_OTG_HS_PERIODICLISTBASE                                 0x80016154
 Y.CREATE.L   HWIO_USB_OTG_HS_DEVICEADDR_ADDR                             0x80016154
 Y.CREATE.L   USB_OTG_HS_DEVICEADDR                                       0x80016154
 Y.CREATE.L   HWIO_USB_OTG_HS_ASYNCLISTADDR_ADDR                          0x80016158
 Y.CREATE.L   USB_OTG_HS_ASYNCLISTADDR                                    0x80016158
 Y.CREATE.L   HWIO_USB_OTG_HS_ENDPOINTLISTADDR_ADDR                       0x80016158
 Y.CREATE.L   USB_OTG_HS_ENDPOINTLISTADDR                                 0x80016158
 Y.CREATE.L   HWIO_USB_OTG_HS_TTCTRL_ADDR                                 0x8001615C
 Y.CREATE.L   USB_OTG_HS_TTCTRL                                           0x8001615C
 Y.CREATE.L   HWIO_USB_OTG_HS_BURSTSIZE_ADDR                              0x80016160
 Y.CREATE.L   USB_OTG_HS_BURSTSIZE                                        0x80016160
 Y.CREATE.L   HWIO_USB_OTG_HS_TXFILLTUNING_ADDR                           0x80016164
 Y.CREATE.L   USB_OTG_HS_TXFILLTUNING                                     0x80016164
 Y.CREATE.L   HWIO_USB_OTG_HS_ULPI_VIEWPORT_ADDR                          0x80016170
 Y.CREATE.L   USB_OTG_HS_ULPI_VIEWPORT                                    0x80016170
 Y.CREATE.L   HWIO_USB_OTG_HS_ENDPTNAK_ADDR                               0x80016178
 Y.CREATE.L   USB_OTG_HS_ENDPTNAK                                         0x80016178
 Y.CREATE.L   HWIO_USB_OTG_HS_ENDPTNAKEN_ADDR                             0x8001617C
 Y.CREATE.L   USB_OTG_HS_ENDPTNAKEN                                       0x8001617C
 Y.CREATE.L   HWIO_USB_OTG_HS_PORTSC_ADDR                                 0x80016184
 Y.CREATE.L   USB_OTG_HS_PORTSC                                           0x80016184
 Y.CREATE.L   HWIO_USB_OTG_HS_OTGSC_ADDR                                  0x800161A4
 Y.CREATE.L   USB_OTG_HS_OTGSC                                            0x800161A4
 Y.CREATE.L   HWIO_USB_OTG_HS_USBMODE_ADDR                                0x800161A8
 Y.CREATE.L   USB_OTG_HS_USBMODE                                          0x800161A8
 Y.CREATE.L   HWIO_USB_OTG_HS_ENPDTSETUPSTAT_ADDR                         0x800161AC
 Y.CREATE.L   USB_OTG_HS_ENPDTSETUPSTAT                                   0x800161AC
 Y.CREATE.L   HWIO_USB_OTG_HS_ENDPTPRIME_ADDR                             0x800161B0
 Y.CREATE.L   USB_OTG_HS_ENDPTPRIME                                       0x800161B0
 Y.CREATE.L   HWIO_USB_OTG_HS_ENDPTFLUSH_ADDR                             0x800161B4
 Y.CREATE.L   USB_OTG_HS_ENDPTFLUSH                                       0x800161B4
 Y.CREATE.L   HWIO_USB_OTG_HS_ENDPTSTAT_ADDR                              0x800161B8
 Y.CREATE.L   USB_OTG_HS_ENDPTSTAT                                        0x800161B8
 Y.CREATE.L   HWIO_USB_OTG_HS_ENDPTCOMPLETE_ADDR                          0x800161BC
 Y.CREATE.L   USB_OTG_HS_ENDPTCOMPLETE                                    0x800161BC
 Y.CREATE.L   HWIO_USB_OTG_HS_ENDPTCTRL0_ADDR                             0x800161C0
 Y.CREATE.L   USB_OTG_HS_ENDPTCTRL0                                       0x800161C0
 Y.CREATE.L   HWIO_USB_OTG_HS_ENDPTCTRL1_ADDR                             0x800161C4
 Y.CREATE.L   USB_OTG_HS_ENDPTCTRL1                                       0x800161C4
 Y.CREATE.L   HWIO_USB_OTG_HS_ENDPTCTRL2_ADDR                             0x800161C8
 Y.CREATE.L   USB_OTG_HS_ENDPTCTRL2                                       0x800161C8
 Y.CREATE.L   HWIO_USB_OTG_HS_ENDPTCTRL3_ADDR                             0x800161CC
 Y.CREATE.L   USB_OTG_HS_ENDPTCTRL3                                       0x800161CC
 Y.CREATE.L   HWIO_USB_OTG_HS_ENDPTCTRL4_ADDR                             0x800161D0
 Y.CREATE.L   USB_OTG_HS_ENDPTCTRL4                                       0x800161D0
 Y.CREATE.L   HWIO_USB_OTG_HS_ENDPTCTRL5_ADDR                             0x800161D4
 Y.CREATE.L   USB_OTG_HS_ENDPTCTRL5                                       0x800161D4
 Y.CREATE.L   HWIO_USB_OTG_HS_ENDPTCTRL6_ADDR                             0x800161D8
 Y.CREATE.L   USB_OTG_HS_ENDPTCTRL6                                       0x800161D8
 Y.CREATE.L   HWIO_USB_OTG_HS_ENDPTCTRL7_ADDR                             0x800161DC
 Y.CREATE.L   USB_OTG_HS_ENDPTCTRL7                                       0x800161DC
 Y.CREATE.L   HWIO_USB_OTG_HS_ENDPTCTRL8_ADDR                             0x800161E0
 Y.CREATE.L   USB_OTG_HS_ENDPTCTRL8                                       0x800161E0
 Y.CREATE.L   HWIO_USB_OTG_HS_ENDPTCTRL9_ADDR                             0x800161E4
 Y.CREATE.L   USB_OTG_HS_ENDPTCTRL9                                       0x800161E4
 Y.CREATE.L   HWIO_USB_OTG_HS_ENDPTCTRL10_ADDR                            0x800161E8
 Y.CREATE.L   USB_OTG_HS_ENDPTCTRL10                                      0x800161E8
 Y.CREATE.L   HWIO_USB_OTG_HS_ENDPTCTRL11_ADDR                            0x800161EC
 Y.CREATE.L   USB_OTG_HS_ENDPTCTRL11                                      0x800161EC
 Y.CREATE.L   HWIO_USB_OTG_HS_ENDPTCTRL12_ADDR                            0x800161F0
 Y.CREATE.L   USB_OTG_HS_ENDPTCTRL12                                      0x800161F0
 Y.CREATE.L   HWIO_USB_OTG_HS_ENDPTCTRL13_ADDR                            0x800161F4
 Y.CREATE.L   USB_OTG_HS_ENDPTCTRL13                                      0x800161F4
 Y.CREATE.L   HWIO_USB_OTG_HS_ENDPTCTRL14_ADDR                            0x800161F8
 Y.CREATE.L   USB_OTG_HS_ENDPTCTRL14                                      0x800161F8
 Y.CREATE.L   HWIO_USB_OTG_HS_ENDPTCTRL15_ADDR                            0x800161FC
 Y.CREATE.L   USB_OTG_HS_ENDPTCTRL15                                      0x800161FC
 Y.CREATE.L   HWIO_SSBI_WRAPPER_SSBI_CTL_ADDR                             0x80018000
 Y.CREATE.L   SSBI_WRAPPER_SSBI_CTL                                       0x80018000
 Y.CREATE.L   HWIO_SSBI_WRAPPER_SSBI_RESET_ADDR                           0x80018004
 Y.CREATE.L   SSBI_WRAPPER_SSBI_RESET                                     0x80018004
 Y.CREATE.L   HWIO_SSBI_WRAPPER_SSBI_CMD_ADDR                             0x80018008
 Y.CREATE.L   SSBI_WRAPPER_SSBI_CMD                                       0x80018008
 Y.CREATE.L   HWIO_SSBI_WRAPPER_SSBI_BYPASS_ADDR                          0x8001800C
 Y.CREATE.L   SSBI_WRAPPER_SSBI_BYPASS                                    0x8001800C
 Y.CREATE.L   HWIO_SSBI_WRAPPER_SSBI_RD_ADDR                              0x80018010
 Y.CREATE.L   SSBI_WRAPPER_SSBI_RD                                        0x80018010
 Y.CREATE.L   HWIO_SSBI_WRAPPER_SSBI_STATUS_ADDR                          0x80018014
 Y.CREATE.L   SSBI_WRAPPER_SSBI_STATUS                                    0x80018014
 Y.CREATE.L   HWIO_SSBI_WRAPPER_SSBI_PRIORITIES_ADDR                      0x80018018
 Y.CREATE.L   SSBI_WRAPPER_SSBI_PRIORITIES                                0x80018018
 Y.CREATE.L   HWIO_SSBI_WRAPPER_SSBI_INTR_MASK_ADDR                       0x80018028
 Y.CREATE.L   SSBI_WRAPPER_SSBI_INTR_MASK                                 0x80018028
 Y.CREATE.L   HWIO_SSBI_WRAPPER_SSBI_INTR_CLEAR_ADDR                      0x8001802C
 Y.CREATE.L   SSBI_WRAPPER_SSBI_INTR_CLEAR                                0x8001802C
 Y.CREATE.L   HWIO_SSBI_WRAPPER_SSBI_INTR_STATUS_ADDR                     0x80018030
 Y.CREATE.L   SSBI_WRAPPER_SSBI_INTR_STATUS                               0x80018030
 Y.CREATE.L   HWIO_MDP_TEST_MODE_ADDR                                     0x8001E000
 Y.CREATE.L   MDP_TEST_MODE                                               0x8001E000
 Y.CREATE.L   HWIO_MDP_COMMAND_ADDR                                       0x8001E004
 Y.CREATE.L   MDP_COMMAND                                                 0x8001E004
 Y.CREATE.L   HWIO_MDP_SCRIPT_ADDR_ADDR                                   0x8001E008
 Y.CREATE.L   MDP_SCRIPT_ADDR                                             0x8001E008
 Y.CREATE.L   HWIO_MDP_CGC_CONFIG_ADDR                                    0x8001E00C
 Y.CREATE.L   MDP_CGC_CONFIG                                              0x8001E00C
 Y.CREATE.L   HWIO_MDP_SYNC_CONFIG_ADDR                                   0x8001E010
 Y.CREATE.L   MDP_SYNC_CONFIG                                             0x8001E010
 Y.CREATE.L   HWIO_MDP_SYNC_STATUS_ADDR                                   0x8001E014
 Y.CREATE.L   MDP_SYNC_STATUS                                             0x8001E014
 Y.CREATE.L   HWIO_MDP_SST_REFRESH_COUNT_ADDR                             0x8001E018
 Y.CREATE.L   MDP_SST_REFRESH_COUNT                                       0x8001E018
 Y.CREATE.L   HWIO_MDP_SCRIPT_STATUS_ADDR                                 0x8001E01C
 Y.CREATE.L   MDP_SCRIPT_STATUS                                           0x8001E01C
 Y.CREATE.L   HWIO_MDP_INTR_ENABLE_ADDR                                   0x8001E020
 Y.CREATE.L   MDP_INTR_ENABLE                                             0x8001E020
 Y.CREATE.L   HWIO_MDP_INTR_STATUS_ADDR                                   0x8001E024
 Y.CREATE.L   MDP_INTR_STATUS                                             0x8001E024
 Y.CREATE.L   HWIO_MDP_INTR_CLEAR_ADDR                                    0x8001E028
 Y.CREATE.L   MDP_INTR_CLEAR                                              0x8001E028
 Y.CREATE.L   HWIO_MDP_TEST_MISR_RESET_ADDR                               0x8001E02C
 Y.CREATE.L   MDP_TEST_MISR_RESET                                         0x8001E02C
 Y.CREATE.L   HWIO_MDP_TEST_EXPORT_MISR_ADDR                              0x8001E030
 Y.CREATE.L   MDP_TEST_EXPORT_MISR                                        0x8001E030
 Y.CREATE.L   HWIO_MDP_TEST_MISR_CURR_VAL_ADDR                            0x8001E034
 Y.CREATE.L   MDP_TEST_MISR_CURR_VAL                                      0x8001E034
 Y.CREATE.L   HWIO_MDP_INIT_SST_RD_PTR_ADDR                               0x8001E038
 Y.CREATE.L   MDP_INIT_SST_RD_PTR                                         0x8001E038
 Y.CREATE.L   HWIO_MDP_ADDRESS_14_ADDR                                    0x8001E038
 Y.CREATE.L   MDP_ADDRESS_14                                              0x8001E038
 Y.CREATE.L   HWIO_MDP_MAX_SST_RD_PTR_ADDR                                0x8001E03C
 Y.CREATE.L   MDP_MAX_SST_RD_PTR                                          0x8001E03C
 Y.CREATE.L   HWIO_MDP_ADDRESS_15_ADDR                                    0x8001E03C
 Y.CREATE.L   MDP_ADDRESS_15                                              0x8001E03C
 Y.CREATE.L   HWIO_MDP_DEBUG_BUS_VALUE_ADDR                               0x8001E040
 Y.CREATE.L   MDP_DEBUG_BUS_VALUE                                         0x8001E040
 Y.CREATE.L   HWIO_QMEMBIST_CLK_ENA_ADDR                                  0x80020000
 Y.CREATE.L   QMEMBIST_CLK_ENA                                            0x80020000
 Y.CREATE.L   HWIO_QMEMBIST_IO_CFG_ADDR                                   0x80020004
 Y.CREATE.L   QMEMBIST_IO_CFG                                             0x80020004
 Y.CREATE.L   HWIO_QMEMBIST_RESET_ADDR                                    0x80020008
 Y.CREATE.L   QMEMBIST_RESET                                              0x80020008
 Y.CREATE.L   HWIO_QMEMBIST_FA_SEQUENCER_SEL_ADDR                         0x8002000C
 Y.CREATE.L   QMEMBIST_FA_SEQUENCER_SEL                                   0x8002000C
 Y.CREATE.L   HWIO_QMEMBIST_EMBEDDED_ALG_CFG_ADDR                         0x80020010
 Y.CREATE.L   QMEMBIST_EMBEDDED_ALG_CFG                                   0x80020010
 Y.CREATE.L   HWIO_QMEMBIST_USR_CMD_DESTINATION_ADDR                      0x80020014
 Y.CREATE.L   QMEMBIST_USR_CMD_DESTINATION                                0x80020014
 Y.CREATE.L   HWIO_QMEMBIST_USR_CMD_CFG_ADDR                              0x80020018
 Y.CREATE.L   QMEMBIST_USR_CMD_CFG                                        0x80020018
 Y.CREATE.L   HWIO_QMEMBIST_TEST_TRIGGER_ADDR                             0x8002001C
 Y.CREATE.L   QMEMBIST_TEST_TRIGGER                                       0x8002001C
 Y.CREATE.L   HWIO_QMEMBIST_TEST_STATUS_ADDR                              0x80020020
 Y.CREATE.L   QMEMBIST_TEST_STATUS                                        0x80020020
 Y.CREATE.L   HWIO_QMEMBIST_TESTED0_ADDR                                  0x80020024
 Y.CREATE.L   QMEMBIST_TESTED0                                            0x80020024
 Y.CREATE.L   HWIO_QMEMBIST_TESTED1_ADDR                                  0x80020028
 Y.CREATE.L   QMEMBIST_TESTED1                                            0x80020028
 Y.CREATE.L   HWIO_QMEMBIST_TESTED2_ADDR                                  0x8002002C
 Y.CREATE.L   QMEMBIST_TESTED2                                            0x8002002C
 Y.CREATE.L   HWIO_QMEMBIST_TESTED3_ADDR                                  0x80020030
 Y.CREATE.L   QMEMBIST_TESTED3                                            0x80020030
 Y.CREATE.L   HWIO_QMEMBIST_FAILED0_ADDR                                  0x80020034
 Y.CREATE.L   QMEMBIST_FAILED0                                            0x80020034
 Y.CREATE.L   HWIO_QMEMBIST_FAILED1_ADDR                                  0x80020038
 Y.CREATE.L   QMEMBIST_FAILED1                                            0x80020038
 Y.CREATE.L   HWIO_QMEMBIST_FAILED2_ADDR                                  0x8002003C
 Y.CREATE.L   QMEMBIST_FAILED2                                            0x8002003C
 Y.CREATE.L   HWIO_QMEMBIST_FAILED3_ADDR                                  0x80020040
 Y.CREATE.L   QMEMBIST_FAILED3                                            0x80020040
 Y.CREATE.L   HWIO_QMEMBIST_RAM_FAIL_MAP_ADDR                             0x80020044
 Y.CREATE.L   QMEMBIST_RAM_FAIL_MAP                                       0x80020044
 Y.CREATE.L   HWIO_QMEMBIST_CLKOFF0_ADDR                                  0x80020048
 Y.CREATE.L   QMEMBIST_CLKOFF0                                            0x80020048
 Y.CREATE.L   HWIO_QMEMBIST_CLKOFF1_ADDR                                  0x8002004C
 Y.CREATE.L   QMEMBIST_CLKOFF1                                            0x8002004C
 Y.CREATE.L   HWIO_QMEMBIST_CLKOFF2_ADDR                                  0x80020050
 Y.CREATE.L   QMEMBIST_CLKOFF2                                            0x80020050
 Y.CREATE.L   HWIO_QMEMBIST_CLKOFF3_ADDR                                  0x80020054
 Y.CREATE.L   QMEMBIST_CLKOFF3                                            0x80020054
 Y.CREATE.L   HWIO_CHIP_ARM9_TEST_MEM_ADDR_ADDR                           0x80024000
 Y.CREATE.L   CHIP_ARM9_TEST_MEM_ADDR                                     0x80024000
 Y.CREATE.L   HWIO_CHIP_ARM9_TEST_MEM_WRITE_ADDR                          0x80024004
 Y.CREATE.L   CHIP_ARM9_TEST_MEM_WRITE                                    0x80024004
 Y.CREATE.L   HWIO_CHIP_ARM9_TEST_MEM_SEL_ADDR                            0x80024008
 Y.CREATE.L   CHIP_ARM9_TEST_MEM_SEL                                      0x80024008
 Y.CREATE.L   HWIO_CHIP_ARM9_TEST_MEM_READ0_ADDR                          0x8002400C
 Y.CREATE.L   CHIP_ARM9_TEST_MEM_READ0                                    0x8002400C
 Y.CREATE.L   HWIO_CHIP_ARM9_TEST_MEM_WRITE_NON_INCR_ADDR                 0x80024010
 Y.CREATE.L   CHIP_ARM9_TEST_MEM_WRITE_NON_INCR                           0x80024010
 Y.CREATE.L   HWIO_CHIP_ARM9_TEST_MEM_READ0_NON_INCR_ADDR                 0x80024014
 Y.CREATE.L   CHIP_ARM9_TEST_MEM_READ0_NON_INCR                           0x80024014
 Y.CREATE.L   HWIO_ARM9_11_MEM_ACC_CTRL_ADDR                              0x80024018
 Y.CREATE.L   ARM9_11_MEM_ACC_CTRL                                        0x80024018
 Y.CREATE.L   HWIO_SYS_MPU_ENABLE_ADDR                                    0x8002C000
 Y.CREATE.L   SYS_MPU_ENABLE                                              0x8002C000
 Y.CREATE.L   HWIO_SYS_MPU_ERR_STATS_ADDR                                 0x8002C004
 Y.CREATE.L   SYS_MPU_ERR_STATS                                           0x8002C004
 Y.CREATE.L   HWIO_SYS_MPU_DEF_PART_PERM0_ADDR                            0x8002C008
 Y.CREATE.L   SYS_MPU_DEF_PART_PERM0                                      0x8002C008
 Y.CREATE.L   HWIO_SYS_MPU_PART_START_ADDR0_ADDR                          0x8002C020
 Y.CREATE.L   SYS_MPU_PART_START_ADDR0                                    0x8002C020
 Y.CREATE.L   HWIO_SYS_MPU_PART_START_ADDR1_ADDR                          0x8002C040
 Y.CREATE.L   SYS_MPU_PART_START_ADDR1                                    0x8002C040
 Y.CREATE.L   HWIO_SYS_MPU_PART_START_ADDR2_ADDR                          0x8002C060
 Y.CREATE.L   SYS_MPU_PART_START_ADDR2                                    0x8002C060
 Y.CREATE.L   HWIO_SYS_MPU_PART_START_ADDR3_ADDR                          0x8002C080
 Y.CREATE.L   SYS_MPU_PART_START_ADDR3                                    0x8002C080
 Y.CREATE.L   HWIO_SYS_MPU_PART_END_ADDR0_ADDR                            0x8002C024
 Y.CREATE.L   SYS_MPU_PART_END_ADDR0                                      0x8002C024
 Y.CREATE.L   HWIO_SYS_MPU_PART_END_ADDR1_ADDR                            0x8002C044
 Y.CREATE.L   SYS_MPU_PART_END_ADDR1                                      0x8002C044
 Y.CREATE.L   HWIO_SYS_MPU_PART_END_ADDR2_ADDR                            0x8002C064
 Y.CREATE.L   SYS_MPU_PART_END_ADDR2                                      0x8002C064
 Y.CREATE.L   HWIO_SYS_MPU_PART_END_ADDR3_ADDR                            0x8002C084
 Y.CREATE.L   SYS_MPU_PART_END_ADDR3                                      0x8002C084
 Y.CREATE.L   HWIO_SYS_MPU_PART_PERM00_ADDR                               0x8002C028
 Y.CREATE.L   SYS_MPU_PART_PERM00                                         0x8002C028
 Y.CREATE.L   HWIO_SYS_MPU_PART_PERM01_ADDR                               0x8002C048
 Y.CREATE.L   SYS_MPU_PART_PERM01                                         0x8002C048
 Y.CREATE.L   HWIO_SYS_MPU_PART_PERM02_ADDR                               0x8002C068
 Y.CREATE.L   SYS_MPU_PART_PERM02                                         0x8002C068
 Y.CREATE.L   HWIO_SYS_MPU_PART_PERM03_ADDR                               0x8002C088
 Y.CREATE.L   SYS_MPU_PART_PERM03                                         0x8002C088
 Y.CREATE.L   HWIO_APP_MPU_ENABLE_ADDR                                    0x8002E000
 Y.CREATE.L   APP_MPU_ENABLE                                              0x8002E000
 Y.CREATE.L   HWIO_APP_MPU_ERR_STATS_ADDR                                 0x8002E004
 Y.CREATE.L   APP_MPU_ERR_STATS                                           0x8002E004
 Y.CREATE.L   HWIO_APP_MPU_DEF_PART_PERM0_ADDR                            0x8002E008
 Y.CREATE.L   APP_MPU_DEF_PART_PERM0                                      0x8002E008
 Y.CREATE.L   HWIO_APP_MPU_PART_START_ADDR0_ADDR                          0x8002E020
 Y.CREATE.L   APP_MPU_PART_START_ADDR0                                    0x8002E020
 Y.CREATE.L   HWIO_APP_MPU_PART_START_ADDR1_ADDR                          0x8002E040
 Y.CREATE.L   APP_MPU_PART_START_ADDR1                                    0x8002E040
 Y.CREATE.L   HWIO_APP_MPU_PART_START_ADDR2_ADDR                          0x8002E060
 Y.CREATE.L   APP_MPU_PART_START_ADDR2                                    0x8002E060
 Y.CREATE.L   HWIO_APP_MPU_PART_START_ADDR3_ADDR                          0x8002E080
 Y.CREATE.L   APP_MPU_PART_START_ADDR3                                    0x8002E080
 Y.CREATE.L   HWIO_APP_MPU_PART_END_ADDR0_ADDR                            0x8002E024
 Y.CREATE.L   APP_MPU_PART_END_ADDR0                                      0x8002E024
 Y.CREATE.L   HWIO_APP_MPU_PART_END_ADDR1_ADDR                            0x8002E044
 Y.CREATE.L   APP_MPU_PART_END_ADDR1                                      0x8002E044
 Y.CREATE.L   HWIO_APP_MPU_PART_END_ADDR2_ADDR                            0x8002E064
 Y.CREATE.L   APP_MPU_PART_END_ADDR2                                      0x8002E064
 Y.CREATE.L   HWIO_APP_MPU_PART_END_ADDR3_ADDR                            0x8002E084
 Y.CREATE.L   APP_MPU_PART_END_ADDR3                                      0x8002E084
 Y.CREATE.L   HWIO_APP_MPU_PART_PERM00_ADDR                               0x8002E028
 Y.CREATE.L   APP_MPU_PART_PERM00                                         0x8002E028
 Y.CREATE.L   HWIO_APP_MPU_PART_PERM01_ADDR                               0x8002E048
 Y.CREATE.L   APP_MPU_PART_PERM01                                         0x8002E048
 Y.CREATE.L   HWIO_APP_MPU_PART_PERM02_ADDR                               0x8002E068
 Y.CREATE.L   APP_MPU_PART_PERM02                                         0x8002E068
 Y.CREATE.L   HWIO_APP_MPU_PART_PERM03_ADDR                               0x8002E088
 Y.CREATE.L   APP_MPU_PART_PERM03                                         0x8002E088
 Y.CREATE.L   HWIO_SLEEP_XTAL_TIMER_0_COUNT_ADDR                          0x80034000
 Y.CREATE.L   SLEEP_XTAL_TIMER_0_COUNT                                    0x80034000
 Y.CREATE.L   HWIO_SLEEP_XTAL_TIMER_1_COUNT_ADDR                          0x80034004
 Y.CREATE.L   SLEEP_XTAL_TIMER_1_COUNT                                    0x80034004
 Y.CREATE.L   HWIO_SLEEP_XTAL_TIMETICK_COUNT_ADDR                         0x80034008
 Y.CREATE.L   SLEEP_XTAL_TIMETICK_COUNT                                   0x80034008
 Y.CREATE.L   HWIO_WDOG_RESET_ADDR                                        0x8003400C
 Y.CREATE.L   WDOG_RESET                                                  0x8003400C
 Y.CREATE.L   HWIO_AUTOKICK_START_ADDR                                    0x80034010
 Y.CREATE.L   AUTOKICK_START                                              0x80034010
 Y.CREATE.L   HWIO_WDOG_UNMASKED_INT_EN_ADDR                              0x80034014
 Y.CREATE.L   WDOG_UNMASKED_INT_EN                                        0x80034014
 Y.CREATE.L   HWIO_WDOG_STATUS_ADDR                                       0x80034018
 Y.CREATE.L   WDOG_STATUS                                                 0x80034018
 Y.CREATE.L   HWIO_SLEEP_XTAL_TIMER_0_ENABLE_ADDR                         0x800340B0
 Y.CREATE.L   SLEEP_XTAL_TIMER_0_ENABLE                                   0x800340B0
 Y.CREATE.L   HWIO_SLEEP_XTAL_TIMER_1_ENABLE_ADDR                         0x800340B4
 Y.CREATE.L   SLEEP_XTAL_TIMER_1_ENABLE                                   0x800340B4
 Y.CREATE.L   HWIO_SLEEP_XTAL_TIMER_0_MATCH_VAL_ADDR                      0x800340B8
 Y.CREATE.L   SLEEP_XTAL_TIMER_0_MATCH_VAL                                0x800340B8
 Y.CREATE.L   HWIO_SLEEP_XTAL_TIMER_1_MATCH_VAL_ADDR                      0x800340BC
 Y.CREATE.L   SLEEP_XTAL_TIMER_1_MATCH_VAL                                0x800340BC
 Y.CREATE.L   HWIO_SLEEP_XTAL_TIMETICK_MATCH_VAL_STATUS_ADDR              0x800340C0
 Y.CREATE.L   SLEEP_XTAL_TIMETICK_MATCH_VAL_STATUS                        0x800340C0
 Y.CREATE.L   HWIO_SLEEP_XTAL_TIMETICK_MATCH_VAL_ADDR                     0x800340C4
 Y.CREATE.L   SLEEP_XTAL_TIMETICK_MATCH_VAL                               0x800340C4
 Y.CREATE.L   HWIO_WDOG_EXPIRED_WIDTH_ADDR                                0x800340C8
 Y.CREATE.L   WDOG_EXPIRED_WIDTH                                          0x800340C8
 Y.CREATE.L   HWIO_WDOG_TEST_LOAD_STATUS_ADDR                             0x800340CC
 Y.CREATE.L   WDOG_TEST_LOAD_STATUS                                       0x800340CC
 Y.CREATE.L   HWIO_WDOG_TEST_LOAD_ADDR                                    0x800340D0
 Y.CREATE.L   WDOG_TEST_LOAD                                              0x800340D0
 Y.CREATE.L   HWIO_WDOG_TEST_ADDR                                         0x800340D4
 Y.CREATE.L   WDOG_TEST                                                   0x800340D4
 Y.CREATE.L   HWIO_EF_CHAIN_SEL_ADDR                                      0x80036000
 Y.CREATE.L   EF_CHAIN_SEL                                                0x80036000
 Y.CREATE.L   HWIO_EF_BLOW_TIMER_ADDR                                     0x80036004
 Y.CREATE.L   EF_BLOW_TIMER                                               0x80036004
 Y.CREATE.L   HWIO_EF_BLOW_VALUE_ADDR                                     0x80036008
 Y.CREATE.L   EF_BLOW_VALUE                                               0x80036008
 Y.CREATE.L   HWIO_EF_SHIFT_VALUE_ADDR                                    0x8003600C
 Y.CREATE.L   EF_SHIFT_VALUE                                              0x8003600C
 Y.CREATE.L   HWIO_EF_STATUS_ADDR                                         0x80036010
 Y.CREATE.L   EF_STATUS                                                   0x80036010
 Y.CREATE.L   HWIO_EF_PWR_CTL_ADDR                                        0x80036014
 Y.CREATE.L   EF_PWR_CTL                                                  0x80036014
 Y.CREATE.L   HWIO_EF_CONFIG_LSB_ADDR                                     0x80036018
 Y.CREATE.L   EF_CONFIG_LSB                                               0x80036018
 Y.CREATE.L   HWIO_EF_CONFIG_MSB_ADDR                                     0x8003601C
 Y.CREATE.L   EF_CONFIG_MSB                                               0x8003601C
 Y.CREATE.L   HWIO_ENABLE_ARM9_JTAG_ADDR                                  0x80036020
 Y.CREATE.L   ENABLE_ARM9_JTAG                                            0x80036020
 Y.CREATE.L   HWIO_RF_CAL_PART1_ADDR                                      0x91C00024
 Y.CREATE.L   RF_CAL_PART1                                                0x91C00024
 Y.CREATE.L   HWIO_RF_CAL_PART2_ADDR                                      0x91C00028
 Y.CREATE.L   RF_CAL_PART2                                                0x91C00028
 Y.CREATE.L   HWIO_RF_CAL_PART3_ADDR                                      0x91C00020
 Y.CREATE.L   RF_CAL_PART3                                                0x91C00020
 Y.CREATE.L   HWIO_GPIO2_OE_0_ADDR                                        0x84022000
 Y.CREATE.L   GPIO2_OE_0                                                  0x84022000
 Y.CREATE.L   HWIO_GPIO2_OE_1_ADDR                                        0x84022004
 Y.CREATE.L   GPIO2_OE_1                                                  0x84022004
 Y.CREATE.L   HWIO_GPIO2_OUT_0_ADDR                                       0x84022008
 Y.CREATE.L   GPIO2_OUT_0                                                 0x84022008
 Y.CREATE.L   HWIO_GPIO2_OUT_1_ADDR                                       0x8402200C
 Y.CREATE.L   GPIO2_OUT_1                                                 0x8402200C
 Y.CREATE.L   HWIO_GPIO2_PAGE_ADDR                                        0x84022010
 Y.CREATE.L   GPIO2_PAGE                                                  0x84022010
 Y.CREATE.L   HWIO_GPIO2_CFG_ADDR                                         0x84022014
 Y.CREATE.L   GPIO2_CFG                                                   0x84022014
 Y.CREATE.L   HWIO_GPIO2_IN_0_ADDR                                        0x84022018
 Y.CREATE.L   GPIO2_IN_0                                                  0x84022018
 Y.CREATE.L   HWIO_GPIO2_IN_1_ADDR                                        0x8402201C
 Y.CREATE.L   GPIO2_IN_1                                                  0x8402201C
 Y.CREATE.L   HWIO_MSM_INT_CLEAR_ADDR                                     0x84006174
 Y.CREATE.L   MSM_INT_CLEAR                                               0x84006174
 Y.CREATE.L   HWIO_MSM_INT_EN_ADDR                                        0x84006178
 Y.CREATE.L   MSM_INT_EN                                                  0x84006178
 Y.CREATE.L   HWIO_MSM_INT_POLARITY_ADDR                                  0x8400617C
 Y.CREATE.L   MSM_INT_POLARITY                                            0x8400617C
 Y.CREATE.L   HWIO_MSM_DETECT_CTL_ADDR                                    0x84006180
 Y.CREATE.L   MSM_DETECT_CTL                                              0x84006180
 Y.CREATE.L   HWIO_MSM_INT_STATUS_ADDR                                    0x84006184
 Y.CREATE.L   MSM_INT_STATUS                                              0x84006184
 Y.CREATE.L   HWIO_MSM_KEYSENSE_GROUP_STATUS_ADDR                         0x84006188
 Y.CREATE.L   MSM_KEYSENSE_GROUP_STATUS                                   0x84006188
 Y.CREATE.L   HWIO_MSM_GPIO2_INT_CLEAR_ADDR                               0x84006194
 Y.CREATE.L   MSM_GPIO2_INT_CLEAR                                         0x84006194
 Y.CREATE.L   HWIO_MSM_GPIO2_INT_EN_ADDR                                  0x840061A8
 Y.CREATE.L   MSM_GPIO2_INT_EN                                            0x840061A8
 Y.CREATE.L   HWIO_MSM_GPIO2_INT_POLARITY_ADDR                            0x840061BC
 Y.CREATE.L   MSM_GPIO2_INT_POLARITY                                      0x840061BC
 Y.CREATE.L   HWIO_MSM_GPIO2_DETECT_CTL_ADDR                              0x840061D0
 Y.CREATE.L   MSM_GPIO2_DETECT_CTL                                        0x840061D0
 Y.CREATE.L   HWIO_MSM_GPIO2_INT_STATUS_ADDR                              0x840061E4
 Y.CREATE.L   MSM_GPIO2_INT_STATUS                                        0x840061E4
 Y.CREATE.L   HWIO_UXMC_PSRAM_CRE_CFG_ADDR                                0x80004000
 Y.CREATE.L   UXMC_PSRAM_CRE_CFG                                          0x80004000
 Y.CREATE.L   HWIO_UXMC_CALIB_CFG_ADDR                                    0x80004004
 Y.CREATE.L   UXMC_CALIB_CFG                                              0x80004004
 Y.CREATE.L   HWIO_UXMC_CALIB_STATUS_ADDR                                 0x80004008
 Y.CREATE.L   UXMC_CALIB_STATUS                                           0x80004008
 Y.CREATE.L   HWIO_UXMC_CORE_ID_ADDR                                      0x8000400C
 Y.CREATE.L   UXMC_CORE_ID                                                0x8000400C
 Y.CREATE.L   HWIO_EBI1_CFG_ADDR                                          0x80026000
 Y.CREATE.L   EBI1_CFG                                                    0x80026000
 Y.CREATE.L   HWIO_EBI1_CS0_CFG0_ADDR                                     0x8002600C
 Y.CREATE.L   EBI1_CS0_CFG0                                               0x8002600C
 Y.CREATE.L   HWIO_EBI1_CS1_CFG0_ADDR                                     0x80026014
 Y.CREATE.L   EBI1_CS1_CFG0                                               0x80026014
 Y.CREATE.L   HWIO_EBI1_CS2_CFG0_ADDR                                     0x8002601C
 Y.CREATE.L   EBI1_CS2_CFG0                                               0x8002601C
 Y.CREATE.L   HWIO_EBI1_CS3_CFG0_ADDR                                     0x80026024
 Y.CREATE.L   EBI1_CS3_CFG0                                               0x80026024
 Y.CREATE.L   HWIO_EBI1_CS0_CFG1_ADDR                                     0x80026010
 Y.CREATE.L   EBI1_CS0_CFG1                                               0x80026010
 Y.CREATE.L   HWIO_EBI1_CS1_CFG1_ADDR                                     0x80026018
 Y.CREATE.L   EBI1_CS1_CFG1                                               0x80026018
 Y.CREATE.L   HWIO_EBI1_CS2_CFG1_ADDR                                     0x80026020
 Y.CREATE.L   EBI1_CS2_CFG1                                               0x80026020
 Y.CREATE.L   HWIO_EBI1_CS3_CFG1_ADDR                                     0x80026028
 Y.CREATE.L   EBI1_CS3_CFG1                                               0x80026028
 Y.CREATE.L   HWIO_EBI1_AHB_RD_PRIORITY_ADDR                              0x80026030
 Y.CREATE.L   EBI1_AHB_RD_PRIORITY                                        0x80026030
 Y.CREATE.L   HWIO_EBI1_AHB_WR_PRIORITY_ADDR                              0x80026034
 Y.CREATE.L   EBI1_AHB_WR_PRIORITY                                        0x80026034
 Y.CREATE.L   HWIO_EBI1_BUFC_CFG_ADDR                                     0x8002603C
 Y.CREATE.L   EBI1_BUFC_CFG                                               0x8002603C
 Y.CREATE.L   HWIO_EBI1_BUFC_STATUS_ADDR                                  0x80026040
 Y.CREATE.L   EBI1_BUFC_STATUS                                            0x80026040
 Y.CREATE.L   HWIO_EBI1_BUFC_PROF_COUNT_CFG_ADDR                          0x80026044
 Y.CREATE.L   EBI1_BUFC_PROF_COUNT_CFG                                    0x80026044
 Y.CREATE.L   HWIO_EBI1_PSRAM_REFRESH_CFG_ADDR                            0x8002604C
 Y.CREATE.L   EBI1_PSRAM_REFRESH_CFG                                      0x8002604C
 Y.CREATE.L   HWIO_EBI1_BUFC_PROF_COUNT0_ADDR                             0x80026054
 Y.CREATE.L   EBI1_BUFC_PROF_COUNT0                                       0x80026054
 Y.CREATE.L   HWIO_EBI1_BUFC_PROF_COUNT1_ADDR                             0x80026058
 Y.CREATE.L   EBI1_BUFC_PROF_COUNT1                                       0x80026058
 Y.CREATE.L   HWIO_EBI1_BUFC_PROF_COUNT2_ADDR                             0x8002605C
 Y.CREATE.L   EBI1_BUFC_PROF_COUNT2                                       0x8002605C
 Y.CREATE.L   HWIO_EBI1_DEBUG_BUS_CFG0_ADDR                               0x80026060
 Y.CREATE.L   EBI1_DEBUG_BUS_CFG0                                         0x80026060
 Y.CREATE.L   HWIO_EBI1_DEBUG_BUS_CFG1_ADDR                               0x80026064
 Y.CREATE.L   EBI1_DEBUG_BUS_CFG1                                         0x80026064
 Y.CREATE.L   HWIO_EBI1_DEBUG_WORD0_BUFC_ADDR                             0x80026070
 Y.CREATE.L   EBI1_DEBUG_WORD0_BUFC                                       0x80026070
 Y.CREATE.L   HWIO_EBI1_DEBUG_WORD1_BUFC_ADDR                             0x80026074
 Y.CREATE.L   EBI1_DEBUG_WORD1_BUFC                                       0x80026074
 Y.CREATE.L   HWIO_EBI1_DEBUG_WORD2_BUFC_ADDR                             0x80026078
 Y.CREATE.L   EBI1_DEBUG_WORD2_BUFC                                       0x80026078
 Y.CREATE.L   HWIO_EBI1_DEBUG_WORD3_BUFC_ADDR                             0x8002607C
 Y.CREATE.L   EBI1_DEBUG_WORD3_BUFC                                       0x8002607C
 Y.CREATE.L   HWIO_EBI1_DEBUG_WORD4_BUFC_ADDR                             0x80026080
 Y.CREATE.L   EBI1_DEBUG_WORD4_BUFC                                       0x80026080
 Y.CREATE.L   HWIO_EBI1_DEBUG_WORD5_BUFC_ADDR                             0x80026084
 Y.CREATE.L   EBI1_DEBUG_WORD5_BUFC                                       0x80026084
 Y.CREATE.L   HWIO_EBI1_DEBUG_WORD6_BUFC_ADDR                             0x80026088
 Y.CREATE.L   EBI1_DEBUG_WORD6_BUFC                                       0x80026088
 Y.CREATE.L   HWIO_EBI1_DEBUG_WORD7_BUFC_ADDR                             0x8002608C
 Y.CREATE.L   EBI1_DEBUG_WORD7_BUFC                                       0x8002608C
 Y.CREATE.L   HWIO_EBI1_DEBUG_WORD_EN0_BUFC_ADDR                          0x80026090
 Y.CREATE.L   EBI1_DEBUG_WORD_EN0_BUFC                                    0x80026090
 Y.CREATE.L   HWIO_EBI1_DEBUG_WORD_EN1_BUFC_ADDR                          0x80026094
 Y.CREATE.L   EBI1_DEBUG_WORD_EN1_BUFC                                    0x80026094
 Y.CREATE.L   HWIO_EBI1_DEBUG_WORD_EN2_BUFC_ADDR                          0x80026098
 Y.CREATE.L   EBI1_DEBUG_WORD_EN2_BUFC                                    0x80026098
 Y.CREATE.L   HWIO_EBI1_DEBUG_WORD_EN3_BUFC_ADDR                          0x8002609C
 Y.CREATE.L   EBI1_DEBUG_WORD_EN3_BUFC                                    0x8002609C
 Y.CREATE.L   HWIO_EBI1_DEBUG_WORD_EN4_BUFC_ADDR                          0x800260A0
 Y.CREATE.L   EBI1_DEBUG_WORD_EN4_BUFC                                    0x800260A0
 Y.CREATE.L   HWIO_EBI1_DEBUG_WORD_EN5_BUFC_ADDR                          0x800260A4
 Y.CREATE.L   EBI1_DEBUG_WORD_EN5_BUFC                                    0x800260A4
 Y.CREATE.L   HWIO_EBI1_DEBUG_WORD_EN6_BUFC_ADDR                          0x800260A8
 Y.CREATE.L   EBI1_DEBUG_WORD_EN6_BUFC                                    0x800260A8
 Y.CREATE.L   HWIO_EBI1_DEBUG_WORD_EN7_BUFC_ADDR                          0x800260AC
 Y.CREATE.L   EBI1_DEBUG_WORD_EN7_BUFC                                    0x800260AC
 Y.CREATE.L   HWIO_EBI1_DEBUG_BUFC_CFG_ADDR                               0x800260B0
 Y.CREATE.L   EBI1_DEBUG_BUFC_CFG                                         0x800260B0
 Y.CREATE.L   HWIO_EBI1_DEBUG_BUFC_TAG_RD0_ADDR                           0x800260BC
 Y.CREATE.L   EBI1_DEBUG_BUFC_TAG_RD0                                     0x800260BC
 Y.CREATE.L   HWIO_EBI1_DEBUG_BUFC_TAG_RD1_ADDR                           0x800260C0
 Y.CREATE.L   EBI1_DEBUG_BUFC_TAG_RD1                                     0x800260C0
 Y.CREATE.L   HWIO_EBI1_BUFC_PROFILING_CFG_ADDR                           0x800260C4
 Y.CREATE.L   EBI1_BUFC_PROFILING_CFG                                     0x800260C4
 Y.CREATE.L   HWIO_EBI1_CS0_CFG2_ADDR                                     0x800260D0
 Y.CREATE.L   EBI1_CS0_CFG2                                               0x800260D0
 Y.CREATE.L   HWIO_EBI1_CS1_CFG2_ADDR                                     0x800260D4
 Y.CREATE.L   EBI1_CS1_CFG2                                               0x800260D4
 Y.CREATE.L   HWIO_EBI1_CS2_CFG2_ADDR                                     0x800260D8
 Y.CREATE.L   EBI1_CS2_CFG2                                               0x800260D8
 Y.CREATE.L   HWIO_EBI1_CS3_CFG2_ADDR                                     0x800260DC
 Y.CREATE.L   EBI1_CS3_CFG2                                               0x800260DC
 Y.CREATE.L   HWIO_EBI1_LCD_CFG_ADDR                                      0x800260E0
 Y.CREATE.L   EBI1_LCD_CFG                                                0x800260E0
 Y.CREATE.L   HWIO_EBI1_2X_XLTR_CFG_ADDR                                  0x800260F0
 Y.CREATE.L   EBI1_2X_XLTR_CFG                                            0x800260F0
 Y.CREATE.L   HWIO_EBI2_CFG_ADDR                                          0x80028000
 Y.CREATE.L   EBI2_CFG                                                    0x80028000
 Y.CREATE.L   HWIO_LCD_CFG0_ADDR                                          0x80028004
 Y.CREATE.L   LCD_CFG0                                                    0x80028004
 Y.CREATE.L   HWIO_LCD_CFG1_ADDR                                          0x80028008
 Y.CREATE.L   LCD_CFG1                                                    0x80028008
 Y.CREATE.L   HWIO_EBI2_CS0_CFG0_ADDR                                     0x8002800C
 Y.CREATE.L   EBI2_CS0_CFG0                                               0x8002800C
 Y.CREATE.L   HWIO_EBI2_CS1_CFG0_ADDR                                     0x80028018
 Y.CREATE.L   EBI2_CS1_CFG0                                               0x80028018
 Y.CREATE.L   HWIO_EBI2_CS2_CFG0_ADDR                                     0x80028024
 Y.CREATE.L   EBI2_CS2_CFG0                                               0x80028024
 Y.CREATE.L   HWIO_EBI2_CS3_CFG0_ADDR                                     0x80028030
 Y.CREATE.L   EBI2_CS3_CFG0                                               0x80028030
 Y.CREATE.L   HWIO_EBI2_CS0_CFG1_ADDR                                     0x80028010
 Y.CREATE.L   EBI2_CS0_CFG1                                               0x80028010
 Y.CREATE.L   HWIO_EBI2_CS1_CFG1_ADDR                                     0x8002801C
 Y.CREATE.L   EBI2_CS1_CFG1                                               0x8002801C
 Y.CREATE.L   HWIO_EBI2_CS2_CFG1_ADDR                                     0x80028028
 Y.CREATE.L   EBI2_CS2_CFG1                                               0x80028028
 Y.CREATE.L   HWIO_EBI2_CS3_CFG1_ADDR                                     0x80028034
 Y.CREATE.L   EBI2_CS3_CFG1                                               0x80028034
 Y.CREATE.L   HWIO_EBI2_CS0_CFG2_ADDR                                     0x80028014
 Y.CREATE.L   EBI2_CS0_CFG2                                               0x80028014
 Y.CREATE.L   HWIO_EBI2_CS1_CFG2_ADDR                                     0x80028020
 Y.CREATE.L   EBI2_CS1_CFG2                                               0x80028020
 Y.CREATE.L   HWIO_EBI2_CS2_CFG2_ADDR                                     0x8002802C
 Y.CREATE.L   EBI2_CS2_CFG2                                               0x8002802C
 Y.CREATE.L   HWIO_EBI2_CS3_CFG2_ADDR                                     0x80028038
 Y.CREATE.L   EBI2_CS3_CFG2                                               0x80028038
 Y.CREATE.L   HWIO_ETM_GPIO2_CFG0_ADDR                                    0x8002804C
 Y.CREATE.L   ETM_GPIO2_CFG0                                              0x8002804C
 Y.CREATE.L   HWIO_ETM_GPIO2_CFG1_ADDR                                    0x80028050
 Y.CREATE.L   ETM_GPIO2_CFG1                                              0x80028050
 Y.CREATE.L   HWIO_EBI2_DEBUG_BUS_CFG_ADDR                                0x80028054
 Y.CREATE.L   EBI2_DEBUG_BUS_CFG                                          0x80028054
 Y.CREATE.L   HWIO_EBI2_PROFILING_CFG_ADDR                                0x80028058
 Y.CREATE.L   EBI2_PROFILING_CFG                                          0x80028058
 Y.CREATE.L   HWIO_EBI2_SWBM_AHB_PRIORITY_ADDR                            0x80028080
 Y.CREATE.L   EBI2_SWBM_AHB_PRIORITY                                      0x80028080
 Y.CREATE.L   HWIO_EBI2_SWBM_STATUS_ADDR                                  0x80028088
 Y.CREATE.L   EBI2_SWBM_STATUS                                            0x80028088
 Y.CREATE.L   HWIO_EBI2_SWBM_DEBUG_BUS_CFG_ADDR                           0x8002808C
 Y.CREATE.L   EBI2_SWBM_DEBUG_BUS_CFG                                     0x8002808C
 Y.CREATE.L   HWIO_EBI2_CBC_AHB_RD_PRIORITY_ADDR                          0x800280B0
 Y.CREATE.L   EBI2_CBC_AHB_RD_PRIORITY                                    0x800280B0
 Y.CREATE.L   HWIO_EBI2_CBC_AHB_WR_PRIORITY_ADDR                          0x800280B4
 Y.CREATE.L   EBI2_CBC_AHB_WR_PRIORITY                                    0x800280B4
 Y.CREATE.L   HWIO_EBI2_CBC_BUFC_CFG_ADDR                                 0x800280B8
 Y.CREATE.L   EBI2_CBC_BUFC_CFG                                           0x800280B8
 Y.CREATE.L   HWIO_EBI2_CBC_BUFC_STATUS_ADDR                              0x800280BC
 Y.CREATE.L   EBI2_CBC_BUFC_STATUS                                        0x800280BC
 Y.CREATE.L   HWIO_EBI2_CBC_PRF_CNT_CFG_ADDR                              0x800280C0
 Y.CREATE.L   EBI2_CBC_PRF_CNT_CFG                                        0x800280C0
 Y.CREATE.L   HWIO_EBI2_CBC_PRF_CNT0_ADDR                                 0x800280C4
 Y.CREATE.L   EBI2_CBC_PRF_CNT0                                           0x800280C4
 Y.CREATE.L   HWIO_EBI2_CBC_PRF_CNT1_ADDR                                 0x800280C8
 Y.CREATE.L   EBI2_CBC_PRF_CNT1                                           0x800280C8
 Y.CREATE.L   HWIO_EBI2_CBC_PRF_CNT2_ADDR                                 0x800280CC
 Y.CREATE.L   EBI2_CBC_PRF_CNT2                                           0x800280CC
 Y.CREATE.L   HWIO_EBI2_CBC_DEBUG_BUS_CFG0_ADDR                           0x800280D0
 Y.CREATE.L   EBI2_CBC_DEBUG_BUS_CFG0                                     0x800280D0
 Y.CREATE.L   HWIO_EBI2_CBC_DEBUG_WORD0_ADDR                              0x800280E0
 Y.CREATE.L   EBI2_CBC_DEBUG_WORD0                                        0x800280E0
 Y.CREATE.L   HWIO_EBI2_CBC_DEBUG_WORD1_ADDR                              0x800280E4
 Y.CREATE.L   EBI2_CBC_DEBUG_WORD1                                        0x800280E4
 Y.CREATE.L   HWIO_EBI2_CBC_DEBUG_WORD2_ADDR                              0x800280E8
 Y.CREATE.L   EBI2_CBC_DEBUG_WORD2                                        0x800280E8
 Y.CREATE.L   HWIO_EBI2_CBC_DEBUG_WORD3_ADDR                              0x800280EC
 Y.CREATE.L   EBI2_CBC_DEBUG_WORD3                                        0x800280EC
 Y.CREATE.L   HWIO_EBI2_CBC_DEBUG_WORD4_ADDR                              0x800280F0
 Y.CREATE.L   EBI2_CBC_DEBUG_WORD4                                        0x800280F0
 Y.CREATE.L   HWIO_EBI2_CBC_DEBUG_WORD5_ADDR                              0x800280F4
 Y.CREATE.L   EBI2_CBC_DEBUG_WORD5                                        0x800280F4
 Y.CREATE.L   HWIO_EBI2_CBC_DEBUG_WORD6_ADDR                              0x800280F8
 Y.CREATE.L   EBI2_CBC_DEBUG_WORD6                                        0x800280F8
 Y.CREATE.L   HWIO_EBI2_CBC_DEBUG_WORD7_ADDR                              0x800280FC
 Y.CREATE.L   EBI2_CBC_DEBUG_WORD7                                        0x800280FC
 Y.CREATE.L   HWIO_EBI2_CBC_DEBUG_WORD_EN0_ADDR                           0x80028100
 Y.CREATE.L   EBI2_CBC_DEBUG_WORD_EN0                                     0x80028100
 Y.CREATE.L   HWIO_EBI2_CBC_DEBUG_WORD_EN1_ADDR                           0x80028104
 Y.CREATE.L   EBI2_CBC_DEBUG_WORD_EN1                                     0x80028104
 Y.CREATE.L   HWIO_EBI2_CBC_DEBUG_WORD_EN2_ADDR                           0x80028108
 Y.CREATE.L   EBI2_CBC_DEBUG_WORD_EN2                                     0x80028108
 Y.CREATE.L   HWIO_EBI2_CBC_DEBUG_WORD_EN3_ADDR                           0x8002810C
 Y.CREATE.L   EBI2_CBC_DEBUG_WORD_EN3                                     0x8002810C
 Y.CREATE.L   HWIO_EBI2_CBC_DEBUG_WORD_EN4_ADDR                           0x80028110
 Y.CREATE.L   EBI2_CBC_DEBUG_WORD_EN4                                     0x80028110
 Y.CREATE.L   HWIO_EBI2_CBC_DEBUG_WORD_EN5_ADDR                           0x80028114
 Y.CREATE.L   EBI2_CBC_DEBUG_WORD_EN5                                     0x80028114
 Y.CREATE.L   HWIO_EBI2_CBC_DEBUG_WORD_EN6_ADDR                           0x80028118
 Y.CREATE.L   EBI2_CBC_DEBUG_WORD_EN6                                     0x80028118
 Y.CREATE.L   HWIO_EBI2_CBC_DEBUG_WORD_EN7_ADDR                           0x8002811C
 Y.CREATE.L   EBI2_CBC_DEBUG_WORD_EN7                                     0x8002811C
 Y.CREATE.L   HWIO_EBI2_CBC_DEBUG_CFG_ADDR                                0x80028120
 Y.CREATE.L   EBI2_CBC_DEBUG_CFG                                          0x80028120
 Y.CREATE.L   HWIO_EBI2_CBC_DEBUG_TAG_RD0_ADDR                            0x80028124
 Y.CREATE.L   EBI2_CBC_DEBUG_TAG_RD0                                      0x80028124
 Y.CREATE.L   HWIO_EBI2_CBC_DEBUG_TAG_RD1_ADDR                            0x80028128
 Y.CREATE.L   EBI2_CBC_DEBUG_TAG_RD1                                      0x80028128
 Y.CREATE.L   HWIO_EBI2_CBC_PRF_CFG_ADDR                                  0x8002812C
 Y.CREATE.L   EBI2_CBC_PRF_CFG                                            0x8002812C
 Y.CREATE.L   HWIO_UXMC_DEBUG_BUS_CTRL_ADDR                               0x8002A000
 Y.CREATE.L   UXMC_DEBUG_BUS_CTRL                                         0x8002A000
 Y.CREATE.L   HWIO_SDRAM_OPT_CFG_ADDR                                     0x80014000
 Y.CREATE.L   SDRAM_OPT_CFG                                               0x80014000
 Y.CREATE.L   HWIO_SDRAM_RFRSH_CFG_ADDR                                   0x80014010
 Y.CREATE.L   SDRAM_RFRSH_CFG                                             0x80014010
 Y.CREATE.L   HWIO_SDRAM_DEV_PARAM_CFG1_ADDR                              0x80014014
 Y.CREATE.L   SDRAM_DEV_PARAM_CFG1                                        0x80014014
 Y.CREATE.L   HWIO_SDRAM_DEV_PARAM_CFG2_ADDR                              0x80014018
 Y.CREATE.L   SDRAM_DEV_PARAM_CFG2                                        0x80014018
 Y.CREATE.L   HWIO_SDRAM_DEV_PARAM_CFG3_ADDR                              0x8001401C
 Y.CREATE.L   SDRAM_DEV_PARAM_CFG3                                        0x8001401C
 Y.CREATE.L   HWIO_SDRAM_CTRL_CFG_ADDR                                    0x80014020
 Y.CREATE.L   SDRAM_CTRL_CFG                                              0x80014020
 Y.CREATE.L   HWIO_SDRAM_DEV_INIT_CFG_ADDR                                0x80014024
 Y.CREATE.L   SDRAM_DEV_INIT_CFG                                          0x80014024
 Y.CREATE.L   HWIO_SDRAM_COL_ROW_SIZE_CFG_ADDR                            0x80014028
 Y.CREATE.L   SDRAM_COL_ROW_SIZE_CFG                                      0x80014028
 Y.CREATE.L   HWIO_SDRAM_HW_DEV_INIT_CFG_ADDR                             0x8001402C
 Y.CREATE.L   SDRAM_HW_DEV_INIT_CFG                                       0x8001402C
 Y.CREATE.L   HWIO_SDRAM_CDCM_CFG_ADDR                                    0x80014030
 Y.CREATE.L   SDRAM_CDCM_CFG                                              0x80014030
 Y.CREATE.L   HWIO_SDRAM_CDCM_INTERNAL1_ADDR                              0x80014034
 Y.CREATE.L   SDRAM_CDCM_INTERNAL1                                        0x80014034
 Y.CREATE.L   HWIO_SDRAM_CDC0_CFG_ADDR                                    0x80014038
 Y.CREATE.L   SDRAM_CDC0_CFG                                              0x80014038
 Y.CREATE.L   HWIO_SDRAM_CDC1_CFG_ADDR                                    0x8001403C
 Y.CREATE.L   SDRAM_CDC1_CFG                                              0x8001403C
 Y.CREATE.L   HWIO_SDRAM_CDCM_STATUS_ADDR                                 0x80014044
 Y.CREATE.L   SDRAM_CDCM_STATUS                                           0x80014044
 Y.CREATE.L   HWIO_SDRAM_CLOCK_VOLTAGE_SWITCH_CFG_ADDR                    0x80014048
 Y.CREATE.L   SDRAM_CLOCK_VOLTAGE_SWITCH_CFG                              0x80014048
 Y.CREATE.L   HWIO_SDRAM_CLK_PWR_DOWN_CFG_ADDR                            0x8001404C
 Y.CREATE.L   SDRAM_CLK_PWR_DOWN_CFG                                      0x8001404C
 Y.CREATE.L   HWIO_SDRAM_PERF_MON_CFG_ADDR                                0x80014050
 Y.CREATE.L   SDRAM_PERF_MON_CFG                                          0x80014050
 Y.CREATE.L   HWIO_SDRAM_PERF_CNTR0_CFG_ADDR                              0x80014054
 Y.CREATE.L   SDRAM_PERF_CNTR0_CFG                                        0x80014054
 Y.CREATE.L   HWIO_SDRAM_PERF_CNTR1_CFG_ADDR                              0x80014058
 Y.CREATE.L   SDRAM_PERF_CNTR1_CFG                                        0x80014058
 Y.CREATE.L   HWIO_SDRAM_PERF_CNTR2_CFG_ADDR                              0x8001405C
 Y.CREATE.L   SDRAM_PERF_CNTR2_CFG                                        0x8001405C
 Y.CREATE.L   HWIO_SDRAM_PERF_CNTR0_OUT_ADDR                              0x80014060
 Y.CREATE.L   SDRAM_PERF_CNTR0_OUT                                        0x80014060
 Y.CREATE.L   HWIO_SDRAM_PERF_CNTR1_OUT_ADDR                              0x80014064
 Y.CREATE.L   SDRAM_PERF_CNTR1_OUT                                        0x80014064
 Y.CREATE.L   HWIO_SDRAM_PERF_CNTR2_OUT_ADDR                              0x80014068
 Y.CREATE.L   SDRAM_PERF_CNTR2_OUT                                        0x80014068
 Y.CREATE.L   HWIO_SDRAM_PERF_CNTR_STATUS_ADDR                            0x8001406C
 Y.CREATE.L   SDRAM_PERF_CNTR_STATUS                                      0x8001406C
 Y.CREATE.L   HWIO_SDRAM_TEST_BUS_CFG_ADDR                                0x80014070
 Y.CREATE.L   SDRAM_TEST_BUS_CFG                                          0x80014070
 Y.CREATE.L   HWIO_SDRAM_MISR_CTRL_ADDR                                   0x80014074
 Y.CREATE.L   SDRAM_MISR_CTRL                                             0x80014074
 Y.CREATE.L   HWIO_SDRAM_MISR_OUT0_ADDR                                   0x80014078
 Y.CREATE.L   SDRAM_MISR_OUT0                                             0x80014078
 Y.CREATE.L   HWIO_SDRAM_MISR_OUT1_ADDR                                   0x8001407C
 Y.CREATE.L   SDRAM_MISR_OUT1                                             0x8001407C
 Y.CREATE.L   HWIO_SDRAM_FPGA_CONTROLLER_CFG1_ADDR                        0x80014080
 Y.CREATE.L   SDRAM_FPGA_CONTROLLER_CFG1                                  0x80014080
 Y.CREATE.L   HWIO_SDRAM_FPGA_CONTROLLER_CFG2_ADDR                        0x80014084
 Y.CREATE.L   SDRAM_FPGA_CONTROLLER_CFG2                                  0x80014084
 Y.CREATE.L   HWIO_SDRAM_FPGA_CONTROLLER_CFG3_ADDR                        0x80014088
 Y.CREATE.L   SDRAM_FPGA_CONTROLLER_CFG3                                  0x80014088
 Y.CREATE.L   HWIO_SDRAM_FPGA_CONTROLLER_CFG4_ADDR                        0x8001408C
 Y.CREATE.L   SDRAM_FPGA_CONTROLLER_CFG4                                  0x8001408C
 Y.CREATE.L   HWIO_SDRAM_FPGA_CONTROLLER_CFG5_ADDR                        0x80014090
 Y.CREATE.L   SDRAM_FPGA_CONTROLLER_CFG5                                  0x80014090
 Y.CREATE.L   HWIO_AUX_CODEC_CTL_ADDR                                     0x8001A000
 Y.CREATE.L   AUX_CODEC_CTL                                               0x8001A000
 Y.CREATE.L   HWIO_PCM_PATH_CTL_ADDR                                      0x8001A004
 Y.CREATE.L   PCM_PATH_CTL                                                0x8001A004
 Y.CREATE.L   HWIO_AUX_CODEC_CTL_OUT_ADDR                                 0x8001A008
 Y.CREATE.L   AUX_CODEC_CTL_OUT                                           0x8001A008
 Y.CREATE.L   HWIO_WB_CODEC_TEST_CTL_ADDR                                 0x8001A00C
 Y.CREATE.L   WB_CODEC_TEST_CTL                                           0x8001A00C
 Y.CREATE.L   HWIO_WB_CODEC_FIFO_WR_REG_ADDR                              0x8001A010
 Y.CREATE.L   WB_CODEC_FIFO_WR_REG                                        0x8001A010
 Y.CREATE.L   HWIO_WB_CODEC_FIFO_RD_REG_ADDR                              0x8001A014
 Y.CREATE.L   WB_CODEC_FIFO_RD_REG                                        0x8001A014
 Y.CREATE.L   HWIO_WB_MISSED_ACKS_CNT_ADDR                                0x8001A018
 Y.CREATE.L   WB_MISSED_ACKS_CNT                                          0x8001A018
 Y.CREATE.L   HWIO_WB_CODEC_CMD_REG_ADDR                                  0x8001A01C
 Y.CREATE.L   WB_CODEC_CMD_REG                                            0x8001A01C
 Y.CREATE.L   HWIO_WB_CODEC_SEL_ADSP_ADDR                                 0x8001A020
 Y.CREATE.L   WB_CODEC_SEL_ADSP                                           0x8001A020
 Y.CREATE.L   HWIO_BPM_CFG_ADDR                                           0x8001C000
 Y.CREATE.L   BPM_CFG                                                     0x8001C000
 Y.CREATE.L   HWIO_BPM_CMD_ADDR                                           0x8001C004
 Y.CREATE.L   BPM_CMD                                                     0x8001C004
 Y.CREATE.L   HWIO_BPM_MSTR_CFG_ADDR                                      0x8001C008
 Y.CREATE.L   BPM_MSTR_CFG                                                0x8001C008
 Y.CREATE.L   HWIO_BPM_TIMER_ADDR                                         0x8001C00C
 Y.CREATE.L   BPM_TIMER                                                   0x8001C00C
 Y.CREATE.L   HWIO_BPM_CYC_CFG_ADDR                                       0x8001C010
 Y.CREATE.L   BPM_CYC_CFG                                                 0x8001C010
 Y.CREATE.L   HWIO_BPM_CYC_OUT_ADDR                                       0x8001C014
 Y.CREATE.L   BPM_CYC_OUT                                                 0x8001C014
 Y.CREATE.L   HWIO_BPM_C0_CFG0_ADDR                                       0x8001C020
 Y.CREATE.L   BPM_C0_CFG0                                                 0x8001C020
 Y.CREATE.L   HWIO_BPM_C1_CFG0_ADDR                                       0x8001C040
 Y.CREATE.L   BPM_C1_CFG0                                                 0x8001C040
 Y.CREATE.L   HWIO_BPM_C2_CFG0_ADDR                                       0x8001C060
 Y.CREATE.L   BPM_C2_CFG0                                                 0x8001C060
 Y.CREATE.L   HWIO_BPM_C3_CFG0_ADDR                                       0x8001C080
 Y.CREATE.L   BPM_C3_CFG0                                                 0x8001C080
 Y.CREATE.L   HWIO_BPM_C0_CFG1_ADDR                                       0x8001C024
 Y.CREATE.L   BPM_C0_CFG1                                                 0x8001C024
 Y.CREATE.L   HWIO_BPM_C1_CFG1_ADDR                                       0x8001C044
 Y.CREATE.L   BPM_C1_CFG1                                                 0x8001C044
 Y.CREATE.L   HWIO_BPM_C2_CFG1_ADDR                                       0x8001C064
 Y.CREATE.L   BPM_C2_CFG1                                                 0x8001C064
 Y.CREATE.L   HWIO_BPM_C3_CFG1_ADDR                                       0x8001C084
 Y.CREATE.L   BPM_C3_CFG1                                                 0x8001C084
 Y.CREATE.L   HWIO_BPM_C0_CFG2_ADDR                                       0x8001C028
 Y.CREATE.L   BPM_C0_CFG2                                                 0x8001C028
 Y.CREATE.L   HWIO_BPM_C1_CFG2_ADDR                                       0x8001C048
 Y.CREATE.L   BPM_C1_CFG2                                                 0x8001C048
 Y.CREATE.L   HWIO_BPM_C2_CFG2_ADDR                                       0x8001C068
 Y.CREATE.L   BPM_C2_CFG2                                                 0x8001C068
 Y.CREATE.L   HWIO_BPM_C3_CFG2_ADDR                                       0x8001C088
 Y.CREATE.L   BPM_C3_CFG2                                                 0x8001C088
 Y.CREATE.L   HWIO_BPM_C0_CFG3_ADDR                                       0x8001C02C
 Y.CREATE.L   BPM_C0_CFG3                                                 0x8001C02C
 Y.CREATE.L   HWIO_BPM_C1_CFG3_ADDR                                       0x8001C04C
 Y.CREATE.L   BPM_C1_CFG3                                                 0x8001C04C
 Y.CREATE.L   HWIO_BPM_C2_CFG3_ADDR                                       0x8001C06C
 Y.CREATE.L   BPM_C2_CFG3                                                 0x8001C06C
 Y.CREATE.L   HWIO_BPM_C3_CFG3_ADDR                                       0x8001C08C
 Y.CREATE.L   BPM_C3_CFG3                                                 0x8001C08C
 Y.CREATE.L   HWIO_BPM_C0_CFG4_ADDR                                       0x8001C030
 Y.CREATE.L   BPM_C0_CFG4                                                 0x8001C030
 Y.CREATE.L   HWIO_BPM_C1_CFG4_ADDR                                       0x8001C050
 Y.CREATE.L   BPM_C1_CFG4                                                 0x8001C050
 Y.CREATE.L   HWIO_BPM_C2_CFG4_ADDR                                       0x8001C070
 Y.CREATE.L   BPM_C2_CFG4                                                 0x8001C070
 Y.CREATE.L   HWIO_BPM_C3_CFG4_ADDR                                       0x8001C090
 Y.CREATE.L   BPM_C3_CFG4                                                 0x8001C090
 Y.CREATE.L   HWIO_BPM_C0_CFG5_ADDR                                       0x8001C034
 Y.CREATE.L   BPM_C0_CFG5                                                 0x8001C034
 Y.CREATE.L   HWIO_BPM_C1_CFG5_ADDR                                       0x8001C054
 Y.CREATE.L   BPM_C1_CFG5                                                 0x8001C054
 Y.CREATE.L   HWIO_BPM_C2_CFG5_ADDR                                       0x8001C074
 Y.CREATE.L   BPM_C2_CFG5                                                 0x8001C074
 Y.CREATE.L   HWIO_BPM_C3_CFG5_ADDR                                       0x8001C094
 Y.CREATE.L   BPM_C3_CFG5                                                 0x8001C094
 Y.CREATE.L   HWIO_BPM_C0_CFG6_ADDR                                       0x8001C038
 Y.CREATE.L   BPM_C0_CFG6                                                 0x8001C038
 Y.CREATE.L   HWIO_BPM_C1_CFG6_ADDR                                       0x8001C058
 Y.CREATE.L   BPM_C1_CFG6                                                 0x8001C058
 Y.CREATE.L   HWIO_BPM_C2_CFG6_ADDR                                       0x8001C078
 Y.CREATE.L   BPM_C2_CFG6                                                 0x8001C078
 Y.CREATE.L   HWIO_BPM_C3_CFG6_ADDR                                       0x8001C098
 Y.CREATE.L   BPM_C3_CFG6                                                 0x8001C098
 Y.CREATE.L   HWIO_BPM_C0_OUT_ADDR                                        0x8001C03C
 Y.CREATE.L   BPM_C0_OUT                                                  0x8001C03C
 Y.CREATE.L   HWIO_BPM_C1_OUT_ADDR                                        0x8001C05C
 Y.CREATE.L   BPM_C1_OUT                                                  0x8001C05C
 Y.CREATE.L   HWIO_BPM_C2_OUT_ADDR                                        0x8001C07C
 Y.CREATE.L   BPM_C2_OUT                                                  0x8001C07C
 Y.CREATE.L   HWIO_BPM_C3_OUT_ADDR                                        0x8001C09C
 Y.CREATE.L   BPM_C3_OUT                                                  0x8001C09C
 Y.CREATE.L   HWIO_BPM_DBG_CFG_ADDR                                       0x8001C220
 Y.CREATE.L   BPM_DBG_CFG                                                 0x8001C220
 Y.CREATE.L   HWIO_IBI0_CFG_ADDR                                          0x80038000
 Y.CREATE.L   IBI0_CFG                                                    0x80038000
 Y.CREATE.L   HWIO_IBI1_CFG_ADDR                                          0x80038004
 Y.CREATE.L   IBI1_CFG                                                    0x80038004
 Y.CREATE.L   HWIO_IBI0_AHB_PRIORITY_ADDR                                 0x80038010
 Y.CREATE.L   IBI0_AHB_PRIORITY                                           0x80038010
 Y.CREATE.L   HWIO_IBI1_AHB_PRIORITY_ADDR                                 0x80038014
 Y.CREATE.L   IBI1_AHB_PRIORITY                                           0x80038014
 Y.CREATE.L   HWIO_IMEM0_CFG_ADDR                                         0x80038020
 Y.CREATE.L   IMEM0_CFG                                                   0x80038020
 Y.CREATE.L   HWIO_IMEM1_CFG_ADDR                                         0x80038024
 Y.CREATE.L   IMEM1_CFG                                                   0x80038024
 Y.CREATE.L   HWIO_IMEM2_CFG_ADDR                                         0x80038028
 Y.CREATE.L   IMEM2_CFG                                                   0x80038028
 Y.CREATE.L   HWIO_IMEM3_CFG_ADDR                                         0x8003802C
 Y.CREATE.L   IMEM3_CFG                                                   0x8003802C
 Y.CREATE.L   HWIO_IMEM_BASE_ADDR_EN_ADDR                                 0x80038040
 Y.CREATE.L   IMEM_BASE_ADDR_EN                                           0x80038040
 Y.CREATE.L   HWIO_IBI0_DEBUG_BUS_CFG_ADDR                                0x80038050
 Y.CREATE.L   IBI0_DEBUG_BUS_CFG                                          0x80038050
 Y.CREATE.L   HWIO_IBI1_DEBUG_BUS_CFG_ADDR                                0x80038054
 Y.CREATE.L   IBI1_DEBUG_BUS_CFG                                          0x80038054
 Y.CREATE.L   HWIO_IBI0_PROFILING_CFG_ADDR                                0x80038060
 Y.CREATE.L   IBI0_PROFILING_CFG                                          0x80038060
 Y.CREATE.L   HWIO_IBI1_PROFILING_CFG_ADDR                                0x80038064
 Y.CREATE.L   IBI1_PROFILING_CFG                                          0x80038064

 Y.CREATE.DONE

 ; y.spath + \\jetsam\vi_qsc1100\shared_code\ASIC\Release\cmm

 ENDDO

