;****************************************************************************
;**           jload.CMM                                                    **
;**           This script sets up for loading AMSS image to PSRAM for      **
;**           shadow mode.                                                 **
;**                                                                        **
;**           Now a day, you only need to configure the jumper on the      **
;**           memory card only. You don't need to configure the rotary     **
;**           switch or jumpers on the SURF as in Cougar any more.         **
;**                                                                        **
;**           Build ID between FFA and SURF are the same now               **
;**           And only SURF supports shadow mode                           **
;**                                                                        **
;**           Changes:                                                     **
;**           05-01-02   First version                                     **
;**           09-25-02   Cleanup                                           **
;**           11-05-05   Modify for QSC60x0                                **
;**           12-02-08   Modify for QSC11x0                                **
;**           03-04-08   Removed breakpoints.cmm                           **
;****************************************************************************

;This .cmm script acts as a main routine for setting up a QSC11x0 platform.
;
; detect if this script has already been run -- only do this for parts that
;  get called when the jtag reconnects with the target
;
;

GLOBAL &ELFdir
GLOBAL &ELFname

ENTRY &ELFname

GLOBAL &BUILDMSdir
GLOBAL &TEMPBREAKname

&BUILDMSdir=OS.PPD()
&TEMPBREAKname=OS.TMPFILE()+".cmm"

; Dialog box to obtain a filename if one not provided on the command line

IF "&ELFname"==""
(
 local &filename
 dialog.file *.elf
 entry &filename
 &ELFname=STRING.CUT("&filename",-4)
)

&ELFdir=OS.FILE.PATH("&ELFname")
&ELFname=OS.FILE.NAME("&ELFname")

; PRINT "ELF dir: &ELFdir"
; PRINT "ELF file name: &ELFname"

; reset config to blank

 System.Reset

 map.reset
 map.denyaccess 	0x00000000--0xffffffff ; DEFAULT TRACE32 NOTOUCH
 map.nodenyaccess	0x00000000--0x17ffffff ; EBI1
 map.nodenyaccess	0x20000000--0x27ffffff ; EBI2
 map.nodenyaccess	0x58000000--0x77ffffff ; ONCHIP
 map.nodenyaccess	0x80000000--0x87ffffff ; ONCHIP
 map.nodenyaccess	0x90000000--0xafffffff ; ONCHIP
 map.nodenyaccess	0xf0000000--0xf7ffffff ; ONCHIP
 map.nodenyaccess	0xffff0000--0xffffffff ; ONCHIP
 map.bonchip            0xffff0000--0xffffffff ; Force onchip breaks (ROM)

  PRINT " "
  PRINT "JLOAD &ELFname commenced "+CLOCK.DATE()+" at "+CLOCK.TIME()

;
; system options
;
;
  ; Turbo mode of debug state accesses - CPU makes checks of memory access in debug mode
  System.Option TURBO off

  ; Disable "Emulator berr error"
  System.Option ShowError OFF

  ; Disassembler selection - Automatically selects correct one.
  System.Option DisMode Auto

  ; select CPU and options
  SYSTEM.CPU ARM926EJ

  SYSTEM.OPTION BIGENDIAN OFF
  SYSTEM.OPTION ENRESET ON

  ; jtag clock is set for real in DetectTarget.cmm
  system.jtagclock 1000000. //hack in a safe value until detecttarget
  system.up
  system.jtagclock RTCK

;
;  Target specific setup information
;

;
;  Detect SURF or FFA, and only SURF can support SHADOW MODE
;  Read the daughter card ID, if ID is SURF, then continue,
;  if it is nothing then it is FFA, and end downloading if so
;
;local &FPGA_DaughterCardIDReg
;&FPGA_DaughterCardIDReg=0x20000044
;local &DaughterCardIDReg

;&DaughterCardIDReg=data.word(RD:&FPGA_DaughterCardIDReg);

;print "Daughter card ID: &DaughterCardIDReg"

;IF "&DaughterCardIDReg"=="0x0"
;(
;     print "ERROR:You can't load Shadow Build to FFA!!!"
;     enddo
;)

SYMBOL.RESET
DO &BUILDMSdir/../../core/systemdrivers/hw/src/hwio.cmm

;
;
; GPIOs, Memory controller if needed
;
DO &BUILDMSdir/qsc11x0_setupebi1.cmm

;
; Make sure that the memory card is configured to support SHADOW mode
;
(
 local &orig_data
 local &read_data

 &orig_data=data.long(RD:0x00000000)
 data.set 0x00000000 %long (~(&orig_data))
 &read_data=data.long(RD:0x00000000)
 data.set 0x00000000 %long &orig_data
 &orig_data=(~(&orig_data))&0xffffffff

 IF "&read_data"!="&orig_data"
 (
  print "Please configure memory card for Shadow mode, check its jumper"
  enddo
 )
)

;
;
; Setup environment defaults
;
  Symbol.AsmFrame on
;  Symbol.CutLine 3
  Symbol.Spath + ".."
  Symbol.case off

  setup.imaskasm on
  setup.imaskhll off

  setup.stepbreak on
  setup.urate 3.
  setup.var %hex %open %symbol %scaled %index %name %compact %tree %inherited

; resets registers
  register.reset

; reset breakpoints
  break.reset

; reset tronchip
  tronchip.reset
  IF ICD()
  (
   tronchip.set.dabort on
   tronchip.set.pabort on
   tronchip.set.undef on
   tronchip.set.reset on
   tronchip.convert off
  )

; Download and set initial breakpoints

 PRINT "Loading &ELFname.mbn target image "
 DATA.LOAD.BINARY &BUILDMSdir/bin/&ELFname/all.mbn /NOCLEAR /NOSYMBOL
 DATA.LOAD.ELF &BUILDMSdir/&ELFname.elf /NOCLEAR /NOCODE /INCLUDE
 PRINT "Completed JLOAD &ELFname ..."

; Add breakpoints now symbols have been loaded
;DO &BUILDMSdir/breakpoints.cmm

;  Setup Path for source code (y.spath env variable)
;
DO &BUILDMSdir/setupyspath.cmm

;
; Window Setup
;
WINCLEAR
DO &BUILDMSdir/setupWindows.cmm

;
; REX Extensions
;
MENU.RESET
DO &BUILDMSdir/qrex_awareness.cmm

;;;;;;;;;;;;;;;;;;;;;;;;;;;;;;;;
;;;;;;;;;;;;;;;;;;;;;;;;;;;;;;;;

;IF Y.EXIST(Reset_Handler)
;(
; REGISTER.SET PC Reset_Handler
;)

;IF (DATA.LONG(C15:0x0001)&0x00002000)!=0
;(
; PRINT "HIGH MEMORY VECTORS"
; REGISTER.SET PC 0xffff0000
;)

; MMU CONTROL REGISTER PROGRAMMING
;PER.SET C15:0x0001 ((DATA.LONG(C15:0x0001)&~0x00000001)|0x00001202)	; CP15:1 CR (-M+I+R+A)
;PER.SET C15:0x0002 0x08000000						; CP15:2 TTB

;if SIMULATOR()
;(
; PRINT "TRACE32:SIMULATOR"
;)

;if ICD()
;(
; PRINT "TRACE32:ICD"
;)

;;;;
;;;; EVENT HANDLERS
;;;;

; SYS UP HANDLER
ON SYSUP GOTO
(
 DO &BUILDMSdir/qsc11x0_setupebi1.cmm
 ;; DO &TEMPBREAKname
 PRINT "-HANDLER:SYSUP"
 STOP
)

; SYS DOWN HANDLER
ON SYSDOWN GOTO
(
 ;; STORE &TEMPBREAKname BREAK
 ;; BREAK.RESET
 PRINT "-HANDLER:SYSDOWN"
 STOP
)

; PROGRAM BREAK HANDLER
ON PBREAK GOTO
(
 PRINT "-HANDLER:PBREAK"
 if R(PC)==0xffff0000
 (
   PRINT "RESET BREAK detected, restoring EBI1"
   DO &BUILDMSdir/qsc11x0_setupebi1.cmm
 )
 STOP
)

; COMMAND HANDLER: QRESET
ON CMD QRESET GOTO
(
 ENTRY &ARG1
 SYSTEM.DOWN
 WAIT 1.
 SYSTEM.UP
 STOP
)

; COMMAND HANDLER: QUP
ON CMD QUP GOTO
(
 ENTRY &ARG1
 SYSTEM.UP
 STOP
)

; COMMAND HANDLER: QDN
ON CMD QDN GOTO
(
 ENTRY &ARG1
 SYSTEM.DOWN
 STOP
)

;ON CMD EDT GOTO
;(
; LOCAL &file &line &cmdline
; ENTRY &file
; IF "&file"==""
; (
;  &file=Y.SOURCEFILE(P:Register(pc))
;  &line=Y.SOURCELINE(P:Register(pc))
;  )
;  &cmdline="os uedit32.exe &file/"+STRING.CUT("&line",-1)
;  &cmdline
;  STOP
;)

;;;;
;;;; QSC1100 MENU
;;;;

MENU.REPROGRAM
(
 ADD
 MENU
 (
  POPUP "&QSC1100"
  (
   MENUITEM "Target Reset"
   (
    QRESET
   )
   MENUITEM "Target Down"
   (
    QDN
   )
   MENUITEM "Target Up"
   (
    QUP
   )
   MENUITEM "Save Breakpoints"
   (
    STORE &TEMPBREAKname BREAK
   )
   SEPARATOR
   MENUITEM "Load Symbols - xBL's"
   (
    DATA.LOAD.ELF &BUILDMSdir/../../core/boot/romboot/pbl/1.0/pbl.00.01.00.elf /noclear /nocode /include
    DATA.LOAD.ELF &BUILDMSdir/../../core/boot/romboot/dbl/dbl_&ELFname.elf /noclear /nocode /include
    DATA.LOAD.ELF &BUILDMSdir/../../core/boot/romboot/fsbl/fsbl_&ELFname.elf /noclear /nocode /include
    DATA.LOAD.ELF &BUILDMSdir/../../core/boot/romboot/osbl/osbl_&ELFname.elf /noclear /nocode /include
   )
   MENUITEM "Load Symbols - AMSS"
   (
    SYMBOL.RESET
    DO &BUILDMSdir/../../core/systemdrivers/hw/src/hwio.cmm
    DATA.LOAD.ELF &BUILDMSdir/&ELFname.elf /noclear /nocode /include
   )
  )
 )
)

;;;; DO NOT TERMINATE THE BATCHFILE EXECUTION STACK FOR
;;;; DEFINED HANDLERS TO BE EXECUTED. ENDDO WILL TERMINATE
;;;; THE EXECUTION OF THIS BATCHFILE.

STOP 		; RETURN TO COMMAND LINE
MENU.RESET	; RESTORE ORIGINAL MENU

PRINT "BATCHFILE TERMINATED"
ENDDO
