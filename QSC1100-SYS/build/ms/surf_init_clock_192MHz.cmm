;============================================================================
; qsc11x0_config_clock_192MHz.cmm
;
;     Clocks Initialization and Configuration for the following regimes:
;      PLL :    192 MHz 
;      ARM9:    96  MHz
;      AHB :    48  MHz
;      EBI1:    48  MHz
;      EBI1_IO: 96  MHz
;      EBI2:    24  MHz
;      EBI2_IO: 24  MHz
;      IMEM :   48  MHz
;      IMEM_IO  48  MHz
;
;     Changes:
;     02-12-08  First version
;     06-23-08  No need to setup clock
;============================================================================

print "Starting ebi setup..."

do "..\..\core\systemdrivers\hw\src\hwio.cmm"

do "..\..\build\ms\qsc11x0_setupEBI1.cmm"
