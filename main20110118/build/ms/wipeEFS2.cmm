;
;  WIPEEFS2.CMM
;  This script reinitializes the EFS2 flash area.
;
;  the .elf image should be loaded before running this script, but should
;  not have been started.   
;     For Shadow mode, execute "do jload SSxx" before this
;     For Burst mode, program the flash and then execute "d.load.elf SBxx.elf /nocode" first
;     For NAND mode, program the flash and then execute "d.load.elf SNxx.elf /nocode" first,
;                    then execute "do debugflashedsdram" to load the code image.  
;  Then run this script.
;
;  11-24-2001   drh     Copyright 2001 Qualcomm, Inc.
;
;
break.reset
break.set fs_super_init /onchip
break.set oemui_init_resources /onchip
go
PRINT "Waiting for breakpoint"
WAIT !run()
v fs_fresh_start=1

PRINT "Please restart phone once it boots"
go


ENDDO


